/*@!Encoding:1252*/
includes
{
  
}

variables
{
  
float signalvalue1;
  
}

testcase S4_SRR_RL_Clu_Mes_0_S4_SRR_RL_Clu_Theta_0()
{
	signalvalue1 = getSignal(S4_SRR_RL_Clu_Theta_0);
	write("S4_SRR_RL_Clu_Theta_0 :%f",signalvalue1);
	write("i_S4_SRR_RL_Clu_Theta_0 :%f",@ecu_Signals::i_S4_SRR_RL_Clu_Theta_0);

	testStep("get expect variable value: ","i_S4_SRR_RL_Clu_Theta_0 :%f",@ecu_Signals::i_S4_SRR_RL_Clu_Theta_0);

	if((abs(@ecu_Signals::i_S4_SRR_RL_Clu_Theta_0)*0.9<=abs(signalvalue1))&&(abs(signalvalue1)<=abs(@ecu_Signals::i_S4_SRR_RL_Clu_Theta_0)*1.1))
	{
	testStepPass("Pass","i_S4_SRR_RL_Clu_Theta_0 :%f",signalvalue1);
	}
	else
	{
	testStepFail("Fail","i_S4_SRR_RL_Clu_Theta_0 :%f",signalvalue1);
	}
}

testcase S4_SRR_RL_Clu_Mes_0_S4_SRR_RL_Clu_Dist_0()
{
	signalvalue1 = getSignal(S4_SRR_RL_Clu_Dist_0);
	write("S4_SRR_RL_Clu_Dist_0 :%f",signalvalue1);
	write("i_S4_SRR_RL_Clu_Dist_0 :%f",@ecu_Signals::i_S4_SRR_RL_Clu_Dist_0);

	testStep("get expect variable value: ","i_S4_SRR_RL_Clu_Dist_0 :%f",@ecu_Signals::i_S4_SRR_RL_Clu_Dist_0);

	if((abs(@ecu_Signals::i_S4_SRR_RL_Clu_Dist_0)*0.9<=abs(signalvalue1))&&(abs(signalvalue1)<=abs(@ecu_Signals::i_S4_SRR_RL_Clu_Dist_0)*1.1))
	{
	testStepPass("Pass","i_S4_SRR_RL_Clu_Dist_0 :%f",signalvalue1);
	}
	else
	{
	testStepFail("Fail","i_S4_SRR_RL_Clu_Dist_0 :%f",signalvalue1);
	}
}

testcase S4_SRR_RL_Clu_Mes_0_S4_SRR_RL_Clu_Vel_0()
{
	signalvalue1 = getSignal(S4_SRR_RL_Clu_Vel_0);
	write("S4_SRR_RL_Clu_Vel_0 :%f",signalvalue1);
	write("i_S4_SRR_RL_Clu_Vel_0 :%f",@ecu_Signals::i_S4_SRR_RL_Clu_Vel_0);

	testStep("get expect variable value: ","i_S4_SRR_RL_Clu_Vel_0 :%f",@ecu_Signals::i_S4_SRR_RL_Clu_Vel_0);

	if((abs(@ecu_Signals::i_S4_SRR_RL_Clu_Vel_0)*0.9<=abs(signalvalue1))&&(abs(signalvalue1)<=abs(@ecu_Signals::i_S4_SRR_RL_Clu_Vel_0)*1.1))
	{
	testStepPass("Pass","i_S4_SRR_RL_Clu_Vel_0 :%f",signalvalue1);
	}
	else
	{
	testStepFail("Fail","i_S4_SRR_RL_Clu_Vel_0 :%f",signalvalue1);
	}
}

testcase S4_SRR_RL_Clu_Mes_0_S4_SRR_RL_Clu_SNR_0()
{
	signalvalue1 = getSignal(S4_SRR_RL_Clu_SNR_0);
	write("S4_SRR_RL_Clu_SNR_0 :%f",signalvalue1);
	write("i_S4_SRR_RL_Clu_SNR_0 :%f",@ecu_Signals::i_S4_SRR_RL_Clu_SNR_0);

	testStep("get expect variable value: ","i_S4_SRR_RL_Clu_SNR_0 :%f",@ecu_Signals::i_S4_SRR_RL_Clu_SNR_0);

	if((abs(@ecu_Signals::i_S4_SRR_RL_Clu_SNR_0)*0.9<=abs(signalvalue1))&&(abs(signalvalue1)<=abs(@ecu_Signals::i_S4_SRR_RL_Clu_SNR_0)*1.1))
	{
	testStepPass("Pass","i_S4_SRR_RL_Clu_SNR_0 :%f",signalvalue1);
	}
	else
	{
	testStepFail("Fail","i_S4_SRR_RL_Clu_SNR_0 :%f",signalvalue1);
	}
}

testcase S4_SRR_RL_Clu_Mes_0_S4_SRR_RL_Clu_DynProp_0()
{
	signalvalue1 = getSignal(S4_SRR_RL_Clu_DynProp_0);
	write("S4_SRR_RL_Clu_DynProp_0 :%f",signalvalue1);
	write("i_S4_SRR_RL_Clu_DynProp_0 :%o",@ecu_Signals::i_S4_SRR_RL_Clu_DynProp_0);

	testStep("get expect variable value: ","i_S4_SRR_RL_Clu_DynProp_0 :%o",@ecu_Signals::i_S4_SRR_RL_Clu_DynProp_0);

	if(signalvalue1==@ecu_Signals::i_S4_SRR_RL_Clu_DynProp_0)
	{
	testStepPass("Pass","i_S4_SRR_RL_Clu_DynProp_0 :%f",signalvalue1);
	}
	else
	{
	testStepFail("Fail","i_S4_SRR_RL_Clu_DynProp_0 :%f",signalvalue1);
	}
}

testcase S4_SRR_RL_Clu_Mes_0_S4_SRR_RL_Clu_Locationvalid_0()
{
	signalvalue1 = getSignal(S4_SRR_RL_Clu_Locationvalid_0);
	write("S4_SRR_RL_Clu_Locationvalid_0 :%f",signalvalue1);
	write("i_S4_SRR_RL_Clu_Locationvalid_0 :%o",@ecu_Signals::i_S4_SRR_RL_Clu_Locationvalid_0);

	testStep("get expect variable value: ","i_S4_SRR_RL_Clu_Locationvalid_0 :%o",@ecu_Signals::i_S4_SRR_RL_Clu_Locationvalid_0);

	if(signalvalue1==@ecu_Signals::i_S4_SRR_RL_Clu_Locationvalid_0)
	{
	testStepPass("Pass","i_S4_SRR_RL_Clu_Locationvalid_0 :%f",signalvalue1);
	}
	else
	{
	testStepFail("Fail","i_S4_SRR_RL_Clu_Locationvalid_0 :%f",signalvalue1);
	}
}

testcase S4_SRR_RL_Clu_Mes_0_S4_SRR_RL_Clu_Timestamps()
{
	signalvalue1 = getSignal(S4_SRR_RL_Clu_Timestamps);
	write("S4_SRR_RL_Clu_Timestamps :%f",signalvalue1);
	write("i_S4_SRR_RL_Clu_Timestamps :%o",@ecu_Signals::i_S4_SRR_RL_Clu_Timestamps);

	testStep("get expect variable value: ","i_S4_SRR_RL_Clu_Timestamps :%o",@ecu_Signals::i_S4_SRR_RL_Clu_Timestamps);

	if(signalvalue1==@ecu_Signals::i_S4_SRR_RL_Clu_Timestamps)
	{
	testStepPass("Pass","i_S4_SRR_RL_Clu_Timestamps :%f",signalvalue1);
	}
	else
	{
	testStepFail("Fail","i_S4_SRR_RL_Clu_Timestamps :%f",signalvalue1);
	}
}

testcase S4_SRR_RL_Clu_Mes_0_S4_SRR_RL_Clu_Timestamps()
{
	signalvalue1 = getSignal(S4_SRR_RL_Clu_Timestamps);
	write("S4_SRR_RL_Clu_Timestamps :%f",signalvalue1);
	write("i_S4_SRR_RL_Clu_Timestamps :%o",@ecu_Signals::i_S4_SRR_RL_Clu_Timestamps);

	testStep("get expect variable value: ","i_S4_SRR_RL_Clu_Timestamps :%o",@ecu_Signals::i_S4_SRR_RL_Clu_Timestamps);

	if(signalvalue1==@ecu_Signals::i_S4_SRR_RL_Clu_Timestamps)
	{
	testStepPass("Pass","i_S4_SRR_RL_Clu_Timestamps :%f",signalvalue1);
	}
	else
	{
	testStepFail("Fail","i_S4_SRR_RL_Clu_Timestamps :%f",signalvalue1);
	}
}

testcase S4_SRR_RL_Clu_Mes_0_S4_SRR_RL_Clu_Timestamps()
{
	signalvalue1 = getSignal(S4_SRR_RL_Clu_Timestamps);
	write("S4_SRR_RL_Clu_Timestamps :%f",signalvalue1);
	write("i_S4_SRR_RL_Clu_Timestamps :%o",@ecu_Signals::i_S4_SRR_RL_Clu_Timestamps);

	testStep("get expect variable value: ","i_S4_SRR_RL_Clu_Timestamps :%o",@ecu_Signals::i_S4_SRR_RL_Clu_Timestamps);

	if(signalvalue1==@ecu_Signals::i_S4_SRR_RL_Clu_Timestamps)
	{
	testStepPass("Pass","i_S4_SRR_RL_Clu_Timestamps :%f",signalvalue1);
	}
	else
	{
	testStepFail("Fail","i_S4_SRR_RL_Clu_Timestamps :%f",signalvalue1);
	}
}

testcase S4_SRR_RL_Obj_Mes_0_S4_SRR_RL_Obj_ID_0()
{
	signalvalue1 = getSignal(S4_SRR_RL_Obj_ID_0);
	write("S4_SRR_RL_Obj_ID_0 :%f",signalvalue1);
	write("i_S4_SRR_RL_Obj_ID_0 :%o",@ecu_Signals::i_S4_SRR_RL_Obj_ID_0);

	testStep("get expect variable value: ","i_S4_SRR_RL_Obj_ID_0 :%o",@ecu_Signals::i_S4_SRR_RL_Obj_ID_0);

	if(signalvalue1==@ecu_Signals::i_S4_SRR_RL_Obj_ID_0)
	{
	testStepPass("Pass","i_S4_SRR_RL_Obj_ID_0 :%f",signalvalue1);
	}
	else
	{
	testStepFail("Fail","i_S4_SRR_RL_Obj_ID_0 :%f",signalvalue1);
	}
}

testcase S4_SRR_RL_Obj_Mes_0_S4_SRR_RL_Obj_DistX_0()
{
	signalvalue1 = getSignal(S4_SRR_RL_Obj_DistX_0);
	write("S4_SRR_RL_Obj_DistX_0 :%f",signalvalue1);
	write("i_S4_SRR_RL_Obj_DistX_0 :%f",@ecu_Signals::i_S4_SRR_RL_Obj_DistX_0);

	testStep("get expect variable value: ","i_S4_SRR_RL_Obj_DistX_0 :%f",@ecu_Signals::i_S4_SRR_RL_Obj_DistX_0);

	if((abs(@ecu_Signals::i_S4_SRR_RL_Obj_DistX_0)*0.9<=abs(signalvalue1))&&(abs(signalvalue1)<=abs(@ecu_Signals::i_S4_SRR_RL_Obj_DistX_0)*1.1))
	{
	testStepPass("Pass","i_S4_SRR_RL_Obj_DistX_0 :%f",signalvalue1);
	}
	else
	{
	testStepFail("Fail","i_S4_SRR_RL_Obj_DistX_0 :%f",signalvalue1);
	}
}

testcase S4_SRR_RL_Obj_Mes_0_S4_SRR_RL_Obj_RelVelX_0()
{
	signalvalue1 = getSignal(S4_SRR_RL_Obj_RelVelX_0);
	write("S4_SRR_RL_Obj_RelVelX_0 :%f",signalvalue1);
	write("i_S4_SRR_RL_Obj_RelVelX_0 :%f",@ecu_Signals::i_S4_SRR_RL_Obj_RelVelX_0);

	testStep("get expect variable value: ","i_S4_SRR_RL_Obj_RelVelX_0 :%f",@ecu_Signals::i_S4_SRR_RL_Obj_RelVelX_0);

	if((abs(@ecu_Signals::i_S4_SRR_RL_Obj_RelVelX_0)*0.9<=abs(signalvalue1))&&(abs(signalvalue1)<=abs(@ecu_Signals::i_S4_SRR_RL_Obj_RelVelX_0)*1.1))
	{
	testStepPass("Pass","i_S4_SRR_RL_Obj_RelVelX_0 :%f",signalvalue1);
	}
	else
	{
	testStepFail("Fail","i_S4_SRR_RL_Obj_RelVelX_0 :%f",signalvalue1);
	}
}

testcase S4_SRR_RL_Obj_Mes_0_S4_SRR_RL_Obj_AccelX_0()
{
	signalvalue1 = getSignal(S4_SRR_RL_Obj_AccelX_0);
	write("S4_SRR_RL_Obj_AccelX_0 :%f",signalvalue1);
	write("i_S4_SRR_RL_Obj_AccelX_0 :%f",@ecu_Signals::i_S4_SRR_RL_Obj_AccelX_0);

	testStep("get expect variable value: ","i_S4_SRR_RL_Obj_AccelX_0 :%f",@ecu_Signals::i_S4_SRR_RL_Obj_AccelX_0);

	if((abs(@ecu_Signals::i_S4_SRR_RL_Obj_AccelX_0)*0.9<=abs(signalvalue1))&&(abs(signalvalue1)<=abs(@ecu_Signals::i_S4_SRR_RL_Obj_AccelX_0)*1.1))
	{
	testStepPass("Pass","i_S4_SRR_RL_Obj_AccelX_0 :%f",signalvalue1);
	}
	else
	{
	testStepFail("Fail","i_S4_SRR_RL_Obj_AccelX_0 :%f",signalvalue1);
	}
}

testcase S4_SRR_RL_Obj_Mes_0_S4_SRR_RL_Obj_DistY_0()
{
	signalvalue1 = getSignal(S4_SRR_RL_Obj_DistY_0);
	write("S4_SRR_RL_Obj_DistY_0 :%f",signalvalue1);
	write("i_S4_SRR_RL_Obj_DistY_0 :%f",@ecu_Signals::i_S4_SRR_RL_Obj_DistY_0);

	testStep("get expect variable value: ","i_S4_SRR_RL_Obj_DistY_0 :%f",@ecu_Signals::i_S4_SRR_RL_Obj_DistY_0);

	if((abs(@ecu_Signals::i_S4_SRR_RL_Obj_DistY_0)*0.9<=abs(signalvalue1))&&(abs(signalvalue1)<=abs(@ecu_Signals::i_S4_SRR_RL_Obj_DistY_0)*1.1))
	{
	testStepPass("Pass","i_S4_SRR_RL_Obj_DistY_0 :%f",signalvalue1);
	}
	else
	{
	testStepFail("Fail","i_S4_SRR_RL_Obj_DistY_0 :%f",signalvalue1);
	}
}

testcase S4_SRR_RL_Obj_Mes_0_S4_SRR_RL_Obj_RelVelY_0()
{
	signalvalue1 = getSignal(S4_SRR_RL_Obj_RelVelY_0);
	write("S4_SRR_RL_Obj_RelVelY_0 :%f",signalvalue1);
	write("i_S4_SRR_RL_Obj_RelVelY_0 :%f",@ecu_Signals::i_S4_SRR_RL_Obj_RelVelY_0);

	testStep("get expect variable value: ","i_S4_SRR_RL_Obj_RelVelY_0 :%f",@ecu_Signals::i_S4_SRR_RL_Obj_RelVelY_0);

	if((abs(@ecu_Signals::i_S4_SRR_RL_Obj_RelVelY_0)*0.9<=abs(signalvalue1))&&(abs(signalvalue1)<=abs(@ecu_Signals::i_S4_SRR_RL_Obj_RelVelY_0)*1.1))
	{
	testStepPass("Pass","i_S4_SRR_RL_Obj_RelVelY_0 :%f",signalvalue1);
	}
	else
	{
	testStepFail("Fail","i_S4_SRR_RL_Obj_RelVelY_0 :%f",signalvalue1);
	}
}

testcase S4_SRR_RL_Obj_Mes_0_S4_SRR_RL_Obj_AccelY_0()
{
	signalvalue1 = getSignal(S4_SRR_RL_Obj_AccelY_0);
	write("S4_SRR_RL_Obj_AccelY_0 :%f",signalvalue1);
	write("i_S4_SRR_RL_Obj_AccelY_0 :%f",@ecu_Signals::i_S4_SRR_RL_Obj_AccelY_0);

	testStep("get expect variable value: ","i_S4_SRR_RL_Obj_AccelY_0 :%f",@ecu_Signals::i_S4_SRR_RL_Obj_AccelY_0);

	if((abs(@ecu_Signals::i_S4_SRR_RL_Obj_AccelY_0)*0.9<=abs(signalvalue1))&&(abs(signalvalue1)<=abs(@ecu_Signals::i_S4_SRR_RL_Obj_AccelY_0)*1.1))
	{
	testStepPass("Pass","i_S4_SRR_RL_Obj_AccelY_0 :%f",signalvalue1);
	}
	else
	{
	testStepFail("Fail","i_S4_SRR_RL_Obj_AccelY_0 :%f",signalvalue1);
	}
}

testcase S4_SRR_RL_Obj_Mes_0_S4_SRR_RL_Obj_DistXStd_0()
{
	signalvalue1 = getSignal(S4_SRR_RL_Obj_DistXStd_0);
	write("S4_SRR_RL_Obj_DistXStd_0 :%f",signalvalue1);
	write("i_S4_SRR_RL_Obj_DistXStd_0 :%f",@ecu_Signals::i_S4_SRR_RL_Obj_DistXStd_0);

	testStep("get expect variable value: ","i_S4_SRR_RL_Obj_DistXStd_0 :%f",@ecu_Signals::i_S4_SRR_RL_Obj_DistXStd_0);

	if((abs(@ecu_Signals::i_S4_SRR_RL_Obj_DistXStd_0)*0.9<=abs(signalvalue1))&&(abs(signalvalue1)<=abs(@ecu_Signals::i_S4_SRR_RL_Obj_DistXStd_0)*1.1))
	{
	testStepPass("Pass","i_S4_SRR_RL_Obj_DistXStd_0 :%f",signalvalue1);
	}
	else
	{
	testStepFail("Fail","i_S4_SRR_RL_Obj_DistXStd_0 :%f",signalvalue1);
	}
}

testcase S4_SRR_RL_Obj_Mes_0_S4_SRR_RL_Obj_RelVelXStd_0()
{
	signalvalue1 = getSignal(S4_SRR_RL_Obj_RelVelXStd_0);
	write("S4_SRR_RL_Obj_RelVelXStd_0 :%f",signalvalue1);
	write("i_S4_SRR_RL_Obj_RelVelXStd_0 :%f",@ecu_Signals::i_S4_SRR_RL_Obj_RelVelXStd_0);

	testStep("get expect variable value: ","i_S4_SRR_RL_Obj_RelVelXStd_0 :%f",@ecu_Signals::i_S4_SRR_RL_Obj_RelVelXStd_0);

	if((abs(@ecu_Signals::i_S4_SRR_RL_Obj_RelVelXStd_0)*0.9<=abs(signalvalue1))&&(abs(signalvalue1)<=abs(@ecu_Signals::i_S4_SRR_RL_Obj_RelVelXStd_0)*1.1))
	{
	testStepPass("Pass","i_S4_SRR_RL_Obj_RelVelXStd_0 :%f",signalvalue1);
	}
	else
	{
	testStepFail("Fail","i_S4_SRR_RL_Obj_RelVelXStd_0 :%f",signalvalue1);
	}
}

testcase S4_SRR_RL_Obj_Mes_0_S4_SRR_RL_Obj_DistYStd_0()
{
	signalvalue1 = getSignal(S4_SRR_RL_Obj_DistYStd_0);
	write("S4_SRR_RL_Obj_DistYStd_0 :%f",signalvalue1);
	write("i_S4_SRR_RL_Obj_DistYStd_0 :%f",@ecu_Signals::i_S4_SRR_RL_Obj_DistYStd_0);

	testStep("get expect variable value: ","i_S4_SRR_RL_Obj_DistYStd_0 :%f",@ecu_Signals::i_S4_SRR_RL_Obj_DistYStd_0);

	if((abs(@ecu_Signals::i_S4_SRR_RL_Obj_DistYStd_0)*0.9<=abs(signalvalue1))&&(abs(signalvalue1)<=abs(@ecu_Signals::i_S4_SRR_RL_Obj_DistYStd_0)*1.1))
	{
	testStepPass("Pass","i_S4_SRR_RL_Obj_DistYStd_0 :%f",signalvalue1);
	}
	else
	{
	testStepFail("Fail","i_S4_SRR_RL_Obj_DistYStd_0 :%f",signalvalue1);
	}
}

testcase S4_SRR_RL_Obj_Mes_0_S4_SRR_RL_Obj_RelVelYStd_0()
{
	signalvalue1 = getSignal(S4_SRR_RL_Obj_RelVelYStd_0);
	write("S4_SRR_RL_Obj_RelVelYStd_0 :%f",signalvalue1);
	write("i_S4_SRR_RL_Obj_RelVelYStd_0 :%f",@ecu_Signals::i_S4_SRR_RL_Obj_RelVelYStd_0);

	testStep("get expect variable value: ","i_S4_SRR_RL_Obj_RelVelYStd_0 :%f",@ecu_Signals::i_S4_SRR_RL_Obj_RelVelYStd_0);

	if((abs(@ecu_Signals::i_S4_SRR_RL_Obj_RelVelYStd_0)*0.9<=abs(signalvalue1))&&(abs(signalvalue1)<=abs(@ecu_Signals::i_S4_SRR_RL_Obj_RelVelYStd_0)*1.1))
	{
	testStepPass("Pass","i_S4_SRR_RL_Obj_RelVelYStd_0 :%f",signalvalue1);
	}
	else
	{
	testStepFail("Fail","i_S4_SRR_RL_Obj_RelVelYStd_0 :%f",signalvalue1);
	}
}

testcase S4_SRR_RL_Obj_Mes_0_S4_SRR_RL_Obj_UpdateFlag_0()
{
	signalvalue1 = getSignal(S4_SRR_RL_Obj_UpdateFlag_0);
	write("S4_SRR_RL_Obj_UpdateFlag_0 :%f",signalvalue1);
	write("i_S4_SRR_RL_Obj_UpdateFlag_0 :%o",@ecu_Signals::i_S4_SRR_RL_Obj_UpdateFlag_0);

	testStep("get expect variable value: ","i_S4_SRR_RL_Obj_UpdateFlag_0 :%o",@ecu_Signals::i_S4_SRR_RL_Obj_UpdateFlag_0);

	if(signalvalue1==@ecu_Signals::i_S4_SRR_RL_Obj_UpdateFlag_0)
	{
	testStepPass("Pass","i_S4_SRR_RL_Obj_UpdateFlag_0 :%f",signalvalue1);
	}
	else
	{
	testStepFail("Fail","i_S4_SRR_RL_Obj_UpdateFlag_0 :%f",signalvalue1);
	}
}

testcase S4_SRR_RL_Obj_Mes_0_S4_SRR_RL_Obj_ExistProb_0()
{
	signalvalue1 = getSignal(S4_SRR_RL_Obj_ExistProb_0);
	write("S4_SRR_RL_Obj_ExistProb_0 :%f",signalvalue1);
	write("i_S4_SRR_RL_Obj_ExistProb_0 :%o",@ecu_Signals::i_S4_SRR_RL_Obj_ExistProb_0);

	testStep("get expect variable value: ","i_S4_SRR_RL_Obj_ExistProb_0 :%o",@ecu_Signals::i_S4_SRR_RL_Obj_ExistProb_0);

	if(signalvalue1==@ecu_Signals::i_S4_SRR_RL_Obj_ExistProb_0)
	{
	testStepPass("Pass","i_S4_SRR_RL_Obj_ExistProb_0 :%f",signalvalue1);
	}
	else
	{
	testStepFail("Fail","i_S4_SRR_RL_Obj_ExistProb_0 :%f",signalvalue1);
	}
}

testcase S4_SRR_RL_Obj_Mes_0_S4_SRR_RL_Obj_Type_0()
{
	signalvalue1 = getSignal(S4_SRR_RL_Obj_Type_0);
	write("S4_SRR_RL_Obj_Type_0 :%f",signalvalue1);
	write("i_S4_SRR_RL_Obj_Type_0 :%o",@ecu_Signals::i_S4_SRR_RL_Obj_Type_0);

	testStep("get expect variable value: ","i_S4_SRR_RL_Obj_Type_0 :%o",@ecu_Signals::i_S4_SRR_RL_Obj_Type_0);

	if(signalvalue1==@ecu_Signals::i_S4_SRR_RL_Obj_Type_0)
	{
	testStepPass("Pass","i_S4_SRR_RL_Obj_Type_0 :%f",signalvalue1);
	}
	else
	{
	testStepFail("Fail","i_S4_SRR_RL_Obj_Type_0 :%f",signalvalue1);
	}
}

testcase S4_SRR_RL_Obj_Mes_0_S4_SRR_RL_Obj_EDynProp_0()
{
	signalvalue1 = getSignal(S4_SRR_RL_Obj_EDynProp_0);
	write("S4_SRR_RL_Obj_EDynProp_0 :%f",signalvalue1);
	write("i_S4_SRR_RL_Obj_EDynProp_0 :%o",@ecu_Signals::i_S4_SRR_RL_Obj_EDynProp_0);

	testStep("get expect variable value: ","i_S4_SRR_RL_Obj_EDynProp_0 :%o",@ecu_Signals::i_S4_SRR_RL_Obj_EDynProp_0);

	if(signalvalue1==@ecu_Signals::i_S4_SRR_RL_Obj_EDynProp_0)
	{
	testStepPass("Pass","i_S4_SRR_RL_Obj_EDynProp_0 :%f",signalvalue1);
	}
	else
	{
	testStepFail("Fail","i_S4_SRR_RL_Obj_EDynProp_0 :%f",signalvalue1);
	}
}

testcase S4_SRR_RL_Obj_Mes_0_S4_SRR_RL_Obj_UiLifeCycles_0()
{
	signalvalue1 = getSignal(S4_SRR_RL_Obj_UiLifeCycles_0);
	write("S4_SRR_RL_Obj_UiLifeCycles_0 :%f",signalvalue1);
	write("i_S4_SRR_RL_Obj_UiLifeCycles_0 :%o",@ecu_Signals::i_S4_SRR_RL_Obj_UiLifeCycles_0);

	testStep("get expect variable value: ","i_S4_SRR_RL_Obj_UiLifeCycles_0 :%o",@ecu_Signals::i_S4_SRR_RL_Obj_UiLifeCycles_0);

	if(signalvalue1==@ecu_Signals::i_S4_SRR_RL_Obj_UiLifeCycles_0)
	{
	testStepPass("Pass","i_S4_SRR_RL_Obj_UiLifeCycles_0 :%f",signalvalue1);
	}
	else
	{
	testStepFail("Fail","i_S4_SRR_RL_Obj_UiLifeCycles_0 :%f",signalvalue1);
	}
}

testcase S4_SRR_RL_Obj_Mes_0_S4_SRR_RL_Obj_Timestamps()
{
	signalvalue1 = getSignal(S4_SRR_RL_Obj_Timestamps);
	write("S4_SRR_RL_Obj_Timestamps :%f",signalvalue1);
	write("i_S4_SRR_RL_Obj_Timestamps :%o",@ecu_Signals::i_S4_SRR_RL_Obj_Timestamps);

	testStep("get expect variable value: ","i_S4_SRR_RL_Obj_Timestamps :%o",@ecu_Signals::i_S4_SRR_RL_Obj_Timestamps);

	if(signalvalue1==@ecu_Signals::i_S4_SRR_RL_Obj_Timestamps)
	{
	testStepPass("Pass","i_S4_SRR_RL_Obj_Timestamps :%f",signalvalue1);
	}
	else
	{
	testStepFail("Fail","i_S4_SRR_RL_Obj_Timestamps :%f",signalvalue1);
	}
}

testcase S4_SRR_RL_Obj_Mes_0_S4_SRR_RL_Obj_Timestamps()
{
	signalvalue1 = getSignal(S4_SRR_RL_Obj_Timestamps);
	write("S4_SRR_RL_Obj_Timestamps :%f",signalvalue1);
	write("i_S4_SRR_RL_Obj_Timestamps :%o",@ecu_Signals::i_S4_SRR_RL_Obj_Timestamps);

	testStep("get expect variable value: ","i_S4_SRR_RL_Obj_Timestamps :%o",@ecu_Signals::i_S4_SRR_RL_Obj_Timestamps);

	if(signalvalue1==@ecu_Signals::i_S4_SRR_RL_Obj_Timestamps)
	{
	testStepPass("Pass","i_S4_SRR_RL_Obj_Timestamps :%f",signalvalue1);
	}
	else
	{
	testStepFail("Fail","i_S4_SRR_RL_Obj_Timestamps :%f",signalvalue1);
	}
}

testcase S4_SRR_RL_Obj_Mes_0_S4_SRR_RL_Obj_Timestamps()
{
	signalvalue1 = getSignal(S4_SRR_RL_Obj_Timestamps);
	write("S4_SRR_RL_Obj_Timestamps :%f",signalvalue1);
	write("i_S4_SRR_RL_Obj_Timestamps :%o",@ecu_Signals::i_S4_SRR_RL_Obj_Timestamps);

	testStep("get expect variable value: ","i_S4_SRR_RL_Obj_Timestamps :%o",@ecu_Signals::i_S4_SRR_RL_Obj_Timestamps);

	if(signalvalue1==@ecu_Signals::i_S4_SRR_RL_Obj_Timestamps)
	{
	testStepPass("Pass","i_S4_SRR_RL_Obj_Timestamps :%f",signalvalue1);
	}
	else
	{
	testStepFail("Fail","i_S4_SRR_RL_Obj_Timestamps :%f",signalvalue1);
	}
}

testcase S4_SRR_RL_Clu_Mes_0_S4_SRR_RL_Clu_Theta_1()
{
	signalvalue1 = getSignal(S4_SRR_RL_Clu_Theta_1);
	write("S4_SRR_RL_Clu_Theta_1 :%f",signalvalue1);
	write("i_S4_SRR_RL_Clu_Theta_1 :%f",@ecu_Signals::i_S4_SRR_RL_Clu_Theta_1);

	testStep("get expect variable value: ","i_S4_SRR_RL_Clu_Theta_1 :%f",@ecu_Signals::i_S4_SRR_RL_Clu_Theta_1);

	if((abs(@ecu_Signals::i_S4_SRR_RL_Clu_Theta_1)*0.9<=abs(signalvalue1))&&(abs(signalvalue1)<=abs(@ecu_Signals::i_S4_SRR_RL_Clu_Theta_1)*1.1))
	{
	testStepPass("Pass","i_S4_SRR_RL_Clu_Theta_1 :%f",signalvalue1);
	}
	else
	{
	testStepFail("Fail","i_S4_SRR_RL_Clu_Theta_1 :%f",signalvalue1);
	}
}

testcase S4_SRR_RL_Clu_Mes_0_S4_SRR_RL_Clu_Dist_1()
{
	signalvalue1 = getSignal(S4_SRR_RL_Clu_Dist_1);
	write("S4_SRR_RL_Clu_Dist_1 :%f",signalvalue1);
	write("i_S4_SRR_RL_Clu_Dist_1 :%f",@ecu_Signals::i_S4_SRR_RL_Clu_Dist_1);

	testStep("get expect variable value: ","i_S4_SRR_RL_Clu_Dist_1 :%f",@ecu_Signals::i_S4_SRR_RL_Clu_Dist_1);

	if((abs(@ecu_Signals::i_S4_SRR_RL_Clu_Dist_1)*0.9<=abs(signalvalue1))&&(abs(signalvalue1)<=abs(@ecu_Signals::i_S4_SRR_RL_Clu_Dist_1)*1.1))
	{
	testStepPass("Pass","i_S4_SRR_RL_Clu_Dist_1 :%f",signalvalue1);
	}
	else
	{
	testStepFail("Fail","i_S4_SRR_RL_Clu_Dist_1 :%f",signalvalue1);
	}
}

testcase S4_SRR_RL_Clu_Mes_0_S4_SRR_RL_Clu_Vel_1()
{
	signalvalue1 = getSignal(S4_SRR_RL_Clu_Vel_1);
	write("S4_SRR_RL_Clu_Vel_1 :%f",signalvalue1);
	write("i_S4_SRR_RL_Clu_Vel_1 :%f",@ecu_Signals::i_S4_SRR_RL_Clu_Vel_1);

	testStep("get expect variable value: ","i_S4_SRR_RL_Clu_Vel_1 :%f",@ecu_Signals::i_S4_SRR_RL_Clu_Vel_1);

	if((abs(@ecu_Signals::i_S4_SRR_RL_Clu_Vel_1)*0.9<=abs(signalvalue1))&&(abs(signalvalue1)<=abs(@ecu_Signals::i_S4_SRR_RL_Clu_Vel_1)*1.1))
	{
	testStepPass("Pass","i_S4_SRR_RL_Clu_Vel_1 :%f",signalvalue1);
	}
	else
	{
	testStepFail("Fail","i_S4_SRR_RL_Clu_Vel_1 :%f",signalvalue1);
	}
}

testcase S4_SRR_RL_Clu_Mes_0_S4_SRR_RL_Clu_SNR_1()
{
	signalvalue1 = getSignal(S4_SRR_RL_Clu_SNR_1);
	write("S4_SRR_RL_Clu_SNR_1 :%f",signalvalue1);
	write("i_S4_SRR_RL_Clu_SNR_1 :%f",@ecu_Signals::i_S4_SRR_RL_Clu_SNR_1);

	testStep("get expect variable value: ","i_S4_SRR_RL_Clu_SNR_1 :%f",@ecu_Signals::i_S4_SRR_RL_Clu_SNR_1);

	if((abs(@ecu_Signals::i_S4_SRR_RL_Clu_SNR_1)*0.9<=abs(signalvalue1))&&(abs(signalvalue1)<=abs(@ecu_Signals::i_S4_SRR_RL_Clu_SNR_1)*1.1))
	{
	testStepPass("Pass","i_S4_SRR_RL_Clu_SNR_1 :%f",signalvalue1);
	}
	else
	{
	testStepFail("Fail","i_S4_SRR_RL_Clu_SNR_1 :%f",signalvalue1);
	}
}

testcase S4_SRR_RL_Clu_Mes_0_S4_SRR_RL_Clu_DynProp_1()
{
	signalvalue1 = getSignal(S4_SRR_RL_Clu_DynProp_1);
	write("S4_SRR_RL_Clu_DynProp_1 :%f",signalvalue1);
	write("i_S4_SRR_RL_Clu_DynProp_1 :%o",@ecu_Signals::i_S4_SRR_RL_Clu_DynProp_1);

	testStep("get expect variable value: ","i_S4_SRR_RL_Clu_DynProp_1 :%o",@ecu_Signals::i_S4_SRR_RL_Clu_DynProp_1);

	if(signalvalue1==@ecu_Signals::i_S4_SRR_RL_Clu_DynProp_1)
	{
	testStepPass("Pass","i_S4_SRR_RL_Clu_DynProp_1 :%f",signalvalue1);
	}
	else
	{
	testStepFail("Fail","i_S4_SRR_RL_Clu_DynProp_1 :%f",signalvalue1);
	}
}

testcase S4_SRR_RL_Clu_Mes_0_S4_SRR_RL_Clu_Locationvalid_1()
{
	signalvalue1 = getSignal(S4_SRR_RL_Clu_Locationvalid_1);
	write("S4_SRR_RL_Clu_Locationvalid_1 :%f",signalvalue1);
	write("i_S4_SRR_RL_Clu_Locationvalid_1 :%o",@ecu_Signals::i_S4_SRR_RL_Clu_Locationvalid_1);

	testStep("get expect variable value: ","i_S4_SRR_RL_Clu_Locationvalid_1 :%o",@ecu_Signals::i_S4_SRR_RL_Clu_Locationvalid_1);

	if(signalvalue1==@ecu_Signals::i_S4_SRR_RL_Clu_Locationvalid_1)
	{
	testStepPass("Pass","i_S4_SRR_RL_Clu_Locationvalid_1 :%f",signalvalue1);
	}
	else
	{
	testStepFail("Fail","i_S4_SRR_RL_Clu_Locationvalid_1 :%f",signalvalue1);
	}
}

testcase S4_SRR_RL_Clu_Mes_0_S4_SRR_RL_Clu_Theta_2()
{
	signalvalue1 = getSignal(S4_SRR_RL_Clu_Theta_2);
	write("S4_SRR_RL_Clu_Theta_2 :%f",signalvalue1);
	write("i_S4_SRR_RL_Clu_Theta_2 :%f",@ecu_Signals::i_S4_SRR_RL_Clu_Theta_2);

	testStep("get expect variable value: ","i_S4_SRR_RL_Clu_Theta_2 :%f",@ecu_Signals::i_S4_SRR_RL_Clu_Theta_2);

	if((abs(@ecu_Signals::i_S4_SRR_RL_Clu_Theta_2)*0.9<=abs(signalvalue1))&&(abs(signalvalue1)<=abs(@ecu_Signals::i_S4_SRR_RL_Clu_Theta_2)*1.1))
	{
	testStepPass("Pass","i_S4_SRR_RL_Clu_Theta_2 :%f",signalvalue1);
	}
	else
	{
	testStepFail("Fail","i_S4_SRR_RL_Clu_Theta_2 :%f",signalvalue1);
	}
}

testcase S4_SRR_RL_Clu_Mes_0_S4_SRR_RL_Clu_Dist_2()
{
	signalvalue1 = getSignal(S4_SRR_RL_Clu_Dist_2);
	write("S4_SRR_RL_Clu_Dist_2 :%f",signalvalue1);
	write("i_S4_SRR_RL_Clu_Dist_2 :%f",@ecu_Signals::i_S4_SRR_RL_Clu_Dist_2);

	testStep("get expect variable value: ","i_S4_SRR_RL_Clu_Dist_2 :%f",@ecu_Signals::i_S4_SRR_RL_Clu_Dist_2);

	if((abs(@ecu_Signals::i_S4_SRR_RL_Clu_Dist_2)*0.9<=abs(signalvalue1))&&(abs(signalvalue1)<=abs(@ecu_Signals::i_S4_SRR_RL_Clu_Dist_2)*1.1))
	{
	testStepPass("Pass","i_S4_SRR_RL_Clu_Dist_2 :%f",signalvalue1);
	}
	else
	{
	testStepFail("Fail","i_S4_SRR_RL_Clu_Dist_2 :%f",signalvalue1);
	}
}

testcase S4_SRR_RL_Clu_Mes_0_S4_SRR_RL_Clu_Vel_2()
{
	signalvalue1 = getSignal(S4_SRR_RL_Clu_Vel_2);
	write("S4_SRR_RL_Clu_Vel_2 :%f",signalvalue1);
	write("i_S4_SRR_RL_Clu_Vel_2 :%f",@ecu_Signals::i_S4_SRR_RL_Clu_Vel_2);

	testStep("get expect variable value: ","i_S4_SRR_RL_Clu_Vel_2 :%f",@ecu_Signals::i_S4_SRR_RL_Clu_Vel_2);

	if((abs(@ecu_Signals::i_S4_SRR_RL_Clu_Vel_2)*0.9<=abs(signalvalue1))&&(abs(signalvalue1)<=abs(@ecu_Signals::i_S4_SRR_RL_Clu_Vel_2)*1.1))
	{
	testStepPass("Pass","i_S4_SRR_RL_Clu_Vel_2 :%f",signalvalue1);
	}
	else
	{
	testStepFail("Fail","i_S4_SRR_RL_Clu_Vel_2 :%f",signalvalue1);
	}
}

testcase S4_SRR_RL_Clu_Mes_0_S4_SRR_RL_Clu_SNR_2()
{
	signalvalue1 = getSignal(S4_SRR_RL_Clu_SNR_2);
	write("S4_SRR_RL_Clu_SNR_2 :%f",signalvalue1);
	write("i_S4_SRR_RL_Clu_SNR_2 :%f",@ecu_Signals::i_S4_SRR_RL_Clu_SNR_2);

	testStep("get expect variable value: ","i_S4_SRR_RL_Clu_SNR_2 :%f",@ecu_Signals::i_S4_SRR_RL_Clu_SNR_2);

	if((abs(@ecu_Signals::i_S4_SRR_RL_Clu_SNR_2)*0.9<=abs(signalvalue1))&&(abs(signalvalue1)<=abs(@ecu_Signals::i_S4_SRR_RL_Clu_SNR_2)*1.1))
	{
	testStepPass("Pass","i_S4_SRR_RL_Clu_SNR_2 :%f",signalvalue1);
	}
	else
	{
	testStepFail("Fail","i_S4_SRR_RL_Clu_SNR_2 :%f",signalvalue1);
	}
}

testcase S4_SRR_RL_Clu_Mes_0_S4_SRR_RL_Clu_DynProp_2()
{
	signalvalue1 = getSignal(S4_SRR_RL_Clu_DynProp_2);
	write("S4_SRR_RL_Clu_DynProp_2 :%f",signalvalue1);
	write("i_S4_SRR_RL_Clu_DynProp_2 :%o",@ecu_Signals::i_S4_SRR_RL_Clu_DynProp_2);

	testStep("get expect variable value: ","i_S4_SRR_RL_Clu_DynProp_2 :%o",@ecu_Signals::i_S4_SRR_RL_Clu_DynProp_2);

	if(signalvalue1==@ecu_Signals::i_S4_SRR_RL_Clu_DynProp_2)
	{
	testStepPass("Pass","i_S4_SRR_RL_Clu_DynProp_2 :%f",signalvalue1);
	}
	else
	{
	testStepFail("Fail","i_S4_SRR_RL_Clu_DynProp_2 :%f",signalvalue1);
	}
}

testcase S4_SRR_RL_Clu_Mes_0_S4_SRR_RL_Clu_Locationvalid_2()
{
	signalvalue1 = getSignal(S4_SRR_RL_Clu_Locationvalid_2);
	write("S4_SRR_RL_Clu_Locationvalid_2 :%f",signalvalue1);
	write("i_S4_SRR_RL_Clu_Locationvalid_2 :%o",@ecu_Signals::i_S4_SRR_RL_Clu_Locationvalid_2);

	testStep("get expect variable value: ","i_S4_SRR_RL_Clu_Locationvalid_2 :%o",@ecu_Signals::i_S4_SRR_RL_Clu_Locationvalid_2);

	if(signalvalue1==@ecu_Signals::i_S4_SRR_RL_Clu_Locationvalid_2)
	{
	testStepPass("Pass","i_S4_SRR_RL_Clu_Locationvalid_2 :%f",signalvalue1);
	}
	else
	{
	testStepFail("Fail","i_S4_SRR_RL_Clu_Locationvalid_2 :%f",signalvalue1);
	}
}

testcase S4_SRR_RL_Clu_Mes_0_S4_SRR_RL_Clu_Theta_3()
{
	signalvalue1 = getSignal(S4_SRR_RL_Clu_Theta_3);
	write("S4_SRR_RL_Clu_Theta_3 :%f",signalvalue1);
	write("i_S4_SRR_RL_Clu_Theta_3 :%f",@ecu_Signals::i_S4_SRR_RL_Clu_Theta_3);

	testStep("get expect variable value: ","i_S4_SRR_RL_Clu_Theta_3 :%f",@ecu_Signals::i_S4_SRR_RL_Clu_Theta_3);

	if((abs(@ecu_Signals::i_S4_SRR_RL_Clu_Theta_3)*0.9<=abs(signalvalue1))&&(abs(signalvalue1)<=abs(@ecu_Signals::i_S4_SRR_RL_Clu_Theta_3)*1.1))
	{
	testStepPass("Pass","i_S4_SRR_RL_Clu_Theta_3 :%f",signalvalue1);
	}
	else
	{
	testStepFail("Fail","i_S4_SRR_RL_Clu_Theta_3 :%f",signalvalue1);
	}
}

testcase S4_SRR_RL_Clu_Mes_0_S4_SRR_RL_Clu_Dist_3()
{
	signalvalue1 = getSignal(S4_SRR_RL_Clu_Dist_3);
	write("S4_SRR_RL_Clu_Dist_3 :%f",signalvalue1);
	write("i_S4_SRR_RL_Clu_Dist_3 :%f",@ecu_Signals::i_S4_SRR_RL_Clu_Dist_3);

	testStep("get expect variable value: ","i_S4_SRR_RL_Clu_Dist_3 :%f",@ecu_Signals::i_S4_SRR_RL_Clu_Dist_3);

	if((abs(@ecu_Signals::i_S4_SRR_RL_Clu_Dist_3)*0.9<=abs(signalvalue1))&&(abs(signalvalue1)<=abs(@ecu_Signals::i_S4_SRR_RL_Clu_Dist_3)*1.1))
	{
	testStepPass("Pass","i_S4_SRR_RL_Clu_Dist_3 :%f",signalvalue1);
	}
	else
	{
	testStepFail("Fail","i_S4_SRR_RL_Clu_Dist_3 :%f",signalvalue1);
	}
}

testcase S4_SRR_RL_Clu_Mes_0_S4_SRR_RL_Clu_Vel_3()
{
	signalvalue1 = getSignal(S4_SRR_RL_Clu_Vel_3);
	write("S4_SRR_RL_Clu_Vel_3 :%f",signalvalue1);
	write("i_S4_SRR_RL_Clu_Vel_3 :%f",@ecu_Signals::i_S4_SRR_RL_Clu_Vel_3);

	testStep("get expect variable value: ","i_S4_SRR_RL_Clu_Vel_3 :%f",@ecu_Signals::i_S4_SRR_RL_Clu_Vel_3);

	if((abs(@ecu_Signals::i_S4_SRR_RL_Clu_Vel_3)*0.9<=abs(signalvalue1))&&(abs(signalvalue1)<=abs(@ecu_Signals::i_S4_SRR_RL_Clu_Vel_3)*1.1))
	{
	testStepPass("Pass","i_S4_SRR_RL_Clu_Vel_3 :%f",signalvalue1);
	}
	else
	{
	testStepFail("Fail","i_S4_SRR_RL_Clu_Vel_3 :%f",signalvalue1);
	}
}

testcase S4_SRR_RL_Clu_Mes_0_S4_SRR_RL_Clu_SNR_3()
{
	signalvalue1 = getSignal(S4_SRR_RL_Clu_SNR_3);
	write("S4_SRR_RL_Clu_SNR_3 :%f",signalvalue1);
	write("i_S4_SRR_RL_Clu_SNR_3 :%f",@ecu_Signals::i_S4_SRR_RL_Clu_SNR_3);

	testStep("get expect variable value: ","i_S4_SRR_RL_Clu_SNR_3 :%f",@ecu_Signals::i_S4_SRR_RL_Clu_SNR_3);

	if((abs(@ecu_Signals::i_S4_SRR_RL_Clu_SNR_3)*0.9<=abs(signalvalue1))&&(abs(signalvalue1)<=abs(@ecu_Signals::i_S4_SRR_RL_Clu_SNR_3)*1.1))
	{
	testStepPass("Pass","i_S4_SRR_RL_Clu_SNR_3 :%f",signalvalue1);
	}
	else
	{
	testStepFail("Fail","i_S4_SRR_RL_Clu_SNR_3 :%f",signalvalue1);
	}
}

testcase S4_SRR_RL_Clu_Mes_0_S4_SRR_RL_Clu_DynProp_3()
{
	signalvalue1 = getSignal(S4_SRR_RL_Clu_DynProp_3);
	write("S4_SRR_RL_Clu_DynProp_3 :%f",signalvalue1);
	write("i_S4_SRR_RL_Clu_DynProp_3 :%o",@ecu_Signals::i_S4_SRR_RL_Clu_DynProp_3);

	testStep("get expect variable value: ","i_S4_SRR_RL_Clu_DynProp_3 :%o",@ecu_Signals::i_S4_SRR_RL_Clu_DynProp_3);

	if(signalvalue1==@ecu_Signals::i_S4_SRR_RL_Clu_DynProp_3)
	{
	testStepPass("Pass","i_S4_SRR_RL_Clu_DynProp_3 :%f",signalvalue1);
	}
	else
	{
	testStepFail("Fail","i_S4_SRR_RL_Clu_DynProp_3 :%f",signalvalue1);
	}
}

testcase S4_SRR_RL_Clu_Mes_0_S4_SRR_RL_Clu_Locationvalid_3()
{
	signalvalue1 = getSignal(S4_SRR_RL_Clu_Locationvalid_3);
	write("S4_SRR_RL_Clu_Locationvalid_3 :%f",signalvalue1);
	write("i_S4_SRR_RL_Clu_Locationvalid_3 :%o",@ecu_Signals::i_S4_SRR_RL_Clu_Locationvalid_3);

	testStep("get expect variable value: ","i_S4_SRR_RL_Clu_Locationvalid_3 :%o",@ecu_Signals::i_S4_SRR_RL_Clu_Locationvalid_3);

	if(signalvalue1==@ecu_Signals::i_S4_SRR_RL_Clu_Locationvalid_3)
	{
	testStepPass("Pass","i_S4_SRR_RL_Clu_Locationvalid_3 :%f",signalvalue1);
	}
	else
	{
	testStepFail("Fail","i_S4_SRR_RL_Clu_Locationvalid_3 :%f",signalvalue1);
	}
}

testcase S4_SRR_RL_Clu_Mes_0_S4_SRR_RL_Clu_Theta_4()
{
	signalvalue1 = getSignal(S4_SRR_RL_Clu_Theta_4);
	write("S4_SRR_RL_Clu_Theta_4 :%f",signalvalue1);
	write("i_S4_SRR_RL_Clu_Theta_4 :%f",@ecu_Signals::i_S4_SRR_RL_Clu_Theta_4);

	testStep("get expect variable value: ","i_S4_SRR_RL_Clu_Theta_4 :%f",@ecu_Signals::i_S4_SRR_RL_Clu_Theta_4);

	if((abs(@ecu_Signals::i_S4_SRR_RL_Clu_Theta_4)*0.9<=abs(signalvalue1))&&(abs(signalvalue1)<=abs(@ecu_Signals::i_S4_SRR_RL_Clu_Theta_4)*1.1))
	{
	testStepPass("Pass","i_S4_SRR_RL_Clu_Theta_4 :%f",signalvalue1);
	}
	else
	{
	testStepFail("Fail","i_S4_SRR_RL_Clu_Theta_4 :%f",signalvalue1);
	}
}

testcase S4_SRR_RL_Clu_Mes_0_S4_SRR_RL_Clu_Dist_4()
{
	signalvalue1 = getSignal(S4_SRR_RL_Clu_Dist_4);
	write("S4_SRR_RL_Clu_Dist_4 :%f",signalvalue1);
	write("i_S4_SRR_RL_Clu_Dist_4 :%f",@ecu_Signals::i_S4_SRR_RL_Clu_Dist_4);

	testStep("get expect variable value: ","i_S4_SRR_RL_Clu_Dist_4 :%f",@ecu_Signals::i_S4_SRR_RL_Clu_Dist_4);

	if((abs(@ecu_Signals::i_S4_SRR_RL_Clu_Dist_4)*0.9<=abs(signalvalue1))&&(abs(signalvalue1)<=abs(@ecu_Signals::i_S4_SRR_RL_Clu_Dist_4)*1.1))
	{
	testStepPass("Pass","i_S4_SRR_RL_Clu_Dist_4 :%f",signalvalue1);
	}
	else
	{
	testStepFail("Fail","i_S4_SRR_RL_Clu_Dist_4 :%f",signalvalue1);
	}
}

testcase S4_SRR_RL_Clu_Mes_0_S4_SRR_RL_Clu_Vel_4()
{
	signalvalue1 = getSignal(S4_SRR_RL_Clu_Vel_4);
	write("S4_SRR_RL_Clu_Vel_4 :%f",signalvalue1);
	write("i_S4_SRR_RL_Clu_Vel_4 :%f",@ecu_Signals::i_S4_SRR_RL_Clu_Vel_4);

	testStep("get expect variable value: ","i_S4_SRR_RL_Clu_Vel_4 :%f",@ecu_Signals::i_S4_SRR_RL_Clu_Vel_4);

	if((abs(@ecu_Signals::i_S4_SRR_RL_Clu_Vel_4)*0.9<=abs(signalvalue1))&&(abs(signalvalue1)<=abs(@ecu_Signals::i_S4_SRR_RL_Clu_Vel_4)*1.1))
	{
	testStepPass("Pass","i_S4_SRR_RL_Clu_Vel_4 :%f",signalvalue1);
	}
	else
	{
	testStepFail("Fail","i_S4_SRR_RL_Clu_Vel_4 :%f",signalvalue1);
	}
}

testcase S4_SRR_RL_Clu_Mes_0_S4_SRR_RL_Clu_SNR_4()
{
	signalvalue1 = getSignal(S4_SRR_RL_Clu_SNR_4);
	write("S4_SRR_RL_Clu_SNR_4 :%f",signalvalue1);
	write("i_S4_SRR_RL_Clu_SNR_4 :%f",@ecu_Signals::i_S4_SRR_RL_Clu_SNR_4);

	testStep("get expect variable value: ","i_S4_SRR_RL_Clu_SNR_4 :%f",@ecu_Signals::i_S4_SRR_RL_Clu_SNR_4);

	if((abs(@ecu_Signals::i_S4_SRR_RL_Clu_SNR_4)*0.9<=abs(signalvalue1))&&(abs(signalvalue1)<=abs(@ecu_Signals::i_S4_SRR_RL_Clu_SNR_4)*1.1))
	{
	testStepPass("Pass","i_S4_SRR_RL_Clu_SNR_4 :%f",signalvalue1);
	}
	else
	{
	testStepFail("Fail","i_S4_SRR_RL_Clu_SNR_4 :%f",signalvalue1);
	}
}

testcase S4_SRR_RL_Clu_Mes_0_S4_SRR_RL_Clu_DynProp_4()
{
	signalvalue1 = getSignal(S4_SRR_RL_Clu_DynProp_4);
	write("S4_SRR_RL_Clu_DynProp_4 :%f",signalvalue1);
	write("i_S4_SRR_RL_Clu_DynProp_4 :%o",@ecu_Signals::i_S4_SRR_RL_Clu_DynProp_4);

	testStep("get expect variable value: ","i_S4_SRR_RL_Clu_DynProp_4 :%o",@ecu_Signals::i_S4_SRR_RL_Clu_DynProp_4);

	if(signalvalue1==@ecu_Signals::i_S4_SRR_RL_Clu_DynProp_4)
	{
	testStepPass("Pass","i_S4_SRR_RL_Clu_DynProp_4 :%f",signalvalue1);
	}
	else
	{
	testStepFail("Fail","i_S4_SRR_RL_Clu_DynProp_4 :%f",signalvalue1);
	}
}

testcase S4_SRR_RL_Clu_Mes_0_S4_SRR_RL_Clu_Locationvalid_4()
{
	signalvalue1 = getSignal(S4_SRR_RL_Clu_Locationvalid_4);
	write("S4_SRR_RL_Clu_Locationvalid_4 :%f",signalvalue1);
	write("i_S4_SRR_RL_Clu_Locationvalid_4 :%o",@ecu_Signals::i_S4_SRR_RL_Clu_Locationvalid_4);

	testStep("get expect variable value: ","i_S4_SRR_RL_Clu_Locationvalid_4 :%o",@ecu_Signals::i_S4_SRR_RL_Clu_Locationvalid_4);

	if(signalvalue1==@ecu_Signals::i_S4_SRR_RL_Clu_Locationvalid_4)
	{
	testStepPass("Pass","i_S4_SRR_RL_Clu_Locationvalid_4 :%f",signalvalue1);
	}
	else
	{
	testStepFail("Fail","i_S4_SRR_RL_Clu_Locationvalid_4 :%f",signalvalue1);
	}
}

testcase S4_SRR_RL_Clu_Mes_0_S4_SRR_RL_Clu_Theta_5()
{
	signalvalue1 = getSignal(S4_SRR_RL_Clu_Theta_5);
	write("S4_SRR_RL_Clu_Theta_5 :%f",signalvalue1);
	write("i_S4_SRR_RL_Clu_Theta_5 :%f",@ecu_Signals::i_S4_SRR_RL_Clu_Theta_5);

	testStep("get expect variable value: ","i_S4_SRR_RL_Clu_Theta_5 :%f",@ecu_Signals::i_S4_SRR_RL_Clu_Theta_5);

	if((abs(@ecu_Signals::i_S4_SRR_RL_Clu_Theta_5)*0.9<=abs(signalvalue1))&&(abs(signalvalue1)<=abs(@ecu_Signals::i_S4_SRR_RL_Clu_Theta_5)*1.1))
	{
	testStepPass("Pass","i_S4_SRR_RL_Clu_Theta_5 :%f",signalvalue1);
	}
	else
	{
	testStepFail("Fail","i_S4_SRR_RL_Clu_Theta_5 :%f",signalvalue1);
	}
}

testcase S4_SRR_RL_Clu_Mes_0_S4_SRR_RL_Clu_Dist_5()
{
	signalvalue1 = getSignal(S4_SRR_RL_Clu_Dist_5);
	write("S4_SRR_RL_Clu_Dist_5 :%f",signalvalue1);
	write("i_S4_SRR_RL_Clu_Dist_5 :%f",@ecu_Signals::i_S4_SRR_RL_Clu_Dist_5);

	testStep("get expect variable value: ","i_S4_SRR_RL_Clu_Dist_5 :%f",@ecu_Signals::i_S4_SRR_RL_Clu_Dist_5);

	if((abs(@ecu_Signals::i_S4_SRR_RL_Clu_Dist_5)*0.9<=abs(signalvalue1))&&(abs(signalvalue1)<=abs(@ecu_Signals::i_S4_SRR_RL_Clu_Dist_5)*1.1))
	{
	testStepPass("Pass","i_S4_SRR_RL_Clu_Dist_5 :%f",signalvalue1);
	}
	else
	{
	testStepFail("Fail","i_S4_SRR_RL_Clu_Dist_5 :%f",signalvalue1);
	}
}

testcase S4_SRR_RL_Clu_Mes_0_S4_SRR_RL_Clu_Vel_5()
{
	signalvalue1 = getSignal(S4_SRR_RL_Clu_Vel_5);
	write("S4_SRR_RL_Clu_Vel_5 :%f",signalvalue1);
	write("i_S4_SRR_RL_Clu_Vel_5 :%f",@ecu_Signals::i_S4_SRR_RL_Clu_Vel_5);

	testStep("get expect variable value: ","i_S4_SRR_RL_Clu_Vel_5 :%f",@ecu_Signals::i_S4_SRR_RL_Clu_Vel_5);

	if((abs(@ecu_Signals::i_S4_SRR_RL_Clu_Vel_5)*0.9<=abs(signalvalue1))&&(abs(signalvalue1)<=abs(@ecu_Signals::i_S4_SRR_RL_Clu_Vel_5)*1.1))
	{
	testStepPass("Pass","i_S4_SRR_RL_Clu_Vel_5 :%f",signalvalue1);
	}
	else
	{
	testStepFail("Fail","i_S4_SRR_RL_Clu_Vel_5 :%f",signalvalue1);
	}
}

testcase S4_SRR_RL_Clu_Mes_0_S4_SRR_RL_Clu_SNR_5()
{
	signalvalue1 = getSignal(S4_SRR_RL_Clu_SNR_5);
	write("S4_SRR_RL_Clu_SNR_5 :%f",signalvalue1);
	write("i_S4_SRR_RL_Clu_SNR_5 :%f",@ecu_Signals::i_S4_SRR_RL_Clu_SNR_5);

	testStep("get expect variable value: ","i_S4_SRR_RL_Clu_SNR_5 :%f",@ecu_Signals::i_S4_SRR_RL_Clu_SNR_5);

	if((abs(@ecu_Signals::i_S4_SRR_RL_Clu_SNR_5)*0.9<=abs(signalvalue1))&&(abs(signalvalue1)<=abs(@ecu_Signals::i_S4_SRR_RL_Clu_SNR_5)*1.1))
	{
	testStepPass("Pass","i_S4_SRR_RL_Clu_SNR_5 :%f",signalvalue1);
	}
	else
	{
	testStepFail("Fail","i_S4_SRR_RL_Clu_SNR_5 :%f",signalvalue1);
	}
}

testcase S4_SRR_RL_Clu_Mes_0_S4_SRR_RL_Clu_DynProp_5()
{
	signalvalue1 = getSignal(S4_SRR_RL_Clu_DynProp_5);
	write("S4_SRR_RL_Clu_DynProp_5 :%f",signalvalue1);
	write("i_S4_SRR_RL_Clu_DynProp_5 :%o",@ecu_Signals::i_S4_SRR_RL_Clu_DynProp_5);

	testStep("get expect variable value: ","i_S4_SRR_RL_Clu_DynProp_5 :%o",@ecu_Signals::i_S4_SRR_RL_Clu_DynProp_5);

	if(signalvalue1==@ecu_Signals::i_S4_SRR_RL_Clu_DynProp_5)
	{
	testStepPass("Pass","i_S4_SRR_RL_Clu_DynProp_5 :%f",signalvalue1);
	}
	else
	{
	testStepFail("Fail","i_S4_SRR_RL_Clu_DynProp_5 :%f",signalvalue1);
	}
}

testcase S4_SRR_RL_Clu_Mes_0_S4_SRR_RL_Clu_Locationvalid_5()
{
	signalvalue1 = getSignal(S4_SRR_RL_Clu_Locationvalid_5);
	write("S4_SRR_RL_Clu_Locationvalid_5 :%f",signalvalue1);
	write("i_S4_SRR_RL_Clu_Locationvalid_5 :%o",@ecu_Signals::i_S4_SRR_RL_Clu_Locationvalid_5);

	testStep("get expect variable value: ","i_S4_SRR_RL_Clu_Locationvalid_5 :%o",@ecu_Signals::i_S4_SRR_RL_Clu_Locationvalid_5);

	if(signalvalue1==@ecu_Signals::i_S4_SRR_RL_Clu_Locationvalid_5)
	{
	testStepPass("Pass","i_S4_SRR_RL_Clu_Locationvalid_5 :%f",signalvalue1);
	}
	else
	{
	testStepFail("Fail","i_S4_SRR_RL_Clu_Locationvalid_5 :%f",signalvalue1);
	}
}

testcase S4_SRR_RL_Clu_Mes_0_S4_SRR_RL_Clu_Theta_6()
{
	signalvalue1 = getSignal(S4_SRR_RL_Clu_Theta_6);
	write("S4_SRR_RL_Clu_Theta_6 :%f",signalvalue1);
	write("i_S4_SRR_RL_Clu_Theta_6 :%f",@ecu_Signals::i_S4_SRR_RL_Clu_Theta_6);

	testStep("get expect variable value: ","i_S4_SRR_RL_Clu_Theta_6 :%f",@ecu_Signals::i_S4_SRR_RL_Clu_Theta_6);

	if((abs(@ecu_Signals::i_S4_SRR_RL_Clu_Theta_6)*0.9<=abs(signalvalue1))&&(abs(signalvalue1)<=abs(@ecu_Signals::i_S4_SRR_RL_Clu_Theta_6)*1.1))
	{
	testStepPass("Pass","i_S4_SRR_RL_Clu_Theta_6 :%f",signalvalue1);
	}
	else
	{
	testStepFail("Fail","i_S4_SRR_RL_Clu_Theta_6 :%f",signalvalue1);
	}
}

testcase S4_SRR_RL_Clu_Mes_0_S4_SRR_RL_Clu_Dist_6()
{
	signalvalue1 = getSignal(S4_SRR_RL_Clu_Dist_6);
	write("S4_SRR_RL_Clu_Dist_6 :%f",signalvalue1);
	write("i_S4_SRR_RL_Clu_Dist_6 :%f",@ecu_Signals::i_S4_SRR_RL_Clu_Dist_6);

	testStep("get expect variable value: ","i_S4_SRR_RL_Clu_Dist_6 :%f",@ecu_Signals::i_S4_SRR_RL_Clu_Dist_6);

	if((abs(@ecu_Signals::i_S4_SRR_RL_Clu_Dist_6)*0.9<=abs(signalvalue1))&&(abs(signalvalue1)<=abs(@ecu_Signals::i_S4_SRR_RL_Clu_Dist_6)*1.1))
	{
	testStepPass("Pass","i_S4_SRR_RL_Clu_Dist_6 :%f",signalvalue1);
	}
	else
	{
	testStepFail("Fail","i_S4_SRR_RL_Clu_Dist_6 :%f",signalvalue1);
	}
}

testcase S4_SRR_RL_Clu_Mes_0_S4_SRR_RL_Clu_Vel_6()
{
	signalvalue1 = getSignal(S4_SRR_RL_Clu_Vel_6);
	write("S4_SRR_RL_Clu_Vel_6 :%f",signalvalue1);
	write("i_S4_SRR_RL_Clu_Vel_6 :%f",@ecu_Signals::i_S4_SRR_RL_Clu_Vel_6);

	testStep("get expect variable value: ","i_S4_SRR_RL_Clu_Vel_6 :%f",@ecu_Signals::i_S4_SRR_RL_Clu_Vel_6);

	if((abs(@ecu_Signals::i_S4_SRR_RL_Clu_Vel_6)*0.9<=abs(signalvalue1))&&(abs(signalvalue1)<=abs(@ecu_Signals::i_S4_SRR_RL_Clu_Vel_6)*1.1))
	{
	testStepPass("Pass","i_S4_SRR_RL_Clu_Vel_6 :%f",signalvalue1);
	}
	else
	{
	testStepFail("Fail","i_S4_SRR_RL_Clu_Vel_6 :%f",signalvalue1);
	}
}

testcase S4_SRR_RL_Clu_Mes_0_S4_SRR_RL_Clu_SNR_6()
{
	signalvalue1 = getSignal(S4_SRR_RL_Clu_SNR_6);
	write("S4_SRR_RL_Clu_SNR_6 :%f",signalvalue1);
	write("i_S4_SRR_RL_Clu_SNR_6 :%f",@ecu_Signals::i_S4_SRR_RL_Clu_SNR_6);

	testStep("get expect variable value: ","i_S4_SRR_RL_Clu_SNR_6 :%f",@ecu_Signals::i_S4_SRR_RL_Clu_SNR_6);

	if((abs(@ecu_Signals::i_S4_SRR_RL_Clu_SNR_6)*0.9<=abs(signalvalue1))&&(abs(signalvalue1)<=abs(@ecu_Signals::i_S4_SRR_RL_Clu_SNR_6)*1.1))
	{
	testStepPass("Pass","i_S4_SRR_RL_Clu_SNR_6 :%f",signalvalue1);
	}
	else
	{
	testStepFail("Fail","i_S4_SRR_RL_Clu_SNR_6 :%f",signalvalue1);
	}
}

testcase S4_SRR_RL_Clu_Mes_0_S4_SRR_RL_Clu_DynProp_6()
{
	signalvalue1 = getSignal(S4_SRR_RL_Clu_DynProp_6);
	write("S4_SRR_RL_Clu_DynProp_6 :%f",signalvalue1);
	write("i_S4_SRR_RL_Clu_DynProp_6 :%o",@ecu_Signals::i_S4_SRR_RL_Clu_DynProp_6);

	testStep("get expect variable value: ","i_S4_SRR_RL_Clu_DynProp_6 :%o",@ecu_Signals::i_S4_SRR_RL_Clu_DynProp_6);

	if(signalvalue1==@ecu_Signals::i_S4_SRR_RL_Clu_DynProp_6)
	{
	testStepPass("Pass","i_S4_SRR_RL_Clu_DynProp_6 :%f",signalvalue1);
	}
	else
	{
	testStepFail("Fail","i_S4_SRR_RL_Clu_DynProp_6 :%f",signalvalue1);
	}
}

testcase S4_SRR_RL_Clu_Mes_0_S4_SRR_RL_Clu_Locationvalid_6()
{
	signalvalue1 = getSignal(S4_SRR_RL_Clu_Locationvalid_6);
	write("S4_SRR_RL_Clu_Locationvalid_6 :%f",signalvalue1);
	write("i_S4_SRR_RL_Clu_Locationvalid_6 :%o",@ecu_Signals::i_S4_SRR_RL_Clu_Locationvalid_6);

	testStep("get expect variable value: ","i_S4_SRR_RL_Clu_Locationvalid_6 :%o",@ecu_Signals::i_S4_SRR_RL_Clu_Locationvalid_6);

	if(signalvalue1==@ecu_Signals::i_S4_SRR_RL_Clu_Locationvalid_6)
	{
	testStepPass("Pass","i_S4_SRR_RL_Clu_Locationvalid_6 :%f",signalvalue1);
	}
	else
	{
	testStepFail("Fail","i_S4_SRR_RL_Clu_Locationvalid_6 :%f",signalvalue1);
	}
}

testcase S4_SRR_RL_Clu_Mes_1_S4_SRR_RL_Clu_Theta_7()
{
	signalvalue1 = getSignal(S4_SRR_RL_Clu_Theta_7);
	write("S4_SRR_RL_Clu_Theta_7 :%f",signalvalue1);
	write("i_S4_SRR_RL_Clu_Theta_7 :%f",@ecu_Signals::i_S4_SRR_RL_Clu_Theta_7);

	testStep("get expect variable value: ","i_S4_SRR_RL_Clu_Theta_7 :%f",@ecu_Signals::i_S4_SRR_RL_Clu_Theta_7);

	if((abs(@ecu_Signals::i_S4_SRR_RL_Clu_Theta_7)*0.9<=abs(signalvalue1))&&(abs(signalvalue1)<=abs(@ecu_Signals::i_S4_SRR_RL_Clu_Theta_7)*1.1))
	{
	testStepPass("Pass","i_S4_SRR_RL_Clu_Theta_7 :%f",signalvalue1);
	}
	else
	{
	testStepFail("Fail","i_S4_SRR_RL_Clu_Theta_7 :%f",signalvalue1);
	}
}

testcase S4_SRR_RL_Clu_Mes_1_S4_SRR_RL_Clu_Dist_7()
{
	signalvalue1 = getSignal(S4_SRR_RL_Clu_Dist_7);
	write("S4_SRR_RL_Clu_Dist_7 :%f",signalvalue1);
	write("i_S4_SRR_RL_Clu_Dist_7 :%f",@ecu_Signals::i_S4_SRR_RL_Clu_Dist_7);

	testStep("get expect variable value: ","i_S4_SRR_RL_Clu_Dist_7 :%f",@ecu_Signals::i_S4_SRR_RL_Clu_Dist_7);

	if((abs(@ecu_Signals::i_S4_SRR_RL_Clu_Dist_7)*0.9<=abs(signalvalue1))&&(abs(signalvalue1)<=abs(@ecu_Signals::i_S4_SRR_RL_Clu_Dist_7)*1.1))
	{
	testStepPass("Pass","i_S4_SRR_RL_Clu_Dist_7 :%f",signalvalue1);
	}
	else
	{
	testStepFail("Fail","i_S4_SRR_RL_Clu_Dist_7 :%f",signalvalue1);
	}
}

testcase S4_SRR_RL_Clu_Mes_1_S4_SRR_RL_Clu_Vel_7()
{
	signalvalue1 = getSignal(S4_SRR_RL_Clu_Vel_7);
	write("S4_SRR_RL_Clu_Vel_7 :%f",signalvalue1);
	write("i_S4_SRR_RL_Clu_Vel_7 :%f",@ecu_Signals::i_S4_SRR_RL_Clu_Vel_7);

	testStep("get expect variable value: ","i_S4_SRR_RL_Clu_Vel_7 :%f",@ecu_Signals::i_S4_SRR_RL_Clu_Vel_7);

	if((abs(@ecu_Signals::i_S4_SRR_RL_Clu_Vel_7)*0.9<=abs(signalvalue1))&&(abs(signalvalue1)<=abs(@ecu_Signals::i_S4_SRR_RL_Clu_Vel_7)*1.1))
	{
	testStepPass("Pass","i_S4_SRR_RL_Clu_Vel_7 :%f",signalvalue1);
	}
	else
	{
	testStepFail("Fail","i_S4_SRR_RL_Clu_Vel_7 :%f",signalvalue1);
	}
}

testcase S4_SRR_RL_Clu_Mes_1_S4_SRR_RL_Clu_SNR_7()
{
	signalvalue1 = getSignal(S4_SRR_RL_Clu_SNR_7);
	write("S4_SRR_RL_Clu_SNR_7 :%f",signalvalue1);
	write("i_S4_SRR_RL_Clu_SNR_7 :%f",@ecu_Signals::i_S4_SRR_RL_Clu_SNR_7);

	testStep("get expect variable value: ","i_S4_SRR_RL_Clu_SNR_7 :%f",@ecu_Signals::i_S4_SRR_RL_Clu_SNR_7);

	if((abs(@ecu_Signals::i_S4_SRR_RL_Clu_SNR_7)*0.9<=abs(signalvalue1))&&(abs(signalvalue1)<=abs(@ecu_Signals::i_S4_SRR_RL_Clu_SNR_7)*1.1))
	{
	testStepPass("Pass","i_S4_SRR_RL_Clu_SNR_7 :%f",signalvalue1);
	}
	else
	{
	testStepFail("Fail","i_S4_SRR_RL_Clu_SNR_7 :%f",signalvalue1);
	}
}

testcase S4_SRR_RL_Clu_Mes_1_S4_SRR_RL_Clu_DynProp_7()
{
	signalvalue1 = getSignal(S4_SRR_RL_Clu_DynProp_7);
	write("S4_SRR_RL_Clu_DynProp_7 :%f",signalvalue1);
	write("i_S4_SRR_RL_Clu_DynProp_7 :%o",@ecu_Signals::i_S4_SRR_RL_Clu_DynProp_7);

	testStep("get expect variable value: ","i_S4_SRR_RL_Clu_DynProp_7 :%o",@ecu_Signals::i_S4_SRR_RL_Clu_DynProp_7);

	if(signalvalue1==@ecu_Signals::i_S4_SRR_RL_Clu_DynProp_7)
	{
	testStepPass("Pass","i_S4_SRR_RL_Clu_DynProp_7 :%f",signalvalue1);
	}
	else
	{
	testStepFail("Fail","i_S4_SRR_RL_Clu_DynProp_7 :%f",signalvalue1);
	}
}

testcase S4_SRR_RL_Clu_Mes_1_S4_SRR_RL_Clu_Locationvalid_7()
{
	signalvalue1 = getSignal(S4_SRR_RL_Clu_Locationvalid_7);
	write("S4_SRR_RL_Clu_Locationvalid_7 :%f",signalvalue1);
	write("i_S4_SRR_RL_Clu_Locationvalid_7 :%o",@ecu_Signals::i_S4_SRR_RL_Clu_Locationvalid_7);

	testStep("get expect variable value: ","i_S4_SRR_RL_Clu_Locationvalid_7 :%o",@ecu_Signals::i_S4_SRR_RL_Clu_Locationvalid_7);

	if(signalvalue1==@ecu_Signals::i_S4_SRR_RL_Clu_Locationvalid_7)
	{
	testStepPass("Pass","i_S4_SRR_RL_Clu_Locationvalid_7 :%f",signalvalue1);
	}
	else
	{
	testStepFail("Fail","i_S4_SRR_RL_Clu_Locationvalid_7 :%f",signalvalue1);
	}
}

testcase S4_SRR_RL_Clu_Mes_1_S4_SRR_RL_Clu_Theta_8()
{
	signalvalue1 = getSignal(S4_SRR_RL_Clu_Theta_8);
	write("S4_SRR_RL_Clu_Theta_8 :%f",signalvalue1);
	write("i_S4_SRR_RL_Clu_Theta_8 :%f",@ecu_Signals::i_S4_SRR_RL_Clu_Theta_8);

	testStep("get expect variable value: ","i_S4_SRR_RL_Clu_Theta_8 :%f",@ecu_Signals::i_S4_SRR_RL_Clu_Theta_8);

	if((abs(@ecu_Signals::i_S4_SRR_RL_Clu_Theta_8)*0.9<=abs(signalvalue1))&&(abs(signalvalue1)<=abs(@ecu_Signals::i_S4_SRR_RL_Clu_Theta_8)*1.1))
	{
	testStepPass("Pass","i_S4_SRR_RL_Clu_Theta_8 :%f",signalvalue1);
	}
	else
	{
	testStepFail("Fail","i_S4_SRR_RL_Clu_Theta_8 :%f",signalvalue1);
	}
}

testcase S4_SRR_RL_Clu_Mes_1_S4_SRR_RL_Clu_Dist_8()
{
	signalvalue1 = getSignal(S4_SRR_RL_Clu_Dist_8);
	write("S4_SRR_RL_Clu_Dist_8 :%f",signalvalue1);
	write("i_S4_SRR_RL_Clu_Dist_8 :%f",@ecu_Signals::i_S4_SRR_RL_Clu_Dist_8);

	testStep("get expect variable value: ","i_S4_SRR_RL_Clu_Dist_8 :%f",@ecu_Signals::i_S4_SRR_RL_Clu_Dist_8);

	if((abs(@ecu_Signals::i_S4_SRR_RL_Clu_Dist_8)*0.9<=abs(signalvalue1))&&(abs(signalvalue1)<=abs(@ecu_Signals::i_S4_SRR_RL_Clu_Dist_8)*1.1))
	{
	testStepPass("Pass","i_S4_SRR_RL_Clu_Dist_8 :%f",signalvalue1);
	}
	else
	{
	testStepFail("Fail","i_S4_SRR_RL_Clu_Dist_8 :%f",signalvalue1);
	}
}

testcase S4_SRR_RL_Clu_Mes_1_S4_SRR_RL_Clu_Vel_8()
{
	signalvalue1 = getSignal(S4_SRR_RL_Clu_Vel_8);
	write("S4_SRR_RL_Clu_Vel_8 :%f",signalvalue1);
	write("i_S4_SRR_RL_Clu_Vel_8 :%f",@ecu_Signals::i_S4_SRR_RL_Clu_Vel_8);

	testStep("get expect variable value: ","i_S4_SRR_RL_Clu_Vel_8 :%f",@ecu_Signals::i_S4_SRR_RL_Clu_Vel_8);

	if((abs(@ecu_Signals::i_S4_SRR_RL_Clu_Vel_8)*0.9<=abs(signalvalue1))&&(abs(signalvalue1)<=abs(@ecu_Signals::i_S4_SRR_RL_Clu_Vel_8)*1.1))
	{
	testStepPass("Pass","i_S4_SRR_RL_Clu_Vel_8 :%f",signalvalue1);
	}
	else
	{
	testStepFail("Fail","i_S4_SRR_RL_Clu_Vel_8 :%f",signalvalue1);
	}
}

testcase S4_SRR_RL_Clu_Mes_1_S4_SRR_RL_Clu_SNR_8()
{
	signalvalue1 = getSignal(S4_SRR_RL_Clu_SNR_8);
	write("S4_SRR_RL_Clu_SNR_8 :%f",signalvalue1);
	write("i_S4_SRR_RL_Clu_SNR_8 :%f",@ecu_Signals::i_S4_SRR_RL_Clu_SNR_8);

	testStep("get expect variable value: ","i_S4_SRR_RL_Clu_SNR_8 :%f",@ecu_Signals::i_S4_SRR_RL_Clu_SNR_8);

	if((abs(@ecu_Signals::i_S4_SRR_RL_Clu_SNR_8)*0.9<=abs(signalvalue1))&&(abs(signalvalue1)<=abs(@ecu_Signals::i_S4_SRR_RL_Clu_SNR_8)*1.1))
	{
	testStepPass("Pass","i_S4_SRR_RL_Clu_SNR_8 :%f",signalvalue1);
	}
	else
	{
	testStepFail("Fail","i_S4_SRR_RL_Clu_SNR_8 :%f",signalvalue1);
	}
}

testcase S4_SRR_RL_Clu_Mes_1_S4_SRR_RL_Clu_DynProp_8()
{
	signalvalue1 = getSignal(S4_SRR_RL_Clu_DynProp_8);
	write("S4_SRR_RL_Clu_DynProp_8 :%f",signalvalue1);
	write("i_S4_SRR_RL_Clu_DynProp_8 :%o",@ecu_Signals::i_S4_SRR_RL_Clu_DynProp_8);

	testStep("get expect variable value: ","i_S4_SRR_RL_Clu_DynProp_8 :%o",@ecu_Signals::i_S4_SRR_RL_Clu_DynProp_8);

	if(signalvalue1==@ecu_Signals::i_S4_SRR_RL_Clu_DynProp_8)
	{
	testStepPass("Pass","i_S4_SRR_RL_Clu_DynProp_8 :%f",signalvalue1);
	}
	else
	{
	testStepFail("Fail","i_S4_SRR_RL_Clu_DynProp_8 :%f",signalvalue1);
	}
}

testcase S4_SRR_RL_Clu_Mes_1_S4_SRR_RL_Clu_Locationvalid_8()
{
	signalvalue1 = getSignal(S4_SRR_RL_Clu_Locationvalid_8);
	write("S4_SRR_RL_Clu_Locationvalid_8 :%f",signalvalue1);
	write("i_S4_SRR_RL_Clu_Locationvalid_8 :%o",@ecu_Signals::i_S4_SRR_RL_Clu_Locationvalid_8);

	testStep("get expect variable value: ","i_S4_SRR_RL_Clu_Locationvalid_8 :%o",@ecu_Signals::i_S4_SRR_RL_Clu_Locationvalid_8);

	if(signalvalue1==@ecu_Signals::i_S4_SRR_RL_Clu_Locationvalid_8)
	{
	testStepPass("Pass","i_S4_SRR_RL_Clu_Locationvalid_8 :%f",signalvalue1);
	}
	else
	{
	testStepFail("Fail","i_S4_SRR_RL_Clu_Locationvalid_8 :%f",signalvalue1);
	}
}

testcase S4_SRR_RL_Clu_Mes_1_S4_SRR_RL_Clu_Theta_9()
{
	signalvalue1 = getSignal(S4_SRR_RL_Clu_Theta_9);
	write("S4_SRR_RL_Clu_Theta_9 :%f",signalvalue1);
	write("i_S4_SRR_RL_Clu_Theta_9 :%f",@ecu_Signals::i_S4_SRR_RL_Clu_Theta_9);

	testStep("get expect variable value: ","i_S4_SRR_RL_Clu_Theta_9 :%f",@ecu_Signals::i_S4_SRR_RL_Clu_Theta_9);

	if((abs(@ecu_Signals::i_S4_SRR_RL_Clu_Theta_9)*0.9<=abs(signalvalue1))&&(abs(signalvalue1)<=abs(@ecu_Signals::i_S4_SRR_RL_Clu_Theta_9)*1.1))
	{
	testStepPass("Pass","i_S4_SRR_RL_Clu_Theta_9 :%f",signalvalue1);
	}
	else
	{
	testStepFail("Fail","i_S4_SRR_RL_Clu_Theta_9 :%f",signalvalue1);
	}
}

testcase S4_SRR_RL_Clu_Mes_1_S4_SRR_RL_Clu_Dist_9()
{
	signalvalue1 = getSignal(S4_SRR_RL_Clu_Dist_9);
	write("S4_SRR_RL_Clu_Dist_9 :%f",signalvalue1);
	write("i_S4_SRR_RL_Clu_Dist_9 :%f",@ecu_Signals::i_S4_SRR_RL_Clu_Dist_9);

	testStep("get expect variable value: ","i_S4_SRR_RL_Clu_Dist_9 :%f",@ecu_Signals::i_S4_SRR_RL_Clu_Dist_9);

	if((abs(@ecu_Signals::i_S4_SRR_RL_Clu_Dist_9)*0.9<=abs(signalvalue1))&&(abs(signalvalue1)<=abs(@ecu_Signals::i_S4_SRR_RL_Clu_Dist_9)*1.1))
	{
	testStepPass("Pass","i_S4_SRR_RL_Clu_Dist_9 :%f",signalvalue1);
	}
	else
	{
	testStepFail("Fail","i_S4_SRR_RL_Clu_Dist_9 :%f",signalvalue1);
	}
}

testcase S4_SRR_RL_Clu_Mes_1_S4_SRR_RL_Clu_Vel_9()
{
	signalvalue1 = getSignal(S4_SRR_RL_Clu_Vel_9);
	write("S4_SRR_RL_Clu_Vel_9 :%f",signalvalue1);
	write("i_S4_SRR_RL_Clu_Vel_9 :%f",@ecu_Signals::i_S4_SRR_RL_Clu_Vel_9);

	testStep("get expect variable value: ","i_S4_SRR_RL_Clu_Vel_9 :%f",@ecu_Signals::i_S4_SRR_RL_Clu_Vel_9);

	if((abs(@ecu_Signals::i_S4_SRR_RL_Clu_Vel_9)*0.9<=abs(signalvalue1))&&(abs(signalvalue1)<=abs(@ecu_Signals::i_S4_SRR_RL_Clu_Vel_9)*1.1))
	{
	testStepPass("Pass","i_S4_SRR_RL_Clu_Vel_9 :%f",signalvalue1);
	}
	else
	{
	testStepFail("Fail","i_S4_SRR_RL_Clu_Vel_9 :%f",signalvalue1);
	}
}

testcase S4_SRR_RL_Clu_Mes_1_S4_SRR_RL_Clu_SNR_9()
{
	signalvalue1 = getSignal(S4_SRR_RL_Clu_SNR_9);
	write("S4_SRR_RL_Clu_SNR_9 :%f",signalvalue1);
	write("i_S4_SRR_RL_Clu_SNR_9 :%f",@ecu_Signals::i_S4_SRR_RL_Clu_SNR_9);

	testStep("get expect variable value: ","i_S4_SRR_RL_Clu_SNR_9 :%f",@ecu_Signals::i_S4_SRR_RL_Clu_SNR_9);

	if((abs(@ecu_Signals::i_S4_SRR_RL_Clu_SNR_9)*0.9<=abs(signalvalue1))&&(abs(signalvalue1)<=abs(@ecu_Signals::i_S4_SRR_RL_Clu_SNR_9)*1.1))
	{
	testStepPass("Pass","i_S4_SRR_RL_Clu_SNR_9 :%f",signalvalue1);
	}
	else
	{
	testStepFail("Fail","i_S4_SRR_RL_Clu_SNR_9 :%f",signalvalue1);
	}
}

testcase S4_SRR_RL_Clu_Mes_1_S4_SRR_RL_Clu_DynProp_9()
{
	signalvalue1 = getSignal(S4_SRR_RL_Clu_DynProp_9);
	write("S4_SRR_RL_Clu_DynProp_9 :%f",signalvalue1);
	write("i_S4_SRR_RL_Clu_DynProp_9 :%o",@ecu_Signals::i_S4_SRR_RL_Clu_DynProp_9);

	testStep("get expect variable value: ","i_S4_SRR_RL_Clu_DynProp_9 :%o",@ecu_Signals::i_S4_SRR_RL_Clu_DynProp_9);

	if(signalvalue1==@ecu_Signals::i_S4_SRR_RL_Clu_DynProp_9)
	{
	testStepPass("Pass","i_S4_SRR_RL_Clu_DynProp_9 :%f",signalvalue1);
	}
	else
	{
	testStepFail("Fail","i_S4_SRR_RL_Clu_DynProp_9 :%f",signalvalue1);
	}
}

testcase S4_SRR_RL_Clu_Mes_1_S4_SRR_RL_Clu_Locationvalid_9()
{
	signalvalue1 = getSignal(S4_SRR_RL_Clu_Locationvalid_9);
	write("S4_SRR_RL_Clu_Locationvalid_9 :%f",signalvalue1);
	write("i_S4_SRR_RL_Clu_Locationvalid_9 :%o",@ecu_Signals::i_S4_SRR_RL_Clu_Locationvalid_9);

	testStep("get expect variable value: ","i_S4_SRR_RL_Clu_Locationvalid_9 :%o",@ecu_Signals::i_S4_SRR_RL_Clu_Locationvalid_9);

	if(signalvalue1==@ecu_Signals::i_S4_SRR_RL_Clu_Locationvalid_9)
	{
	testStepPass("Pass","i_S4_SRR_RL_Clu_Locationvalid_9 :%f",signalvalue1);
	}
	else
	{
	testStepFail("Fail","i_S4_SRR_RL_Clu_Locationvalid_9 :%f",signalvalue1);
	}
}

testcase S4_SRR_RL_Clu_Mes_1_S4_SRR_RL_Clu_Theta_10()
{
	signalvalue1 = getSignal(S4_SRR_RL_Clu_Theta_10);
	write("S4_SRR_RL_Clu_Theta_10 :%f",signalvalue1);
	write("i_S4_SRR_RL_Clu_Theta_10 :%f",@ecu_Signals::i_S4_SRR_RL_Clu_Theta_10);

	testStep("get expect variable value: ","i_S4_SRR_RL_Clu_Theta_10 :%f",@ecu_Signals::i_S4_SRR_RL_Clu_Theta_10);

	if((abs(@ecu_Signals::i_S4_SRR_RL_Clu_Theta_10)*0.9<=abs(signalvalue1))&&(abs(signalvalue1)<=abs(@ecu_Signals::i_S4_SRR_RL_Clu_Theta_10)*1.1))
	{
	testStepPass("Pass","i_S4_SRR_RL_Clu_Theta_10 :%f",signalvalue1);
	}
	else
	{
	testStepFail("Fail","i_S4_SRR_RL_Clu_Theta_10 :%f",signalvalue1);
	}
}

testcase S4_SRR_RL_Clu_Mes_1_S4_SRR_RL_Clu_Dist_10()
{
	signalvalue1 = getSignal(S4_SRR_RL_Clu_Dist_10);
	write("S4_SRR_RL_Clu_Dist_10 :%f",signalvalue1);
	write("i_S4_SRR_RL_Clu_Dist_10 :%f",@ecu_Signals::i_S4_SRR_RL_Clu_Dist_10);

	testStep("get expect variable value: ","i_S4_SRR_RL_Clu_Dist_10 :%f",@ecu_Signals::i_S4_SRR_RL_Clu_Dist_10);

	if((abs(@ecu_Signals::i_S4_SRR_RL_Clu_Dist_10)*0.9<=abs(signalvalue1))&&(abs(signalvalue1)<=abs(@ecu_Signals::i_S4_SRR_RL_Clu_Dist_10)*1.1))
	{
	testStepPass("Pass","i_S4_SRR_RL_Clu_Dist_10 :%f",signalvalue1);
	}
	else
	{
	testStepFail("Fail","i_S4_SRR_RL_Clu_Dist_10 :%f",signalvalue1);
	}
}

testcase S4_SRR_RL_Clu_Mes_1_S4_SRR_RL_Clu_Vel_10()
{
	signalvalue1 = getSignal(S4_SRR_RL_Clu_Vel_10);
	write("S4_SRR_RL_Clu_Vel_10 :%f",signalvalue1);
	write("i_S4_SRR_RL_Clu_Vel_10 :%f",@ecu_Signals::i_S4_SRR_RL_Clu_Vel_10);

	testStep("get expect variable value: ","i_S4_SRR_RL_Clu_Vel_10 :%f",@ecu_Signals::i_S4_SRR_RL_Clu_Vel_10);

	if((abs(@ecu_Signals::i_S4_SRR_RL_Clu_Vel_10)*0.9<=abs(signalvalue1))&&(abs(signalvalue1)<=abs(@ecu_Signals::i_S4_SRR_RL_Clu_Vel_10)*1.1))
	{
	testStepPass("Pass","i_S4_SRR_RL_Clu_Vel_10 :%f",signalvalue1);
	}
	else
	{
	testStepFail("Fail","i_S4_SRR_RL_Clu_Vel_10 :%f",signalvalue1);
	}
}

testcase S4_SRR_RL_Clu_Mes_1_S4_SRR_RL_Clu_SNR_10()
{
	signalvalue1 = getSignal(S4_SRR_RL_Clu_SNR_10);
	write("S4_SRR_RL_Clu_SNR_10 :%f",signalvalue1);
	write("i_S4_SRR_RL_Clu_SNR_10 :%f",@ecu_Signals::i_S4_SRR_RL_Clu_SNR_10);

	testStep("get expect variable value: ","i_S4_SRR_RL_Clu_SNR_10 :%f",@ecu_Signals::i_S4_SRR_RL_Clu_SNR_10);

	if((abs(@ecu_Signals::i_S4_SRR_RL_Clu_SNR_10)*0.9<=abs(signalvalue1))&&(abs(signalvalue1)<=abs(@ecu_Signals::i_S4_SRR_RL_Clu_SNR_10)*1.1))
	{
	testStepPass("Pass","i_S4_SRR_RL_Clu_SNR_10 :%f",signalvalue1);
	}
	else
	{
	testStepFail("Fail","i_S4_SRR_RL_Clu_SNR_10 :%f",signalvalue1);
	}
}

testcase S4_SRR_RL_Clu_Mes_1_S4_SRR_RL_Clu_DynProp_10()
{
	signalvalue1 = getSignal(S4_SRR_RL_Clu_DynProp_10);
	write("S4_SRR_RL_Clu_DynProp_10 :%f",signalvalue1);
	write("i_S4_SRR_RL_Clu_DynProp_10 :%o",@ecu_Signals::i_S4_SRR_RL_Clu_DynProp_10);

	testStep("get expect variable value: ","i_S4_SRR_RL_Clu_DynProp_10 :%o",@ecu_Signals::i_S4_SRR_RL_Clu_DynProp_10);

	if(signalvalue1==@ecu_Signals::i_S4_SRR_RL_Clu_DynProp_10)
	{
	testStepPass("Pass","i_S4_SRR_RL_Clu_DynProp_10 :%f",signalvalue1);
	}
	else
	{
	testStepFail("Fail","i_S4_SRR_RL_Clu_DynProp_10 :%f",signalvalue1);
	}
}

testcase S4_SRR_RL_Clu_Mes_1_S4_SRR_RL_Clu_Locationvalid_10()
{
	signalvalue1 = getSignal(S4_SRR_RL_Clu_Locationvalid_10);
	write("S4_SRR_RL_Clu_Locationvalid_10 :%f",signalvalue1);
	write("i_S4_SRR_RL_Clu_Locationvalid_10 :%o",@ecu_Signals::i_S4_SRR_RL_Clu_Locationvalid_10);

	testStep("get expect variable value: ","i_S4_SRR_RL_Clu_Locationvalid_10 :%o",@ecu_Signals::i_S4_SRR_RL_Clu_Locationvalid_10);

	if(signalvalue1==@ecu_Signals::i_S4_SRR_RL_Clu_Locationvalid_10)
	{
	testStepPass("Pass","i_S4_SRR_RL_Clu_Locationvalid_10 :%f",signalvalue1);
	}
	else
	{
	testStepFail("Fail","i_S4_SRR_RL_Clu_Locationvalid_10 :%f",signalvalue1);
	}
}

testcase S4_SRR_RL_Clu_Mes_1_S4_SRR_RL_Clu_Theta_11()
{
	signalvalue1 = getSignal(S4_SRR_RL_Clu_Theta_11);
	write("S4_SRR_RL_Clu_Theta_11 :%f",signalvalue1);
	write("i_S4_SRR_RL_Clu_Theta_11 :%f",@ecu_Signals::i_S4_SRR_RL_Clu_Theta_11);

	testStep("get expect variable value: ","i_S4_SRR_RL_Clu_Theta_11 :%f",@ecu_Signals::i_S4_SRR_RL_Clu_Theta_11);

	if((abs(@ecu_Signals::i_S4_SRR_RL_Clu_Theta_11)*0.9<=abs(signalvalue1))&&(abs(signalvalue1)<=abs(@ecu_Signals::i_S4_SRR_RL_Clu_Theta_11)*1.1))
	{
	testStepPass("Pass","i_S4_SRR_RL_Clu_Theta_11 :%f",signalvalue1);
	}
	else
	{
	testStepFail("Fail","i_S4_SRR_RL_Clu_Theta_11 :%f",signalvalue1);
	}
}

testcase S4_SRR_RL_Clu_Mes_1_S4_SRR_RL_Clu_Dist_11()
{
	signalvalue1 = getSignal(S4_SRR_RL_Clu_Dist_11);
	write("S4_SRR_RL_Clu_Dist_11 :%f",signalvalue1);
	write("i_S4_SRR_RL_Clu_Dist_11 :%f",@ecu_Signals::i_S4_SRR_RL_Clu_Dist_11);

	testStep("get expect variable value: ","i_S4_SRR_RL_Clu_Dist_11 :%f",@ecu_Signals::i_S4_SRR_RL_Clu_Dist_11);

	if((abs(@ecu_Signals::i_S4_SRR_RL_Clu_Dist_11)*0.9<=abs(signalvalue1))&&(abs(signalvalue1)<=abs(@ecu_Signals::i_S4_SRR_RL_Clu_Dist_11)*1.1))
	{
	testStepPass("Pass","i_S4_SRR_RL_Clu_Dist_11 :%f",signalvalue1);
	}
	else
	{
	testStepFail("Fail","i_S4_SRR_RL_Clu_Dist_11 :%f",signalvalue1);
	}
}

testcase S4_SRR_RL_Clu_Mes_1_S4_SRR_RL_Clu_Vel_11()
{
	signalvalue1 = getSignal(S4_SRR_RL_Clu_Vel_11);
	write("S4_SRR_RL_Clu_Vel_11 :%f",signalvalue1);
	write("i_S4_SRR_RL_Clu_Vel_11 :%f",@ecu_Signals::i_S4_SRR_RL_Clu_Vel_11);

	testStep("get expect variable value: ","i_S4_SRR_RL_Clu_Vel_11 :%f",@ecu_Signals::i_S4_SRR_RL_Clu_Vel_11);

	if((abs(@ecu_Signals::i_S4_SRR_RL_Clu_Vel_11)*0.9<=abs(signalvalue1))&&(abs(signalvalue1)<=abs(@ecu_Signals::i_S4_SRR_RL_Clu_Vel_11)*1.1))
	{
	testStepPass("Pass","i_S4_SRR_RL_Clu_Vel_11 :%f",signalvalue1);
	}
	else
	{
	testStepFail("Fail","i_S4_SRR_RL_Clu_Vel_11 :%f",signalvalue1);
	}
}

testcase S4_SRR_RL_Clu_Mes_1_S4_SRR_RL_Clu_SNR_11()
{
	signalvalue1 = getSignal(S4_SRR_RL_Clu_SNR_11);
	write("S4_SRR_RL_Clu_SNR_11 :%f",signalvalue1);
	write("i_S4_SRR_RL_Clu_SNR_11 :%f",@ecu_Signals::i_S4_SRR_RL_Clu_SNR_11);

	testStep("get expect variable value: ","i_S4_SRR_RL_Clu_SNR_11 :%f",@ecu_Signals::i_S4_SRR_RL_Clu_SNR_11);

	if((abs(@ecu_Signals::i_S4_SRR_RL_Clu_SNR_11)*0.9<=abs(signalvalue1))&&(abs(signalvalue1)<=abs(@ecu_Signals::i_S4_SRR_RL_Clu_SNR_11)*1.1))
	{
	testStepPass("Pass","i_S4_SRR_RL_Clu_SNR_11 :%f",signalvalue1);
	}
	else
	{
	testStepFail("Fail","i_S4_SRR_RL_Clu_SNR_11 :%f",signalvalue1);
	}
}

testcase S4_SRR_RL_Clu_Mes_1_S4_SRR_RL_Clu_DynProp_11()
{
	signalvalue1 = getSignal(S4_SRR_RL_Clu_DynProp_11);
	write("S4_SRR_RL_Clu_DynProp_11 :%f",signalvalue1);
	write("i_S4_SRR_RL_Clu_DynProp_11 :%o",@ecu_Signals::i_S4_SRR_RL_Clu_DynProp_11);

	testStep("get expect variable value: ","i_S4_SRR_RL_Clu_DynProp_11 :%o",@ecu_Signals::i_S4_SRR_RL_Clu_DynProp_11);

	if(signalvalue1==@ecu_Signals::i_S4_SRR_RL_Clu_DynProp_11)
	{
	testStepPass("Pass","i_S4_SRR_RL_Clu_DynProp_11 :%f",signalvalue1);
	}
	else
	{
	testStepFail("Fail","i_S4_SRR_RL_Clu_DynProp_11 :%f",signalvalue1);
	}
}

testcase S4_SRR_RL_Clu_Mes_1_S4_SRR_RL_Clu_Locationvalid_11()
{
	signalvalue1 = getSignal(S4_SRR_RL_Clu_Locationvalid_11);
	write("S4_SRR_RL_Clu_Locationvalid_11 :%f",signalvalue1);
	write("i_S4_SRR_RL_Clu_Locationvalid_11 :%o",@ecu_Signals::i_S4_SRR_RL_Clu_Locationvalid_11);

	testStep("get expect variable value: ","i_S4_SRR_RL_Clu_Locationvalid_11 :%o",@ecu_Signals::i_S4_SRR_RL_Clu_Locationvalid_11);

	if(signalvalue1==@ecu_Signals::i_S4_SRR_RL_Clu_Locationvalid_11)
	{
	testStepPass("Pass","i_S4_SRR_RL_Clu_Locationvalid_11 :%f",signalvalue1);
	}
	else
	{
	testStepFail("Fail","i_S4_SRR_RL_Clu_Locationvalid_11 :%f",signalvalue1);
	}
}

testcase S4_SRR_RL_Clu_Mes_1_S4_SRR_RL_Clu_Theta_12()
{
	signalvalue1 = getSignal(S4_SRR_RL_Clu_Theta_12);
	write("S4_SRR_RL_Clu_Theta_12 :%f",signalvalue1);
	write("i_S4_SRR_RL_Clu_Theta_12 :%f",@ecu_Signals::i_S4_SRR_RL_Clu_Theta_12);

	testStep("get expect variable value: ","i_S4_SRR_RL_Clu_Theta_12 :%f",@ecu_Signals::i_S4_SRR_RL_Clu_Theta_12);

	if((abs(@ecu_Signals::i_S4_SRR_RL_Clu_Theta_12)*0.9<=abs(signalvalue1))&&(abs(signalvalue1)<=abs(@ecu_Signals::i_S4_SRR_RL_Clu_Theta_12)*1.1))
	{
	testStepPass("Pass","i_S4_SRR_RL_Clu_Theta_12 :%f",signalvalue1);
	}
	else
	{
	testStepFail("Fail","i_S4_SRR_RL_Clu_Theta_12 :%f",signalvalue1);
	}
}

testcase S4_SRR_RL_Clu_Mes_1_S4_SRR_RL_Clu_Dist_12()
{
	signalvalue1 = getSignal(S4_SRR_RL_Clu_Dist_12);
	write("S4_SRR_RL_Clu_Dist_12 :%f",signalvalue1);
	write("i_S4_SRR_RL_Clu_Dist_12 :%f",@ecu_Signals::i_S4_SRR_RL_Clu_Dist_12);

	testStep("get expect variable value: ","i_S4_SRR_RL_Clu_Dist_12 :%f",@ecu_Signals::i_S4_SRR_RL_Clu_Dist_12);

	if((abs(@ecu_Signals::i_S4_SRR_RL_Clu_Dist_12)*0.9<=abs(signalvalue1))&&(abs(signalvalue1)<=abs(@ecu_Signals::i_S4_SRR_RL_Clu_Dist_12)*1.1))
	{
	testStepPass("Pass","i_S4_SRR_RL_Clu_Dist_12 :%f",signalvalue1);
	}
	else
	{
	testStepFail("Fail","i_S4_SRR_RL_Clu_Dist_12 :%f",signalvalue1);
	}
}

testcase S4_SRR_RL_Clu_Mes_1_S4_SRR_RL_Clu_Vel_12()
{
	signalvalue1 = getSignal(S4_SRR_RL_Clu_Vel_12);
	write("S4_SRR_RL_Clu_Vel_12 :%f",signalvalue1);
	write("i_S4_SRR_RL_Clu_Vel_12 :%f",@ecu_Signals::i_S4_SRR_RL_Clu_Vel_12);

	testStep("get expect variable value: ","i_S4_SRR_RL_Clu_Vel_12 :%f",@ecu_Signals::i_S4_SRR_RL_Clu_Vel_12);

	if((abs(@ecu_Signals::i_S4_SRR_RL_Clu_Vel_12)*0.9<=abs(signalvalue1))&&(abs(signalvalue1)<=abs(@ecu_Signals::i_S4_SRR_RL_Clu_Vel_12)*1.1))
	{
	testStepPass("Pass","i_S4_SRR_RL_Clu_Vel_12 :%f",signalvalue1);
	}
	else
	{
	testStepFail("Fail","i_S4_SRR_RL_Clu_Vel_12 :%f",signalvalue1);
	}
}

testcase S4_SRR_RL_Clu_Mes_1_S4_SRR_RL_Clu_SNR_12()
{
	signalvalue1 = getSignal(S4_SRR_RL_Clu_SNR_12);
	write("S4_SRR_RL_Clu_SNR_12 :%f",signalvalue1);
	write("i_S4_SRR_RL_Clu_SNR_12 :%f",@ecu_Signals::i_S4_SRR_RL_Clu_SNR_12);

	testStep("get expect variable value: ","i_S4_SRR_RL_Clu_SNR_12 :%f",@ecu_Signals::i_S4_SRR_RL_Clu_SNR_12);

	if((abs(@ecu_Signals::i_S4_SRR_RL_Clu_SNR_12)*0.9<=abs(signalvalue1))&&(abs(signalvalue1)<=abs(@ecu_Signals::i_S4_SRR_RL_Clu_SNR_12)*1.1))
	{
	testStepPass("Pass","i_S4_SRR_RL_Clu_SNR_12 :%f",signalvalue1);
	}
	else
	{
	testStepFail("Fail","i_S4_SRR_RL_Clu_SNR_12 :%f",signalvalue1);
	}
}

testcase S4_SRR_RL_Clu_Mes_1_S4_SRR_RL_Clu_DynProp_12()
{
	signalvalue1 = getSignal(S4_SRR_RL_Clu_DynProp_12);
	write("S4_SRR_RL_Clu_DynProp_12 :%f",signalvalue1);
	write("i_S4_SRR_RL_Clu_DynProp_12 :%o",@ecu_Signals::i_S4_SRR_RL_Clu_DynProp_12);

	testStep("get expect variable value: ","i_S4_SRR_RL_Clu_DynProp_12 :%o",@ecu_Signals::i_S4_SRR_RL_Clu_DynProp_12);

	if(signalvalue1==@ecu_Signals::i_S4_SRR_RL_Clu_DynProp_12)
	{
	testStepPass("Pass","i_S4_SRR_RL_Clu_DynProp_12 :%f",signalvalue1);
	}
	else
	{
	testStepFail("Fail","i_S4_SRR_RL_Clu_DynProp_12 :%f",signalvalue1);
	}
}

testcase S4_SRR_RL_Clu_Mes_1_S4_SRR_RL_Clu_Locationvalid_12()
{
	signalvalue1 = getSignal(S4_SRR_RL_Clu_Locationvalid_12);
	write("S4_SRR_RL_Clu_Locationvalid_12 :%f",signalvalue1);
	write("i_S4_SRR_RL_Clu_Locationvalid_12 :%o",@ecu_Signals::i_S4_SRR_RL_Clu_Locationvalid_12);

	testStep("get expect variable value: ","i_S4_SRR_RL_Clu_Locationvalid_12 :%o",@ecu_Signals::i_S4_SRR_RL_Clu_Locationvalid_12);

	if(signalvalue1==@ecu_Signals::i_S4_SRR_RL_Clu_Locationvalid_12)
	{
	testStepPass("Pass","i_S4_SRR_RL_Clu_Locationvalid_12 :%f",signalvalue1);
	}
	else
	{
	testStepFail("Fail","i_S4_SRR_RL_Clu_Locationvalid_12 :%f",signalvalue1);
	}
}

testcase S4_SRR_RL_Clu_Mes_1_S4_SRR_RL_Clu_Theta_13()
{
	signalvalue1 = getSignal(S4_SRR_RL_Clu_Theta_13);
	write("S4_SRR_RL_Clu_Theta_13 :%f",signalvalue1);
	write("i_S4_SRR_RL_Clu_Theta_13 :%f",@ecu_Signals::i_S4_SRR_RL_Clu_Theta_13);

	testStep("get expect variable value: ","i_S4_SRR_RL_Clu_Theta_13 :%f",@ecu_Signals::i_S4_SRR_RL_Clu_Theta_13);

	if((abs(@ecu_Signals::i_S4_SRR_RL_Clu_Theta_13)*0.9<=abs(signalvalue1))&&(abs(signalvalue1)<=abs(@ecu_Signals::i_S4_SRR_RL_Clu_Theta_13)*1.1))
	{
	testStepPass("Pass","i_S4_SRR_RL_Clu_Theta_13 :%f",signalvalue1);
	}
	else
	{
	testStepFail("Fail","i_S4_SRR_RL_Clu_Theta_13 :%f",signalvalue1);
	}
}

testcase S4_SRR_RL_Clu_Mes_1_S4_SRR_RL_Clu_Dist_13()
{
	signalvalue1 = getSignal(S4_SRR_RL_Clu_Dist_13);
	write("S4_SRR_RL_Clu_Dist_13 :%f",signalvalue1);
	write("i_S4_SRR_RL_Clu_Dist_13 :%f",@ecu_Signals::i_S4_SRR_RL_Clu_Dist_13);

	testStep("get expect variable value: ","i_S4_SRR_RL_Clu_Dist_13 :%f",@ecu_Signals::i_S4_SRR_RL_Clu_Dist_13);

	if((abs(@ecu_Signals::i_S4_SRR_RL_Clu_Dist_13)*0.9<=abs(signalvalue1))&&(abs(signalvalue1)<=abs(@ecu_Signals::i_S4_SRR_RL_Clu_Dist_13)*1.1))
	{
	testStepPass("Pass","i_S4_SRR_RL_Clu_Dist_13 :%f",signalvalue1);
	}
	else
	{
	testStepFail("Fail","i_S4_SRR_RL_Clu_Dist_13 :%f",signalvalue1);
	}
}

testcase S4_SRR_RL_Clu_Mes_1_S4_SRR_RL_Clu_Vel_13()
{
	signalvalue1 = getSignal(S4_SRR_RL_Clu_Vel_13);
	write("S4_SRR_RL_Clu_Vel_13 :%f",signalvalue1);
	write("i_S4_SRR_RL_Clu_Vel_13 :%f",@ecu_Signals::i_S4_SRR_RL_Clu_Vel_13);

	testStep("get expect variable value: ","i_S4_SRR_RL_Clu_Vel_13 :%f",@ecu_Signals::i_S4_SRR_RL_Clu_Vel_13);

	if((abs(@ecu_Signals::i_S4_SRR_RL_Clu_Vel_13)*0.9<=abs(signalvalue1))&&(abs(signalvalue1)<=abs(@ecu_Signals::i_S4_SRR_RL_Clu_Vel_13)*1.1))
	{
	testStepPass("Pass","i_S4_SRR_RL_Clu_Vel_13 :%f",signalvalue1);
	}
	else
	{
	testStepFail("Fail","i_S4_SRR_RL_Clu_Vel_13 :%f",signalvalue1);
	}
}

testcase S4_SRR_RL_Clu_Mes_1_S4_SRR_RL_Clu_SNR_13()
{
	signalvalue1 = getSignal(S4_SRR_RL_Clu_SNR_13);
	write("S4_SRR_RL_Clu_SNR_13 :%f",signalvalue1);
	write("i_S4_SRR_RL_Clu_SNR_13 :%f",@ecu_Signals::i_S4_SRR_RL_Clu_SNR_13);

	testStep("get expect variable value: ","i_S4_SRR_RL_Clu_SNR_13 :%f",@ecu_Signals::i_S4_SRR_RL_Clu_SNR_13);

	if((abs(@ecu_Signals::i_S4_SRR_RL_Clu_SNR_13)*0.9<=abs(signalvalue1))&&(abs(signalvalue1)<=abs(@ecu_Signals::i_S4_SRR_RL_Clu_SNR_13)*1.1))
	{
	testStepPass("Pass","i_S4_SRR_RL_Clu_SNR_13 :%f",signalvalue1);
	}
	else
	{
	testStepFail("Fail","i_S4_SRR_RL_Clu_SNR_13 :%f",signalvalue1);
	}
}

testcase S4_SRR_RL_Clu_Mes_1_S4_SRR_RL_Clu_DynProp_13()
{
	signalvalue1 = getSignal(S4_SRR_RL_Clu_DynProp_13);
	write("S4_SRR_RL_Clu_DynProp_13 :%f",signalvalue1);
	write("i_S4_SRR_RL_Clu_DynProp_13 :%o",@ecu_Signals::i_S4_SRR_RL_Clu_DynProp_13);

	testStep("get expect variable value: ","i_S4_SRR_RL_Clu_DynProp_13 :%o",@ecu_Signals::i_S4_SRR_RL_Clu_DynProp_13);

	if(signalvalue1==@ecu_Signals::i_S4_SRR_RL_Clu_DynProp_13)
	{
	testStepPass("Pass","i_S4_SRR_RL_Clu_DynProp_13 :%f",signalvalue1);
	}
	else
	{
	testStepFail("Fail","i_S4_SRR_RL_Clu_DynProp_13 :%f",signalvalue1);
	}
}

testcase S4_SRR_RL_Clu_Mes_1_S4_SRR_RL_Clu_Locationvalid_13()
{
	signalvalue1 = getSignal(S4_SRR_RL_Clu_Locationvalid_13);
	write("S4_SRR_RL_Clu_Locationvalid_13 :%f",signalvalue1);
	write("i_S4_SRR_RL_Clu_Locationvalid_13 :%o",@ecu_Signals::i_S4_SRR_RL_Clu_Locationvalid_13);

	testStep("get expect variable value: ","i_S4_SRR_RL_Clu_Locationvalid_13 :%o",@ecu_Signals::i_S4_SRR_RL_Clu_Locationvalid_13);

	if(signalvalue1==@ecu_Signals::i_S4_SRR_RL_Clu_Locationvalid_13)
	{
	testStepPass("Pass","i_S4_SRR_RL_Clu_Locationvalid_13 :%f",signalvalue1);
	}
	else
	{
	testStepFail("Fail","i_S4_SRR_RL_Clu_Locationvalid_13 :%f",signalvalue1);
	}
}

testcase S4_SRR_RL_Clu_Mes_2_S4_SRR_RL_Clu_Theta_14()
{
	signalvalue1 = getSignal(S4_SRR_RL_Clu_Theta_14);
	write("S4_SRR_RL_Clu_Theta_14 :%f",signalvalue1);
	write("i_S4_SRR_RL_Clu_Theta_14 :%f",@ecu_Signals::i_S4_SRR_RL_Clu_Theta_14);

	testStep("get expect variable value: ","i_S4_SRR_RL_Clu_Theta_14 :%f",@ecu_Signals::i_S4_SRR_RL_Clu_Theta_14);

	if((abs(@ecu_Signals::i_S4_SRR_RL_Clu_Theta_14)*0.9<=abs(signalvalue1))&&(abs(signalvalue1)<=abs(@ecu_Signals::i_S4_SRR_RL_Clu_Theta_14)*1.1))
	{
	testStepPass("Pass","i_S4_SRR_RL_Clu_Theta_14 :%f",signalvalue1);
	}
	else
	{
	testStepFail("Fail","i_S4_SRR_RL_Clu_Theta_14 :%f",signalvalue1);
	}
}

testcase S4_SRR_RL_Clu_Mes_2_S4_SRR_RL_Clu_Dist_14()
{
	signalvalue1 = getSignal(S4_SRR_RL_Clu_Dist_14);
	write("S4_SRR_RL_Clu_Dist_14 :%f",signalvalue1);
	write("i_S4_SRR_RL_Clu_Dist_14 :%f",@ecu_Signals::i_S4_SRR_RL_Clu_Dist_14);

	testStep("get expect variable value: ","i_S4_SRR_RL_Clu_Dist_14 :%f",@ecu_Signals::i_S4_SRR_RL_Clu_Dist_14);

	if((abs(@ecu_Signals::i_S4_SRR_RL_Clu_Dist_14)*0.9<=abs(signalvalue1))&&(abs(signalvalue1)<=abs(@ecu_Signals::i_S4_SRR_RL_Clu_Dist_14)*1.1))
	{
	testStepPass("Pass","i_S4_SRR_RL_Clu_Dist_14 :%f",signalvalue1);
	}
	else
	{
	testStepFail("Fail","i_S4_SRR_RL_Clu_Dist_14 :%f",signalvalue1);
	}
}

testcase S4_SRR_RL_Clu_Mes_2_S4_SRR_RL_Clu_Vel_14()
{
	signalvalue1 = getSignal(S4_SRR_RL_Clu_Vel_14);
	write("S4_SRR_RL_Clu_Vel_14 :%f",signalvalue1);
	write("i_S4_SRR_RL_Clu_Vel_14 :%f",@ecu_Signals::i_S4_SRR_RL_Clu_Vel_14);

	testStep("get expect variable value: ","i_S4_SRR_RL_Clu_Vel_14 :%f",@ecu_Signals::i_S4_SRR_RL_Clu_Vel_14);

	if((abs(@ecu_Signals::i_S4_SRR_RL_Clu_Vel_14)*0.9<=abs(signalvalue1))&&(abs(signalvalue1)<=abs(@ecu_Signals::i_S4_SRR_RL_Clu_Vel_14)*1.1))
	{
	testStepPass("Pass","i_S4_SRR_RL_Clu_Vel_14 :%f",signalvalue1);
	}
	else
	{
	testStepFail("Fail","i_S4_SRR_RL_Clu_Vel_14 :%f",signalvalue1);
	}
}

testcase S4_SRR_RL_Clu_Mes_2_S4_SRR_RL_Clu_SNR_14()
{
	signalvalue1 = getSignal(S4_SRR_RL_Clu_SNR_14);
	write("S4_SRR_RL_Clu_SNR_14 :%f",signalvalue1);
	write("i_S4_SRR_RL_Clu_SNR_14 :%f",@ecu_Signals::i_S4_SRR_RL_Clu_SNR_14);

	testStep("get expect variable value: ","i_S4_SRR_RL_Clu_SNR_14 :%f",@ecu_Signals::i_S4_SRR_RL_Clu_SNR_14);

	if((abs(@ecu_Signals::i_S4_SRR_RL_Clu_SNR_14)*0.9<=abs(signalvalue1))&&(abs(signalvalue1)<=abs(@ecu_Signals::i_S4_SRR_RL_Clu_SNR_14)*1.1))
	{
	testStepPass("Pass","i_S4_SRR_RL_Clu_SNR_14 :%f",signalvalue1);
	}
	else
	{
	testStepFail("Fail","i_S4_SRR_RL_Clu_SNR_14 :%f",signalvalue1);
	}
}

testcase S4_SRR_RL_Clu_Mes_2_S4_SRR_RL_Clu_DynProp_14()
{
	signalvalue1 = getSignal(S4_SRR_RL_Clu_DynProp_14);
	write("S4_SRR_RL_Clu_DynProp_14 :%f",signalvalue1);
	write("i_S4_SRR_RL_Clu_DynProp_14 :%o",@ecu_Signals::i_S4_SRR_RL_Clu_DynProp_14);

	testStep("get expect variable value: ","i_S4_SRR_RL_Clu_DynProp_14 :%o",@ecu_Signals::i_S4_SRR_RL_Clu_DynProp_14);

	if(signalvalue1==@ecu_Signals::i_S4_SRR_RL_Clu_DynProp_14)
	{
	testStepPass("Pass","i_S4_SRR_RL_Clu_DynProp_14 :%f",signalvalue1);
	}
	else
	{
	testStepFail("Fail","i_S4_SRR_RL_Clu_DynProp_14 :%f",signalvalue1);
	}
}

testcase S4_SRR_RL_Clu_Mes_2_S4_SRR_RL_Clu_Locationvalid_14()
{
	signalvalue1 = getSignal(S4_SRR_RL_Clu_Locationvalid_14);
	write("S4_SRR_RL_Clu_Locationvalid_14 :%f",signalvalue1);
	write("i_S4_SRR_RL_Clu_Locationvalid_14 :%o",@ecu_Signals::i_S4_SRR_RL_Clu_Locationvalid_14);

	testStep("get expect variable value: ","i_S4_SRR_RL_Clu_Locationvalid_14 :%o",@ecu_Signals::i_S4_SRR_RL_Clu_Locationvalid_14);

	if(signalvalue1==@ecu_Signals::i_S4_SRR_RL_Clu_Locationvalid_14)
	{
	testStepPass("Pass","i_S4_SRR_RL_Clu_Locationvalid_14 :%f",signalvalue1);
	}
	else
	{
	testStepFail("Fail","i_S4_SRR_RL_Clu_Locationvalid_14 :%f",signalvalue1);
	}
}

testcase S4_SRR_RL_Clu_Mes_2_S4_SRR_RL_Clu_Theta_15()
{
	signalvalue1 = getSignal(S4_SRR_RL_Clu_Theta_15);
	write("S4_SRR_RL_Clu_Theta_15 :%f",signalvalue1);
	write("i_S4_SRR_RL_Clu_Theta_15 :%f",@ecu_Signals::i_S4_SRR_RL_Clu_Theta_15);

	testStep("get expect variable value: ","i_S4_SRR_RL_Clu_Theta_15 :%f",@ecu_Signals::i_S4_SRR_RL_Clu_Theta_15);

	if((abs(@ecu_Signals::i_S4_SRR_RL_Clu_Theta_15)*0.9<=abs(signalvalue1))&&(abs(signalvalue1)<=abs(@ecu_Signals::i_S4_SRR_RL_Clu_Theta_15)*1.1))
	{
	testStepPass("Pass","i_S4_SRR_RL_Clu_Theta_15 :%f",signalvalue1);
	}
	else
	{
	testStepFail("Fail","i_S4_SRR_RL_Clu_Theta_15 :%f",signalvalue1);
	}
}

testcase S4_SRR_RL_Clu_Mes_2_S4_SRR_RL_Clu_Dist_15()
{
	signalvalue1 = getSignal(S4_SRR_RL_Clu_Dist_15);
	write("S4_SRR_RL_Clu_Dist_15 :%f",signalvalue1);
	write("i_S4_SRR_RL_Clu_Dist_15 :%f",@ecu_Signals::i_S4_SRR_RL_Clu_Dist_15);

	testStep("get expect variable value: ","i_S4_SRR_RL_Clu_Dist_15 :%f",@ecu_Signals::i_S4_SRR_RL_Clu_Dist_15);

	if((abs(@ecu_Signals::i_S4_SRR_RL_Clu_Dist_15)*0.9<=abs(signalvalue1))&&(abs(signalvalue1)<=abs(@ecu_Signals::i_S4_SRR_RL_Clu_Dist_15)*1.1))
	{
	testStepPass("Pass","i_S4_SRR_RL_Clu_Dist_15 :%f",signalvalue1);
	}
	else
	{
	testStepFail("Fail","i_S4_SRR_RL_Clu_Dist_15 :%f",signalvalue1);
	}
}

testcase S4_SRR_RL_Clu_Mes_2_S4_SRR_RL_Clu_Vel_15()
{
	signalvalue1 = getSignal(S4_SRR_RL_Clu_Vel_15);
	write("S4_SRR_RL_Clu_Vel_15 :%f",signalvalue1);
	write("i_S4_SRR_RL_Clu_Vel_15 :%f",@ecu_Signals::i_S4_SRR_RL_Clu_Vel_15);

	testStep("get expect variable value: ","i_S4_SRR_RL_Clu_Vel_15 :%f",@ecu_Signals::i_S4_SRR_RL_Clu_Vel_15);

	if((abs(@ecu_Signals::i_S4_SRR_RL_Clu_Vel_15)*0.9<=abs(signalvalue1))&&(abs(signalvalue1)<=abs(@ecu_Signals::i_S4_SRR_RL_Clu_Vel_15)*1.1))
	{
	testStepPass("Pass","i_S4_SRR_RL_Clu_Vel_15 :%f",signalvalue1);
	}
	else
	{
	testStepFail("Fail","i_S4_SRR_RL_Clu_Vel_15 :%f",signalvalue1);
	}
}

testcase S4_SRR_RL_Clu_Mes_2_S4_SRR_RL_Clu_SNR_15()
{
	signalvalue1 = getSignal(S4_SRR_RL_Clu_SNR_15);
	write("S4_SRR_RL_Clu_SNR_15 :%f",signalvalue1);
	write("i_S4_SRR_RL_Clu_SNR_15 :%f",@ecu_Signals::i_S4_SRR_RL_Clu_SNR_15);

	testStep("get expect variable value: ","i_S4_SRR_RL_Clu_SNR_15 :%f",@ecu_Signals::i_S4_SRR_RL_Clu_SNR_15);

	if((abs(@ecu_Signals::i_S4_SRR_RL_Clu_SNR_15)*0.9<=abs(signalvalue1))&&(abs(signalvalue1)<=abs(@ecu_Signals::i_S4_SRR_RL_Clu_SNR_15)*1.1))
	{
	testStepPass("Pass","i_S4_SRR_RL_Clu_SNR_15 :%f",signalvalue1);
	}
	else
	{
	testStepFail("Fail","i_S4_SRR_RL_Clu_SNR_15 :%f",signalvalue1);
	}
}

testcase S4_SRR_RL_Clu_Mes_2_S4_SRR_RL_Clu_DynProp_15()
{
	signalvalue1 = getSignal(S4_SRR_RL_Clu_DynProp_15);
	write("S4_SRR_RL_Clu_DynProp_15 :%f",signalvalue1);
	write("i_S4_SRR_RL_Clu_DynProp_15 :%o",@ecu_Signals::i_S4_SRR_RL_Clu_DynProp_15);

	testStep("get expect variable value: ","i_S4_SRR_RL_Clu_DynProp_15 :%o",@ecu_Signals::i_S4_SRR_RL_Clu_DynProp_15);

	if(signalvalue1==@ecu_Signals::i_S4_SRR_RL_Clu_DynProp_15)
	{
	testStepPass("Pass","i_S4_SRR_RL_Clu_DynProp_15 :%f",signalvalue1);
	}
	else
	{
	testStepFail("Fail","i_S4_SRR_RL_Clu_DynProp_15 :%f",signalvalue1);
	}
}

testcase S4_SRR_RL_Clu_Mes_2_S4_SRR_RL_Clu_Locationvalid_15()
{
	signalvalue1 = getSignal(S4_SRR_RL_Clu_Locationvalid_15);
	write("S4_SRR_RL_Clu_Locationvalid_15 :%f",signalvalue1);
	write("i_S4_SRR_RL_Clu_Locationvalid_15 :%o",@ecu_Signals::i_S4_SRR_RL_Clu_Locationvalid_15);

	testStep("get expect variable value: ","i_S4_SRR_RL_Clu_Locationvalid_15 :%o",@ecu_Signals::i_S4_SRR_RL_Clu_Locationvalid_15);

	if(signalvalue1==@ecu_Signals::i_S4_SRR_RL_Clu_Locationvalid_15)
	{
	testStepPass("Pass","i_S4_SRR_RL_Clu_Locationvalid_15 :%f",signalvalue1);
	}
	else
	{
	testStepFail("Fail","i_S4_SRR_RL_Clu_Locationvalid_15 :%f",signalvalue1);
	}
}

testcase S4_SRR_RL_Clu_Mes_2_S4_SRR_RL_Clu_Theta_16()
{
	signalvalue1 = getSignal(S4_SRR_RL_Clu_Theta_16);
	write("S4_SRR_RL_Clu_Theta_16 :%f",signalvalue1);
	write("i_S4_SRR_RL_Clu_Theta_16 :%f",@ecu_Signals::i_S4_SRR_RL_Clu_Theta_16);

	testStep("get expect variable value: ","i_S4_SRR_RL_Clu_Theta_16 :%f",@ecu_Signals::i_S4_SRR_RL_Clu_Theta_16);

	if((abs(@ecu_Signals::i_S4_SRR_RL_Clu_Theta_16)*0.9<=abs(signalvalue1))&&(abs(signalvalue1)<=abs(@ecu_Signals::i_S4_SRR_RL_Clu_Theta_16)*1.1))
	{
	testStepPass("Pass","i_S4_SRR_RL_Clu_Theta_16 :%f",signalvalue1);
	}
	else
	{
	testStepFail("Fail","i_S4_SRR_RL_Clu_Theta_16 :%f",signalvalue1);
	}
}

testcase S4_SRR_RL_Clu_Mes_2_S4_SRR_RL_Clu_Dist_16()
{
	signalvalue1 = getSignal(S4_SRR_RL_Clu_Dist_16);
	write("S4_SRR_RL_Clu_Dist_16 :%f",signalvalue1);
	write("i_S4_SRR_RL_Clu_Dist_16 :%f",@ecu_Signals::i_S4_SRR_RL_Clu_Dist_16);

	testStep("get expect variable value: ","i_S4_SRR_RL_Clu_Dist_16 :%f",@ecu_Signals::i_S4_SRR_RL_Clu_Dist_16);

	if((abs(@ecu_Signals::i_S4_SRR_RL_Clu_Dist_16)*0.9<=abs(signalvalue1))&&(abs(signalvalue1)<=abs(@ecu_Signals::i_S4_SRR_RL_Clu_Dist_16)*1.1))
	{
	testStepPass("Pass","i_S4_SRR_RL_Clu_Dist_16 :%f",signalvalue1);
	}
	else
	{
	testStepFail("Fail","i_S4_SRR_RL_Clu_Dist_16 :%f",signalvalue1);
	}
}

testcase S4_SRR_RL_Clu_Mes_2_S4_SRR_RL_Clu_Vel_16()
{
	signalvalue1 = getSignal(S4_SRR_RL_Clu_Vel_16);
	write("S4_SRR_RL_Clu_Vel_16 :%f",signalvalue1);
	write("i_S4_SRR_RL_Clu_Vel_16 :%f",@ecu_Signals::i_S4_SRR_RL_Clu_Vel_16);

	testStep("get expect variable value: ","i_S4_SRR_RL_Clu_Vel_16 :%f",@ecu_Signals::i_S4_SRR_RL_Clu_Vel_16);

	if((abs(@ecu_Signals::i_S4_SRR_RL_Clu_Vel_16)*0.9<=abs(signalvalue1))&&(abs(signalvalue1)<=abs(@ecu_Signals::i_S4_SRR_RL_Clu_Vel_16)*1.1))
	{
	testStepPass("Pass","i_S4_SRR_RL_Clu_Vel_16 :%f",signalvalue1);
	}
	else
	{
	testStepFail("Fail","i_S4_SRR_RL_Clu_Vel_16 :%f",signalvalue1);
	}
}

testcase S4_SRR_RL_Clu_Mes_2_S4_SRR_RL_Clu_SNR_16()
{
	signalvalue1 = getSignal(S4_SRR_RL_Clu_SNR_16);
	write("S4_SRR_RL_Clu_SNR_16 :%f",signalvalue1);
	write("i_S4_SRR_RL_Clu_SNR_16 :%f",@ecu_Signals::i_S4_SRR_RL_Clu_SNR_16);

	testStep("get expect variable value: ","i_S4_SRR_RL_Clu_SNR_16 :%f",@ecu_Signals::i_S4_SRR_RL_Clu_SNR_16);

	if((abs(@ecu_Signals::i_S4_SRR_RL_Clu_SNR_16)*0.9<=abs(signalvalue1))&&(abs(signalvalue1)<=abs(@ecu_Signals::i_S4_SRR_RL_Clu_SNR_16)*1.1))
	{
	testStepPass("Pass","i_S4_SRR_RL_Clu_SNR_16 :%f",signalvalue1);
	}
	else
	{
	testStepFail("Fail","i_S4_SRR_RL_Clu_SNR_16 :%f",signalvalue1);
	}
}

testcase S4_SRR_RL_Clu_Mes_2_S4_SRR_RL_Clu_DynProp_16()
{
	signalvalue1 = getSignal(S4_SRR_RL_Clu_DynProp_16);
	write("S4_SRR_RL_Clu_DynProp_16 :%f",signalvalue1);
	write("i_S4_SRR_RL_Clu_DynProp_16 :%o",@ecu_Signals::i_S4_SRR_RL_Clu_DynProp_16);

	testStep("get expect variable value: ","i_S4_SRR_RL_Clu_DynProp_16 :%o",@ecu_Signals::i_S4_SRR_RL_Clu_DynProp_16);

	if(signalvalue1==@ecu_Signals::i_S4_SRR_RL_Clu_DynProp_16)
	{
	testStepPass("Pass","i_S4_SRR_RL_Clu_DynProp_16 :%f",signalvalue1);
	}
	else
	{
	testStepFail("Fail","i_S4_SRR_RL_Clu_DynProp_16 :%f",signalvalue1);
	}
}

testcase S4_SRR_RL_Clu_Mes_2_S4_SRR_RL_Clu_Locationvalid_16()
{
	signalvalue1 = getSignal(S4_SRR_RL_Clu_Locationvalid_16);
	write("S4_SRR_RL_Clu_Locationvalid_16 :%f",signalvalue1);
	write("i_S4_SRR_RL_Clu_Locationvalid_16 :%o",@ecu_Signals::i_S4_SRR_RL_Clu_Locationvalid_16);

	testStep("get expect variable value: ","i_S4_SRR_RL_Clu_Locationvalid_16 :%o",@ecu_Signals::i_S4_SRR_RL_Clu_Locationvalid_16);

	if(signalvalue1==@ecu_Signals::i_S4_SRR_RL_Clu_Locationvalid_16)
	{
	testStepPass("Pass","i_S4_SRR_RL_Clu_Locationvalid_16 :%f",signalvalue1);
	}
	else
	{
	testStepFail("Fail","i_S4_SRR_RL_Clu_Locationvalid_16 :%f",signalvalue1);
	}
}

testcase S4_SRR_RL_Clu_Mes_2_S4_SRR_RL_Clu_Theta_17()
{
	signalvalue1 = getSignal(S4_SRR_RL_Clu_Theta_17);
	write("S4_SRR_RL_Clu_Theta_17 :%f",signalvalue1);
	write("i_S4_SRR_RL_Clu_Theta_17 :%f",@ecu_Signals::i_S4_SRR_RL_Clu_Theta_17);

	testStep("get expect variable value: ","i_S4_SRR_RL_Clu_Theta_17 :%f",@ecu_Signals::i_S4_SRR_RL_Clu_Theta_17);

	if((abs(@ecu_Signals::i_S4_SRR_RL_Clu_Theta_17)*0.9<=abs(signalvalue1))&&(abs(signalvalue1)<=abs(@ecu_Signals::i_S4_SRR_RL_Clu_Theta_17)*1.1))
	{
	testStepPass("Pass","i_S4_SRR_RL_Clu_Theta_17 :%f",signalvalue1);
	}
	else
	{
	testStepFail("Fail","i_S4_SRR_RL_Clu_Theta_17 :%f",signalvalue1);
	}
}

testcase S4_SRR_RL_Clu_Mes_2_S4_SRR_RL_Clu_Dist_17()
{
	signalvalue1 = getSignal(S4_SRR_RL_Clu_Dist_17);
	write("S4_SRR_RL_Clu_Dist_17 :%f",signalvalue1);
	write("i_S4_SRR_RL_Clu_Dist_17 :%f",@ecu_Signals::i_S4_SRR_RL_Clu_Dist_17);

	testStep("get expect variable value: ","i_S4_SRR_RL_Clu_Dist_17 :%f",@ecu_Signals::i_S4_SRR_RL_Clu_Dist_17);

	if((abs(@ecu_Signals::i_S4_SRR_RL_Clu_Dist_17)*0.9<=abs(signalvalue1))&&(abs(signalvalue1)<=abs(@ecu_Signals::i_S4_SRR_RL_Clu_Dist_17)*1.1))
	{
	testStepPass("Pass","i_S4_SRR_RL_Clu_Dist_17 :%f",signalvalue1);
	}
	else
	{
	testStepFail("Fail","i_S4_SRR_RL_Clu_Dist_17 :%f",signalvalue1);
	}
}

testcase S4_SRR_RL_Clu_Mes_2_S4_SRR_RL_Clu_Vel_17()
{
	signalvalue1 = getSignal(S4_SRR_RL_Clu_Vel_17);
	write("S4_SRR_RL_Clu_Vel_17 :%f",signalvalue1);
	write("i_S4_SRR_RL_Clu_Vel_17 :%f",@ecu_Signals::i_S4_SRR_RL_Clu_Vel_17);

	testStep("get expect variable value: ","i_S4_SRR_RL_Clu_Vel_17 :%f",@ecu_Signals::i_S4_SRR_RL_Clu_Vel_17);

	if((abs(@ecu_Signals::i_S4_SRR_RL_Clu_Vel_17)*0.9<=abs(signalvalue1))&&(abs(signalvalue1)<=abs(@ecu_Signals::i_S4_SRR_RL_Clu_Vel_17)*1.1))
	{
	testStepPass("Pass","i_S4_SRR_RL_Clu_Vel_17 :%f",signalvalue1);
	}
	else
	{
	testStepFail("Fail","i_S4_SRR_RL_Clu_Vel_17 :%f",signalvalue1);
	}
}

testcase S4_SRR_RL_Clu_Mes_2_S4_SRR_RL_Clu_SNR_17()
{
	signalvalue1 = getSignal(S4_SRR_RL_Clu_SNR_17);
	write("S4_SRR_RL_Clu_SNR_17 :%f",signalvalue1);
	write("i_S4_SRR_RL_Clu_SNR_17 :%f",@ecu_Signals::i_S4_SRR_RL_Clu_SNR_17);

	testStep("get expect variable value: ","i_S4_SRR_RL_Clu_SNR_17 :%f",@ecu_Signals::i_S4_SRR_RL_Clu_SNR_17);

	if((abs(@ecu_Signals::i_S4_SRR_RL_Clu_SNR_17)*0.9<=abs(signalvalue1))&&(abs(signalvalue1)<=abs(@ecu_Signals::i_S4_SRR_RL_Clu_SNR_17)*1.1))
	{
	testStepPass("Pass","i_S4_SRR_RL_Clu_SNR_17 :%f",signalvalue1);
	}
	else
	{
	testStepFail("Fail","i_S4_SRR_RL_Clu_SNR_17 :%f",signalvalue1);
	}
}

testcase S4_SRR_RL_Clu_Mes_2_S4_SRR_RL_Clu_DynProp_17()
{
	signalvalue1 = getSignal(S4_SRR_RL_Clu_DynProp_17);
	write("S4_SRR_RL_Clu_DynProp_17 :%f",signalvalue1);
	write("i_S4_SRR_RL_Clu_DynProp_17 :%o",@ecu_Signals::i_S4_SRR_RL_Clu_DynProp_17);

	testStep("get expect variable value: ","i_S4_SRR_RL_Clu_DynProp_17 :%o",@ecu_Signals::i_S4_SRR_RL_Clu_DynProp_17);

	if(signalvalue1==@ecu_Signals::i_S4_SRR_RL_Clu_DynProp_17)
	{
	testStepPass("Pass","i_S4_SRR_RL_Clu_DynProp_17 :%f",signalvalue1);
	}
	else
	{
	testStepFail("Fail","i_S4_SRR_RL_Clu_DynProp_17 :%f",signalvalue1);
	}
}

testcase S4_SRR_RL_Clu_Mes_2_S4_SRR_RL_Clu_Locationvalid_17()
{
	signalvalue1 = getSignal(S4_SRR_RL_Clu_Locationvalid_17);
	write("S4_SRR_RL_Clu_Locationvalid_17 :%f",signalvalue1);
	write("i_S4_SRR_RL_Clu_Locationvalid_17 :%o",@ecu_Signals::i_S4_SRR_RL_Clu_Locationvalid_17);

	testStep("get expect variable value: ","i_S4_SRR_RL_Clu_Locationvalid_17 :%o",@ecu_Signals::i_S4_SRR_RL_Clu_Locationvalid_17);

	if(signalvalue1==@ecu_Signals::i_S4_SRR_RL_Clu_Locationvalid_17)
	{
	testStepPass("Pass","i_S4_SRR_RL_Clu_Locationvalid_17 :%f",signalvalue1);
	}
	else
	{
	testStepFail("Fail","i_S4_SRR_RL_Clu_Locationvalid_17 :%f",signalvalue1);
	}
}

testcase S4_SRR_RL_Clu_Mes_2_S4_SRR_RL_Clu_Theta_18()
{
	signalvalue1 = getSignal(S4_SRR_RL_Clu_Theta_18);
	write("S4_SRR_RL_Clu_Theta_18 :%f",signalvalue1);
	write("i_S4_SRR_RL_Clu_Theta_18 :%f",@ecu_Signals::i_S4_SRR_RL_Clu_Theta_18);

	testStep("get expect variable value: ","i_S4_SRR_RL_Clu_Theta_18 :%f",@ecu_Signals::i_S4_SRR_RL_Clu_Theta_18);

	if((abs(@ecu_Signals::i_S4_SRR_RL_Clu_Theta_18)*0.9<=abs(signalvalue1))&&(abs(signalvalue1)<=abs(@ecu_Signals::i_S4_SRR_RL_Clu_Theta_18)*1.1))
	{
	testStepPass("Pass","i_S4_SRR_RL_Clu_Theta_18 :%f",signalvalue1);
	}
	else
	{
	testStepFail("Fail","i_S4_SRR_RL_Clu_Theta_18 :%f",signalvalue1);
	}
}

testcase S4_SRR_RL_Clu_Mes_2_S4_SRR_RL_Clu_Dist_18()
{
	signalvalue1 = getSignal(S4_SRR_RL_Clu_Dist_18);
	write("S4_SRR_RL_Clu_Dist_18 :%f",signalvalue1);
	write("i_S4_SRR_RL_Clu_Dist_18 :%f",@ecu_Signals::i_S4_SRR_RL_Clu_Dist_18);

	testStep("get expect variable value: ","i_S4_SRR_RL_Clu_Dist_18 :%f",@ecu_Signals::i_S4_SRR_RL_Clu_Dist_18);

	if((abs(@ecu_Signals::i_S4_SRR_RL_Clu_Dist_18)*0.9<=abs(signalvalue1))&&(abs(signalvalue1)<=abs(@ecu_Signals::i_S4_SRR_RL_Clu_Dist_18)*1.1))
	{
	testStepPass("Pass","i_S4_SRR_RL_Clu_Dist_18 :%f",signalvalue1);
	}
	else
	{
	testStepFail("Fail","i_S4_SRR_RL_Clu_Dist_18 :%f",signalvalue1);
	}
}

testcase S4_SRR_RL_Clu_Mes_2_S4_SRR_RL_Clu_Vel_18()
{
	signalvalue1 = getSignal(S4_SRR_RL_Clu_Vel_18);
	write("S4_SRR_RL_Clu_Vel_18 :%f",signalvalue1);
	write("i_S4_SRR_RL_Clu_Vel_18 :%f",@ecu_Signals::i_S4_SRR_RL_Clu_Vel_18);

	testStep("get expect variable value: ","i_S4_SRR_RL_Clu_Vel_18 :%f",@ecu_Signals::i_S4_SRR_RL_Clu_Vel_18);

	if((abs(@ecu_Signals::i_S4_SRR_RL_Clu_Vel_18)*0.9<=abs(signalvalue1))&&(abs(signalvalue1)<=abs(@ecu_Signals::i_S4_SRR_RL_Clu_Vel_18)*1.1))
	{
	testStepPass("Pass","i_S4_SRR_RL_Clu_Vel_18 :%f",signalvalue1);
	}
	else
	{
	testStepFail("Fail","i_S4_SRR_RL_Clu_Vel_18 :%f",signalvalue1);
	}
}

testcase S4_SRR_RL_Clu_Mes_2_S4_SRR_RL_Clu_SNR_18()
{
	signalvalue1 = getSignal(S4_SRR_RL_Clu_SNR_18);
	write("S4_SRR_RL_Clu_SNR_18 :%f",signalvalue1);
	write("i_S4_SRR_RL_Clu_SNR_18 :%f",@ecu_Signals::i_S4_SRR_RL_Clu_SNR_18);

	testStep("get expect variable value: ","i_S4_SRR_RL_Clu_SNR_18 :%f",@ecu_Signals::i_S4_SRR_RL_Clu_SNR_18);

	if((abs(@ecu_Signals::i_S4_SRR_RL_Clu_SNR_18)*0.9<=abs(signalvalue1))&&(abs(signalvalue1)<=abs(@ecu_Signals::i_S4_SRR_RL_Clu_SNR_18)*1.1))
	{
	testStepPass("Pass","i_S4_SRR_RL_Clu_SNR_18 :%f",signalvalue1);
	}
	else
	{
	testStepFail("Fail","i_S4_SRR_RL_Clu_SNR_18 :%f",signalvalue1);
	}
}

testcase S4_SRR_RL_Clu_Mes_2_S4_SRR_RL_Clu_DynProp_18()
{
	signalvalue1 = getSignal(S4_SRR_RL_Clu_DynProp_18);
	write("S4_SRR_RL_Clu_DynProp_18 :%f",signalvalue1);
	write("i_S4_SRR_RL_Clu_DynProp_18 :%o",@ecu_Signals::i_S4_SRR_RL_Clu_DynProp_18);

	testStep("get expect variable value: ","i_S4_SRR_RL_Clu_DynProp_18 :%o",@ecu_Signals::i_S4_SRR_RL_Clu_DynProp_18);

	if(signalvalue1==@ecu_Signals::i_S4_SRR_RL_Clu_DynProp_18)
	{
	testStepPass("Pass","i_S4_SRR_RL_Clu_DynProp_18 :%f",signalvalue1);
	}
	else
	{
	testStepFail("Fail","i_S4_SRR_RL_Clu_DynProp_18 :%f",signalvalue1);
	}
}

testcase S4_SRR_RL_Clu_Mes_2_S4_SRR_RL_Clu_Locationvalid_18()
{
	signalvalue1 = getSignal(S4_SRR_RL_Clu_Locationvalid_18);
	write("S4_SRR_RL_Clu_Locationvalid_18 :%f",signalvalue1);
	write("i_S4_SRR_RL_Clu_Locationvalid_18 :%o",@ecu_Signals::i_S4_SRR_RL_Clu_Locationvalid_18);

	testStep("get expect variable value: ","i_S4_SRR_RL_Clu_Locationvalid_18 :%o",@ecu_Signals::i_S4_SRR_RL_Clu_Locationvalid_18);

	if(signalvalue1==@ecu_Signals::i_S4_SRR_RL_Clu_Locationvalid_18)
	{
	testStepPass("Pass","i_S4_SRR_RL_Clu_Locationvalid_18 :%f",signalvalue1);
	}
	else
	{
	testStepFail("Fail","i_S4_SRR_RL_Clu_Locationvalid_18 :%f",signalvalue1);
	}
}

testcase S4_SRR_RL_Clu_Mes_2_S4_SRR_RL_Clu_Theta_19()
{
	signalvalue1 = getSignal(S4_SRR_RL_Clu_Theta_19);
	write("S4_SRR_RL_Clu_Theta_19 :%f",signalvalue1);
	write("i_S4_SRR_RL_Clu_Theta_19 :%f",@ecu_Signals::i_S4_SRR_RL_Clu_Theta_19);

	testStep("get expect variable value: ","i_S4_SRR_RL_Clu_Theta_19 :%f",@ecu_Signals::i_S4_SRR_RL_Clu_Theta_19);

	if((abs(@ecu_Signals::i_S4_SRR_RL_Clu_Theta_19)*0.9<=abs(signalvalue1))&&(abs(signalvalue1)<=abs(@ecu_Signals::i_S4_SRR_RL_Clu_Theta_19)*1.1))
	{
	testStepPass("Pass","i_S4_SRR_RL_Clu_Theta_19 :%f",signalvalue1);
	}
	else
	{
	testStepFail("Fail","i_S4_SRR_RL_Clu_Theta_19 :%f",signalvalue1);
	}
}

testcase S4_SRR_RL_Clu_Mes_2_S4_SRR_RL_Clu_Dist_19()
{
	signalvalue1 = getSignal(S4_SRR_RL_Clu_Dist_19);
	write("S4_SRR_RL_Clu_Dist_19 :%f",signalvalue1);
	write("i_S4_SRR_RL_Clu_Dist_19 :%f",@ecu_Signals::i_S4_SRR_RL_Clu_Dist_19);

	testStep("get expect variable value: ","i_S4_SRR_RL_Clu_Dist_19 :%f",@ecu_Signals::i_S4_SRR_RL_Clu_Dist_19);

	if((abs(@ecu_Signals::i_S4_SRR_RL_Clu_Dist_19)*0.9<=abs(signalvalue1))&&(abs(signalvalue1)<=abs(@ecu_Signals::i_S4_SRR_RL_Clu_Dist_19)*1.1))
	{
	testStepPass("Pass","i_S4_SRR_RL_Clu_Dist_19 :%f",signalvalue1);
	}
	else
	{
	testStepFail("Fail","i_S4_SRR_RL_Clu_Dist_19 :%f",signalvalue1);
	}
}

testcase S4_SRR_RL_Clu_Mes_2_S4_SRR_RL_Clu_Vel_19()
{
	signalvalue1 = getSignal(S4_SRR_RL_Clu_Vel_19);
	write("S4_SRR_RL_Clu_Vel_19 :%f",signalvalue1);
	write("i_S4_SRR_RL_Clu_Vel_19 :%f",@ecu_Signals::i_S4_SRR_RL_Clu_Vel_19);

	testStep("get expect variable value: ","i_S4_SRR_RL_Clu_Vel_19 :%f",@ecu_Signals::i_S4_SRR_RL_Clu_Vel_19);

	if((abs(@ecu_Signals::i_S4_SRR_RL_Clu_Vel_19)*0.9<=abs(signalvalue1))&&(abs(signalvalue1)<=abs(@ecu_Signals::i_S4_SRR_RL_Clu_Vel_19)*1.1))
	{
	testStepPass("Pass","i_S4_SRR_RL_Clu_Vel_19 :%f",signalvalue1);
	}
	else
	{
	testStepFail("Fail","i_S4_SRR_RL_Clu_Vel_19 :%f",signalvalue1);
	}
}

testcase S4_SRR_RL_Clu_Mes_2_S4_SRR_RL_Clu_SNR_19()
{
	signalvalue1 = getSignal(S4_SRR_RL_Clu_SNR_19);
	write("S4_SRR_RL_Clu_SNR_19 :%f",signalvalue1);
	write("i_S4_SRR_RL_Clu_SNR_19 :%f",@ecu_Signals::i_S4_SRR_RL_Clu_SNR_19);

	testStep("get expect variable value: ","i_S4_SRR_RL_Clu_SNR_19 :%f",@ecu_Signals::i_S4_SRR_RL_Clu_SNR_19);

	if((abs(@ecu_Signals::i_S4_SRR_RL_Clu_SNR_19)*0.9<=abs(signalvalue1))&&(abs(signalvalue1)<=abs(@ecu_Signals::i_S4_SRR_RL_Clu_SNR_19)*1.1))
	{
	testStepPass("Pass","i_S4_SRR_RL_Clu_SNR_19 :%f",signalvalue1);
	}
	else
	{
	testStepFail("Fail","i_S4_SRR_RL_Clu_SNR_19 :%f",signalvalue1);
	}
}

testcase S4_SRR_RL_Clu_Mes_2_S4_SRR_RL_Clu_DynProp_19()
{
	signalvalue1 = getSignal(S4_SRR_RL_Clu_DynProp_19);
	write("S4_SRR_RL_Clu_DynProp_19 :%f",signalvalue1);
	write("i_S4_SRR_RL_Clu_DynProp_19 :%o",@ecu_Signals::i_S4_SRR_RL_Clu_DynProp_19);

	testStep("get expect variable value: ","i_S4_SRR_RL_Clu_DynProp_19 :%o",@ecu_Signals::i_S4_SRR_RL_Clu_DynProp_19);

	if(signalvalue1==@ecu_Signals::i_S4_SRR_RL_Clu_DynProp_19)
	{
	testStepPass("Pass","i_S4_SRR_RL_Clu_DynProp_19 :%f",signalvalue1);
	}
	else
	{
	testStepFail("Fail","i_S4_SRR_RL_Clu_DynProp_19 :%f",signalvalue1);
	}
}

testcase S4_SRR_RL_Clu_Mes_2_S4_SRR_RL_Clu_Locationvalid_19()
{
	signalvalue1 = getSignal(S4_SRR_RL_Clu_Locationvalid_19);
	write("S4_SRR_RL_Clu_Locationvalid_19 :%f",signalvalue1);
	write("i_S4_SRR_RL_Clu_Locationvalid_19 :%o",@ecu_Signals::i_S4_SRR_RL_Clu_Locationvalid_19);

	testStep("get expect variable value: ","i_S4_SRR_RL_Clu_Locationvalid_19 :%o",@ecu_Signals::i_S4_SRR_RL_Clu_Locationvalid_19);

	if(signalvalue1==@ecu_Signals::i_S4_SRR_RL_Clu_Locationvalid_19)
	{
	testStepPass("Pass","i_S4_SRR_RL_Clu_Locationvalid_19 :%f",signalvalue1);
	}
	else
	{
	testStepFail("Fail","i_S4_SRR_RL_Clu_Locationvalid_19 :%f",signalvalue1);
	}
}

testcase S4_SRR_RL_Clu_Mes_2_S4_SRR_RL_Clu_Theta_20()
{
	signalvalue1 = getSignal(S4_SRR_RL_Clu_Theta_20);
	write("S4_SRR_RL_Clu_Theta_20 :%f",signalvalue1);
	write("i_S4_SRR_RL_Clu_Theta_20 :%f",@ecu_Signals::i_S4_SRR_RL_Clu_Theta_20);

	testStep("get expect variable value: ","i_S4_SRR_RL_Clu_Theta_20 :%f",@ecu_Signals::i_S4_SRR_RL_Clu_Theta_20);

	if((abs(@ecu_Signals::i_S4_SRR_RL_Clu_Theta_20)*0.9<=abs(signalvalue1))&&(abs(signalvalue1)<=abs(@ecu_Signals::i_S4_SRR_RL_Clu_Theta_20)*1.1))
	{
	testStepPass("Pass","i_S4_SRR_RL_Clu_Theta_20 :%f",signalvalue1);
	}
	else
	{
	testStepFail("Fail","i_S4_SRR_RL_Clu_Theta_20 :%f",signalvalue1);
	}
}

testcase S4_SRR_RL_Clu_Mes_2_S4_SRR_RL_Clu_Dist_20()
{
	signalvalue1 = getSignal(S4_SRR_RL_Clu_Dist_20);
	write("S4_SRR_RL_Clu_Dist_20 :%f",signalvalue1);
	write("i_S4_SRR_RL_Clu_Dist_20 :%f",@ecu_Signals::i_S4_SRR_RL_Clu_Dist_20);

	testStep("get expect variable value: ","i_S4_SRR_RL_Clu_Dist_20 :%f",@ecu_Signals::i_S4_SRR_RL_Clu_Dist_20);

	if((abs(@ecu_Signals::i_S4_SRR_RL_Clu_Dist_20)*0.9<=abs(signalvalue1))&&(abs(signalvalue1)<=abs(@ecu_Signals::i_S4_SRR_RL_Clu_Dist_20)*1.1))
	{
	testStepPass("Pass","i_S4_SRR_RL_Clu_Dist_20 :%f",signalvalue1);
	}
	else
	{
	testStepFail("Fail","i_S4_SRR_RL_Clu_Dist_20 :%f",signalvalue1);
	}
}

testcase S4_SRR_RL_Clu_Mes_2_S4_SRR_RL_Clu_Vel_20()
{
	signalvalue1 = getSignal(S4_SRR_RL_Clu_Vel_20);
	write("S4_SRR_RL_Clu_Vel_20 :%f",signalvalue1);
	write("i_S4_SRR_RL_Clu_Vel_20 :%f",@ecu_Signals::i_S4_SRR_RL_Clu_Vel_20);

	testStep("get expect variable value: ","i_S4_SRR_RL_Clu_Vel_20 :%f",@ecu_Signals::i_S4_SRR_RL_Clu_Vel_20);

	if((abs(@ecu_Signals::i_S4_SRR_RL_Clu_Vel_20)*0.9<=abs(signalvalue1))&&(abs(signalvalue1)<=abs(@ecu_Signals::i_S4_SRR_RL_Clu_Vel_20)*1.1))
	{
	testStepPass("Pass","i_S4_SRR_RL_Clu_Vel_20 :%f",signalvalue1);
	}
	else
	{
	testStepFail("Fail","i_S4_SRR_RL_Clu_Vel_20 :%f",signalvalue1);
	}
}

testcase S4_SRR_RL_Clu_Mes_2_S4_SRR_RL_Clu_SNR_20()
{
	signalvalue1 = getSignal(S4_SRR_RL_Clu_SNR_20);
	write("S4_SRR_RL_Clu_SNR_20 :%f",signalvalue1);
	write("i_S4_SRR_RL_Clu_SNR_20 :%f",@ecu_Signals::i_S4_SRR_RL_Clu_SNR_20);

	testStep("get expect variable value: ","i_S4_SRR_RL_Clu_SNR_20 :%f",@ecu_Signals::i_S4_SRR_RL_Clu_SNR_20);

	if((abs(@ecu_Signals::i_S4_SRR_RL_Clu_SNR_20)*0.9<=abs(signalvalue1))&&(abs(signalvalue1)<=abs(@ecu_Signals::i_S4_SRR_RL_Clu_SNR_20)*1.1))
	{
	testStepPass("Pass","i_S4_SRR_RL_Clu_SNR_20 :%f",signalvalue1);
	}
	else
	{
	testStepFail("Fail","i_S4_SRR_RL_Clu_SNR_20 :%f",signalvalue1);
	}
}

testcase S4_SRR_RL_Clu_Mes_2_S4_SRR_RL_Clu_DynProp_20()
{
	signalvalue1 = getSignal(S4_SRR_RL_Clu_DynProp_20);
	write("S4_SRR_RL_Clu_DynProp_20 :%f",signalvalue1);
	write("i_S4_SRR_RL_Clu_DynProp_20 :%o",@ecu_Signals::i_S4_SRR_RL_Clu_DynProp_20);

	testStep("get expect variable value: ","i_S4_SRR_RL_Clu_DynProp_20 :%o",@ecu_Signals::i_S4_SRR_RL_Clu_DynProp_20);

	if(signalvalue1==@ecu_Signals::i_S4_SRR_RL_Clu_DynProp_20)
	{
	testStepPass("Pass","i_S4_SRR_RL_Clu_DynProp_20 :%f",signalvalue1);
	}
	else
	{
	testStepFail("Fail","i_S4_SRR_RL_Clu_DynProp_20 :%f",signalvalue1);
	}
}

testcase S4_SRR_RL_Clu_Mes_2_S4_SRR_RL_Clu_Locationvalid_20()
{
	signalvalue1 = getSignal(S4_SRR_RL_Clu_Locationvalid_20);
	write("S4_SRR_RL_Clu_Locationvalid_20 :%f",signalvalue1);
	write("i_S4_SRR_RL_Clu_Locationvalid_20 :%o",@ecu_Signals::i_S4_SRR_RL_Clu_Locationvalid_20);

	testStep("get expect variable value: ","i_S4_SRR_RL_Clu_Locationvalid_20 :%o",@ecu_Signals::i_S4_SRR_RL_Clu_Locationvalid_20);

	if(signalvalue1==@ecu_Signals::i_S4_SRR_RL_Clu_Locationvalid_20)
	{
	testStepPass("Pass","i_S4_SRR_RL_Clu_Locationvalid_20 :%f",signalvalue1);
	}
	else
	{
	testStepFail("Fail","i_S4_SRR_RL_Clu_Locationvalid_20 :%f",signalvalue1);
	}
}

testcase S4_SRR_RL_Clu_Mes_3_S4_SRR_RL_Clu_Theta_21()
{
	signalvalue1 = getSignal(S4_SRR_RL_Clu_Theta_21);
	write("S4_SRR_RL_Clu_Theta_21 :%f",signalvalue1);
	write("i_S4_SRR_RL_Clu_Theta_21 :%f",@ecu_Signals::i_S4_SRR_RL_Clu_Theta_21);

	testStep("get expect variable value: ","i_S4_SRR_RL_Clu_Theta_21 :%f",@ecu_Signals::i_S4_SRR_RL_Clu_Theta_21);

	if((abs(@ecu_Signals::i_S4_SRR_RL_Clu_Theta_21)*0.9<=abs(signalvalue1))&&(abs(signalvalue1)<=abs(@ecu_Signals::i_S4_SRR_RL_Clu_Theta_21)*1.1))
	{
	testStepPass("Pass","i_S4_SRR_RL_Clu_Theta_21 :%f",signalvalue1);
	}
	else
	{
	testStepFail("Fail","i_S4_SRR_RL_Clu_Theta_21 :%f",signalvalue1);
	}
}

testcase S4_SRR_RL_Clu_Mes_3_S4_SRR_RL_Clu_Dist_21()
{
	signalvalue1 = getSignal(S4_SRR_RL_Clu_Dist_21);
	write("S4_SRR_RL_Clu_Dist_21 :%f",signalvalue1);
	write("i_S4_SRR_RL_Clu_Dist_21 :%f",@ecu_Signals::i_S4_SRR_RL_Clu_Dist_21);

	testStep("get expect variable value: ","i_S4_SRR_RL_Clu_Dist_21 :%f",@ecu_Signals::i_S4_SRR_RL_Clu_Dist_21);

	if((abs(@ecu_Signals::i_S4_SRR_RL_Clu_Dist_21)*0.9<=abs(signalvalue1))&&(abs(signalvalue1)<=abs(@ecu_Signals::i_S4_SRR_RL_Clu_Dist_21)*1.1))
	{
	testStepPass("Pass","i_S4_SRR_RL_Clu_Dist_21 :%f",signalvalue1);
	}
	else
	{
	testStepFail("Fail","i_S4_SRR_RL_Clu_Dist_21 :%f",signalvalue1);
	}
}

testcase S4_SRR_RL_Clu_Mes_3_S4_SRR_RL_Clu_Vel_21()
{
	signalvalue1 = getSignal(S4_SRR_RL_Clu_Vel_21);
	write("S4_SRR_RL_Clu_Vel_21 :%f",signalvalue1);
	write("i_S4_SRR_RL_Clu_Vel_21 :%f",@ecu_Signals::i_S4_SRR_RL_Clu_Vel_21);

	testStep("get expect variable value: ","i_S4_SRR_RL_Clu_Vel_21 :%f",@ecu_Signals::i_S4_SRR_RL_Clu_Vel_21);

	if((abs(@ecu_Signals::i_S4_SRR_RL_Clu_Vel_21)*0.9<=abs(signalvalue1))&&(abs(signalvalue1)<=abs(@ecu_Signals::i_S4_SRR_RL_Clu_Vel_21)*1.1))
	{
	testStepPass("Pass","i_S4_SRR_RL_Clu_Vel_21 :%f",signalvalue1);
	}
	else
	{
	testStepFail("Fail","i_S4_SRR_RL_Clu_Vel_21 :%f",signalvalue1);
	}
}

testcase S4_SRR_RL_Clu_Mes_3_S4_SRR_RL_Clu_SNR_21()
{
	signalvalue1 = getSignal(S4_SRR_RL_Clu_SNR_21);
	write("S4_SRR_RL_Clu_SNR_21 :%f",signalvalue1);
	write("i_S4_SRR_RL_Clu_SNR_21 :%f",@ecu_Signals::i_S4_SRR_RL_Clu_SNR_21);

	testStep("get expect variable value: ","i_S4_SRR_RL_Clu_SNR_21 :%f",@ecu_Signals::i_S4_SRR_RL_Clu_SNR_21);

	if((abs(@ecu_Signals::i_S4_SRR_RL_Clu_SNR_21)*0.9<=abs(signalvalue1))&&(abs(signalvalue1)<=abs(@ecu_Signals::i_S4_SRR_RL_Clu_SNR_21)*1.1))
	{
	testStepPass("Pass","i_S4_SRR_RL_Clu_SNR_21 :%f",signalvalue1);
	}
	else
	{
	testStepFail("Fail","i_S4_SRR_RL_Clu_SNR_21 :%f",signalvalue1);
	}
}

testcase S4_SRR_RL_Clu_Mes_3_S4_SRR_RL_Clu_DynProp_21()
{
	signalvalue1 = getSignal(S4_SRR_RL_Clu_DynProp_21);
	write("S4_SRR_RL_Clu_DynProp_21 :%f",signalvalue1);
	write("i_S4_SRR_RL_Clu_DynProp_21 :%o",@ecu_Signals::i_S4_SRR_RL_Clu_DynProp_21);

	testStep("get expect variable value: ","i_S4_SRR_RL_Clu_DynProp_21 :%o",@ecu_Signals::i_S4_SRR_RL_Clu_DynProp_21);

	if(signalvalue1==@ecu_Signals::i_S4_SRR_RL_Clu_DynProp_21)
	{
	testStepPass("Pass","i_S4_SRR_RL_Clu_DynProp_21 :%f",signalvalue1);
	}
	else
	{
	testStepFail("Fail","i_S4_SRR_RL_Clu_DynProp_21 :%f",signalvalue1);
	}
}

testcase S4_SRR_RL_Clu_Mes_3_S4_SRR_RL_Clu_Locationvalid_21()
{
	signalvalue1 = getSignal(S4_SRR_RL_Clu_Locationvalid_21);
	write("S4_SRR_RL_Clu_Locationvalid_21 :%f",signalvalue1);
	write("i_S4_SRR_RL_Clu_Locationvalid_21 :%o",@ecu_Signals::i_S4_SRR_RL_Clu_Locationvalid_21);

	testStep("get expect variable value: ","i_S4_SRR_RL_Clu_Locationvalid_21 :%o",@ecu_Signals::i_S4_SRR_RL_Clu_Locationvalid_21);

	if(signalvalue1==@ecu_Signals::i_S4_SRR_RL_Clu_Locationvalid_21)
	{
	testStepPass("Pass","i_S4_SRR_RL_Clu_Locationvalid_21 :%f",signalvalue1);
	}
	else
	{
	testStepFail("Fail","i_S4_SRR_RL_Clu_Locationvalid_21 :%f",signalvalue1);
	}
}

testcase S4_SRR_RL_Clu_Mes_3_S4_SRR_RL_Clu_Theta_22()
{
	signalvalue1 = getSignal(S4_SRR_RL_Clu_Theta_22);
	write("S4_SRR_RL_Clu_Theta_22 :%f",signalvalue1);
	write("i_S4_SRR_RL_Clu_Theta_22 :%f",@ecu_Signals::i_S4_SRR_RL_Clu_Theta_22);

	testStep("get expect variable value: ","i_S4_SRR_RL_Clu_Theta_22 :%f",@ecu_Signals::i_S4_SRR_RL_Clu_Theta_22);

	if((abs(@ecu_Signals::i_S4_SRR_RL_Clu_Theta_22)*0.9<=abs(signalvalue1))&&(abs(signalvalue1)<=abs(@ecu_Signals::i_S4_SRR_RL_Clu_Theta_22)*1.1))
	{
	testStepPass("Pass","i_S4_SRR_RL_Clu_Theta_22 :%f",signalvalue1);
	}
	else
	{
	testStepFail("Fail","i_S4_SRR_RL_Clu_Theta_22 :%f",signalvalue1);
	}
}

testcase S4_SRR_RL_Clu_Mes_3_S4_SRR_RL_Clu_Dist_22()
{
	signalvalue1 = getSignal(S4_SRR_RL_Clu_Dist_22);
	write("S4_SRR_RL_Clu_Dist_22 :%f",signalvalue1);
	write("i_S4_SRR_RL_Clu_Dist_22 :%f",@ecu_Signals::i_S4_SRR_RL_Clu_Dist_22);

	testStep("get expect variable value: ","i_S4_SRR_RL_Clu_Dist_22 :%f",@ecu_Signals::i_S4_SRR_RL_Clu_Dist_22);

	if((abs(@ecu_Signals::i_S4_SRR_RL_Clu_Dist_22)*0.9<=abs(signalvalue1))&&(abs(signalvalue1)<=abs(@ecu_Signals::i_S4_SRR_RL_Clu_Dist_22)*1.1))
	{
	testStepPass("Pass","i_S4_SRR_RL_Clu_Dist_22 :%f",signalvalue1);
	}
	else
	{
	testStepFail("Fail","i_S4_SRR_RL_Clu_Dist_22 :%f",signalvalue1);
	}
}

testcase S4_SRR_RL_Clu_Mes_3_S4_SRR_RL_Clu_Vel_22()
{
	signalvalue1 = getSignal(S4_SRR_RL_Clu_Vel_22);
	write("S4_SRR_RL_Clu_Vel_22 :%f",signalvalue1);
	write("i_S4_SRR_RL_Clu_Vel_22 :%f",@ecu_Signals::i_S4_SRR_RL_Clu_Vel_22);

	testStep("get expect variable value: ","i_S4_SRR_RL_Clu_Vel_22 :%f",@ecu_Signals::i_S4_SRR_RL_Clu_Vel_22);

	if((abs(@ecu_Signals::i_S4_SRR_RL_Clu_Vel_22)*0.9<=abs(signalvalue1))&&(abs(signalvalue1)<=abs(@ecu_Signals::i_S4_SRR_RL_Clu_Vel_22)*1.1))
	{
	testStepPass("Pass","i_S4_SRR_RL_Clu_Vel_22 :%f",signalvalue1);
	}
	else
	{
	testStepFail("Fail","i_S4_SRR_RL_Clu_Vel_22 :%f",signalvalue1);
	}
}

testcase S4_SRR_RL_Clu_Mes_3_S4_SRR_RL_Clu_SNR_22()
{
	signalvalue1 = getSignal(S4_SRR_RL_Clu_SNR_22);
	write("S4_SRR_RL_Clu_SNR_22 :%f",signalvalue1);
	write("i_S4_SRR_RL_Clu_SNR_22 :%f",@ecu_Signals::i_S4_SRR_RL_Clu_SNR_22);

	testStep("get expect variable value: ","i_S4_SRR_RL_Clu_SNR_22 :%f",@ecu_Signals::i_S4_SRR_RL_Clu_SNR_22);

	if((abs(@ecu_Signals::i_S4_SRR_RL_Clu_SNR_22)*0.9<=abs(signalvalue1))&&(abs(signalvalue1)<=abs(@ecu_Signals::i_S4_SRR_RL_Clu_SNR_22)*1.1))
	{
	testStepPass("Pass","i_S4_SRR_RL_Clu_SNR_22 :%f",signalvalue1);
	}
	else
	{
	testStepFail("Fail","i_S4_SRR_RL_Clu_SNR_22 :%f",signalvalue1);
	}
}

testcase S4_SRR_RL_Clu_Mes_3_S4_SRR_RL_Clu_DynProp_22()
{
	signalvalue1 = getSignal(S4_SRR_RL_Clu_DynProp_22);
	write("S4_SRR_RL_Clu_DynProp_22 :%f",signalvalue1);
	write("i_S4_SRR_RL_Clu_DynProp_22 :%o",@ecu_Signals::i_S4_SRR_RL_Clu_DynProp_22);

	testStep("get expect variable value: ","i_S4_SRR_RL_Clu_DynProp_22 :%o",@ecu_Signals::i_S4_SRR_RL_Clu_DynProp_22);

	if(signalvalue1==@ecu_Signals::i_S4_SRR_RL_Clu_DynProp_22)
	{
	testStepPass("Pass","i_S4_SRR_RL_Clu_DynProp_22 :%f",signalvalue1);
	}
	else
	{
	testStepFail("Fail","i_S4_SRR_RL_Clu_DynProp_22 :%f",signalvalue1);
	}
}

testcase S4_SRR_RL_Clu_Mes_3_S4_SRR_RL_Clu_Locationvalid_22()
{
	signalvalue1 = getSignal(S4_SRR_RL_Clu_Locationvalid_22);
	write("S4_SRR_RL_Clu_Locationvalid_22 :%f",signalvalue1);
	write("i_S4_SRR_RL_Clu_Locationvalid_22 :%o",@ecu_Signals::i_S4_SRR_RL_Clu_Locationvalid_22);

	testStep("get expect variable value: ","i_S4_SRR_RL_Clu_Locationvalid_22 :%o",@ecu_Signals::i_S4_SRR_RL_Clu_Locationvalid_22);

	if(signalvalue1==@ecu_Signals::i_S4_SRR_RL_Clu_Locationvalid_22)
	{
	testStepPass("Pass","i_S4_SRR_RL_Clu_Locationvalid_22 :%f",signalvalue1);
	}
	else
	{
	testStepFail("Fail","i_S4_SRR_RL_Clu_Locationvalid_22 :%f",signalvalue1);
	}
}

testcase S4_SRR_RL_Clu_Mes_3_S4_SRR_RL_Clu_Theta_23()
{
	signalvalue1 = getSignal(S4_SRR_RL_Clu_Theta_23);
	write("S4_SRR_RL_Clu_Theta_23 :%f",signalvalue1);
	write("i_S4_SRR_RL_Clu_Theta_23 :%f",@ecu_Signals::i_S4_SRR_RL_Clu_Theta_23);

	testStep("get expect variable value: ","i_S4_SRR_RL_Clu_Theta_23 :%f",@ecu_Signals::i_S4_SRR_RL_Clu_Theta_23);

	if((abs(@ecu_Signals::i_S4_SRR_RL_Clu_Theta_23)*0.9<=abs(signalvalue1))&&(abs(signalvalue1)<=abs(@ecu_Signals::i_S4_SRR_RL_Clu_Theta_23)*1.1))
	{
	testStepPass("Pass","i_S4_SRR_RL_Clu_Theta_23 :%f",signalvalue1);
	}
	else
	{
	testStepFail("Fail","i_S4_SRR_RL_Clu_Theta_23 :%f",signalvalue1);
	}
}

testcase S4_SRR_RL_Clu_Mes_3_S4_SRR_RL_Clu_Dist_23()
{
	signalvalue1 = getSignal(S4_SRR_RL_Clu_Dist_23);
	write("S4_SRR_RL_Clu_Dist_23 :%f",signalvalue1);
	write("i_S4_SRR_RL_Clu_Dist_23 :%f",@ecu_Signals::i_S4_SRR_RL_Clu_Dist_23);

	testStep("get expect variable value: ","i_S4_SRR_RL_Clu_Dist_23 :%f",@ecu_Signals::i_S4_SRR_RL_Clu_Dist_23);

	if((abs(@ecu_Signals::i_S4_SRR_RL_Clu_Dist_23)*0.9<=abs(signalvalue1))&&(abs(signalvalue1)<=abs(@ecu_Signals::i_S4_SRR_RL_Clu_Dist_23)*1.1))
	{
	testStepPass("Pass","i_S4_SRR_RL_Clu_Dist_23 :%f",signalvalue1);
	}
	else
	{
	testStepFail("Fail","i_S4_SRR_RL_Clu_Dist_23 :%f",signalvalue1);
	}
}

testcase S4_SRR_RL_Clu_Mes_3_S4_SRR_RL_Clu_Vel_23()
{
	signalvalue1 = getSignal(S4_SRR_RL_Clu_Vel_23);
	write("S4_SRR_RL_Clu_Vel_23 :%f",signalvalue1);
	write("i_S4_SRR_RL_Clu_Vel_23 :%f",@ecu_Signals::i_S4_SRR_RL_Clu_Vel_23);

	testStep("get expect variable value: ","i_S4_SRR_RL_Clu_Vel_23 :%f",@ecu_Signals::i_S4_SRR_RL_Clu_Vel_23);

	if((abs(@ecu_Signals::i_S4_SRR_RL_Clu_Vel_23)*0.9<=abs(signalvalue1))&&(abs(signalvalue1)<=abs(@ecu_Signals::i_S4_SRR_RL_Clu_Vel_23)*1.1))
	{
	testStepPass("Pass","i_S4_SRR_RL_Clu_Vel_23 :%f",signalvalue1);
	}
	else
	{
	testStepFail("Fail","i_S4_SRR_RL_Clu_Vel_23 :%f",signalvalue1);
	}
}

testcase S4_SRR_RL_Clu_Mes_3_S4_SRR_RL_Clu_SNR_23()
{
	signalvalue1 = getSignal(S4_SRR_RL_Clu_SNR_23);
	write("S4_SRR_RL_Clu_SNR_23 :%f",signalvalue1);
	write("i_S4_SRR_RL_Clu_SNR_23 :%f",@ecu_Signals::i_S4_SRR_RL_Clu_SNR_23);

	testStep("get expect variable value: ","i_S4_SRR_RL_Clu_SNR_23 :%f",@ecu_Signals::i_S4_SRR_RL_Clu_SNR_23);

	if((abs(@ecu_Signals::i_S4_SRR_RL_Clu_SNR_23)*0.9<=abs(signalvalue1))&&(abs(signalvalue1)<=abs(@ecu_Signals::i_S4_SRR_RL_Clu_SNR_23)*1.1))
	{
	testStepPass("Pass","i_S4_SRR_RL_Clu_SNR_23 :%f",signalvalue1);
	}
	else
	{
	testStepFail("Fail","i_S4_SRR_RL_Clu_SNR_23 :%f",signalvalue1);
	}
}

testcase S4_SRR_RL_Clu_Mes_3_S4_SRR_RL_Clu_DynProp_23()
{
	signalvalue1 = getSignal(S4_SRR_RL_Clu_DynProp_23);
	write("S4_SRR_RL_Clu_DynProp_23 :%f",signalvalue1);
	write("i_S4_SRR_RL_Clu_DynProp_23 :%o",@ecu_Signals::i_S4_SRR_RL_Clu_DynProp_23);

	testStep("get expect variable value: ","i_S4_SRR_RL_Clu_DynProp_23 :%o",@ecu_Signals::i_S4_SRR_RL_Clu_DynProp_23);

	if(signalvalue1==@ecu_Signals::i_S4_SRR_RL_Clu_DynProp_23)
	{
	testStepPass("Pass","i_S4_SRR_RL_Clu_DynProp_23 :%f",signalvalue1);
	}
	else
	{
	testStepFail("Fail","i_S4_SRR_RL_Clu_DynProp_23 :%f",signalvalue1);
	}
}

testcase S4_SRR_RL_Clu_Mes_3_S4_SRR_RL_Clu_Locationvalid_23()
{
	signalvalue1 = getSignal(S4_SRR_RL_Clu_Locationvalid_23);
	write("S4_SRR_RL_Clu_Locationvalid_23 :%f",signalvalue1);
	write("i_S4_SRR_RL_Clu_Locationvalid_23 :%o",@ecu_Signals::i_S4_SRR_RL_Clu_Locationvalid_23);

	testStep("get expect variable value: ","i_S4_SRR_RL_Clu_Locationvalid_23 :%o",@ecu_Signals::i_S4_SRR_RL_Clu_Locationvalid_23);

	if(signalvalue1==@ecu_Signals::i_S4_SRR_RL_Clu_Locationvalid_23)
	{
	testStepPass("Pass","i_S4_SRR_RL_Clu_Locationvalid_23 :%f",signalvalue1);
	}
	else
	{
	testStepFail("Fail","i_S4_SRR_RL_Clu_Locationvalid_23 :%f",signalvalue1);
	}
}

testcase S4_SRR_RL_Clu_Mes_3_S4_SRR_RL_Clu_Theta_24()
{
	signalvalue1 = getSignal(S4_SRR_RL_Clu_Theta_24);
	write("S4_SRR_RL_Clu_Theta_24 :%f",signalvalue1);
	write("i_S4_SRR_RL_Clu_Theta_24 :%f",@ecu_Signals::i_S4_SRR_RL_Clu_Theta_24);

	testStep("get expect variable value: ","i_S4_SRR_RL_Clu_Theta_24 :%f",@ecu_Signals::i_S4_SRR_RL_Clu_Theta_24);

	if((abs(@ecu_Signals::i_S4_SRR_RL_Clu_Theta_24)*0.9<=abs(signalvalue1))&&(abs(signalvalue1)<=abs(@ecu_Signals::i_S4_SRR_RL_Clu_Theta_24)*1.1))
	{
	testStepPass("Pass","i_S4_SRR_RL_Clu_Theta_24 :%f",signalvalue1);
	}
	else
	{
	testStepFail("Fail","i_S4_SRR_RL_Clu_Theta_24 :%f",signalvalue1);
	}
}

testcase S4_SRR_RL_Clu_Mes_3_S4_SRR_RL_Clu_Dist_24()
{
	signalvalue1 = getSignal(S4_SRR_RL_Clu_Dist_24);
	write("S4_SRR_RL_Clu_Dist_24 :%f",signalvalue1);
	write("i_S4_SRR_RL_Clu_Dist_24 :%f",@ecu_Signals::i_S4_SRR_RL_Clu_Dist_24);

	testStep("get expect variable value: ","i_S4_SRR_RL_Clu_Dist_24 :%f",@ecu_Signals::i_S4_SRR_RL_Clu_Dist_24);

	if((abs(@ecu_Signals::i_S4_SRR_RL_Clu_Dist_24)*0.9<=abs(signalvalue1))&&(abs(signalvalue1)<=abs(@ecu_Signals::i_S4_SRR_RL_Clu_Dist_24)*1.1))
	{
	testStepPass("Pass","i_S4_SRR_RL_Clu_Dist_24 :%f",signalvalue1);
	}
	else
	{
	testStepFail("Fail","i_S4_SRR_RL_Clu_Dist_24 :%f",signalvalue1);
	}
}

testcase S4_SRR_RL_Clu_Mes_3_S4_SRR_RL_Clu_Vel_24()
{
	signalvalue1 = getSignal(S4_SRR_RL_Clu_Vel_24);
	write("S4_SRR_RL_Clu_Vel_24 :%f",signalvalue1);
	write("i_S4_SRR_RL_Clu_Vel_24 :%f",@ecu_Signals::i_S4_SRR_RL_Clu_Vel_24);

	testStep("get expect variable value: ","i_S4_SRR_RL_Clu_Vel_24 :%f",@ecu_Signals::i_S4_SRR_RL_Clu_Vel_24);

	if((abs(@ecu_Signals::i_S4_SRR_RL_Clu_Vel_24)*0.9<=abs(signalvalue1))&&(abs(signalvalue1)<=abs(@ecu_Signals::i_S4_SRR_RL_Clu_Vel_24)*1.1))
	{
	testStepPass("Pass","i_S4_SRR_RL_Clu_Vel_24 :%f",signalvalue1);
	}
	else
	{
	testStepFail("Fail","i_S4_SRR_RL_Clu_Vel_24 :%f",signalvalue1);
	}
}

testcase S4_SRR_RL_Clu_Mes_3_S4_SRR_RL_Clu_SNR_24()
{
	signalvalue1 = getSignal(S4_SRR_RL_Clu_SNR_24);
	write("S4_SRR_RL_Clu_SNR_24 :%f",signalvalue1);
	write("i_S4_SRR_RL_Clu_SNR_24 :%f",@ecu_Signals::i_S4_SRR_RL_Clu_SNR_24);

	testStep("get expect variable value: ","i_S4_SRR_RL_Clu_SNR_24 :%f",@ecu_Signals::i_S4_SRR_RL_Clu_SNR_24);

	if((abs(@ecu_Signals::i_S4_SRR_RL_Clu_SNR_24)*0.9<=abs(signalvalue1))&&(abs(signalvalue1)<=abs(@ecu_Signals::i_S4_SRR_RL_Clu_SNR_24)*1.1))
	{
	testStepPass("Pass","i_S4_SRR_RL_Clu_SNR_24 :%f",signalvalue1);
	}
	else
	{
	testStepFail("Fail","i_S4_SRR_RL_Clu_SNR_24 :%f",signalvalue1);
	}
}

testcase S4_SRR_RL_Clu_Mes_3_S4_SRR_RL_Clu_DynProp_24()
{
	signalvalue1 = getSignal(S4_SRR_RL_Clu_DynProp_24);
	write("S4_SRR_RL_Clu_DynProp_24 :%f",signalvalue1);
	write("i_S4_SRR_RL_Clu_DynProp_24 :%o",@ecu_Signals::i_S4_SRR_RL_Clu_DynProp_24);

	testStep("get expect variable value: ","i_S4_SRR_RL_Clu_DynProp_24 :%o",@ecu_Signals::i_S4_SRR_RL_Clu_DynProp_24);

	if(signalvalue1==@ecu_Signals::i_S4_SRR_RL_Clu_DynProp_24)
	{
	testStepPass("Pass","i_S4_SRR_RL_Clu_DynProp_24 :%f",signalvalue1);
	}
	else
	{
	testStepFail("Fail","i_S4_SRR_RL_Clu_DynProp_24 :%f",signalvalue1);
	}
}

testcase S4_SRR_RL_Clu_Mes_3_S4_SRR_RL_Clu_Locationvalid_24()
{
	signalvalue1 = getSignal(S4_SRR_RL_Clu_Locationvalid_24);
	write("S4_SRR_RL_Clu_Locationvalid_24 :%f",signalvalue1);
	write("i_S4_SRR_RL_Clu_Locationvalid_24 :%o",@ecu_Signals::i_S4_SRR_RL_Clu_Locationvalid_24);

	testStep("get expect variable value: ","i_S4_SRR_RL_Clu_Locationvalid_24 :%o",@ecu_Signals::i_S4_SRR_RL_Clu_Locationvalid_24);

	if(signalvalue1==@ecu_Signals::i_S4_SRR_RL_Clu_Locationvalid_24)
	{
	testStepPass("Pass","i_S4_SRR_RL_Clu_Locationvalid_24 :%f",signalvalue1);
	}
	else
	{
	testStepFail("Fail","i_S4_SRR_RL_Clu_Locationvalid_24 :%f",signalvalue1);
	}
}

testcase S4_SRR_RL_Clu_Mes_3_S4_SRR_RL_Clu_Theta_25()
{
	signalvalue1 = getSignal(S4_SRR_RL_Clu_Theta_25);
	write("S4_SRR_RL_Clu_Theta_25 :%f",signalvalue1);
	write("i_S4_SRR_RL_Clu_Theta_25 :%f",@ecu_Signals::i_S4_SRR_RL_Clu_Theta_25);

	testStep("get expect variable value: ","i_S4_SRR_RL_Clu_Theta_25 :%f",@ecu_Signals::i_S4_SRR_RL_Clu_Theta_25);

	if((abs(@ecu_Signals::i_S4_SRR_RL_Clu_Theta_25)*0.9<=abs(signalvalue1))&&(abs(signalvalue1)<=abs(@ecu_Signals::i_S4_SRR_RL_Clu_Theta_25)*1.1))
	{
	testStepPass("Pass","i_S4_SRR_RL_Clu_Theta_25 :%f",signalvalue1);
	}
	else
	{
	testStepFail("Fail","i_S4_SRR_RL_Clu_Theta_25 :%f",signalvalue1);
	}
}

testcase S4_SRR_RL_Clu_Mes_3_S4_SRR_RL_Clu_Dist_25()
{
	signalvalue1 = getSignal(S4_SRR_RL_Clu_Dist_25);
	write("S4_SRR_RL_Clu_Dist_25 :%f",signalvalue1);
	write("i_S4_SRR_RL_Clu_Dist_25 :%f",@ecu_Signals::i_S4_SRR_RL_Clu_Dist_25);

	testStep("get expect variable value: ","i_S4_SRR_RL_Clu_Dist_25 :%f",@ecu_Signals::i_S4_SRR_RL_Clu_Dist_25);

	if((abs(@ecu_Signals::i_S4_SRR_RL_Clu_Dist_25)*0.9<=abs(signalvalue1))&&(abs(signalvalue1)<=abs(@ecu_Signals::i_S4_SRR_RL_Clu_Dist_25)*1.1))
	{
	testStepPass("Pass","i_S4_SRR_RL_Clu_Dist_25 :%f",signalvalue1);
	}
	else
	{
	testStepFail("Fail","i_S4_SRR_RL_Clu_Dist_25 :%f",signalvalue1);
	}
}

testcase S4_SRR_RL_Clu_Mes_3_S4_SRR_RL_Clu_Vel_25()
{
	signalvalue1 = getSignal(S4_SRR_RL_Clu_Vel_25);
	write("S4_SRR_RL_Clu_Vel_25 :%f",signalvalue1);
	write("i_S4_SRR_RL_Clu_Vel_25 :%f",@ecu_Signals::i_S4_SRR_RL_Clu_Vel_25);

	testStep("get expect variable value: ","i_S4_SRR_RL_Clu_Vel_25 :%f",@ecu_Signals::i_S4_SRR_RL_Clu_Vel_25);

	if((abs(@ecu_Signals::i_S4_SRR_RL_Clu_Vel_25)*0.9<=abs(signalvalue1))&&(abs(signalvalue1)<=abs(@ecu_Signals::i_S4_SRR_RL_Clu_Vel_25)*1.1))
	{
	testStepPass("Pass","i_S4_SRR_RL_Clu_Vel_25 :%f",signalvalue1);
	}
	else
	{
	testStepFail("Fail","i_S4_SRR_RL_Clu_Vel_25 :%f",signalvalue1);
	}
}

testcase S4_SRR_RL_Clu_Mes_3_S4_SRR_RL_Clu_SNR_25()
{
	signalvalue1 = getSignal(S4_SRR_RL_Clu_SNR_25);
	write("S4_SRR_RL_Clu_SNR_25 :%f",signalvalue1);
	write("i_S4_SRR_RL_Clu_SNR_25 :%f",@ecu_Signals::i_S4_SRR_RL_Clu_SNR_25);

	testStep("get expect variable value: ","i_S4_SRR_RL_Clu_SNR_25 :%f",@ecu_Signals::i_S4_SRR_RL_Clu_SNR_25);

	if((abs(@ecu_Signals::i_S4_SRR_RL_Clu_SNR_25)*0.9<=abs(signalvalue1))&&(abs(signalvalue1)<=abs(@ecu_Signals::i_S4_SRR_RL_Clu_SNR_25)*1.1))
	{
	testStepPass("Pass","i_S4_SRR_RL_Clu_SNR_25 :%f",signalvalue1);
	}
	else
	{
	testStepFail("Fail","i_S4_SRR_RL_Clu_SNR_25 :%f",signalvalue1);
	}
}

testcase S4_SRR_RL_Clu_Mes_3_S4_SRR_RL_Clu_DynProp_25()
{
	signalvalue1 = getSignal(S4_SRR_RL_Clu_DynProp_25);
	write("S4_SRR_RL_Clu_DynProp_25 :%f",signalvalue1);
	write("i_S4_SRR_RL_Clu_DynProp_25 :%o",@ecu_Signals::i_S4_SRR_RL_Clu_DynProp_25);

	testStep("get expect variable value: ","i_S4_SRR_RL_Clu_DynProp_25 :%o",@ecu_Signals::i_S4_SRR_RL_Clu_DynProp_25);

	if(signalvalue1==@ecu_Signals::i_S4_SRR_RL_Clu_DynProp_25)
	{
	testStepPass("Pass","i_S4_SRR_RL_Clu_DynProp_25 :%f",signalvalue1);
	}
	else
	{
	testStepFail("Fail","i_S4_SRR_RL_Clu_DynProp_25 :%f",signalvalue1);
	}
}

testcase S4_SRR_RL_Clu_Mes_3_S4_SRR_RL_Clu_Locationvalid_25()
{
	signalvalue1 = getSignal(S4_SRR_RL_Clu_Locationvalid_25);
	write("S4_SRR_RL_Clu_Locationvalid_25 :%f",signalvalue1);
	write("i_S4_SRR_RL_Clu_Locationvalid_25 :%o",@ecu_Signals::i_S4_SRR_RL_Clu_Locationvalid_25);

	testStep("get expect variable value: ","i_S4_SRR_RL_Clu_Locationvalid_25 :%o",@ecu_Signals::i_S4_SRR_RL_Clu_Locationvalid_25);

	if(signalvalue1==@ecu_Signals::i_S4_SRR_RL_Clu_Locationvalid_25)
	{
	testStepPass("Pass","i_S4_SRR_RL_Clu_Locationvalid_25 :%f",signalvalue1);
	}
	else
	{
	testStepFail("Fail","i_S4_SRR_RL_Clu_Locationvalid_25 :%f",signalvalue1);
	}
}

testcase S4_SRR_RL_Clu_Mes_3_S4_SRR_RL_Clu_Theta_26()
{
	signalvalue1 = getSignal(S4_SRR_RL_Clu_Theta_26);
	write("S4_SRR_RL_Clu_Theta_26 :%f",signalvalue1);
	write("i_S4_SRR_RL_Clu_Theta_26 :%f",@ecu_Signals::i_S4_SRR_RL_Clu_Theta_26);

	testStep("get expect variable value: ","i_S4_SRR_RL_Clu_Theta_26 :%f",@ecu_Signals::i_S4_SRR_RL_Clu_Theta_26);

	if((abs(@ecu_Signals::i_S4_SRR_RL_Clu_Theta_26)*0.9<=abs(signalvalue1))&&(abs(signalvalue1)<=abs(@ecu_Signals::i_S4_SRR_RL_Clu_Theta_26)*1.1))
	{
	testStepPass("Pass","i_S4_SRR_RL_Clu_Theta_26 :%f",signalvalue1);
	}
	else
	{
	testStepFail("Fail","i_S4_SRR_RL_Clu_Theta_26 :%f",signalvalue1);
	}
}

testcase S4_SRR_RL_Clu_Mes_3_S4_SRR_RL_Clu_Dist_26()
{
	signalvalue1 = getSignal(S4_SRR_RL_Clu_Dist_26);
	write("S4_SRR_RL_Clu_Dist_26 :%f",signalvalue1);
	write("i_S4_SRR_RL_Clu_Dist_26 :%f",@ecu_Signals::i_S4_SRR_RL_Clu_Dist_26);

	testStep("get expect variable value: ","i_S4_SRR_RL_Clu_Dist_26 :%f",@ecu_Signals::i_S4_SRR_RL_Clu_Dist_26);

	if((abs(@ecu_Signals::i_S4_SRR_RL_Clu_Dist_26)*0.9<=abs(signalvalue1))&&(abs(signalvalue1)<=abs(@ecu_Signals::i_S4_SRR_RL_Clu_Dist_26)*1.1))
	{
	testStepPass("Pass","i_S4_SRR_RL_Clu_Dist_26 :%f",signalvalue1);
	}
	else
	{
	testStepFail("Fail","i_S4_SRR_RL_Clu_Dist_26 :%f",signalvalue1);
	}
}

testcase S4_SRR_RL_Clu_Mes_3_S4_SRR_RL_Clu_Vel_26()
{
	signalvalue1 = getSignal(S4_SRR_RL_Clu_Vel_26);
	write("S4_SRR_RL_Clu_Vel_26 :%f",signalvalue1);
	write("i_S4_SRR_RL_Clu_Vel_26 :%f",@ecu_Signals::i_S4_SRR_RL_Clu_Vel_26);

	testStep("get expect variable value: ","i_S4_SRR_RL_Clu_Vel_26 :%f",@ecu_Signals::i_S4_SRR_RL_Clu_Vel_26);

	if((abs(@ecu_Signals::i_S4_SRR_RL_Clu_Vel_26)*0.9<=abs(signalvalue1))&&(abs(signalvalue1)<=abs(@ecu_Signals::i_S4_SRR_RL_Clu_Vel_26)*1.1))
	{
	testStepPass("Pass","i_S4_SRR_RL_Clu_Vel_26 :%f",signalvalue1);
	}
	else
	{
	testStepFail("Fail","i_S4_SRR_RL_Clu_Vel_26 :%f",signalvalue1);
	}
}

testcase S4_SRR_RL_Clu_Mes_3_S4_SRR_RL_Clu_SNR_26()
{
	signalvalue1 = getSignal(S4_SRR_RL_Clu_SNR_26);
	write("S4_SRR_RL_Clu_SNR_26 :%f",signalvalue1);
	write("i_S4_SRR_RL_Clu_SNR_26 :%f",@ecu_Signals::i_S4_SRR_RL_Clu_SNR_26);

	testStep("get expect variable value: ","i_S4_SRR_RL_Clu_SNR_26 :%f",@ecu_Signals::i_S4_SRR_RL_Clu_SNR_26);

	if((abs(@ecu_Signals::i_S4_SRR_RL_Clu_SNR_26)*0.9<=abs(signalvalue1))&&(abs(signalvalue1)<=abs(@ecu_Signals::i_S4_SRR_RL_Clu_SNR_26)*1.1))
	{
	testStepPass("Pass","i_S4_SRR_RL_Clu_SNR_26 :%f",signalvalue1);
	}
	else
	{
	testStepFail("Fail","i_S4_SRR_RL_Clu_SNR_26 :%f",signalvalue1);
	}
}

testcase S4_SRR_RL_Clu_Mes_3_S4_SRR_RL_Clu_DynProp_26()
{
	signalvalue1 = getSignal(S4_SRR_RL_Clu_DynProp_26);
	write("S4_SRR_RL_Clu_DynProp_26 :%f",signalvalue1);
	write("i_S4_SRR_RL_Clu_DynProp_26 :%o",@ecu_Signals::i_S4_SRR_RL_Clu_DynProp_26);

	testStep("get expect variable value: ","i_S4_SRR_RL_Clu_DynProp_26 :%o",@ecu_Signals::i_S4_SRR_RL_Clu_DynProp_26);

	if(signalvalue1==@ecu_Signals::i_S4_SRR_RL_Clu_DynProp_26)
	{
	testStepPass("Pass","i_S4_SRR_RL_Clu_DynProp_26 :%f",signalvalue1);
	}
	else
	{
	testStepFail("Fail","i_S4_SRR_RL_Clu_DynProp_26 :%f",signalvalue1);
	}
}

testcase S4_SRR_RL_Clu_Mes_3_S4_SRR_RL_Clu_Locationvalid_26()
{
	signalvalue1 = getSignal(S4_SRR_RL_Clu_Locationvalid_26);
	write("S4_SRR_RL_Clu_Locationvalid_26 :%f",signalvalue1);
	write("i_S4_SRR_RL_Clu_Locationvalid_26 :%o",@ecu_Signals::i_S4_SRR_RL_Clu_Locationvalid_26);

	testStep("get expect variable value: ","i_S4_SRR_RL_Clu_Locationvalid_26 :%o",@ecu_Signals::i_S4_SRR_RL_Clu_Locationvalid_26);

	if(signalvalue1==@ecu_Signals::i_S4_SRR_RL_Clu_Locationvalid_26)
	{
	testStepPass("Pass","i_S4_SRR_RL_Clu_Locationvalid_26 :%f",signalvalue1);
	}
	else
	{
	testStepFail("Fail","i_S4_SRR_RL_Clu_Locationvalid_26 :%f",signalvalue1);
	}
}

testcase S4_SRR_RL_Clu_Mes_3_S4_SRR_RL_Clu_Theta_27()
{
	signalvalue1 = getSignal(S4_SRR_RL_Clu_Theta_27);
	write("S4_SRR_RL_Clu_Theta_27 :%f",signalvalue1);
	write("i_S4_SRR_RL_Clu_Theta_27 :%f",@ecu_Signals::i_S4_SRR_RL_Clu_Theta_27);

	testStep("get expect variable value: ","i_S4_SRR_RL_Clu_Theta_27 :%f",@ecu_Signals::i_S4_SRR_RL_Clu_Theta_27);

	if((abs(@ecu_Signals::i_S4_SRR_RL_Clu_Theta_27)*0.9<=abs(signalvalue1))&&(abs(signalvalue1)<=abs(@ecu_Signals::i_S4_SRR_RL_Clu_Theta_27)*1.1))
	{
	testStepPass("Pass","i_S4_SRR_RL_Clu_Theta_27 :%f",signalvalue1);
	}
	else
	{
	testStepFail("Fail","i_S4_SRR_RL_Clu_Theta_27 :%f",signalvalue1);
	}
}

testcase S4_SRR_RL_Clu_Mes_3_S4_SRR_RL_Clu_Dist_27()
{
	signalvalue1 = getSignal(S4_SRR_RL_Clu_Dist_27);
	write("S4_SRR_RL_Clu_Dist_27 :%f",signalvalue1);
	write("i_S4_SRR_RL_Clu_Dist_27 :%f",@ecu_Signals::i_S4_SRR_RL_Clu_Dist_27);

	testStep("get expect variable value: ","i_S4_SRR_RL_Clu_Dist_27 :%f",@ecu_Signals::i_S4_SRR_RL_Clu_Dist_27);

	if((abs(@ecu_Signals::i_S4_SRR_RL_Clu_Dist_27)*0.9<=abs(signalvalue1))&&(abs(signalvalue1)<=abs(@ecu_Signals::i_S4_SRR_RL_Clu_Dist_27)*1.1))
	{
	testStepPass("Pass","i_S4_SRR_RL_Clu_Dist_27 :%f",signalvalue1);
	}
	else
	{
	testStepFail("Fail","i_S4_SRR_RL_Clu_Dist_27 :%f",signalvalue1);
	}
}

testcase S4_SRR_RL_Clu_Mes_3_S4_SRR_RL_Clu_Vel_27()
{
	signalvalue1 = getSignal(S4_SRR_RL_Clu_Vel_27);
	write("S4_SRR_RL_Clu_Vel_27 :%f",signalvalue1);
	write("i_S4_SRR_RL_Clu_Vel_27 :%f",@ecu_Signals::i_S4_SRR_RL_Clu_Vel_27);

	testStep("get expect variable value: ","i_S4_SRR_RL_Clu_Vel_27 :%f",@ecu_Signals::i_S4_SRR_RL_Clu_Vel_27);

	if((abs(@ecu_Signals::i_S4_SRR_RL_Clu_Vel_27)*0.9<=abs(signalvalue1))&&(abs(signalvalue1)<=abs(@ecu_Signals::i_S4_SRR_RL_Clu_Vel_27)*1.1))
	{
	testStepPass("Pass","i_S4_SRR_RL_Clu_Vel_27 :%f",signalvalue1);
	}
	else
	{
	testStepFail("Fail","i_S4_SRR_RL_Clu_Vel_27 :%f",signalvalue1);
	}
}

testcase S4_SRR_RL_Clu_Mes_3_S4_SRR_RL_Clu_SNR_27()
{
	signalvalue1 = getSignal(S4_SRR_RL_Clu_SNR_27);
	write("S4_SRR_RL_Clu_SNR_27 :%f",signalvalue1);
	write("i_S4_SRR_RL_Clu_SNR_27 :%f",@ecu_Signals::i_S4_SRR_RL_Clu_SNR_27);

	testStep("get expect variable value: ","i_S4_SRR_RL_Clu_SNR_27 :%f",@ecu_Signals::i_S4_SRR_RL_Clu_SNR_27);

	if((abs(@ecu_Signals::i_S4_SRR_RL_Clu_SNR_27)*0.9<=abs(signalvalue1))&&(abs(signalvalue1)<=abs(@ecu_Signals::i_S4_SRR_RL_Clu_SNR_27)*1.1))
	{
	testStepPass("Pass","i_S4_SRR_RL_Clu_SNR_27 :%f",signalvalue1);
	}
	else
	{
	testStepFail("Fail","i_S4_SRR_RL_Clu_SNR_27 :%f",signalvalue1);
	}
}

testcase S4_SRR_RL_Clu_Mes_3_S4_SRR_RL_Clu_DynProp_27()
{
	signalvalue1 = getSignal(S4_SRR_RL_Clu_DynProp_27);
	write("S4_SRR_RL_Clu_DynProp_27 :%f",signalvalue1);
	write("i_S4_SRR_RL_Clu_DynProp_27 :%o",@ecu_Signals::i_S4_SRR_RL_Clu_DynProp_27);

	testStep("get expect variable value: ","i_S4_SRR_RL_Clu_DynProp_27 :%o",@ecu_Signals::i_S4_SRR_RL_Clu_DynProp_27);

	if(signalvalue1==@ecu_Signals::i_S4_SRR_RL_Clu_DynProp_27)
	{
	testStepPass("Pass","i_S4_SRR_RL_Clu_DynProp_27 :%f",signalvalue1);
	}
	else
	{
	testStepFail("Fail","i_S4_SRR_RL_Clu_DynProp_27 :%f",signalvalue1);
	}
}

testcase S4_SRR_RL_Clu_Mes_3_S4_SRR_RL_Clu_Locationvalid_27()
{
	signalvalue1 = getSignal(S4_SRR_RL_Clu_Locationvalid_27);
	write("S4_SRR_RL_Clu_Locationvalid_27 :%f",signalvalue1);
	write("i_S4_SRR_RL_Clu_Locationvalid_27 :%o",@ecu_Signals::i_S4_SRR_RL_Clu_Locationvalid_27);

	testStep("get expect variable value: ","i_S4_SRR_RL_Clu_Locationvalid_27 :%o",@ecu_Signals::i_S4_SRR_RL_Clu_Locationvalid_27);

	if(signalvalue1==@ecu_Signals::i_S4_SRR_RL_Clu_Locationvalid_27)
	{
	testStepPass("Pass","i_S4_SRR_RL_Clu_Locationvalid_27 :%f",signalvalue1);
	}
	else
	{
	testStepFail("Fail","i_S4_SRR_RL_Clu_Locationvalid_27 :%f",signalvalue1);
	}
}

testcase S4_SRR_RL_Clu_Mes_4_S4_SRR_RL_Clu_Theta_28()
{
	signalvalue1 = getSignal(S4_SRR_RL_Clu_Theta_28);
	write("S4_SRR_RL_Clu_Theta_28 :%f",signalvalue1);
	write("i_S4_SRR_RL_Clu_Theta_28 :%f",@ecu_Signals::i_S4_SRR_RL_Clu_Theta_28);

	testStep("get expect variable value: ","i_S4_SRR_RL_Clu_Theta_28 :%f",@ecu_Signals::i_S4_SRR_RL_Clu_Theta_28);

	if((abs(@ecu_Signals::i_S4_SRR_RL_Clu_Theta_28)*0.9<=abs(signalvalue1))&&(abs(signalvalue1)<=abs(@ecu_Signals::i_S4_SRR_RL_Clu_Theta_28)*1.1))
	{
	testStepPass("Pass","i_S4_SRR_RL_Clu_Theta_28 :%f",signalvalue1);
	}
	else
	{
	testStepFail("Fail","i_S4_SRR_RL_Clu_Theta_28 :%f",signalvalue1);
	}
}

testcase S4_SRR_RL_Clu_Mes_4_S4_SRR_RL_Clu_Dist_28()
{
	signalvalue1 = getSignal(S4_SRR_RL_Clu_Dist_28);
	write("S4_SRR_RL_Clu_Dist_28 :%f",signalvalue1);
	write("i_S4_SRR_RL_Clu_Dist_28 :%f",@ecu_Signals::i_S4_SRR_RL_Clu_Dist_28);

	testStep("get expect variable value: ","i_S4_SRR_RL_Clu_Dist_28 :%f",@ecu_Signals::i_S4_SRR_RL_Clu_Dist_28);

	if((abs(@ecu_Signals::i_S4_SRR_RL_Clu_Dist_28)*0.9<=abs(signalvalue1))&&(abs(signalvalue1)<=abs(@ecu_Signals::i_S4_SRR_RL_Clu_Dist_28)*1.1))
	{
	testStepPass("Pass","i_S4_SRR_RL_Clu_Dist_28 :%f",signalvalue1);
	}
	else
	{
	testStepFail("Fail","i_S4_SRR_RL_Clu_Dist_28 :%f",signalvalue1);
	}
}

testcase S4_SRR_RL_Clu_Mes_4_S4_SRR_RL_Clu_Vel_28()
{
	signalvalue1 = getSignal(S4_SRR_RL_Clu_Vel_28);
	write("S4_SRR_RL_Clu_Vel_28 :%f",signalvalue1);
	write("i_S4_SRR_RL_Clu_Vel_28 :%f",@ecu_Signals::i_S4_SRR_RL_Clu_Vel_28);

	testStep("get expect variable value: ","i_S4_SRR_RL_Clu_Vel_28 :%f",@ecu_Signals::i_S4_SRR_RL_Clu_Vel_28);

	if((abs(@ecu_Signals::i_S4_SRR_RL_Clu_Vel_28)*0.9<=abs(signalvalue1))&&(abs(signalvalue1)<=abs(@ecu_Signals::i_S4_SRR_RL_Clu_Vel_28)*1.1))
	{
	testStepPass("Pass","i_S4_SRR_RL_Clu_Vel_28 :%f",signalvalue1);
	}
	else
	{
	testStepFail("Fail","i_S4_SRR_RL_Clu_Vel_28 :%f",signalvalue1);
	}
}

testcase S4_SRR_RL_Clu_Mes_4_S4_SRR_RL_Clu_SNR_28()
{
	signalvalue1 = getSignal(S4_SRR_RL_Clu_SNR_28);
	write("S4_SRR_RL_Clu_SNR_28 :%f",signalvalue1);
	write("i_S4_SRR_RL_Clu_SNR_28 :%f",@ecu_Signals::i_S4_SRR_RL_Clu_SNR_28);

	testStep("get expect variable value: ","i_S4_SRR_RL_Clu_SNR_28 :%f",@ecu_Signals::i_S4_SRR_RL_Clu_SNR_28);

	if((abs(@ecu_Signals::i_S4_SRR_RL_Clu_SNR_28)*0.9<=abs(signalvalue1))&&(abs(signalvalue1)<=abs(@ecu_Signals::i_S4_SRR_RL_Clu_SNR_28)*1.1))
	{
	testStepPass("Pass","i_S4_SRR_RL_Clu_SNR_28 :%f",signalvalue1);
	}
	else
	{
	testStepFail("Fail","i_S4_SRR_RL_Clu_SNR_28 :%f",signalvalue1);
	}
}

testcase S4_SRR_RL_Clu_Mes_4_S4_SRR_RL_Clu_DynProp_28()
{
	signalvalue1 = getSignal(S4_SRR_RL_Clu_DynProp_28);
	write("S4_SRR_RL_Clu_DynProp_28 :%f",signalvalue1);
	write("i_S4_SRR_RL_Clu_DynProp_28 :%o",@ecu_Signals::i_S4_SRR_RL_Clu_DynProp_28);

	testStep("get expect variable value: ","i_S4_SRR_RL_Clu_DynProp_28 :%o",@ecu_Signals::i_S4_SRR_RL_Clu_DynProp_28);

	if(signalvalue1==@ecu_Signals::i_S4_SRR_RL_Clu_DynProp_28)
	{
	testStepPass("Pass","i_S4_SRR_RL_Clu_DynProp_28 :%f",signalvalue1);
	}
	else
	{
	testStepFail("Fail","i_S4_SRR_RL_Clu_DynProp_28 :%f",signalvalue1);
	}
}

testcase S4_SRR_RL_Clu_Mes_4_S4_SRR_RL_Clu_Locationvalid_28()
{
	signalvalue1 = getSignal(S4_SRR_RL_Clu_Locationvalid_28);
	write("S4_SRR_RL_Clu_Locationvalid_28 :%f",signalvalue1);
	write("i_S4_SRR_RL_Clu_Locationvalid_28 :%o",@ecu_Signals::i_S4_SRR_RL_Clu_Locationvalid_28);

	testStep("get expect variable value: ","i_S4_SRR_RL_Clu_Locationvalid_28 :%o",@ecu_Signals::i_S4_SRR_RL_Clu_Locationvalid_28);

	if(signalvalue1==@ecu_Signals::i_S4_SRR_RL_Clu_Locationvalid_28)
	{
	testStepPass("Pass","i_S4_SRR_RL_Clu_Locationvalid_28 :%f",signalvalue1);
	}
	else
	{
	testStepFail("Fail","i_S4_SRR_RL_Clu_Locationvalid_28 :%f",signalvalue1);
	}
}

testcase S4_SRR_RL_Clu_Mes_4_S4_SRR_RL_Clu_Theta_29()
{
	signalvalue1 = getSignal(S4_SRR_RL_Clu_Theta_29);
	write("S4_SRR_RL_Clu_Theta_29 :%f",signalvalue1);
	write("i_S4_SRR_RL_Clu_Theta_29 :%f",@ecu_Signals::i_S4_SRR_RL_Clu_Theta_29);

	testStep("get expect variable value: ","i_S4_SRR_RL_Clu_Theta_29 :%f",@ecu_Signals::i_S4_SRR_RL_Clu_Theta_29);

	if((abs(@ecu_Signals::i_S4_SRR_RL_Clu_Theta_29)*0.9<=abs(signalvalue1))&&(abs(signalvalue1)<=abs(@ecu_Signals::i_S4_SRR_RL_Clu_Theta_29)*1.1))
	{
	testStepPass("Pass","i_S4_SRR_RL_Clu_Theta_29 :%f",signalvalue1);
	}
	else
	{
	testStepFail("Fail","i_S4_SRR_RL_Clu_Theta_29 :%f",signalvalue1);
	}
}

testcase S4_SRR_RL_Clu_Mes_4_S4_SRR_RL_Clu_Dist_29()
{
	signalvalue1 = getSignal(S4_SRR_RL_Clu_Dist_29);
	write("S4_SRR_RL_Clu_Dist_29 :%f",signalvalue1);
	write("i_S4_SRR_RL_Clu_Dist_29 :%f",@ecu_Signals::i_S4_SRR_RL_Clu_Dist_29);

	testStep("get expect variable value: ","i_S4_SRR_RL_Clu_Dist_29 :%f",@ecu_Signals::i_S4_SRR_RL_Clu_Dist_29);

	if((abs(@ecu_Signals::i_S4_SRR_RL_Clu_Dist_29)*0.9<=abs(signalvalue1))&&(abs(signalvalue1)<=abs(@ecu_Signals::i_S4_SRR_RL_Clu_Dist_29)*1.1))
	{
	testStepPass("Pass","i_S4_SRR_RL_Clu_Dist_29 :%f",signalvalue1);
	}
	else
	{
	testStepFail("Fail","i_S4_SRR_RL_Clu_Dist_29 :%f",signalvalue1);
	}
}

testcase S4_SRR_RL_Clu_Mes_4_S4_SRR_RL_Clu_Vel_29()
{
	signalvalue1 = getSignal(S4_SRR_RL_Clu_Vel_29);
	write("S4_SRR_RL_Clu_Vel_29 :%f",signalvalue1);
	write("i_S4_SRR_RL_Clu_Vel_29 :%f",@ecu_Signals::i_S4_SRR_RL_Clu_Vel_29);

	testStep("get expect variable value: ","i_S4_SRR_RL_Clu_Vel_29 :%f",@ecu_Signals::i_S4_SRR_RL_Clu_Vel_29);

	if((abs(@ecu_Signals::i_S4_SRR_RL_Clu_Vel_29)*0.9<=abs(signalvalue1))&&(abs(signalvalue1)<=abs(@ecu_Signals::i_S4_SRR_RL_Clu_Vel_29)*1.1))
	{
	testStepPass("Pass","i_S4_SRR_RL_Clu_Vel_29 :%f",signalvalue1);
	}
	else
	{
	testStepFail("Fail","i_S4_SRR_RL_Clu_Vel_29 :%f",signalvalue1);
	}
}

testcase S4_SRR_RL_Clu_Mes_4_S4_SRR_RL_Clu_SNR_29()
{
	signalvalue1 = getSignal(S4_SRR_RL_Clu_SNR_29);
	write("S4_SRR_RL_Clu_SNR_29 :%f",signalvalue1);
	write("i_S4_SRR_RL_Clu_SNR_29 :%f",@ecu_Signals::i_S4_SRR_RL_Clu_SNR_29);

	testStep("get expect variable value: ","i_S4_SRR_RL_Clu_SNR_29 :%f",@ecu_Signals::i_S4_SRR_RL_Clu_SNR_29);

	if((abs(@ecu_Signals::i_S4_SRR_RL_Clu_SNR_29)*0.9<=abs(signalvalue1))&&(abs(signalvalue1)<=abs(@ecu_Signals::i_S4_SRR_RL_Clu_SNR_29)*1.1))
	{
	testStepPass("Pass","i_S4_SRR_RL_Clu_SNR_29 :%f",signalvalue1);
	}
	else
	{
	testStepFail("Fail","i_S4_SRR_RL_Clu_SNR_29 :%f",signalvalue1);
	}
}

testcase S4_SRR_RL_Clu_Mes_4_S4_SRR_RL_Clu_DynProp_29()
{
	signalvalue1 = getSignal(S4_SRR_RL_Clu_DynProp_29);
	write("S4_SRR_RL_Clu_DynProp_29 :%f",signalvalue1);
	write("i_S4_SRR_RL_Clu_DynProp_29 :%o",@ecu_Signals::i_S4_SRR_RL_Clu_DynProp_29);

	testStep("get expect variable value: ","i_S4_SRR_RL_Clu_DynProp_29 :%o",@ecu_Signals::i_S4_SRR_RL_Clu_DynProp_29);

	if(signalvalue1==@ecu_Signals::i_S4_SRR_RL_Clu_DynProp_29)
	{
	testStepPass("Pass","i_S4_SRR_RL_Clu_DynProp_29 :%f",signalvalue1);
	}
	else
	{
	testStepFail("Fail","i_S4_SRR_RL_Clu_DynProp_29 :%f",signalvalue1);
	}
}

testcase S4_SRR_RL_Clu_Mes_4_S4_SRR_RL_Clu_Locationvalid_29()
{
	signalvalue1 = getSignal(S4_SRR_RL_Clu_Locationvalid_29);
	write("S4_SRR_RL_Clu_Locationvalid_29 :%f",signalvalue1);
	write("i_S4_SRR_RL_Clu_Locationvalid_29 :%o",@ecu_Signals::i_S4_SRR_RL_Clu_Locationvalid_29);

	testStep("get expect variable value: ","i_S4_SRR_RL_Clu_Locationvalid_29 :%o",@ecu_Signals::i_S4_SRR_RL_Clu_Locationvalid_29);

	if(signalvalue1==@ecu_Signals::i_S4_SRR_RL_Clu_Locationvalid_29)
	{
	testStepPass("Pass","i_S4_SRR_RL_Clu_Locationvalid_29 :%f",signalvalue1);
	}
	else
	{
	testStepFail("Fail","i_S4_SRR_RL_Clu_Locationvalid_29 :%f",signalvalue1);
	}
}

testcase S4_SRR_RL_Clu_Mes_4_S4_SRR_RL_Clu_Theta_30()
{
	signalvalue1 = getSignal(S4_SRR_RL_Clu_Theta_30);
	write("S4_SRR_RL_Clu_Theta_30 :%f",signalvalue1);
	write("i_S4_SRR_RL_Clu_Theta_30 :%f",@ecu_Signals::i_S4_SRR_RL_Clu_Theta_30);

	testStep("get expect variable value: ","i_S4_SRR_RL_Clu_Theta_30 :%f",@ecu_Signals::i_S4_SRR_RL_Clu_Theta_30);

	if((abs(@ecu_Signals::i_S4_SRR_RL_Clu_Theta_30)*0.9<=abs(signalvalue1))&&(abs(signalvalue1)<=abs(@ecu_Signals::i_S4_SRR_RL_Clu_Theta_30)*1.1))
	{
	testStepPass("Pass","i_S4_SRR_RL_Clu_Theta_30 :%f",signalvalue1);
	}
	else
	{
	testStepFail("Fail","i_S4_SRR_RL_Clu_Theta_30 :%f",signalvalue1);
	}
}

testcase S4_SRR_RL_Clu_Mes_4_S4_SRR_RL_Clu_Dist_30()
{
	signalvalue1 = getSignal(S4_SRR_RL_Clu_Dist_30);
	write("S4_SRR_RL_Clu_Dist_30 :%f",signalvalue1);
	write("i_S4_SRR_RL_Clu_Dist_30 :%f",@ecu_Signals::i_S4_SRR_RL_Clu_Dist_30);

	testStep("get expect variable value: ","i_S4_SRR_RL_Clu_Dist_30 :%f",@ecu_Signals::i_S4_SRR_RL_Clu_Dist_30);

	if((abs(@ecu_Signals::i_S4_SRR_RL_Clu_Dist_30)*0.9<=abs(signalvalue1))&&(abs(signalvalue1)<=abs(@ecu_Signals::i_S4_SRR_RL_Clu_Dist_30)*1.1))
	{
	testStepPass("Pass","i_S4_SRR_RL_Clu_Dist_30 :%f",signalvalue1);
	}
	else
	{
	testStepFail("Fail","i_S4_SRR_RL_Clu_Dist_30 :%f",signalvalue1);
	}
}

testcase S4_SRR_RL_Clu_Mes_4_S4_SRR_RL_Clu_Vel_30()
{
	signalvalue1 = getSignal(S4_SRR_RL_Clu_Vel_30);
	write("S4_SRR_RL_Clu_Vel_30 :%f",signalvalue1);
	write("i_S4_SRR_RL_Clu_Vel_30 :%f",@ecu_Signals::i_S4_SRR_RL_Clu_Vel_30);

	testStep("get expect variable value: ","i_S4_SRR_RL_Clu_Vel_30 :%f",@ecu_Signals::i_S4_SRR_RL_Clu_Vel_30);

	if((abs(@ecu_Signals::i_S4_SRR_RL_Clu_Vel_30)*0.9<=abs(signalvalue1))&&(abs(signalvalue1)<=abs(@ecu_Signals::i_S4_SRR_RL_Clu_Vel_30)*1.1))
	{
	testStepPass("Pass","i_S4_SRR_RL_Clu_Vel_30 :%f",signalvalue1);
	}
	else
	{
	testStepFail("Fail","i_S4_SRR_RL_Clu_Vel_30 :%f",signalvalue1);
	}
}

testcase S4_SRR_RL_Clu_Mes_4_S4_SRR_RL_Clu_SNR_30()
{
	signalvalue1 = getSignal(S4_SRR_RL_Clu_SNR_30);
	write("S4_SRR_RL_Clu_SNR_30 :%f",signalvalue1);
	write("i_S4_SRR_RL_Clu_SNR_30 :%f",@ecu_Signals::i_S4_SRR_RL_Clu_SNR_30);

	testStep("get expect variable value: ","i_S4_SRR_RL_Clu_SNR_30 :%f",@ecu_Signals::i_S4_SRR_RL_Clu_SNR_30);

	if((abs(@ecu_Signals::i_S4_SRR_RL_Clu_SNR_30)*0.9<=abs(signalvalue1))&&(abs(signalvalue1)<=abs(@ecu_Signals::i_S4_SRR_RL_Clu_SNR_30)*1.1))
	{
	testStepPass("Pass","i_S4_SRR_RL_Clu_SNR_30 :%f",signalvalue1);
	}
	else
	{
	testStepFail("Fail","i_S4_SRR_RL_Clu_SNR_30 :%f",signalvalue1);
	}
}

testcase S4_SRR_RL_Clu_Mes_4_S4_SRR_RL_Clu_DynProp_30()
{
	signalvalue1 = getSignal(S4_SRR_RL_Clu_DynProp_30);
	write("S4_SRR_RL_Clu_DynProp_30 :%f",signalvalue1);
	write("i_S4_SRR_RL_Clu_DynProp_30 :%o",@ecu_Signals::i_S4_SRR_RL_Clu_DynProp_30);

	testStep("get expect variable value: ","i_S4_SRR_RL_Clu_DynProp_30 :%o",@ecu_Signals::i_S4_SRR_RL_Clu_DynProp_30);

	if(signalvalue1==@ecu_Signals::i_S4_SRR_RL_Clu_DynProp_30)
	{
	testStepPass("Pass","i_S4_SRR_RL_Clu_DynProp_30 :%f",signalvalue1);
	}
	else
	{
	testStepFail("Fail","i_S4_SRR_RL_Clu_DynProp_30 :%f",signalvalue1);
	}
}

testcase S4_SRR_RL_Clu_Mes_4_S4_SRR_RL_Clu_Locationvalid_30()
{
	signalvalue1 = getSignal(S4_SRR_RL_Clu_Locationvalid_30);
	write("S4_SRR_RL_Clu_Locationvalid_30 :%f",signalvalue1);
	write("i_S4_SRR_RL_Clu_Locationvalid_30 :%o",@ecu_Signals::i_S4_SRR_RL_Clu_Locationvalid_30);

	testStep("get expect variable value: ","i_S4_SRR_RL_Clu_Locationvalid_30 :%o",@ecu_Signals::i_S4_SRR_RL_Clu_Locationvalid_30);

	if(signalvalue1==@ecu_Signals::i_S4_SRR_RL_Clu_Locationvalid_30)
	{
	testStepPass("Pass","i_S4_SRR_RL_Clu_Locationvalid_30 :%f",signalvalue1);
	}
	else
	{
	testStepFail("Fail","i_S4_SRR_RL_Clu_Locationvalid_30 :%f",signalvalue1);
	}
}

testcase S4_SRR_RL_Clu_Mes_4_S4_SRR_RL_Clu_Theta_31()
{
	signalvalue1 = getSignal(S4_SRR_RL_Clu_Theta_31);
	write("S4_SRR_RL_Clu_Theta_31 :%f",signalvalue1);
	write("i_S4_SRR_RL_Clu_Theta_31 :%f",@ecu_Signals::i_S4_SRR_RL_Clu_Theta_31);

	testStep("get expect variable value: ","i_S4_SRR_RL_Clu_Theta_31 :%f",@ecu_Signals::i_S4_SRR_RL_Clu_Theta_31);

	if((abs(@ecu_Signals::i_S4_SRR_RL_Clu_Theta_31)*0.9<=abs(signalvalue1))&&(abs(signalvalue1)<=abs(@ecu_Signals::i_S4_SRR_RL_Clu_Theta_31)*1.1))
	{
	testStepPass("Pass","i_S4_SRR_RL_Clu_Theta_31 :%f",signalvalue1);
	}
	else
	{
	testStepFail("Fail","i_S4_SRR_RL_Clu_Theta_31 :%f",signalvalue1);
	}
}

testcase S4_SRR_RL_Clu_Mes_4_S4_SRR_RL_Clu_Dist_31()
{
	signalvalue1 = getSignal(S4_SRR_RL_Clu_Dist_31);
	write("S4_SRR_RL_Clu_Dist_31 :%f",signalvalue1);
	write("i_S4_SRR_RL_Clu_Dist_31 :%f",@ecu_Signals::i_S4_SRR_RL_Clu_Dist_31);

	testStep("get expect variable value: ","i_S4_SRR_RL_Clu_Dist_31 :%f",@ecu_Signals::i_S4_SRR_RL_Clu_Dist_31);

	if((abs(@ecu_Signals::i_S4_SRR_RL_Clu_Dist_31)*0.9<=abs(signalvalue1))&&(abs(signalvalue1)<=abs(@ecu_Signals::i_S4_SRR_RL_Clu_Dist_31)*1.1))
	{
	testStepPass("Pass","i_S4_SRR_RL_Clu_Dist_31 :%f",signalvalue1);
	}
	else
	{
	testStepFail("Fail","i_S4_SRR_RL_Clu_Dist_31 :%f",signalvalue1);
	}
}

testcase S4_SRR_RL_Clu_Mes_4_S4_SRR_RL_Clu_Vel_31()
{
	signalvalue1 = getSignal(S4_SRR_RL_Clu_Vel_31);
	write("S4_SRR_RL_Clu_Vel_31 :%f",signalvalue1);
	write("i_S4_SRR_RL_Clu_Vel_31 :%f",@ecu_Signals::i_S4_SRR_RL_Clu_Vel_31);

	testStep("get expect variable value: ","i_S4_SRR_RL_Clu_Vel_31 :%f",@ecu_Signals::i_S4_SRR_RL_Clu_Vel_31);

	if((abs(@ecu_Signals::i_S4_SRR_RL_Clu_Vel_31)*0.9<=abs(signalvalue1))&&(abs(signalvalue1)<=abs(@ecu_Signals::i_S4_SRR_RL_Clu_Vel_31)*1.1))
	{
	testStepPass("Pass","i_S4_SRR_RL_Clu_Vel_31 :%f",signalvalue1);
	}
	else
	{
	testStepFail("Fail","i_S4_SRR_RL_Clu_Vel_31 :%f",signalvalue1);
	}
}

testcase S4_SRR_RL_Clu_Mes_4_S4_SRR_RL_Clu_SNR_31()
{
	signalvalue1 = getSignal(S4_SRR_RL_Clu_SNR_31);
	write("S4_SRR_RL_Clu_SNR_31 :%f",signalvalue1);
	write("i_S4_SRR_RL_Clu_SNR_31 :%f",@ecu_Signals::i_S4_SRR_RL_Clu_SNR_31);

	testStep("get expect variable value: ","i_S4_SRR_RL_Clu_SNR_31 :%f",@ecu_Signals::i_S4_SRR_RL_Clu_SNR_31);

	if((abs(@ecu_Signals::i_S4_SRR_RL_Clu_SNR_31)*0.9<=abs(signalvalue1))&&(abs(signalvalue1)<=abs(@ecu_Signals::i_S4_SRR_RL_Clu_SNR_31)*1.1))
	{
	testStepPass("Pass","i_S4_SRR_RL_Clu_SNR_31 :%f",signalvalue1);
	}
	else
	{
	testStepFail("Fail","i_S4_SRR_RL_Clu_SNR_31 :%f",signalvalue1);
	}
}

testcase S4_SRR_RL_Clu_Mes_4_S4_SRR_RL_Clu_DynProp_31()
{
	signalvalue1 = getSignal(S4_SRR_RL_Clu_DynProp_31);
	write("S4_SRR_RL_Clu_DynProp_31 :%f",signalvalue1);
	write("i_S4_SRR_RL_Clu_DynProp_31 :%o",@ecu_Signals::i_S4_SRR_RL_Clu_DynProp_31);

	testStep("get expect variable value: ","i_S4_SRR_RL_Clu_DynProp_31 :%o",@ecu_Signals::i_S4_SRR_RL_Clu_DynProp_31);

	if(signalvalue1==@ecu_Signals::i_S4_SRR_RL_Clu_DynProp_31)
	{
	testStepPass("Pass","i_S4_SRR_RL_Clu_DynProp_31 :%f",signalvalue1);
	}
	else
	{
	testStepFail("Fail","i_S4_SRR_RL_Clu_DynProp_31 :%f",signalvalue1);
	}
}

testcase S4_SRR_RL_Clu_Mes_4_S4_SRR_RL_Clu_Locationvalid_31()
{
	signalvalue1 = getSignal(S4_SRR_RL_Clu_Locationvalid_31);
	write("S4_SRR_RL_Clu_Locationvalid_31 :%f",signalvalue1);
	write("i_S4_SRR_RL_Clu_Locationvalid_31 :%o",@ecu_Signals::i_S4_SRR_RL_Clu_Locationvalid_31);

	testStep("get expect variable value: ","i_S4_SRR_RL_Clu_Locationvalid_31 :%o",@ecu_Signals::i_S4_SRR_RL_Clu_Locationvalid_31);

	if(signalvalue1==@ecu_Signals::i_S4_SRR_RL_Clu_Locationvalid_31)
	{
	testStepPass("Pass","i_S4_SRR_RL_Clu_Locationvalid_31 :%f",signalvalue1);
	}
	else
	{
	testStepFail("Fail","i_S4_SRR_RL_Clu_Locationvalid_31 :%f",signalvalue1);
	}
}

testcase S4_SRR_RL_Clu_Mes_4_S4_SRR_RL_Clu_Theta_32()
{
	signalvalue1 = getSignal(S4_SRR_RL_Clu_Theta_32);
	write("S4_SRR_RL_Clu_Theta_32 :%f",signalvalue1);
	write("i_S4_SRR_RL_Clu_Theta_32 :%f",@ecu_Signals::i_S4_SRR_RL_Clu_Theta_32);

	testStep("get expect variable value: ","i_S4_SRR_RL_Clu_Theta_32 :%f",@ecu_Signals::i_S4_SRR_RL_Clu_Theta_32);

	if((abs(@ecu_Signals::i_S4_SRR_RL_Clu_Theta_32)*0.9<=abs(signalvalue1))&&(abs(signalvalue1)<=abs(@ecu_Signals::i_S4_SRR_RL_Clu_Theta_32)*1.1))
	{
	testStepPass("Pass","i_S4_SRR_RL_Clu_Theta_32 :%f",signalvalue1);
	}
	else
	{
	testStepFail("Fail","i_S4_SRR_RL_Clu_Theta_32 :%f",signalvalue1);
	}
}

testcase S4_SRR_RL_Clu_Mes_4_S4_SRR_RL_Clu_Dist_32()
{
	signalvalue1 = getSignal(S4_SRR_RL_Clu_Dist_32);
	write("S4_SRR_RL_Clu_Dist_32 :%f",signalvalue1);
	write("i_S4_SRR_RL_Clu_Dist_32 :%f",@ecu_Signals::i_S4_SRR_RL_Clu_Dist_32);

	testStep("get expect variable value: ","i_S4_SRR_RL_Clu_Dist_32 :%f",@ecu_Signals::i_S4_SRR_RL_Clu_Dist_32);

	if((abs(@ecu_Signals::i_S4_SRR_RL_Clu_Dist_32)*0.9<=abs(signalvalue1))&&(abs(signalvalue1)<=abs(@ecu_Signals::i_S4_SRR_RL_Clu_Dist_32)*1.1))
	{
	testStepPass("Pass","i_S4_SRR_RL_Clu_Dist_32 :%f",signalvalue1);
	}
	else
	{
	testStepFail("Fail","i_S4_SRR_RL_Clu_Dist_32 :%f",signalvalue1);
	}
}

testcase S4_SRR_RL_Clu_Mes_4_S4_SRR_RL_Clu_Vel_32()
{
	signalvalue1 = getSignal(S4_SRR_RL_Clu_Vel_32);
	write("S4_SRR_RL_Clu_Vel_32 :%f",signalvalue1);
	write("i_S4_SRR_RL_Clu_Vel_32 :%f",@ecu_Signals::i_S4_SRR_RL_Clu_Vel_32);

	testStep("get expect variable value: ","i_S4_SRR_RL_Clu_Vel_32 :%f",@ecu_Signals::i_S4_SRR_RL_Clu_Vel_32);

	if((abs(@ecu_Signals::i_S4_SRR_RL_Clu_Vel_32)*0.9<=abs(signalvalue1))&&(abs(signalvalue1)<=abs(@ecu_Signals::i_S4_SRR_RL_Clu_Vel_32)*1.1))
	{
	testStepPass("Pass","i_S4_SRR_RL_Clu_Vel_32 :%f",signalvalue1);
	}
	else
	{
	testStepFail("Fail","i_S4_SRR_RL_Clu_Vel_32 :%f",signalvalue1);
	}
}

testcase S4_SRR_RL_Clu_Mes_4_S4_SRR_RL_Clu_SNR_32()
{
	signalvalue1 = getSignal(S4_SRR_RL_Clu_SNR_32);
	write("S4_SRR_RL_Clu_SNR_32 :%f",signalvalue1);
	write("i_S4_SRR_RL_Clu_SNR_32 :%f",@ecu_Signals::i_S4_SRR_RL_Clu_SNR_32);

	testStep("get expect variable value: ","i_S4_SRR_RL_Clu_SNR_32 :%f",@ecu_Signals::i_S4_SRR_RL_Clu_SNR_32);

	if((abs(@ecu_Signals::i_S4_SRR_RL_Clu_SNR_32)*0.9<=abs(signalvalue1))&&(abs(signalvalue1)<=abs(@ecu_Signals::i_S4_SRR_RL_Clu_SNR_32)*1.1))
	{
	testStepPass("Pass","i_S4_SRR_RL_Clu_SNR_32 :%f",signalvalue1);
	}
	else
	{
	testStepFail("Fail","i_S4_SRR_RL_Clu_SNR_32 :%f",signalvalue1);
	}
}

testcase S4_SRR_RL_Clu_Mes_4_S4_SRR_RL_Clu_DynProp_32()
{
	signalvalue1 = getSignal(S4_SRR_RL_Clu_DynProp_32);
	write("S4_SRR_RL_Clu_DynProp_32 :%f",signalvalue1);
	write("i_S4_SRR_RL_Clu_DynProp_32 :%o",@ecu_Signals::i_S4_SRR_RL_Clu_DynProp_32);

	testStep("get expect variable value: ","i_S4_SRR_RL_Clu_DynProp_32 :%o",@ecu_Signals::i_S4_SRR_RL_Clu_DynProp_32);

	if(signalvalue1==@ecu_Signals::i_S4_SRR_RL_Clu_DynProp_32)
	{
	testStepPass("Pass","i_S4_SRR_RL_Clu_DynProp_32 :%f",signalvalue1);
	}
	else
	{
	testStepFail("Fail","i_S4_SRR_RL_Clu_DynProp_32 :%f",signalvalue1);
	}
}

testcase S4_SRR_RL_Clu_Mes_4_S4_SRR_RL_Clu_Locationvalid_32()
{
	signalvalue1 = getSignal(S4_SRR_RL_Clu_Locationvalid_32);
	write("S4_SRR_RL_Clu_Locationvalid_32 :%f",signalvalue1);
	write("i_S4_SRR_RL_Clu_Locationvalid_32 :%o",@ecu_Signals::i_S4_SRR_RL_Clu_Locationvalid_32);

	testStep("get expect variable value: ","i_S4_SRR_RL_Clu_Locationvalid_32 :%o",@ecu_Signals::i_S4_SRR_RL_Clu_Locationvalid_32);

	if(signalvalue1==@ecu_Signals::i_S4_SRR_RL_Clu_Locationvalid_32)
	{
	testStepPass("Pass","i_S4_SRR_RL_Clu_Locationvalid_32 :%f",signalvalue1);
	}
	else
	{
	testStepFail("Fail","i_S4_SRR_RL_Clu_Locationvalid_32 :%f",signalvalue1);
	}
}

testcase S4_SRR_RL_Clu_Mes_4_S4_SRR_RL_Clu_Theta_33()
{
	signalvalue1 = getSignal(S4_SRR_RL_Clu_Theta_33);
	write("S4_SRR_RL_Clu_Theta_33 :%f",signalvalue1);
	write("i_S4_SRR_RL_Clu_Theta_33 :%f",@ecu_Signals::i_S4_SRR_RL_Clu_Theta_33);

	testStep("get expect variable value: ","i_S4_SRR_RL_Clu_Theta_33 :%f",@ecu_Signals::i_S4_SRR_RL_Clu_Theta_33);

	if((abs(@ecu_Signals::i_S4_SRR_RL_Clu_Theta_33)*0.9<=abs(signalvalue1))&&(abs(signalvalue1)<=abs(@ecu_Signals::i_S4_SRR_RL_Clu_Theta_33)*1.1))
	{
	testStepPass("Pass","i_S4_SRR_RL_Clu_Theta_33 :%f",signalvalue1);
	}
	else
	{
	testStepFail("Fail","i_S4_SRR_RL_Clu_Theta_33 :%f",signalvalue1);
	}
}

testcase S4_SRR_RL_Clu_Mes_4_S4_SRR_RL_Clu_Dist_33()
{
	signalvalue1 = getSignal(S4_SRR_RL_Clu_Dist_33);
	write("S4_SRR_RL_Clu_Dist_33 :%f",signalvalue1);
	write("i_S4_SRR_RL_Clu_Dist_33 :%f",@ecu_Signals::i_S4_SRR_RL_Clu_Dist_33);

	testStep("get expect variable value: ","i_S4_SRR_RL_Clu_Dist_33 :%f",@ecu_Signals::i_S4_SRR_RL_Clu_Dist_33);

	if((abs(@ecu_Signals::i_S4_SRR_RL_Clu_Dist_33)*0.9<=abs(signalvalue1))&&(abs(signalvalue1)<=abs(@ecu_Signals::i_S4_SRR_RL_Clu_Dist_33)*1.1))
	{
	testStepPass("Pass","i_S4_SRR_RL_Clu_Dist_33 :%f",signalvalue1);
	}
	else
	{
	testStepFail("Fail","i_S4_SRR_RL_Clu_Dist_33 :%f",signalvalue1);
	}
}

testcase S4_SRR_RL_Clu_Mes_4_S4_SRR_RL_Clu_Vel_33()
{
	signalvalue1 = getSignal(S4_SRR_RL_Clu_Vel_33);
	write("S4_SRR_RL_Clu_Vel_33 :%f",signalvalue1);
	write("i_S4_SRR_RL_Clu_Vel_33 :%f",@ecu_Signals::i_S4_SRR_RL_Clu_Vel_33);

	testStep("get expect variable value: ","i_S4_SRR_RL_Clu_Vel_33 :%f",@ecu_Signals::i_S4_SRR_RL_Clu_Vel_33);

	if((abs(@ecu_Signals::i_S4_SRR_RL_Clu_Vel_33)*0.9<=abs(signalvalue1))&&(abs(signalvalue1)<=abs(@ecu_Signals::i_S4_SRR_RL_Clu_Vel_33)*1.1))
	{
	testStepPass("Pass","i_S4_SRR_RL_Clu_Vel_33 :%f",signalvalue1);
	}
	else
	{
	testStepFail("Fail","i_S4_SRR_RL_Clu_Vel_33 :%f",signalvalue1);
	}
}

testcase S4_SRR_RL_Clu_Mes_4_S4_SRR_RL_Clu_SNR_33()
{
	signalvalue1 = getSignal(S4_SRR_RL_Clu_SNR_33);
	write("S4_SRR_RL_Clu_SNR_33 :%f",signalvalue1);
	write("i_S4_SRR_RL_Clu_SNR_33 :%f",@ecu_Signals::i_S4_SRR_RL_Clu_SNR_33);

	testStep("get expect variable value: ","i_S4_SRR_RL_Clu_SNR_33 :%f",@ecu_Signals::i_S4_SRR_RL_Clu_SNR_33);

	if((abs(@ecu_Signals::i_S4_SRR_RL_Clu_SNR_33)*0.9<=abs(signalvalue1))&&(abs(signalvalue1)<=abs(@ecu_Signals::i_S4_SRR_RL_Clu_SNR_33)*1.1))
	{
	testStepPass("Pass","i_S4_SRR_RL_Clu_SNR_33 :%f",signalvalue1);
	}
	else
	{
	testStepFail("Fail","i_S4_SRR_RL_Clu_SNR_33 :%f",signalvalue1);
	}
}

testcase S4_SRR_RL_Clu_Mes_4_S4_SRR_RL_Clu_DynProp_33()
{
	signalvalue1 = getSignal(S4_SRR_RL_Clu_DynProp_33);
	write("S4_SRR_RL_Clu_DynProp_33 :%f",signalvalue1);
	write("i_S4_SRR_RL_Clu_DynProp_33 :%o",@ecu_Signals::i_S4_SRR_RL_Clu_DynProp_33);

	testStep("get expect variable value: ","i_S4_SRR_RL_Clu_DynProp_33 :%o",@ecu_Signals::i_S4_SRR_RL_Clu_DynProp_33);

	if(signalvalue1==@ecu_Signals::i_S4_SRR_RL_Clu_DynProp_33)
	{
	testStepPass("Pass","i_S4_SRR_RL_Clu_DynProp_33 :%f",signalvalue1);
	}
	else
	{
	testStepFail("Fail","i_S4_SRR_RL_Clu_DynProp_33 :%f",signalvalue1);
	}
}

testcase S4_SRR_RL_Clu_Mes_4_S4_SRR_RL_Clu_Locationvalid_33()
{
	signalvalue1 = getSignal(S4_SRR_RL_Clu_Locationvalid_33);
	write("S4_SRR_RL_Clu_Locationvalid_33 :%f",signalvalue1);
	write("i_S4_SRR_RL_Clu_Locationvalid_33 :%o",@ecu_Signals::i_S4_SRR_RL_Clu_Locationvalid_33);

	testStep("get expect variable value: ","i_S4_SRR_RL_Clu_Locationvalid_33 :%o",@ecu_Signals::i_S4_SRR_RL_Clu_Locationvalid_33);

	if(signalvalue1==@ecu_Signals::i_S4_SRR_RL_Clu_Locationvalid_33)
	{
	testStepPass("Pass","i_S4_SRR_RL_Clu_Locationvalid_33 :%f",signalvalue1);
	}
	else
	{
	testStepFail("Fail","i_S4_SRR_RL_Clu_Locationvalid_33 :%f",signalvalue1);
	}
}

testcase S4_SRR_RL_Clu_Mes_4_S4_SRR_RL_Clu_Theta_34()
{
	signalvalue1 = getSignal(S4_SRR_RL_Clu_Theta_34);
	write("S4_SRR_RL_Clu_Theta_34 :%f",signalvalue1);
	write("i_S4_SRR_RL_Clu_Theta_34 :%f",@ecu_Signals::i_S4_SRR_RL_Clu_Theta_34);

	testStep("get expect variable value: ","i_S4_SRR_RL_Clu_Theta_34 :%f",@ecu_Signals::i_S4_SRR_RL_Clu_Theta_34);

	if((abs(@ecu_Signals::i_S4_SRR_RL_Clu_Theta_34)*0.9<=abs(signalvalue1))&&(abs(signalvalue1)<=abs(@ecu_Signals::i_S4_SRR_RL_Clu_Theta_34)*1.1))
	{
	testStepPass("Pass","i_S4_SRR_RL_Clu_Theta_34 :%f",signalvalue1);
	}
	else
	{
	testStepFail("Fail","i_S4_SRR_RL_Clu_Theta_34 :%f",signalvalue1);
	}
}

testcase S4_SRR_RL_Clu_Mes_4_S4_SRR_RL_Clu_Dist_34()
{
	signalvalue1 = getSignal(S4_SRR_RL_Clu_Dist_34);
	write("S4_SRR_RL_Clu_Dist_34 :%f",signalvalue1);
	write("i_S4_SRR_RL_Clu_Dist_34 :%f",@ecu_Signals::i_S4_SRR_RL_Clu_Dist_34);

	testStep("get expect variable value: ","i_S4_SRR_RL_Clu_Dist_34 :%f",@ecu_Signals::i_S4_SRR_RL_Clu_Dist_34);

	if((abs(@ecu_Signals::i_S4_SRR_RL_Clu_Dist_34)*0.9<=abs(signalvalue1))&&(abs(signalvalue1)<=abs(@ecu_Signals::i_S4_SRR_RL_Clu_Dist_34)*1.1))
	{
	testStepPass("Pass","i_S4_SRR_RL_Clu_Dist_34 :%f",signalvalue1);
	}
	else
	{
	testStepFail("Fail","i_S4_SRR_RL_Clu_Dist_34 :%f",signalvalue1);
	}
}

testcase S4_SRR_RL_Clu_Mes_4_S4_SRR_RL_Clu_Vel_34()
{
	signalvalue1 = getSignal(S4_SRR_RL_Clu_Vel_34);
	write("S4_SRR_RL_Clu_Vel_34 :%f",signalvalue1);
	write("i_S4_SRR_RL_Clu_Vel_34 :%f",@ecu_Signals::i_S4_SRR_RL_Clu_Vel_34);

	testStep("get expect variable value: ","i_S4_SRR_RL_Clu_Vel_34 :%f",@ecu_Signals::i_S4_SRR_RL_Clu_Vel_34);

	if((abs(@ecu_Signals::i_S4_SRR_RL_Clu_Vel_34)*0.9<=abs(signalvalue1))&&(abs(signalvalue1)<=abs(@ecu_Signals::i_S4_SRR_RL_Clu_Vel_34)*1.1))
	{
	testStepPass("Pass","i_S4_SRR_RL_Clu_Vel_34 :%f",signalvalue1);
	}
	else
	{
	testStepFail("Fail","i_S4_SRR_RL_Clu_Vel_34 :%f",signalvalue1);
	}
}

testcase S4_SRR_RL_Clu_Mes_4_S4_SRR_RL_Clu_SNR_34()
{
	signalvalue1 = getSignal(S4_SRR_RL_Clu_SNR_34);
	write("S4_SRR_RL_Clu_SNR_34 :%f",signalvalue1);
	write("i_S4_SRR_RL_Clu_SNR_34 :%f",@ecu_Signals::i_S4_SRR_RL_Clu_SNR_34);

	testStep("get expect variable value: ","i_S4_SRR_RL_Clu_SNR_34 :%f",@ecu_Signals::i_S4_SRR_RL_Clu_SNR_34);

	if((abs(@ecu_Signals::i_S4_SRR_RL_Clu_SNR_34)*0.9<=abs(signalvalue1))&&(abs(signalvalue1)<=abs(@ecu_Signals::i_S4_SRR_RL_Clu_SNR_34)*1.1))
	{
	testStepPass("Pass","i_S4_SRR_RL_Clu_SNR_34 :%f",signalvalue1);
	}
	else
	{
	testStepFail("Fail","i_S4_SRR_RL_Clu_SNR_34 :%f",signalvalue1);
	}
}

testcase S4_SRR_RL_Clu_Mes_4_S4_SRR_RL_Clu_DynProp_34()
{
	signalvalue1 = getSignal(S4_SRR_RL_Clu_DynProp_34);
	write("S4_SRR_RL_Clu_DynProp_34 :%f",signalvalue1);
	write("i_S4_SRR_RL_Clu_DynProp_34 :%o",@ecu_Signals::i_S4_SRR_RL_Clu_DynProp_34);

	testStep("get expect variable value: ","i_S4_SRR_RL_Clu_DynProp_34 :%o",@ecu_Signals::i_S4_SRR_RL_Clu_DynProp_34);

	if(signalvalue1==@ecu_Signals::i_S4_SRR_RL_Clu_DynProp_34)
	{
	testStepPass("Pass","i_S4_SRR_RL_Clu_DynProp_34 :%f",signalvalue1);
	}
	else
	{
	testStepFail("Fail","i_S4_SRR_RL_Clu_DynProp_34 :%f",signalvalue1);
	}
}

testcase S4_SRR_RL_Clu_Mes_4_S4_SRR_RL_Clu_Locationvalid_34()
{
	signalvalue1 = getSignal(S4_SRR_RL_Clu_Locationvalid_34);
	write("S4_SRR_RL_Clu_Locationvalid_34 :%f",signalvalue1);
	write("i_S4_SRR_RL_Clu_Locationvalid_34 :%o",@ecu_Signals::i_S4_SRR_RL_Clu_Locationvalid_34);

	testStep("get expect variable value: ","i_S4_SRR_RL_Clu_Locationvalid_34 :%o",@ecu_Signals::i_S4_SRR_RL_Clu_Locationvalid_34);

	if(signalvalue1==@ecu_Signals::i_S4_SRR_RL_Clu_Locationvalid_34)
	{
	testStepPass("Pass","i_S4_SRR_RL_Clu_Locationvalid_34 :%f",signalvalue1);
	}
	else
	{
	testStepFail("Fail","i_S4_SRR_RL_Clu_Locationvalid_34 :%f",signalvalue1);
	}
}

testcase S4_SRR_RL_Clu_Mes_5_S4_SRR_RL_Clu_Theta_35()
{
	signalvalue1 = getSignal(S4_SRR_RL_Clu_Theta_35);
	write("S4_SRR_RL_Clu_Theta_35 :%f",signalvalue1);
	write("i_S4_SRR_RL_Clu_Theta_35 :%f",@ecu_Signals::i_S4_SRR_RL_Clu_Theta_35);

	testStep("get expect variable value: ","i_S4_SRR_RL_Clu_Theta_35 :%f",@ecu_Signals::i_S4_SRR_RL_Clu_Theta_35);

	if((abs(@ecu_Signals::i_S4_SRR_RL_Clu_Theta_35)*0.9<=abs(signalvalue1))&&(abs(signalvalue1)<=abs(@ecu_Signals::i_S4_SRR_RL_Clu_Theta_35)*1.1))
	{
	testStepPass("Pass","i_S4_SRR_RL_Clu_Theta_35 :%f",signalvalue1);
	}
	else
	{
	testStepFail("Fail","i_S4_SRR_RL_Clu_Theta_35 :%f",signalvalue1);
	}
}

testcase S4_SRR_RL_Clu_Mes_5_S4_SRR_RL_Clu_Dist_35()
{
	signalvalue1 = getSignal(S4_SRR_RL_Clu_Dist_35);
	write("S4_SRR_RL_Clu_Dist_35 :%f",signalvalue1);
	write("i_S4_SRR_RL_Clu_Dist_35 :%f",@ecu_Signals::i_S4_SRR_RL_Clu_Dist_35);

	testStep("get expect variable value: ","i_S4_SRR_RL_Clu_Dist_35 :%f",@ecu_Signals::i_S4_SRR_RL_Clu_Dist_35);

	if((abs(@ecu_Signals::i_S4_SRR_RL_Clu_Dist_35)*0.9<=abs(signalvalue1))&&(abs(signalvalue1)<=abs(@ecu_Signals::i_S4_SRR_RL_Clu_Dist_35)*1.1))
	{
	testStepPass("Pass","i_S4_SRR_RL_Clu_Dist_35 :%f",signalvalue1);
	}
	else
	{
	testStepFail("Fail","i_S4_SRR_RL_Clu_Dist_35 :%f",signalvalue1);
	}
}

testcase S4_SRR_RL_Clu_Mes_5_S4_SRR_RL_Clu_Vel_35()
{
	signalvalue1 = getSignal(S4_SRR_RL_Clu_Vel_35);
	write("S4_SRR_RL_Clu_Vel_35 :%f",signalvalue1);
	write("i_S4_SRR_RL_Clu_Vel_35 :%f",@ecu_Signals::i_S4_SRR_RL_Clu_Vel_35);

	testStep("get expect variable value: ","i_S4_SRR_RL_Clu_Vel_35 :%f",@ecu_Signals::i_S4_SRR_RL_Clu_Vel_35);

	if((abs(@ecu_Signals::i_S4_SRR_RL_Clu_Vel_35)*0.9<=abs(signalvalue1))&&(abs(signalvalue1)<=abs(@ecu_Signals::i_S4_SRR_RL_Clu_Vel_35)*1.1))
	{
	testStepPass("Pass","i_S4_SRR_RL_Clu_Vel_35 :%f",signalvalue1);
	}
	else
	{
	testStepFail("Fail","i_S4_SRR_RL_Clu_Vel_35 :%f",signalvalue1);
	}
}

testcase S4_SRR_RL_Clu_Mes_5_S4_SRR_RL_Clu_SNR_35()
{
	signalvalue1 = getSignal(S4_SRR_RL_Clu_SNR_35);
	write("S4_SRR_RL_Clu_SNR_35 :%f",signalvalue1);
	write("i_S4_SRR_RL_Clu_SNR_35 :%f",@ecu_Signals::i_S4_SRR_RL_Clu_SNR_35);

	testStep("get expect variable value: ","i_S4_SRR_RL_Clu_SNR_35 :%f",@ecu_Signals::i_S4_SRR_RL_Clu_SNR_35);

	if((abs(@ecu_Signals::i_S4_SRR_RL_Clu_SNR_35)*0.9<=abs(signalvalue1))&&(abs(signalvalue1)<=abs(@ecu_Signals::i_S4_SRR_RL_Clu_SNR_35)*1.1))
	{
	testStepPass("Pass","i_S4_SRR_RL_Clu_SNR_35 :%f",signalvalue1);
	}
	else
	{
	testStepFail("Fail","i_S4_SRR_RL_Clu_SNR_35 :%f",signalvalue1);
	}
}

testcase S4_SRR_RL_Clu_Mes_5_S4_SRR_RL_Clu_DynProp_35()
{
	signalvalue1 = getSignal(S4_SRR_RL_Clu_DynProp_35);
	write("S4_SRR_RL_Clu_DynProp_35 :%f",signalvalue1);
	write("i_S4_SRR_RL_Clu_DynProp_35 :%o",@ecu_Signals::i_S4_SRR_RL_Clu_DynProp_35);

	testStep("get expect variable value: ","i_S4_SRR_RL_Clu_DynProp_35 :%o",@ecu_Signals::i_S4_SRR_RL_Clu_DynProp_35);

	if(signalvalue1==@ecu_Signals::i_S4_SRR_RL_Clu_DynProp_35)
	{
	testStepPass("Pass","i_S4_SRR_RL_Clu_DynProp_35 :%f",signalvalue1);
	}
	else
	{
	testStepFail("Fail","i_S4_SRR_RL_Clu_DynProp_35 :%f",signalvalue1);
	}
}

testcase S4_SRR_RL_Clu_Mes_5_S4_SRR_RL_Clu_Locationvalid_35()
{
	signalvalue1 = getSignal(S4_SRR_RL_Clu_Locationvalid_35);
	write("S4_SRR_RL_Clu_Locationvalid_35 :%f",signalvalue1);
	write("i_S4_SRR_RL_Clu_Locationvalid_35 :%o",@ecu_Signals::i_S4_SRR_RL_Clu_Locationvalid_35);

	testStep("get expect variable value: ","i_S4_SRR_RL_Clu_Locationvalid_35 :%o",@ecu_Signals::i_S4_SRR_RL_Clu_Locationvalid_35);

	if(signalvalue1==@ecu_Signals::i_S4_SRR_RL_Clu_Locationvalid_35)
	{
	testStepPass("Pass","i_S4_SRR_RL_Clu_Locationvalid_35 :%f",signalvalue1);
	}
	else
	{
	testStepFail("Fail","i_S4_SRR_RL_Clu_Locationvalid_35 :%f",signalvalue1);
	}
}

testcase S4_SRR_RL_Clu_Mes_5_S4_SRR_RL_Clu_Theta_36()
{
	signalvalue1 = getSignal(S4_SRR_RL_Clu_Theta_36);
	write("S4_SRR_RL_Clu_Theta_36 :%f",signalvalue1);
	write("i_S4_SRR_RL_Clu_Theta_36 :%f",@ecu_Signals::i_S4_SRR_RL_Clu_Theta_36);

	testStep("get expect variable value: ","i_S4_SRR_RL_Clu_Theta_36 :%f",@ecu_Signals::i_S4_SRR_RL_Clu_Theta_36);

	if((abs(@ecu_Signals::i_S4_SRR_RL_Clu_Theta_36)*0.9<=abs(signalvalue1))&&(abs(signalvalue1)<=abs(@ecu_Signals::i_S4_SRR_RL_Clu_Theta_36)*1.1))
	{
	testStepPass("Pass","i_S4_SRR_RL_Clu_Theta_36 :%f",signalvalue1);
	}
	else
	{
	testStepFail("Fail","i_S4_SRR_RL_Clu_Theta_36 :%f",signalvalue1);
	}
}

testcase S4_SRR_RL_Clu_Mes_5_S4_SRR_RL_Clu_Dist_36()
{
	signalvalue1 = getSignal(S4_SRR_RL_Clu_Dist_36);
	write("S4_SRR_RL_Clu_Dist_36 :%f",signalvalue1);
	write("i_S4_SRR_RL_Clu_Dist_36 :%f",@ecu_Signals::i_S4_SRR_RL_Clu_Dist_36);

	testStep("get expect variable value: ","i_S4_SRR_RL_Clu_Dist_36 :%f",@ecu_Signals::i_S4_SRR_RL_Clu_Dist_36);

	if((abs(@ecu_Signals::i_S4_SRR_RL_Clu_Dist_36)*0.9<=abs(signalvalue1))&&(abs(signalvalue1)<=abs(@ecu_Signals::i_S4_SRR_RL_Clu_Dist_36)*1.1))
	{
	testStepPass("Pass","i_S4_SRR_RL_Clu_Dist_36 :%f",signalvalue1);
	}
	else
	{
	testStepFail("Fail","i_S4_SRR_RL_Clu_Dist_36 :%f",signalvalue1);
	}
}

testcase S4_SRR_RL_Clu_Mes_5_S4_SRR_RL_Clu_Vel_36()
{
	signalvalue1 = getSignal(S4_SRR_RL_Clu_Vel_36);
	write("S4_SRR_RL_Clu_Vel_36 :%f",signalvalue1);
	write("i_S4_SRR_RL_Clu_Vel_36 :%f",@ecu_Signals::i_S4_SRR_RL_Clu_Vel_36);

	testStep("get expect variable value: ","i_S4_SRR_RL_Clu_Vel_36 :%f",@ecu_Signals::i_S4_SRR_RL_Clu_Vel_36);

	if((abs(@ecu_Signals::i_S4_SRR_RL_Clu_Vel_36)*0.9<=abs(signalvalue1))&&(abs(signalvalue1)<=abs(@ecu_Signals::i_S4_SRR_RL_Clu_Vel_36)*1.1))
	{
	testStepPass("Pass","i_S4_SRR_RL_Clu_Vel_36 :%f",signalvalue1);
	}
	else
	{
	testStepFail("Fail","i_S4_SRR_RL_Clu_Vel_36 :%f",signalvalue1);
	}
}

testcase S4_SRR_RL_Clu_Mes_5_S4_SRR_RL_Clu_SNR_36()
{
	signalvalue1 = getSignal(S4_SRR_RL_Clu_SNR_36);
	write("S4_SRR_RL_Clu_SNR_36 :%f",signalvalue1);
	write("i_S4_SRR_RL_Clu_SNR_36 :%f",@ecu_Signals::i_S4_SRR_RL_Clu_SNR_36);

	testStep("get expect variable value: ","i_S4_SRR_RL_Clu_SNR_36 :%f",@ecu_Signals::i_S4_SRR_RL_Clu_SNR_36);

	if((abs(@ecu_Signals::i_S4_SRR_RL_Clu_SNR_36)*0.9<=abs(signalvalue1))&&(abs(signalvalue1)<=abs(@ecu_Signals::i_S4_SRR_RL_Clu_SNR_36)*1.1))
	{
	testStepPass("Pass","i_S4_SRR_RL_Clu_SNR_36 :%f",signalvalue1);
	}
	else
	{
	testStepFail("Fail","i_S4_SRR_RL_Clu_SNR_36 :%f",signalvalue1);
	}
}

testcase S4_SRR_RL_Clu_Mes_5_S4_SRR_RL_Clu_DynProp_36()
{
	signalvalue1 = getSignal(S4_SRR_RL_Clu_DynProp_36);
	write("S4_SRR_RL_Clu_DynProp_36 :%f",signalvalue1);
	write("i_S4_SRR_RL_Clu_DynProp_36 :%o",@ecu_Signals::i_S4_SRR_RL_Clu_DynProp_36);

	testStep("get expect variable value: ","i_S4_SRR_RL_Clu_DynProp_36 :%o",@ecu_Signals::i_S4_SRR_RL_Clu_DynProp_36);

	if(signalvalue1==@ecu_Signals::i_S4_SRR_RL_Clu_DynProp_36)
	{
	testStepPass("Pass","i_S4_SRR_RL_Clu_DynProp_36 :%f",signalvalue1);
	}
	else
	{
	testStepFail("Fail","i_S4_SRR_RL_Clu_DynProp_36 :%f",signalvalue1);
	}
}

testcase S4_SRR_RL_Clu_Mes_5_S4_SRR_RL_Clu_Locationvalid_36()
{
	signalvalue1 = getSignal(S4_SRR_RL_Clu_Locationvalid_36);
	write("S4_SRR_RL_Clu_Locationvalid_36 :%f",signalvalue1);
	write("i_S4_SRR_RL_Clu_Locationvalid_36 :%o",@ecu_Signals::i_S4_SRR_RL_Clu_Locationvalid_36);

	testStep("get expect variable value: ","i_S4_SRR_RL_Clu_Locationvalid_36 :%o",@ecu_Signals::i_S4_SRR_RL_Clu_Locationvalid_36);

	if(signalvalue1==@ecu_Signals::i_S4_SRR_RL_Clu_Locationvalid_36)
	{
	testStepPass("Pass","i_S4_SRR_RL_Clu_Locationvalid_36 :%f",signalvalue1);
	}
	else
	{
	testStepFail("Fail","i_S4_SRR_RL_Clu_Locationvalid_36 :%f",signalvalue1);
	}
}

testcase S4_SRR_RL_Clu_Mes_5_S4_SRR_RL_Clu_Theta_37()
{
	signalvalue1 = getSignal(S4_SRR_RL_Clu_Theta_37);
	write("S4_SRR_RL_Clu_Theta_37 :%f",signalvalue1);
	write("i_S4_SRR_RL_Clu_Theta_37 :%f",@ecu_Signals::i_S4_SRR_RL_Clu_Theta_37);

	testStep("get expect variable value: ","i_S4_SRR_RL_Clu_Theta_37 :%f",@ecu_Signals::i_S4_SRR_RL_Clu_Theta_37);

	if((abs(@ecu_Signals::i_S4_SRR_RL_Clu_Theta_37)*0.9<=abs(signalvalue1))&&(abs(signalvalue1)<=abs(@ecu_Signals::i_S4_SRR_RL_Clu_Theta_37)*1.1))
	{
	testStepPass("Pass","i_S4_SRR_RL_Clu_Theta_37 :%f",signalvalue1);
	}
	else
	{
	testStepFail("Fail","i_S4_SRR_RL_Clu_Theta_37 :%f",signalvalue1);
	}
}

testcase S4_SRR_RL_Clu_Mes_5_S4_SRR_RL_Clu_Dist_37()
{
	signalvalue1 = getSignal(S4_SRR_RL_Clu_Dist_37);
	write("S4_SRR_RL_Clu_Dist_37 :%f",signalvalue1);
	write("i_S4_SRR_RL_Clu_Dist_37 :%f",@ecu_Signals::i_S4_SRR_RL_Clu_Dist_37);

	testStep("get expect variable value: ","i_S4_SRR_RL_Clu_Dist_37 :%f",@ecu_Signals::i_S4_SRR_RL_Clu_Dist_37);

	if((abs(@ecu_Signals::i_S4_SRR_RL_Clu_Dist_37)*0.9<=abs(signalvalue1))&&(abs(signalvalue1)<=abs(@ecu_Signals::i_S4_SRR_RL_Clu_Dist_37)*1.1))
	{
	testStepPass("Pass","i_S4_SRR_RL_Clu_Dist_37 :%f",signalvalue1);
	}
	else
	{
	testStepFail("Fail","i_S4_SRR_RL_Clu_Dist_37 :%f",signalvalue1);
	}
}

testcase S4_SRR_RL_Clu_Mes_5_S4_SRR_RL_Clu_Vel_37()
{
	signalvalue1 = getSignal(S4_SRR_RL_Clu_Vel_37);
	write("S4_SRR_RL_Clu_Vel_37 :%f",signalvalue1);
	write("i_S4_SRR_RL_Clu_Vel_37 :%f",@ecu_Signals::i_S4_SRR_RL_Clu_Vel_37);

	testStep("get expect variable value: ","i_S4_SRR_RL_Clu_Vel_37 :%f",@ecu_Signals::i_S4_SRR_RL_Clu_Vel_37);

	if((abs(@ecu_Signals::i_S4_SRR_RL_Clu_Vel_37)*0.9<=abs(signalvalue1))&&(abs(signalvalue1)<=abs(@ecu_Signals::i_S4_SRR_RL_Clu_Vel_37)*1.1))
	{
	testStepPass("Pass","i_S4_SRR_RL_Clu_Vel_37 :%f",signalvalue1);
	}
	else
	{
	testStepFail("Fail","i_S4_SRR_RL_Clu_Vel_37 :%f",signalvalue1);
	}
}

testcase S4_SRR_RL_Clu_Mes_5_S4_SRR_RL_Clu_SNR_37()
{
	signalvalue1 = getSignal(S4_SRR_RL_Clu_SNR_37);
	write("S4_SRR_RL_Clu_SNR_37 :%f",signalvalue1);
	write("i_S4_SRR_RL_Clu_SNR_37 :%f",@ecu_Signals::i_S4_SRR_RL_Clu_SNR_37);

	testStep("get expect variable value: ","i_S4_SRR_RL_Clu_SNR_37 :%f",@ecu_Signals::i_S4_SRR_RL_Clu_SNR_37);

	if((abs(@ecu_Signals::i_S4_SRR_RL_Clu_SNR_37)*0.9<=abs(signalvalue1))&&(abs(signalvalue1)<=abs(@ecu_Signals::i_S4_SRR_RL_Clu_SNR_37)*1.1))
	{
	testStepPass("Pass","i_S4_SRR_RL_Clu_SNR_37 :%f",signalvalue1);
	}
	else
	{
	testStepFail("Fail","i_S4_SRR_RL_Clu_SNR_37 :%f",signalvalue1);
	}
}

testcase S4_SRR_RL_Clu_Mes_5_S4_SRR_RL_Clu_DynProp_37()
{
	signalvalue1 = getSignal(S4_SRR_RL_Clu_DynProp_37);
	write("S4_SRR_RL_Clu_DynProp_37 :%f",signalvalue1);
	write("i_S4_SRR_RL_Clu_DynProp_37 :%o",@ecu_Signals::i_S4_SRR_RL_Clu_DynProp_37);

	testStep("get expect variable value: ","i_S4_SRR_RL_Clu_DynProp_37 :%o",@ecu_Signals::i_S4_SRR_RL_Clu_DynProp_37);

	if(signalvalue1==@ecu_Signals::i_S4_SRR_RL_Clu_DynProp_37)
	{
	testStepPass("Pass","i_S4_SRR_RL_Clu_DynProp_37 :%f",signalvalue1);
	}
	else
	{
	testStepFail("Fail","i_S4_SRR_RL_Clu_DynProp_37 :%f",signalvalue1);
	}
}

testcase S4_SRR_RL_Clu_Mes_5_S4_SRR_RL_Clu_Locationvalid_37()
{
	signalvalue1 = getSignal(S4_SRR_RL_Clu_Locationvalid_37);
	write("S4_SRR_RL_Clu_Locationvalid_37 :%f",signalvalue1);
	write("i_S4_SRR_RL_Clu_Locationvalid_37 :%o",@ecu_Signals::i_S4_SRR_RL_Clu_Locationvalid_37);

	testStep("get expect variable value: ","i_S4_SRR_RL_Clu_Locationvalid_37 :%o",@ecu_Signals::i_S4_SRR_RL_Clu_Locationvalid_37);

	if(signalvalue1==@ecu_Signals::i_S4_SRR_RL_Clu_Locationvalid_37)
	{
	testStepPass("Pass","i_S4_SRR_RL_Clu_Locationvalid_37 :%f",signalvalue1);
	}
	else
	{
	testStepFail("Fail","i_S4_SRR_RL_Clu_Locationvalid_37 :%f",signalvalue1);
	}
}

testcase S4_SRR_RL_Clu_Mes_5_S4_SRR_RL_Clu_Theta_38()
{
	signalvalue1 = getSignal(S4_SRR_RL_Clu_Theta_38);
	write("S4_SRR_RL_Clu_Theta_38 :%f",signalvalue1);
	write("i_S4_SRR_RL_Clu_Theta_38 :%f",@ecu_Signals::i_S4_SRR_RL_Clu_Theta_38);

	testStep("get expect variable value: ","i_S4_SRR_RL_Clu_Theta_38 :%f",@ecu_Signals::i_S4_SRR_RL_Clu_Theta_38);

	if((abs(@ecu_Signals::i_S4_SRR_RL_Clu_Theta_38)*0.9<=abs(signalvalue1))&&(abs(signalvalue1)<=abs(@ecu_Signals::i_S4_SRR_RL_Clu_Theta_38)*1.1))
	{
	testStepPass("Pass","i_S4_SRR_RL_Clu_Theta_38 :%f",signalvalue1);
	}
	else
	{
	testStepFail("Fail","i_S4_SRR_RL_Clu_Theta_38 :%f",signalvalue1);
	}
}

testcase S4_SRR_RL_Clu_Mes_5_S4_SRR_RL_Clu_Dist_38()
{
	signalvalue1 = getSignal(S4_SRR_RL_Clu_Dist_38);
	write("S4_SRR_RL_Clu_Dist_38 :%f",signalvalue1);
	write("i_S4_SRR_RL_Clu_Dist_38 :%f",@ecu_Signals::i_S4_SRR_RL_Clu_Dist_38);

	testStep("get expect variable value: ","i_S4_SRR_RL_Clu_Dist_38 :%f",@ecu_Signals::i_S4_SRR_RL_Clu_Dist_38);

	if((abs(@ecu_Signals::i_S4_SRR_RL_Clu_Dist_38)*0.9<=abs(signalvalue1))&&(abs(signalvalue1)<=abs(@ecu_Signals::i_S4_SRR_RL_Clu_Dist_38)*1.1))
	{
	testStepPass("Pass","i_S4_SRR_RL_Clu_Dist_38 :%f",signalvalue1);
	}
	else
	{
	testStepFail("Fail","i_S4_SRR_RL_Clu_Dist_38 :%f",signalvalue1);
	}
}

testcase S4_SRR_RL_Clu_Mes_5_S4_SRR_RL_Clu_Vel_38()
{
	signalvalue1 = getSignal(S4_SRR_RL_Clu_Vel_38);
	write("S4_SRR_RL_Clu_Vel_38 :%f",signalvalue1);
	write("i_S4_SRR_RL_Clu_Vel_38 :%f",@ecu_Signals::i_S4_SRR_RL_Clu_Vel_38);

	testStep("get expect variable value: ","i_S4_SRR_RL_Clu_Vel_38 :%f",@ecu_Signals::i_S4_SRR_RL_Clu_Vel_38);

	if((abs(@ecu_Signals::i_S4_SRR_RL_Clu_Vel_38)*0.9<=abs(signalvalue1))&&(abs(signalvalue1)<=abs(@ecu_Signals::i_S4_SRR_RL_Clu_Vel_38)*1.1))
	{
	testStepPass("Pass","i_S4_SRR_RL_Clu_Vel_38 :%f",signalvalue1);
	}
	else
	{
	testStepFail("Fail","i_S4_SRR_RL_Clu_Vel_38 :%f",signalvalue1);
	}
}

testcase S4_SRR_RL_Clu_Mes_5_S4_SRR_RL_Clu_SNR_38()
{
	signalvalue1 = getSignal(S4_SRR_RL_Clu_SNR_38);
	write("S4_SRR_RL_Clu_SNR_38 :%f",signalvalue1);
	write("i_S4_SRR_RL_Clu_SNR_38 :%f",@ecu_Signals::i_S4_SRR_RL_Clu_SNR_38);

	testStep("get expect variable value: ","i_S4_SRR_RL_Clu_SNR_38 :%f",@ecu_Signals::i_S4_SRR_RL_Clu_SNR_38);

	if((abs(@ecu_Signals::i_S4_SRR_RL_Clu_SNR_38)*0.9<=abs(signalvalue1))&&(abs(signalvalue1)<=abs(@ecu_Signals::i_S4_SRR_RL_Clu_SNR_38)*1.1))
	{
	testStepPass("Pass","i_S4_SRR_RL_Clu_SNR_38 :%f",signalvalue1);
	}
	else
	{
	testStepFail("Fail","i_S4_SRR_RL_Clu_SNR_38 :%f",signalvalue1);
	}
}

testcase S4_SRR_RL_Clu_Mes_5_S4_SRR_RL_Clu_DynProp_38()
{
	signalvalue1 = getSignal(S4_SRR_RL_Clu_DynProp_38);
	write("S4_SRR_RL_Clu_DynProp_38 :%f",signalvalue1);
	write("i_S4_SRR_RL_Clu_DynProp_38 :%o",@ecu_Signals::i_S4_SRR_RL_Clu_DynProp_38);

	testStep("get expect variable value: ","i_S4_SRR_RL_Clu_DynProp_38 :%o",@ecu_Signals::i_S4_SRR_RL_Clu_DynProp_38);

	if(signalvalue1==@ecu_Signals::i_S4_SRR_RL_Clu_DynProp_38)
	{
	testStepPass("Pass","i_S4_SRR_RL_Clu_DynProp_38 :%f",signalvalue1);
	}
	else
	{
	testStepFail("Fail","i_S4_SRR_RL_Clu_DynProp_38 :%f",signalvalue1);
	}
}

testcase S4_SRR_RL_Clu_Mes_5_S4_SRR_RL_Clu_Locationvalid_38()
{
	signalvalue1 = getSignal(S4_SRR_RL_Clu_Locationvalid_38);
	write("S4_SRR_RL_Clu_Locationvalid_38 :%f",signalvalue1);
	write("i_S4_SRR_RL_Clu_Locationvalid_38 :%o",@ecu_Signals::i_S4_SRR_RL_Clu_Locationvalid_38);

	testStep("get expect variable value: ","i_S4_SRR_RL_Clu_Locationvalid_38 :%o",@ecu_Signals::i_S4_SRR_RL_Clu_Locationvalid_38);

	if(signalvalue1==@ecu_Signals::i_S4_SRR_RL_Clu_Locationvalid_38)
	{
	testStepPass("Pass","i_S4_SRR_RL_Clu_Locationvalid_38 :%f",signalvalue1);
	}
	else
	{
	testStepFail("Fail","i_S4_SRR_RL_Clu_Locationvalid_38 :%f",signalvalue1);
	}
}

testcase S4_SRR_RL_Clu_Mes_5_S4_SRR_RL_Clu_Theta_39()
{
	signalvalue1 = getSignal(S4_SRR_RL_Clu_Theta_39);
	write("S4_SRR_RL_Clu_Theta_39 :%f",signalvalue1);
	write("i_S4_SRR_RL_Clu_Theta_39 :%f",@ecu_Signals::i_S4_SRR_RL_Clu_Theta_39);

	testStep("get expect variable value: ","i_S4_SRR_RL_Clu_Theta_39 :%f",@ecu_Signals::i_S4_SRR_RL_Clu_Theta_39);

	if((abs(@ecu_Signals::i_S4_SRR_RL_Clu_Theta_39)*0.9<=abs(signalvalue1))&&(abs(signalvalue1)<=abs(@ecu_Signals::i_S4_SRR_RL_Clu_Theta_39)*1.1))
	{
	testStepPass("Pass","i_S4_SRR_RL_Clu_Theta_39 :%f",signalvalue1);
	}
	else
	{
	testStepFail("Fail","i_S4_SRR_RL_Clu_Theta_39 :%f",signalvalue1);
	}
}

testcase S4_SRR_RL_Clu_Mes_5_S4_SRR_RL_Clu_Dist_39()
{
	signalvalue1 = getSignal(S4_SRR_RL_Clu_Dist_39);
	write("S4_SRR_RL_Clu_Dist_39 :%f",signalvalue1);
	write("i_S4_SRR_RL_Clu_Dist_39 :%f",@ecu_Signals::i_S4_SRR_RL_Clu_Dist_39);

	testStep("get expect variable value: ","i_S4_SRR_RL_Clu_Dist_39 :%f",@ecu_Signals::i_S4_SRR_RL_Clu_Dist_39);

	if((abs(@ecu_Signals::i_S4_SRR_RL_Clu_Dist_39)*0.9<=abs(signalvalue1))&&(abs(signalvalue1)<=abs(@ecu_Signals::i_S4_SRR_RL_Clu_Dist_39)*1.1))
	{
	testStepPass("Pass","i_S4_SRR_RL_Clu_Dist_39 :%f",signalvalue1);
	}
	else
	{
	testStepFail("Fail","i_S4_SRR_RL_Clu_Dist_39 :%f",signalvalue1);
	}
}

testcase S4_SRR_RL_Clu_Mes_5_S4_SRR_RL_Clu_Vel_39()
{
	signalvalue1 = getSignal(S4_SRR_RL_Clu_Vel_39);
	write("S4_SRR_RL_Clu_Vel_39 :%f",signalvalue1);
	write("i_S4_SRR_RL_Clu_Vel_39 :%f",@ecu_Signals::i_S4_SRR_RL_Clu_Vel_39);

	testStep("get expect variable value: ","i_S4_SRR_RL_Clu_Vel_39 :%f",@ecu_Signals::i_S4_SRR_RL_Clu_Vel_39);

	if((abs(@ecu_Signals::i_S4_SRR_RL_Clu_Vel_39)*0.9<=abs(signalvalue1))&&(abs(signalvalue1)<=abs(@ecu_Signals::i_S4_SRR_RL_Clu_Vel_39)*1.1))
	{
	testStepPass("Pass","i_S4_SRR_RL_Clu_Vel_39 :%f",signalvalue1);
	}
	else
	{
	testStepFail("Fail","i_S4_SRR_RL_Clu_Vel_39 :%f",signalvalue1);
	}
}

testcase S4_SRR_RL_Clu_Mes_5_S4_SRR_RL_Clu_SNR_39()
{
	signalvalue1 = getSignal(S4_SRR_RL_Clu_SNR_39);
	write("S4_SRR_RL_Clu_SNR_39 :%f",signalvalue1);
	write("i_S4_SRR_RL_Clu_SNR_39 :%f",@ecu_Signals::i_S4_SRR_RL_Clu_SNR_39);

	testStep("get expect variable value: ","i_S4_SRR_RL_Clu_SNR_39 :%f",@ecu_Signals::i_S4_SRR_RL_Clu_SNR_39);

	if((abs(@ecu_Signals::i_S4_SRR_RL_Clu_SNR_39)*0.9<=abs(signalvalue1))&&(abs(signalvalue1)<=abs(@ecu_Signals::i_S4_SRR_RL_Clu_SNR_39)*1.1))
	{
	testStepPass("Pass","i_S4_SRR_RL_Clu_SNR_39 :%f",signalvalue1);
	}
	else
	{
	testStepFail("Fail","i_S4_SRR_RL_Clu_SNR_39 :%f",signalvalue1);
	}
}

testcase S4_SRR_RL_Clu_Mes_5_S4_SRR_RL_Clu_DynProp_39()
{
	signalvalue1 = getSignal(S4_SRR_RL_Clu_DynProp_39);
	write("S4_SRR_RL_Clu_DynProp_39 :%f",signalvalue1);
	write("i_S4_SRR_RL_Clu_DynProp_39 :%o",@ecu_Signals::i_S4_SRR_RL_Clu_DynProp_39);

	testStep("get expect variable value: ","i_S4_SRR_RL_Clu_DynProp_39 :%o",@ecu_Signals::i_S4_SRR_RL_Clu_DynProp_39);

	if(signalvalue1==@ecu_Signals::i_S4_SRR_RL_Clu_DynProp_39)
	{
	testStepPass("Pass","i_S4_SRR_RL_Clu_DynProp_39 :%f",signalvalue1);
	}
	else
	{
	testStepFail("Fail","i_S4_SRR_RL_Clu_DynProp_39 :%f",signalvalue1);
	}
}

testcase S4_SRR_RL_Clu_Mes_5_S4_SRR_RL_Clu_Locationvalid_39()
{
	signalvalue1 = getSignal(S4_SRR_RL_Clu_Locationvalid_39);
	write("S4_SRR_RL_Clu_Locationvalid_39 :%f",signalvalue1);
	write("i_S4_SRR_RL_Clu_Locationvalid_39 :%o",@ecu_Signals::i_S4_SRR_RL_Clu_Locationvalid_39);

	testStep("get expect variable value: ","i_S4_SRR_RL_Clu_Locationvalid_39 :%o",@ecu_Signals::i_S4_SRR_RL_Clu_Locationvalid_39);

	if(signalvalue1==@ecu_Signals::i_S4_SRR_RL_Clu_Locationvalid_39)
	{
	testStepPass("Pass","i_S4_SRR_RL_Clu_Locationvalid_39 :%f",signalvalue1);
	}
	else
	{
	testStepFail("Fail","i_S4_SRR_RL_Clu_Locationvalid_39 :%f",signalvalue1);
	}
}

testcase S4_SRR_RL_Clu_Mes_5_S4_SRR_RL_Clu_Theta_40()
{
	signalvalue1 = getSignal(S4_SRR_RL_Clu_Theta_40);
	write("S4_SRR_RL_Clu_Theta_40 :%f",signalvalue1);
	write("i_S4_SRR_RL_Clu_Theta_40 :%f",@ecu_Signals::i_S4_SRR_RL_Clu_Theta_40);

	testStep("get expect variable value: ","i_S4_SRR_RL_Clu_Theta_40 :%f",@ecu_Signals::i_S4_SRR_RL_Clu_Theta_40);

	if((abs(@ecu_Signals::i_S4_SRR_RL_Clu_Theta_40)*0.9<=abs(signalvalue1))&&(abs(signalvalue1)<=abs(@ecu_Signals::i_S4_SRR_RL_Clu_Theta_40)*1.1))
	{
	testStepPass("Pass","i_S4_SRR_RL_Clu_Theta_40 :%f",signalvalue1);
	}
	else
	{
	testStepFail("Fail","i_S4_SRR_RL_Clu_Theta_40 :%f",signalvalue1);
	}
}

testcase S4_SRR_RL_Clu_Mes_5_S4_SRR_RL_Clu_Dist_40()
{
	signalvalue1 = getSignal(S4_SRR_RL_Clu_Dist_40);
	write("S4_SRR_RL_Clu_Dist_40 :%f",signalvalue1);
	write("i_S4_SRR_RL_Clu_Dist_40 :%f",@ecu_Signals::i_S4_SRR_RL_Clu_Dist_40);

	testStep("get expect variable value: ","i_S4_SRR_RL_Clu_Dist_40 :%f",@ecu_Signals::i_S4_SRR_RL_Clu_Dist_40);

	if((abs(@ecu_Signals::i_S4_SRR_RL_Clu_Dist_40)*0.9<=abs(signalvalue1))&&(abs(signalvalue1)<=abs(@ecu_Signals::i_S4_SRR_RL_Clu_Dist_40)*1.1))
	{
	testStepPass("Pass","i_S4_SRR_RL_Clu_Dist_40 :%f",signalvalue1);
	}
	else
	{
	testStepFail("Fail","i_S4_SRR_RL_Clu_Dist_40 :%f",signalvalue1);
	}
}

testcase S4_SRR_RL_Clu_Mes_5_S4_SRR_RL_Clu_Vel_40()
{
	signalvalue1 = getSignal(S4_SRR_RL_Clu_Vel_40);
	write("S4_SRR_RL_Clu_Vel_40 :%f",signalvalue1);
	write("i_S4_SRR_RL_Clu_Vel_40 :%f",@ecu_Signals::i_S4_SRR_RL_Clu_Vel_40);

	testStep("get expect variable value: ","i_S4_SRR_RL_Clu_Vel_40 :%f",@ecu_Signals::i_S4_SRR_RL_Clu_Vel_40);

	if((abs(@ecu_Signals::i_S4_SRR_RL_Clu_Vel_40)*0.9<=abs(signalvalue1))&&(abs(signalvalue1)<=abs(@ecu_Signals::i_S4_SRR_RL_Clu_Vel_40)*1.1))
	{
	testStepPass("Pass","i_S4_SRR_RL_Clu_Vel_40 :%f",signalvalue1);
	}
	else
	{
	testStepFail("Fail","i_S4_SRR_RL_Clu_Vel_40 :%f",signalvalue1);
	}
}

testcase S4_SRR_RL_Clu_Mes_5_S4_SRR_RL_Clu_SNR_40()
{
	signalvalue1 = getSignal(S4_SRR_RL_Clu_SNR_40);
	write("S4_SRR_RL_Clu_SNR_40 :%f",signalvalue1);
	write("i_S4_SRR_RL_Clu_SNR_40 :%f",@ecu_Signals::i_S4_SRR_RL_Clu_SNR_40);

	testStep("get expect variable value: ","i_S4_SRR_RL_Clu_SNR_40 :%f",@ecu_Signals::i_S4_SRR_RL_Clu_SNR_40);

	if((abs(@ecu_Signals::i_S4_SRR_RL_Clu_SNR_40)*0.9<=abs(signalvalue1))&&(abs(signalvalue1)<=abs(@ecu_Signals::i_S4_SRR_RL_Clu_SNR_40)*1.1))
	{
	testStepPass("Pass","i_S4_SRR_RL_Clu_SNR_40 :%f",signalvalue1);
	}
	else
	{
	testStepFail("Fail","i_S4_SRR_RL_Clu_SNR_40 :%f",signalvalue1);
	}
}

testcase S4_SRR_RL_Clu_Mes_5_S4_SRR_RL_Clu_DynProp_40()
{
	signalvalue1 = getSignal(S4_SRR_RL_Clu_DynProp_40);
	write("S4_SRR_RL_Clu_DynProp_40 :%f",signalvalue1);
	write("i_S4_SRR_RL_Clu_DynProp_40 :%o",@ecu_Signals::i_S4_SRR_RL_Clu_DynProp_40);

	testStep("get expect variable value: ","i_S4_SRR_RL_Clu_DynProp_40 :%o",@ecu_Signals::i_S4_SRR_RL_Clu_DynProp_40);

	if(signalvalue1==@ecu_Signals::i_S4_SRR_RL_Clu_DynProp_40)
	{
	testStepPass("Pass","i_S4_SRR_RL_Clu_DynProp_40 :%f",signalvalue1);
	}
	else
	{
	testStepFail("Fail","i_S4_SRR_RL_Clu_DynProp_40 :%f",signalvalue1);
	}
}

testcase S4_SRR_RL_Clu_Mes_5_S4_SRR_RL_Clu_Locationvalid_40()
{
	signalvalue1 = getSignal(S4_SRR_RL_Clu_Locationvalid_40);
	write("S4_SRR_RL_Clu_Locationvalid_40 :%f",signalvalue1);
	write("i_S4_SRR_RL_Clu_Locationvalid_40 :%o",@ecu_Signals::i_S4_SRR_RL_Clu_Locationvalid_40);

	testStep("get expect variable value: ","i_S4_SRR_RL_Clu_Locationvalid_40 :%o",@ecu_Signals::i_S4_SRR_RL_Clu_Locationvalid_40);

	if(signalvalue1==@ecu_Signals::i_S4_SRR_RL_Clu_Locationvalid_40)
	{
	testStepPass("Pass","i_S4_SRR_RL_Clu_Locationvalid_40 :%f",signalvalue1);
	}
	else
	{
	testStepFail("Fail","i_S4_SRR_RL_Clu_Locationvalid_40 :%f",signalvalue1);
	}
}

testcase S4_SRR_RL_Clu_Mes_5_S4_SRR_RL_Clu_Theta_41()
{
	signalvalue1 = getSignal(S4_SRR_RL_Clu_Theta_41);
	write("S4_SRR_RL_Clu_Theta_41 :%f",signalvalue1);
	write("i_S4_SRR_RL_Clu_Theta_41 :%f",@ecu_Signals::i_S4_SRR_RL_Clu_Theta_41);

	testStep("get expect variable value: ","i_S4_SRR_RL_Clu_Theta_41 :%f",@ecu_Signals::i_S4_SRR_RL_Clu_Theta_41);

	if((abs(@ecu_Signals::i_S4_SRR_RL_Clu_Theta_41)*0.9<=abs(signalvalue1))&&(abs(signalvalue1)<=abs(@ecu_Signals::i_S4_SRR_RL_Clu_Theta_41)*1.1))
	{
	testStepPass("Pass","i_S4_SRR_RL_Clu_Theta_41 :%f",signalvalue1);
	}
	else
	{
	testStepFail("Fail","i_S4_SRR_RL_Clu_Theta_41 :%f",signalvalue1);
	}
}

testcase S4_SRR_RL_Clu_Mes_5_S4_SRR_RL_Clu_Dist_41()
{
	signalvalue1 = getSignal(S4_SRR_RL_Clu_Dist_41);
	write("S4_SRR_RL_Clu_Dist_41 :%f",signalvalue1);
	write("i_S4_SRR_RL_Clu_Dist_41 :%f",@ecu_Signals::i_S4_SRR_RL_Clu_Dist_41);

	testStep("get expect variable value: ","i_S4_SRR_RL_Clu_Dist_41 :%f",@ecu_Signals::i_S4_SRR_RL_Clu_Dist_41);

	if((abs(@ecu_Signals::i_S4_SRR_RL_Clu_Dist_41)*0.9<=abs(signalvalue1))&&(abs(signalvalue1)<=abs(@ecu_Signals::i_S4_SRR_RL_Clu_Dist_41)*1.1))
	{
	testStepPass("Pass","i_S4_SRR_RL_Clu_Dist_41 :%f",signalvalue1);
	}
	else
	{
	testStepFail("Fail","i_S4_SRR_RL_Clu_Dist_41 :%f",signalvalue1);
	}
}

testcase S4_SRR_RL_Clu_Mes_5_S4_SRR_RL_Clu_Vel_41()
{
	signalvalue1 = getSignal(S4_SRR_RL_Clu_Vel_41);
	write("S4_SRR_RL_Clu_Vel_41 :%f",signalvalue1);
	write("i_S4_SRR_RL_Clu_Vel_41 :%f",@ecu_Signals::i_S4_SRR_RL_Clu_Vel_41);

	testStep("get expect variable value: ","i_S4_SRR_RL_Clu_Vel_41 :%f",@ecu_Signals::i_S4_SRR_RL_Clu_Vel_41);

	if((abs(@ecu_Signals::i_S4_SRR_RL_Clu_Vel_41)*0.9<=abs(signalvalue1))&&(abs(signalvalue1)<=abs(@ecu_Signals::i_S4_SRR_RL_Clu_Vel_41)*1.1))
	{
	testStepPass("Pass","i_S4_SRR_RL_Clu_Vel_41 :%f",signalvalue1);
	}
	else
	{
	testStepFail("Fail","i_S4_SRR_RL_Clu_Vel_41 :%f",signalvalue1);
	}
}

testcase S4_SRR_RL_Clu_Mes_5_S4_SRR_RL_Clu_SNR_41()
{
	signalvalue1 = getSignal(S4_SRR_RL_Clu_SNR_41);
	write("S4_SRR_RL_Clu_SNR_41 :%f",signalvalue1);
	write("i_S4_SRR_RL_Clu_SNR_41 :%f",@ecu_Signals::i_S4_SRR_RL_Clu_SNR_41);

	testStep("get expect variable value: ","i_S4_SRR_RL_Clu_SNR_41 :%f",@ecu_Signals::i_S4_SRR_RL_Clu_SNR_41);

	if((abs(@ecu_Signals::i_S4_SRR_RL_Clu_SNR_41)*0.9<=abs(signalvalue1))&&(abs(signalvalue1)<=abs(@ecu_Signals::i_S4_SRR_RL_Clu_SNR_41)*1.1))
	{
	testStepPass("Pass","i_S4_SRR_RL_Clu_SNR_41 :%f",signalvalue1);
	}
	else
	{
	testStepFail("Fail","i_S4_SRR_RL_Clu_SNR_41 :%f",signalvalue1);
	}
}

testcase S4_SRR_RL_Clu_Mes_5_S4_SRR_RL_Clu_DynProp_41()
{
	signalvalue1 = getSignal(S4_SRR_RL_Clu_DynProp_41);
	write("S4_SRR_RL_Clu_DynProp_41 :%f",signalvalue1);
	write("i_S4_SRR_RL_Clu_DynProp_41 :%o",@ecu_Signals::i_S4_SRR_RL_Clu_DynProp_41);

	testStep("get expect variable value: ","i_S4_SRR_RL_Clu_DynProp_41 :%o",@ecu_Signals::i_S4_SRR_RL_Clu_DynProp_41);

	if(signalvalue1==@ecu_Signals::i_S4_SRR_RL_Clu_DynProp_41)
	{
	testStepPass("Pass","i_S4_SRR_RL_Clu_DynProp_41 :%f",signalvalue1);
	}
	else
	{
	testStepFail("Fail","i_S4_SRR_RL_Clu_DynProp_41 :%f",signalvalue1);
	}
}

testcase S4_SRR_RL_Clu_Mes_5_S4_SRR_RL_Clu_Locationvalid_41()
{
	signalvalue1 = getSignal(S4_SRR_RL_Clu_Locationvalid_41);
	write("S4_SRR_RL_Clu_Locationvalid_41 :%f",signalvalue1);
	write("i_S4_SRR_RL_Clu_Locationvalid_41 :%o",@ecu_Signals::i_S4_SRR_RL_Clu_Locationvalid_41);

	testStep("get expect variable value: ","i_S4_SRR_RL_Clu_Locationvalid_41 :%o",@ecu_Signals::i_S4_SRR_RL_Clu_Locationvalid_41);

	if(signalvalue1==@ecu_Signals::i_S4_SRR_RL_Clu_Locationvalid_41)
	{
	testStepPass("Pass","i_S4_SRR_RL_Clu_Locationvalid_41 :%f",signalvalue1);
	}
	else
	{
	testStepFail("Fail","i_S4_SRR_RL_Clu_Locationvalid_41 :%f",signalvalue1);
	}
}

testcase S4_SRR_RL_Clu_Mes_6_S4_SRR_RL_Clu_Theta_42()
{
	signalvalue1 = getSignal(S4_SRR_RL_Clu_Theta_42);
	write("S4_SRR_RL_Clu_Theta_42 :%f",signalvalue1);
	write("i_S4_SRR_RL_Clu_Theta_42 :%f",@ecu_Signals::i_S4_SRR_RL_Clu_Theta_42);

	testStep("get expect variable value: ","i_S4_SRR_RL_Clu_Theta_42 :%f",@ecu_Signals::i_S4_SRR_RL_Clu_Theta_42);

	if((abs(@ecu_Signals::i_S4_SRR_RL_Clu_Theta_42)*0.9<=abs(signalvalue1))&&(abs(signalvalue1)<=abs(@ecu_Signals::i_S4_SRR_RL_Clu_Theta_42)*1.1))
	{
	testStepPass("Pass","i_S4_SRR_RL_Clu_Theta_42 :%f",signalvalue1);
	}
	else
	{
	testStepFail("Fail","i_S4_SRR_RL_Clu_Theta_42 :%f",signalvalue1);
	}
}

testcase S4_SRR_RL_Clu_Mes_6_S4_SRR_RL_Clu_Dist_42()
{
	signalvalue1 = getSignal(S4_SRR_RL_Clu_Dist_42);
	write("S4_SRR_RL_Clu_Dist_42 :%f",signalvalue1);
	write("i_S4_SRR_RL_Clu_Dist_42 :%f",@ecu_Signals::i_S4_SRR_RL_Clu_Dist_42);

	testStep("get expect variable value: ","i_S4_SRR_RL_Clu_Dist_42 :%f",@ecu_Signals::i_S4_SRR_RL_Clu_Dist_42);

	if((abs(@ecu_Signals::i_S4_SRR_RL_Clu_Dist_42)*0.9<=abs(signalvalue1))&&(abs(signalvalue1)<=abs(@ecu_Signals::i_S4_SRR_RL_Clu_Dist_42)*1.1))
	{
	testStepPass("Pass","i_S4_SRR_RL_Clu_Dist_42 :%f",signalvalue1);
	}
	else
	{
	testStepFail("Fail","i_S4_SRR_RL_Clu_Dist_42 :%f",signalvalue1);
	}
}

testcase S4_SRR_RL_Clu_Mes_6_S4_SRR_RL_Clu_Vel_42()
{
	signalvalue1 = getSignal(S4_SRR_RL_Clu_Vel_42);
	write("S4_SRR_RL_Clu_Vel_42 :%f",signalvalue1);
	write("i_S4_SRR_RL_Clu_Vel_42 :%f",@ecu_Signals::i_S4_SRR_RL_Clu_Vel_42);

	testStep("get expect variable value: ","i_S4_SRR_RL_Clu_Vel_42 :%f",@ecu_Signals::i_S4_SRR_RL_Clu_Vel_42);

	if((abs(@ecu_Signals::i_S4_SRR_RL_Clu_Vel_42)*0.9<=abs(signalvalue1))&&(abs(signalvalue1)<=abs(@ecu_Signals::i_S4_SRR_RL_Clu_Vel_42)*1.1))
	{
	testStepPass("Pass","i_S4_SRR_RL_Clu_Vel_42 :%f",signalvalue1);
	}
	else
	{
	testStepFail("Fail","i_S4_SRR_RL_Clu_Vel_42 :%f",signalvalue1);
	}
}

testcase S4_SRR_RL_Clu_Mes_6_S4_SRR_RL_Clu_SNR_42()
{
	signalvalue1 = getSignal(S4_SRR_RL_Clu_SNR_42);
	write("S4_SRR_RL_Clu_SNR_42 :%f",signalvalue1);
	write("i_S4_SRR_RL_Clu_SNR_42 :%f",@ecu_Signals::i_S4_SRR_RL_Clu_SNR_42);

	testStep("get expect variable value: ","i_S4_SRR_RL_Clu_SNR_42 :%f",@ecu_Signals::i_S4_SRR_RL_Clu_SNR_42);

	if((abs(@ecu_Signals::i_S4_SRR_RL_Clu_SNR_42)*0.9<=abs(signalvalue1))&&(abs(signalvalue1)<=abs(@ecu_Signals::i_S4_SRR_RL_Clu_SNR_42)*1.1))
	{
	testStepPass("Pass","i_S4_SRR_RL_Clu_SNR_42 :%f",signalvalue1);
	}
	else
	{
	testStepFail("Fail","i_S4_SRR_RL_Clu_SNR_42 :%f",signalvalue1);
	}
}

testcase S4_SRR_RL_Clu_Mes_6_S4_SRR_RL_Clu_DynProp_42()
{
	signalvalue1 = getSignal(S4_SRR_RL_Clu_DynProp_42);
	write("S4_SRR_RL_Clu_DynProp_42 :%f",signalvalue1);
	write("i_S4_SRR_RL_Clu_DynProp_42 :%o",@ecu_Signals::i_S4_SRR_RL_Clu_DynProp_42);

	testStep("get expect variable value: ","i_S4_SRR_RL_Clu_DynProp_42 :%o",@ecu_Signals::i_S4_SRR_RL_Clu_DynProp_42);

	if(signalvalue1==@ecu_Signals::i_S4_SRR_RL_Clu_DynProp_42)
	{
	testStepPass("Pass","i_S4_SRR_RL_Clu_DynProp_42 :%f",signalvalue1);
	}
	else
	{
	testStepFail("Fail","i_S4_SRR_RL_Clu_DynProp_42 :%f",signalvalue1);
	}
}

testcase S4_SRR_RL_Clu_Mes_6_S4_SRR_RL_Clu_Locationvalid_42()
{
	signalvalue1 = getSignal(S4_SRR_RL_Clu_Locationvalid_42);
	write("S4_SRR_RL_Clu_Locationvalid_42 :%f",signalvalue1);
	write("i_S4_SRR_RL_Clu_Locationvalid_42 :%o",@ecu_Signals::i_S4_SRR_RL_Clu_Locationvalid_42);

	testStep("get expect variable value: ","i_S4_SRR_RL_Clu_Locationvalid_42 :%o",@ecu_Signals::i_S4_SRR_RL_Clu_Locationvalid_42);

	if(signalvalue1==@ecu_Signals::i_S4_SRR_RL_Clu_Locationvalid_42)
	{
	testStepPass("Pass","i_S4_SRR_RL_Clu_Locationvalid_42 :%f",signalvalue1);
	}
	else
	{
	testStepFail("Fail","i_S4_SRR_RL_Clu_Locationvalid_42 :%f",signalvalue1);
	}
}

testcase S4_SRR_RL_Clu_Mes_6_S4_SRR_RL_Clu_Theta_43()
{
	signalvalue1 = getSignal(S4_SRR_RL_Clu_Theta_43);
	write("S4_SRR_RL_Clu_Theta_43 :%f",signalvalue1);
	write("i_S4_SRR_RL_Clu_Theta_43 :%f",@ecu_Signals::i_S4_SRR_RL_Clu_Theta_43);

	testStep("get expect variable value: ","i_S4_SRR_RL_Clu_Theta_43 :%f",@ecu_Signals::i_S4_SRR_RL_Clu_Theta_43);

	if((abs(@ecu_Signals::i_S4_SRR_RL_Clu_Theta_43)*0.9<=abs(signalvalue1))&&(abs(signalvalue1)<=abs(@ecu_Signals::i_S4_SRR_RL_Clu_Theta_43)*1.1))
	{
	testStepPass("Pass","i_S4_SRR_RL_Clu_Theta_43 :%f",signalvalue1);
	}
	else
	{
	testStepFail("Fail","i_S4_SRR_RL_Clu_Theta_43 :%f",signalvalue1);
	}
}

testcase S4_SRR_RL_Clu_Mes_6_S4_SRR_RL_Clu_Dist_43()
{
	signalvalue1 = getSignal(S4_SRR_RL_Clu_Dist_43);
	write("S4_SRR_RL_Clu_Dist_43 :%f",signalvalue1);
	write("i_S4_SRR_RL_Clu_Dist_43 :%f",@ecu_Signals::i_S4_SRR_RL_Clu_Dist_43);

	testStep("get expect variable value: ","i_S4_SRR_RL_Clu_Dist_43 :%f",@ecu_Signals::i_S4_SRR_RL_Clu_Dist_43);

	if((abs(@ecu_Signals::i_S4_SRR_RL_Clu_Dist_43)*0.9<=abs(signalvalue1))&&(abs(signalvalue1)<=abs(@ecu_Signals::i_S4_SRR_RL_Clu_Dist_43)*1.1))
	{
	testStepPass("Pass","i_S4_SRR_RL_Clu_Dist_43 :%f",signalvalue1);
	}
	else
	{
	testStepFail("Fail","i_S4_SRR_RL_Clu_Dist_43 :%f",signalvalue1);
	}
}

testcase S4_SRR_RL_Clu_Mes_6_S4_SRR_RL_Clu_Vel_43()
{
	signalvalue1 = getSignal(S4_SRR_RL_Clu_Vel_43);
	write("S4_SRR_RL_Clu_Vel_43 :%f",signalvalue1);
	write("i_S4_SRR_RL_Clu_Vel_43 :%f",@ecu_Signals::i_S4_SRR_RL_Clu_Vel_43);

	testStep("get expect variable value: ","i_S4_SRR_RL_Clu_Vel_43 :%f",@ecu_Signals::i_S4_SRR_RL_Clu_Vel_43);

	if((abs(@ecu_Signals::i_S4_SRR_RL_Clu_Vel_43)*0.9<=abs(signalvalue1))&&(abs(signalvalue1)<=abs(@ecu_Signals::i_S4_SRR_RL_Clu_Vel_43)*1.1))
	{
	testStepPass("Pass","i_S4_SRR_RL_Clu_Vel_43 :%f",signalvalue1);
	}
	else
	{
	testStepFail("Fail","i_S4_SRR_RL_Clu_Vel_43 :%f",signalvalue1);
	}
}

testcase S4_SRR_RL_Clu_Mes_6_S4_SRR_RL_Clu_SNR_43()
{
	signalvalue1 = getSignal(S4_SRR_RL_Clu_SNR_43);
	write("S4_SRR_RL_Clu_SNR_43 :%f",signalvalue1);
	write("i_S4_SRR_RL_Clu_SNR_43 :%f",@ecu_Signals::i_S4_SRR_RL_Clu_SNR_43);

	testStep("get expect variable value: ","i_S4_SRR_RL_Clu_SNR_43 :%f",@ecu_Signals::i_S4_SRR_RL_Clu_SNR_43);

	if((abs(@ecu_Signals::i_S4_SRR_RL_Clu_SNR_43)*0.9<=abs(signalvalue1))&&(abs(signalvalue1)<=abs(@ecu_Signals::i_S4_SRR_RL_Clu_SNR_43)*1.1))
	{
	testStepPass("Pass","i_S4_SRR_RL_Clu_SNR_43 :%f",signalvalue1);
	}
	else
	{
	testStepFail("Fail","i_S4_SRR_RL_Clu_SNR_43 :%f",signalvalue1);
	}
}

testcase S4_SRR_RL_Clu_Mes_6_S4_SRR_RL_Clu_DynProp_43()
{
	signalvalue1 = getSignal(S4_SRR_RL_Clu_DynProp_43);
	write("S4_SRR_RL_Clu_DynProp_43 :%f",signalvalue1);
	write("i_S4_SRR_RL_Clu_DynProp_43 :%o",@ecu_Signals::i_S4_SRR_RL_Clu_DynProp_43);

	testStep("get expect variable value: ","i_S4_SRR_RL_Clu_DynProp_43 :%o",@ecu_Signals::i_S4_SRR_RL_Clu_DynProp_43);

	if(signalvalue1==@ecu_Signals::i_S4_SRR_RL_Clu_DynProp_43)
	{
	testStepPass("Pass","i_S4_SRR_RL_Clu_DynProp_43 :%f",signalvalue1);
	}
	else
	{
	testStepFail("Fail","i_S4_SRR_RL_Clu_DynProp_43 :%f",signalvalue1);
	}
}

testcase S4_SRR_RL_Clu_Mes_6_S4_SRR_RL_Clu_Locationvalid_43()
{
	signalvalue1 = getSignal(S4_SRR_RL_Clu_Locationvalid_43);
	write("S4_SRR_RL_Clu_Locationvalid_43 :%f",signalvalue1);
	write("i_S4_SRR_RL_Clu_Locationvalid_43 :%o",@ecu_Signals::i_S4_SRR_RL_Clu_Locationvalid_43);

	testStep("get expect variable value: ","i_S4_SRR_RL_Clu_Locationvalid_43 :%o",@ecu_Signals::i_S4_SRR_RL_Clu_Locationvalid_43);

	if(signalvalue1==@ecu_Signals::i_S4_SRR_RL_Clu_Locationvalid_43)
	{
	testStepPass("Pass","i_S4_SRR_RL_Clu_Locationvalid_43 :%f",signalvalue1);
	}
	else
	{
	testStepFail("Fail","i_S4_SRR_RL_Clu_Locationvalid_43 :%f",signalvalue1);
	}
}

testcase S4_SRR_RL_Clu_Mes_6_S4_SRR_RL_Clu_Theta_44()
{
	signalvalue1 = getSignal(S4_SRR_RL_Clu_Theta_44);
	write("S4_SRR_RL_Clu_Theta_44 :%f",signalvalue1);
	write("i_S4_SRR_RL_Clu_Theta_44 :%f",@ecu_Signals::i_S4_SRR_RL_Clu_Theta_44);

	testStep("get expect variable value: ","i_S4_SRR_RL_Clu_Theta_44 :%f",@ecu_Signals::i_S4_SRR_RL_Clu_Theta_44);

	if((abs(@ecu_Signals::i_S4_SRR_RL_Clu_Theta_44)*0.9<=abs(signalvalue1))&&(abs(signalvalue1)<=abs(@ecu_Signals::i_S4_SRR_RL_Clu_Theta_44)*1.1))
	{
	testStepPass("Pass","i_S4_SRR_RL_Clu_Theta_44 :%f",signalvalue1);
	}
	else
	{
	testStepFail("Fail","i_S4_SRR_RL_Clu_Theta_44 :%f",signalvalue1);
	}
}

testcase S4_SRR_RL_Clu_Mes_6_S4_SRR_RL_Clu_Dist_44()
{
	signalvalue1 = getSignal(S4_SRR_RL_Clu_Dist_44);
	write("S4_SRR_RL_Clu_Dist_44 :%f",signalvalue1);
	write("i_S4_SRR_RL_Clu_Dist_44 :%f",@ecu_Signals::i_S4_SRR_RL_Clu_Dist_44);

	testStep("get expect variable value: ","i_S4_SRR_RL_Clu_Dist_44 :%f",@ecu_Signals::i_S4_SRR_RL_Clu_Dist_44);

	if((abs(@ecu_Signals::i_S4_SRR_RL_Clu_Dist_44)*0.9<=abs(signalvalue1))&&(abs(signalvalue1)<=abs(@ecu_Signals::i_S4_SRR_RL_Clu_Dist_44)*1.1))
	{
	testStepPass("Pass","i_S4_SRR_RL_Clu_Dist_44 :%f",signalvalue1);
	}
	else
	{
	testStepFail("Fail","i_S4_SRR_RL_Clu_Dist_44 :%f",signalvalue1);
	}
}

testcase S4_SRR_RL_Clu_Mes_6_S4_SRR_RL_Clu_Vel_44()
{
	signalvalue1 = getSignal(S4_SRR_RL_Clu_Vel_44);
	write("S4_SRR_RL_Clu_Vel_44 :%f",signalvalue1);
	write("i_S4_SRR_RL_Clu_Vel_44 :%f",@ecu_Signals::i_S4_SRR_RL_Clu_Vel_44);

	testStep("get expect variable value: ","i_S4_SRR_RL_Clu_Vel_44 :%f",@ecu_Signals::i_S4_SRR_RL_Clu_Vel_44);

	if((abs(@ecu_Signals::i_S4_SRR_RL_Clu_Vel_44)*0.9<=abs(signalvalue1))&&(abs(signalvalue1)<=abs(@ecu_Signals::i_S4_SRR_RL_Clu_Vel_44)*1.1))
	{
	testStepPass("Pass","i_S4_SRR_RL_Clu_Vel_44 :%f",signalvalue1);
	}
	else
	{
	testStepFail("Fail","i_S4_SRR_RL_Clu_Vel_44 :%f",signalvalue1);
	}
}

testcase S4_SRR_RL_Clu_Mes_6_S4_SRR_RL_Clu_SNR_44()
{
	signalvalue1 = getSignal(S4_SRR_RL_Clu_SNR_44);
	write("S4_SRR_RL_Clu_SNR_44 :%f",signalvalue1);
	write("i_S4_SRR_RL_Clu_SNR_44 :%f",@ecu_Signals::i_S4_SRR_RL_Clu_SNR_44);

	testStep("get expect variable value: ","i_S4_SRR_RL_Clu_SNR_44 :%f",@ecu_Signals::i_S4_SRR_RL_Clu_SNR_44);

	if((abs(@ecu_Signals::i_S4_SRR_RL_Clu_SNR_44)*0.9<=abs(signalvalue1))&&(abs(signalvalue1)<=abs(@ecu_Signals::i_S4_SRR_RL_Clu_SNR_44)*1.1))
	{
	testStepPass("Pass","i_S4_SRR_RL_Clu_SNR_44 :%f",signalvalue1);
	}
	else
	{
	testStepFail("Fail","i_S4_SRR_RL_Clu_SNR_44 :%f",signalvalue1);
	}
}

testcase S4_SRR_RL_Clu_Mes_6_S4_SRR_RL_Clu_DynProp_44()
{
	signalvalue1 = getSignal(S4_SRR_RL_Clu_DynProp_44);
	write("S4_SRR_RL_Clu_DynProp_44 :%f",signalvalue1);
	write("i_S4_SRR_RL_Clu_DynProp_44 :%o",@ecu_Signals::i_S4_SRR_RL_Clu_DynProp_44);

	testStep("get expect variable value: ","i_S4_SRR_RL_Clu_DynProp_44 :%o",@ecu_Signals::i_S4_SRR_RL_Clu_DynProp_44);

	if(signalvalue1==@ecu_Signals::i_S4_SRR_RL_Clu_DynProp_44)
	{
	testStepPass("Pass","i_S4_SRR_RL_Clu_DynProp_44 :%f",signalvalue1);
	}
	else
	{
	testStepFail("Fail","i_S4_SRR_RL_Clu_DynProp_44 :%f",signalvalue1);
	}
}

testcase S4_SRR_RL_Clu_Mes_6_S4_SRR_RL_Clu_Locationvalid_44()
{
	signalvalue1 = getSignal(S4_SRR_RL_Clu_Locationvalid_44);
	write("S4_SRR_RL_Clu_Locationvalid_44 :%f",signalvalue1);
	write("i_S4_SRR_RL_Clu_Locationvalid_44 :%o",@ecu_Signals::i_S4_SRR_RL_Clu_Locationvalid_44);

	testStep("get expect variable value: ","i_S4_SRR_RL_Clu_Locationvalid_44 :%o",@ecu_Signals::i_S4_SRR_RL_Clu_Locationvalid_44);

	if(signalvalue1==@ecu_Signals::i_S4_SRR_RL_Clu_Locationvalid_44)
	{
	testStepPass("Pass","i_S4_SRR_RL_Clu_Locationvalid_44 :%f",signalvalue1);
	}
	else
	{
	testStepFail("Fail","i_S4_SRR_RL_Clu_Locationvalid_44 :%f",signalvalue1);
	}
}

testcase S4_SRR_RL_Clu_Mes_6_S4_SRR_RL_Clu_Theta_45()
{
	signalvalue1 = getSignal(S4_SRR_RL_Clu_Theta_45);
	write("S4_SRR_RL_Clu_Theta_45 :%f",signalvalue1);
	write("i_S4_SRR_RL_Clu_Theta_45 :%f",@ecu_Signals::i_S4_SRR_RL_Clu_Theta_45);

	testStep("get expect variable value: ","i_S4_SRR_RL_Clu_Theta_45 :%f",@ecu_Signals::i_S4_SRR_RL_Clu_Theta_45);

	if((abs(@ecu_Signals::i_S4_SRR_RL_Clu_Theta_45)*0.9<=abs(signalvalue1))&&(abs(signalvalue1)<=abs(@ecu_Signals::i_S4_SRR_RL_Clu_Theta_45)*1.1))
	{
	testStepPass("Pass","i_S4_SRR_RL_Clu_Theta_45 :%f",signalvalue1);
	}
	else
	{
	testStepFail("Fail","i_S4_SRR_RL_Clu_Theta_45 :%f",signalvalue1);
	}
}

testcase S4_SRR_RL_Clu_Mes_6_S4_SRR_RL_Clu_Dist_45()
{
	signalvalue1 = getSignal(S4_SRR_RL_Clu_Dist_45);
	write("S4_SRR_RL_Clu_Dist_45 :%f",signalvalue1);
	write("i_S4_SRR_RL_Clu_Dist_45 :%f",@ecu_Signals::i_S4_SRR_RL_Clu_Dist_45);

	testStep("get expect variable value: ","i_S4_SRR_RL_Clu_Dist_45 :%f",@ecu_Signals::i_S4_SRR_RL_Clu_Dist_45);

	if((abs(@ecu_Signals::i_S4_SRR_RL_Clu_Dist_45)*0.9<=abs(signalvalue1))&&(abs(signalvalue1)<=abs(@ecu_Signals::i_S4_SRR_RL_Clu_Dist_45)*1.1))
	{
	testStepPass("Pass","i_S4_SRR_RL_Clu_Dist_45 :%f",signalvalue1);
	}
	else
	{
	testStepFail("Fail","i_S4_SRR_RL_Clu_Dist_45 :%f",signalvalue1);
	}
}

testcase S4_SRR_RL_Clu_Mes_6_S4_SRR_RL_Clu_Vel_45()
{
	signalvalue1 = getSignal(S4_SRR_RL_Clu_Vel_45);
	write("S4_SRR_RL_Clu_Vel_45 :%f",signalvalue1);
	write("i_S4_SRR_RL_Clu_Vel_45 :%f",@ecu_Signals::i_S4_SRR_RL_Clu_Vel_45);

	testStep("get expect variable value: ","i_S4_SRR_RL_Clu_Vel_45 :%f",@ecu_Signals::i_S4_SRR_RL_Clu_Vel_45);

	if((abs(@ecu_Signals::i_S4_SRR_RL_Clu_Vel_45)*0.9<=abs(signalvalue1))&&(abs(signalvalue1)<=abs(@ecu_Signals::i_S4_SRR_RL_Clu_Vel_45)*1.1))
	{
	testStepPass("Pass","i_S4_SRR_RL_Clu_Vel_45 :%f",signalvalue1);
	}
	else
	{
	testStepFail("Fail","i_S4_SRR_RL_Clu_Vel_45 :%f",signalvalue1);
	}
}

testcase S4_SRR_RL_Clu_Mes_6_S4_SRR_RL_Clu_SNR_45()
{
	signalvalue1 = getSignal(S4_SRR_RL_Clu_SNR_45);
	write("S4_SRR_RL_Clu_SNR_45 :%f",signalvalue1);
	write("i_S4_SRR_RL_Clu_SNR_45 :%f",@ecu_Signals::i_S4_SRR_RL_Clu_SNR_45);

	testStep("get expect variable value: ","i_S4_SRR_RL_Clu_SNR_45 :%f",@ecu_Signals::i_S4_SRR_RL_Clu_SNR_45);

	if((abs(@ecu_Signals::i_S4_SRR_RL_Clu_SNR_45)*0.9<=abs(signalvalue1))&&(abs(signalvalue1)<=abs(@ecu_Signals::i_S4_SRR_RL_Clu_SNR_45)*1.1))
	{
	testStepPass("Pass","i_S4_SRR_RL_Clu_SNR_45 :%f",signalvalue1);
	}
	else
	{
	testStepFail("Fail","i_S4_SRR_RL_Clu_SNR_45 :%f",signalvalue1);
	}
}

testcase S4_SRR_RL_Clu_Mes_6_S4_SRR_RL_Clu_DynProp_45()
{
	signalvalue1 = getSignal(S4_SRR_RL_Clu_DynProp_45);
	write("S4_SRR_RL_Clu_DynProp_45 :%f",signalvalue1);
	write("i_S4_SRR_RL_Clu_DynProp_45 :%o",@ecu_Signals::i_S4_SRR_RL_Clu_DynProp_45);

	testStep("get expect variable value: ","i_S4_SRR_RL_Clu_DynProp_45 :%o",@ecu_Signals::i_S4_SRR_RL_Clu_DynProp_45);

	if(signalvalue1==@ecu_Signals::i_S4_SRR_RL_Clu_DynProp_45)
	{
	testStepPass("Pass","i_S4_SRR_RL_Clu_DynProp_45 :%f",signalvalue1);
	}
	else
	{
	testStepFail("Fail","i_S4_SRR_RL_Clu_DynProp_45 :%f",signalvalue1);
	}
}

testcase S4_SRR_RL_Clu_Mes_6_S4_SRR_RL_Clu_Locationvalid_45()
{
	signalvalue1 = getSignal(S4_SRR_RL_Clu_Locationvalid_45);
	write("S4_SRR_RL_Clu_Locationvalid_45 :%f",signalvalue1);
	write("i_S4_SRR_RL_Clu_Locationvalid_45 :%o",@ecu_Signals::i_S4_SRR_RL_Clu_Locationvalid_45);

	testStep("get expect variable value: ","i_S4_SRR_RL_Clu_Locationvalid_45 :%o",@ecu_Signals::i_S4_SRR_RL_Clu_Locationvalid_45);

	if(signalvalue1==@ecu_Signals::i_S4_SRR_RL_Clu_Locationvalid_45)
	{
	testStepPass("Pass","i_S4_SRR_RL_Clu_Locationvalid_45 :%f",signalvalue1);
	}
	else
	{
	testStepFail("Fail","i_S4_SRR_RL_Clu_Locationvalid_45 :%f",signalvalue1);
	}
}

testcase S4_SRR_RL_Clu_Mes_6_S4_SRR_RL_Clu_Theta_46()
{
	signalvalue1 = getSignal(S4_SRR_RL_Clu_Theta_46);
	write("S4_SRR_RL_Clu_Theta_46 :%f",signalvalue1);
	write("i_S4_SRR_RL_Clu_Theta_46 :%f",@ecu_Signals::i_S4_SRR_RL_Clu_Theta_46);

	testStep("get expect variable value: ","i_S4_SRR_RL_Clu_Theta_46 :%f",@ecu_Signals::i_S4_SRR_RL_Clu_Theta_46);

	if((abs(@ecu_Signals::i_S4_SRR_RL_Clu_Theta_46)*0.9<=abs(signalvalue1))&&(abs(signalvalue1)<=abs(@ecu_Signals::i_S4_SRR_RL_Clu_Theta_46)*1.1))
	{
	testStepPass("Pass","i_S4_SRR_RL_Clu_Theta_46 :%f",signalvalue1);
	}
	else
	{
	testStepFail("Fail","i_S4_SRR_RL_Clu_Theta_46 :%f",signalvalue1);
	}
}

testcase S4_SRR_RL_Clu_Mes_6_S4_SRR_RL_Clu_Dist_46()
{
	signalvalue1 = getSignal(S4_SRR_RL_Clu_Dist_46);
	write("S4_SRR_RL_Clu_Dist_46 :%f",signalvalue1);
	write("i_S4_SRR_RL_Clu_Dist_46 :%f",@ecu_Signals::i_S4_SRR_RL_Clu_Dist_46);

	testStep("get expect variable value: ","i_S4_SRR_RL_Clu_Dist_46 :%f",@ecu_Signals::i_S4_SRR_RL_Clu_Dist_46);

	if((abs(@ecu_Signals::i_S4_SRR_RL_Clu_Dist_46)*0.9<=abs(signalvalue1))&&(abs(signalvalue1)<=abs(@ecu_Signals::i_S4_SRR_RL_Clu_Dist_46)*1.1))
	{
	testStepPass("Pass","i_S4_SRR_RL_Clu_Dist_46 :%f",signalvalue1);
	}
	else
	{
	testStepFail("Fail","i_S4_SRR_RL_Clu_Dist_46 :%f",signalvalue1);
	}
}

testcase S4_SRR_RL_Clu_Mes_6_S4_SRR_RL_Clu_Vel_46()
{
	signalvalue1 = getSignal(S4_SRR_RL_Clu_Vel_46);
	write("S4_SRR_RL_Clu_Vel_46 :%f",signalvalue1);
	write("i_S4_SRR_RL_Clu_Vel_46 :%f",@ecu_Signals::i_S4_SRR_RL_Clu_Vel_46);

	testStep("get expect variable value: ","i_S4_SRR_RL_Clu_Vel_46 :%f",@ecu_Signals::i_S4_SRR_RL_Clu_Vel_46);

	if((abs(@ecu_Signals::i_S4_SRR_RL_Clu_Vel_46)*0.9<=abs(signalvalue1))&&(abs(signalvalue1)<=abs(@ecu_Signals::i_S4_SRR_RL_Clu_Vel_46)*1.1))
	{
	testStepPass("Pass","i_S4_SRR_RL_Clu_Vel_46 :%f",signalvalue1);
	}
	else
	{
	testStepFail("Fail","i_S4_SRR_RL_Clu_Vel_46 :%f",signalvalue1);
	}
}

testcase S4_SRR_RL_Clu_Mes_6_S4_SRR_RL_Clu_SNR_46()
{
	signalvalue1 = getSignal(S4_SRR_RL_Clu_SNR_46);
	write("S4_SRR_RL_Clu_SNR_46 :%f",signalvalue1);
	write("i_S4_SRR_RL_Clu_SNR_46 :%f",@ecu_Signals::i_S4_SRR_RL_Clu_SNR_46);

	testStep("get expect variable value: ","i_S4_SRR_RL_Clu_SNR_46 :%f",@ecu_Signals::i_S4_SRR_RL_Clu_SNR_46);

	if((abs(@ecu_Signals::i_S4_SRR_RL_Clu_SNR_46)*0.9<=abs(signalvalue1))&&(abs(signalvalue1)<=abs(@ecu_Signals::i_S4_SRR_RL_Clu_SNR_46)*1.1))
	{
	testStepPass("Pass","i_S4_SRR_RL_Clu_SNR_46 :%f",signalvalue1);
	}
	else
	{
	testStepFail("Fail","i_S4_SRR_RL_Clu_SNR_46 :%f",signalvalue1);
	}
}

testcase S4_SRR_RL_Clu_Mes_6_S4_SRR_RL_Clu_DynProp_46()
{
	signalvalue1 = getSignal(S4_SRR_RL_Clu_DynProp_46);
	write("S4_SRR_RL_Clu_DynProp_46 :%f",signalvalue1);
	write("i_S4_SRR_RL_Clu_DynProp_46 :%o",@ecu_Signals::i_S4_SRR_RL_Clu_DynProp_46);

	testStep("get expect variable value: ","i_S4_SRR_RL_Clu_DynProp_46 :%o",@ecu_Signals::i_S4_SRR_RL_Clu_DynProp_46);

	if(signalvalue1==@ecu_Signals::i_S4_SRR_RL_Clu_DynProp_46)
	{
	testStepPass("Pass","i_S4_SRR_RL_Clu_DynProp_46 :%f",signalvalue1);
	}
	else
	{
	testStepFail("Fail","i_S4_SRR_RL_Clu_DynProp_46 :%f",signalvalue1);
	}
}

testcase S4_SRR_RL_Clu_Mes_6_S4_SRR_RL_Clu_Locationvalid_46()
{
	signalvalue1 = getSignal(S4_SRR_RL_Clu_Locationvalid_46);
	write("S4_SRR_RL_Clu_Locationvalid_46 :%f",signalvalue1);
	write("i_S4_SRR_RL_Clu_Locationvalid_46 :%o",@ecu_Signals::i_S4_SRR_RL_Clu_Locationvalid_46);

	testStep("get expect variable value: ","i_S4_SRR_RL_Clu_Locationvalid_46 :%o",@ecu_Signals::i_S4_SRR_RL_Clu_Locationvalid_46);

	if(signalvalue1==@ecu_Signals::i_S4_SRR_RL_Clu_Locationvalid_46)
	{
	testStepPass("Pass","i_S4_SRR_RL_Clu_Locationvalid_46 :%f",signalvalue1);
	}
	else
	{
	testStepFail("Fail","i_S4_SRR_RL_Clu_Locationvalid_46 :%f",signalvalue1);
	}
}

testcase S4_SRR_RL_Clu_Mes_6_S4_SRR_RL_Clu_Theta_47()
{
	signalvalue1 = getSignal(S4_SRR_RL_Clu_Theta_47);
	write("S4_SRR_RL_Clu_Theta_47 :%f",signalvalue1);
	write("i_S4_SRR_RL_Clu_Theta_47 :%f",@ecu_Signals::i_S4_SRR_RL_Clu_Theta_47);

	testStep("get expect variable value: ","i_S4_SRR_RL_Clu_Theta_47 :%f",@ecu_Signals::i_S4_SRR_RL_Clu_Theta_47);

	if((abs(@ecu_Signals::i_S4_SRR_RL_Clu_Theta_47)*0.9<=abs(signalvalue1))&&(abs(signalvalue1)<=abs(@ecu_Signals::i_S4_SRR_RL_Clu_Theta_47)*1.1))
	{
	testStepPass("Pass","i_S4_SRR_RL_Clu_Theta_47 :%f",signalvalue1);
	}
	else
	{
	testStepFail("Fail","i_S4_SRR_RL_Clu_Theta_47 :%f",signalvalue1);
	}
}

testcase S4_SRR_RL_Clu_Mes_6_S4_SRR_RL_Clu_Dist_47()
{
	signalvalue1 = getSignal(S4_SRR_RL_Clu_Dist_47);
	write("S4_SRR_RL_Clu_Dist_47 :%f",signalvalue1);
	write("i_S4_SRR_RL_Clu_Dist_47 :%f",@ecu_Signals::i_S4_SRR_RL_Clu_Dist_47);

	testStep("get expect variable value: ","i_S4_SRR_RL_Clu_Dist_47 :%f",@ecu_Signals::i_S4_SRR_RL_Clu_Dist_47);

	if((abs(@ecu_Signals::i_S4_SRR_RL_Clu_Dist_47)*0.9<=abs(signalvalue1))&&(abs(signalvalue1)<=abs(@ecu_Signals::i_S4_SRR_RL_Clu_Dist_47)*1.1))
	{
	testStepPass("Pass","i_S4_SRR_RL_Clu_Dist_47 :%f",signalvalue1);
	}
	else
	{
	testStepFail("Fail","i_S4_SRR_RL_Clu_Dist_47 :%f",signalvalue1);
	}
}

testcase S4_SRR_RL_Clu_Mes_6_S4_SRR_RL_Clu_Vel_47()
{
	signalvalue1 = getSignal(S4_SRR_RL_Clu_Vel_47);
	write("S4_SRR_RL_Clu_Vel_47 :%f",signalvalue1);
	write("i_S4_SRR_RL_Clu_Vel_47 :%f",@ecu_Signals::i_S4_SRR_RL_Clu_Vel_47);

	testStep("get expect variable value: ","i_S4_SRR_RL_Clu_Vel_47 :%f",@ecu_Signals::i_S4_SRR_RL_Clu_Vel_47);

	if((abs(@ecu_Signals::i_S4_SRR_RL_Clu_Vel_47)*0.9<=abs(signalvalue1))&&(abs(signalvalue1)<=abs(@ecu_Signals::i_S4_SRR_RL_Clu_Vel_47)*1.1))
	{
	testStepPass("Pass","i_S4_SRR_RL_Clu_Vel_47 :%f",signalvalue1);
	}
	else
	{
	testStepFail("Fail","i_S4_SRR_RL_Clu_Vel_47 :%f",signalvalue1);
	}
}

testcase S4_SRR_RL_Clu_Mes_6_S4_SRR_RL_Clu_SNR_47()
{
	signalvalue1 = getSignal(S4_SRR_RL_Clu_SNR_47);
	write("S4_SRR_RL_Clu_SNR_47 :%f",signalvalue1);
	write("i_S4_SRR_RL_Clu_SNR_47 :%f",@ecu_Signals::i_S4_SRR_RL_Clu_SNR_47);

	testStep("get expect variable value: ","i_S4_SRR_RL_Clu_SNR_47 :%f",@ecu_Signals::i_S4_SRR_RL_Clu_SNR_47);

	if((abs(@ecu_Signals::i_S4_SRR_RL_Clu_SNR_47)*0.9<=abs(signalvalue1))&&(abs(signalvalue1)<=abs(@ecu_Signals::i_S4_SRR_RL_Clu_SNR_47)*1.1))
	{
	testStepPass("Pass","i_S4_SRR_RL_Clu_SNR_47 :%f",signalvalue1);
	}
	else
	{
	testStepFail("Fail","i_S4_SRR_RL_Clu_SNR_47 :%f",signalvalue1);
	}
}

testcase S4_SRR_RL_Clu_Mes_6_S4_SRR_RL_Clu_DynProp_47()
{
	signalvalue1 = getSignal(S4_SRR_RL_Clu_DynProp_47);
	write("S4_SRR_RL_Clu_DynProp_47 :%f",signalvalue1);
	write("i_S4_SRR_RL_Clu_DynProp_47 :%o",@ecu_Signals::i_S4_SRR_RL_Clu_DynProp_47);

	testStep("get expect variable value: ","i_S4_SRR_RL_Clu_DynProp_47 :%o",@ecu_Signals::i_S4_SRR_RL_Clu_DynProp_47);

	if(signalvalue1==@ecu_Signals::i_S4_SRR_RL_Clu_DynProp_47)
	{
	testStepPass("Pass","i_S4_SRR_RL_Clu_DynProp_47 :%f",signalvalue1);
	}
	else
	{
	testStepFail("Fail","i_S4_SRR_RL_Clu_DynProp_47 :%f",signalvalue1);
	}
}

testcase S4_SRR_RL_Clu_Mes_6_S4_SRR_RL_Clu_Locationvalid_47()
{
	signalvalue1 = getSignal(S4_SRR_RL_Clu_Locationvalid_47);
	write("S4_SRR_RL_Clu_Locationvalid_47 :%f",signalvalue1);
	write("i_S4_SRR_RL_Clu_Locationvalid_47 :%o",@ecu_Signals::i_S4_SRR_RL_Clu_Locationvalid_47);

	testStep("get expect variable value: ","i_S4_SRR_RL_Clu_Locationvalid_47 :%o",@ecu_Signals::i_S4_SRR_RL_Clu_Locationvalid_47);

	if(signalvalue1==@ecu_Signals::i_S4_SRR_RL_Clu_Locationvalid_47)
	{
	testStepPass("Pass","i_S4_SRR_RL_Clu_Locationvalid_47 :%f",signalvalue1);
	}
	else
	{
	testStepFail("Fail","i_S4_SRR_RL_Clu_Locationvalid_47 :%f",signalvalue1);
	}
}

testcase S4_SRR_RL_Clu_Mes_6_S4_SRR_RL_Clu_Theta_48()
{
	signalvalue1 = getSignal(S4_SRR_RL_Clu_Theta_48);
	write("S4_SRR_RL_Clu_Theta_48 :%f",signalvalue1);
	write("i_S4_SRR_RL_Clu_Theta_48 :%f",@ecu_Signals::i_S4_SRR_RL_Clu_Theta_48);

	testStep("get expect variable value: ","i_S4_SRR_RL_Clu_Theta_48 :%f",@ecu_Signals::i_S4_SRR_RL_Clu_Theta_48);

	if((abs(@ecu_Signals::i_S4_SRR_RL_Clu_Theta_48)*0.9<=abs(signalvalue1))&&(abs(signalvalue1)<=abs(@ecu_Signals::i_S4_SRR_RL_Clu_Theta_48)*1.1))
	{
	testStepPass("Pass","i_S4_SRR_RL_Clu_Theta_48 :%f",signalvalue1);
	}
	else
	{
	testStepFail("Fail","i_S4_SRR_RL_Clu_Theta_48 :%f",signalvalue1);
	}
}

testcase S4_SRR_RL_Clu_Mes_6_S4_SRR_RL_Clu_Dist_48()
{
	signalvalue1 = getSignal(S4_SRR_RL_Clu_Dist_48);
	write("S4_SRR_RL_Clu_Dist_48 :%f",signalvalue1);
	write("i_S4_SRR_RL_Clu_Dist_48 :%f",@ecu_Signals::i_S4_SRR_RL_Clu_Dist_48);

	testStep("get expect variable value: ","i_S4_SRR_RL_Clu_Dist_48 :%f",@ecu_Signals::i_S4_SRR_RL_Clu_Dist_48);

	if((abs(@ecu_Signals::i_S4_SRR_RL_Clu_Dist_48)*0.9<=abs(signalvalue1))&&(abs(signalvalue1)<=abs(@ecu_Signals::i_S4_SRR_RL_Clu_Dist_48)*1.1))
	{
	testStepPass("Pass","i_S4_SRR_RL_Clu_Dist_48 :%f",signalvalue1);
	}
	else
	{
	testStepFail("Fail","i_S4_SRR_RL_Clu_Dist_48 :%f",signalvalue1);
	}
}

testcase S4_SRR_RL_Clu_Mes_6_S4_SRR_RL_Clu_Vel_48()
{
	signalvalue1 = getSignal(S4_SRR_RL_Clu_Vel_48);
	write("S4_SRR_RL_Clu_Vel_48 :%f",signalvalue1);
	write("i_S4_SRR_RL_Clu_Vel_48 :%f",@ecu_Signals::i_S4_SRR_RL_Clu_Vel_48);

	testStep("get expect variable value: ","i_S4_SRR_RL_Clu_Vel_48 :%f",@ecu_Signals::i_S4_SRR_RL_Clu_Vel_48);

	if((abs(@ecu_Signals::i_S4_SRR_RL_Clu_Vel_48)*0.9<=abs(signalvalue1))&&(abs(signalvalue1)<=abs(@ecu_Signals::i_S4_SRR_RL_Clu_Vel_48)*1.1))
	{
	testStepPass("Pass","i_S4_SRR_RL_Clu_Vel_48 :%f",signalvalue1);
	}
	else
	{
	testStepFail("Fail","i_S4_SRR_RL_Clu_Vel_48 :%f",signalvalue1);
	}
}

testcase S4_SRR_RL_Clu_Mes_6_S4_SRR_RL_Clu_SNR_48()
{
	signalvalue1 = getSignal(S4_SRR_RL_Clu_SNR_48);
	write("S4_SRR_RL_Clu_SNR_48 :%f",signalvalue1);
	write("i_S4_SRR_RL_Clu_SNR_48 :%f",@ecu_Signals::i_S4_SRR_RL_Clu_SNR_48);

	testStep("get expect variable value: ","i_S4_SRR_RL_Clu_SNR_48 :%f",@ecu_Signals::i_S4_SRR_RL_Clu_SNR_48);

	if((abs(@ecu_Signals::i_S4_SRR_RL_Clu_SNR_48)*0.9<=abs(signalvalue1))&&(abs(signalvalue1)<=abs(@ecu_Signals::i_S4_SRR_RL_Clu_SNR_48)*1.1))
	{
	testStepPass("Pass","i_S4_SRR_RL_Clu_SNR_48 :%f",signalvalue1);
	}
	else
	{
	testStepFail("Fail","i_S4_SRR_RL_Clu_SNR_48 :%f",signalvalue1);
	}
}

testcase S4_SRR_RL_Clu_Mes_6_S4_SRR_RL_Clu_DynProp_48()
{
	signalvalue1 = getSignal(S4_SRR_RL_Clu_DynProp_48);
	write("S4_SRR_RL_Clu_DynProp_48 :%f",signalvalue1);
	write("i_S4_SRR_RL_Clu_DynProp_48 :%o",@ecu_Signals::i_S4_SRR_RL_Clu_DynProp_48);

	testStep("get expect variable value: ","i_S4_SRR_RL_Clu_DynProp_48 :%o",@ecu_Signals::i_S4_SRR_RL_Clu_DynProp_48);

	if(signalvalue1==@ecu_Signals::i_S4_SRR_RL_Clu_DynProp_48)
	{
	testStepPass("Pass","i_S4_SRR_RL_Clu_DynProp_48 :%f",signalvalue1);
	}
	else
	{
	testStepFail("Fail","i_S4_SRR_RL_Clu_DynProp_48 :%f",signalvalue1);
	}
}

testcase S4_SRR_RL_Clu_Mes_6_S4_SRR_RL_Clu_Locationvalid_48()
{
	signalvalue1 = getSignal(S4_SRR_RL_Clu_Locationvalid_48);
	write("S4_SRR_RL_Clu_Locationvalid_48 :%f",signalvalue1);
	write("i_S4_SRR_RL_Clu_Locationvalid_48 :%o",@ecu_Signals::i_S4_SRR_RL_Clu_Locationvalid_48);

	testStep("get expect variable value: ","i_S4_SRR_RL_Clu_Locationvalid_48 :%o",@ecu_Signals::i_S4_SRR_RL_Clu_Locationvalid_48);

	if(signalvalue1==@ecu_Signals::i_S4_SRR_RL_Clu_Locationvalid_48)
	{
	testStepPass("Pass","i_S4_SRR_RL_Clu_Locationvalid_48 :%f",signalvalue1);
	}
	else
	{
	testStepFail("Fail","i_S4_SRR_RL_Clu_Locationvalid_48 :%f",signalvalue1);
	}
}

testcase S4_SRR_RL_Clu_Mes_7_S4_SRR_RL_Clu_Theta_49()
{
	signalvalue1 = getSignal(S4_SRR_RL_Clu_Theta_49);
	write("S4_SRR_RL_Clu_Theta_49 :%f",signalvalue1);
	write("i_S4_SRR_RL_Clu_Theta_49 :%f",@ecu_Signals::i_S4_SRR_RL_Clu_Theta_49);

	testStep("get expect variable value: ","i_S4_SRR_RL_Clu_Theta_49 :%f",@ecu_Signals::i_S4_SRR_RL_Clu_Theta_49);

	if((abs(@ecu_Signals::i_S4_SRR_RL_Clu_Theta_49)*0.9<=abs(signalvalue1))&&(abs(signalvalue1)<=abs(@ecu_Signals::i_S4_SRR_RL_Clu_Theta_49)*1.1))
	{
	testStepPass("Pass","i_S4_SRR_RL_Clu_Theta_49 :%f",signalvalue1);
	}
	else
	{
	testStepFail("Fail","i_S4_SRR_RL_Clu_Theta_49 :%f",signalvalue1);
	}
}

testcase S4_SRR_RL_Clu_Mes_7_S4_SRR_RL_Clu_Dist_49()
{
	signalvalue1 = getSignal(S4_SRR_RL_Clu_Dist_49);
	write("S4_SRR_RL_Clu_Dist_49 :%f",signalvalue1);
	write("i_S4_SRR_RL_Clu_Dist_49 :%f",@ecu_Signals::i_S4_SRR_RL_Clu_Dist_49);

	testStep("get expect variable value: ","i_S4_SRR_RL_Clu_Dist_49 :%f",@ecu_Signals::i_S4_SRR_RL_Clu_Dist_49);

	if((abs(@ecu_Signals::i_S4_SRR_RL_Clu_Dist_49)*0.9<=abs(signalvalue1))&&(abs(signalvalue1)<=abs(@ecu_Signals::i_S4_SRR_RL_Clu_Dist_49)*1.1))
	{
	testStepPass("Pass","i_S4_SRR_RL_Clu_Dist_49 :%f",signalvalue1);
	}
	else
	{
	testStepFail("Fail","i_S4_SRR_RL_Clu_Dist_49 :%f",signalvalue1);
	}
}

testcase S4_SRR_RL_Clu_Mes_7_S4_SRR_RL_Clu_Vel_49()
{
	signalvalue1 = getSignal(S4_SRR_RL_Clu_Vel_49);
	write("S4_SRR_RL_Clu_Vel_49 :%f",signalvalue1);
	write("i_S4_SRR_RL_Clu_Vel_49 :%f",@ecu_Signals::i_S4_SRR_RL_Clu_Vel_49);

	testStep("get expect variable value: ","i_S4_SRR_RL_Clu_Vel_49 :%f",@ecu_Signals::i_S4_SRR_RL_Clu_Vel_49);

	if((abs(@ecu_Signals::i_S4_SRR_RL_Clu_Vel_49)*0.9<=abs(signalvalue1))&&(abs(signalvalue1)<=abs(@ecu_Signals::i_S4_SRR_RL_Clu_Vel_49)*1.1))
	{
	testStepPass("Pass","i_S4_SRR_RL_Clu_Vel_49 :%f",signalvalue1);
	}
	else
	{
	testStepFail("Fail","i_S4_SRR_RL_Clu_Vel_49 :%f",signalvalue1);
	}
}

testcase S4_SRR_RL_Clu_Mes_7_S4_SRR_RL_Clu_SNR_49()
{
	signalvalue1 = getSignal(S4_SRR_RL_Clu_SNR_49);
	write("S4_SRR_RL_Clu_SNR_49 :%f",signalvalue1);
	write("i_S4_SRR_RL_Clu_SNR_49 :%f",@ecu_Signals::i_S4_SRR_RL_Clu_SNR_49);

	testStep("get expect variable value: ","i_S4_SRR_RL_Clu_SNR_49 :%f",@ecu_Signals::i_S4_SRR_RL_Clu_SNR_49);

	if((abs(@ecu_Signals::i_S4_SRR_RL_Clu_SNR_49)*0.9<=abs(signalvalue1))&&(abs(signalvalue1)<=abs(@ecu_Signals::i_S4_SRR_RL_Clu_SNR_49)*1.1))
	{
	testStepPass("Pass","i_S4_SRR_RL_Clu_SNR_49 :%f",signalvalue1);
	}
	else
	{
	testStepFail("Fail","i_S4_SRR_RL_Clu_SNR_49 :%f",signalvalue1);
	}
}

testcase S4_SRR_RL_Clu_Mes_7_S4_SRR_RL_Clu_DynProp_49()
{
	signalvalue1 = getSignal(S4_SRR_RL_Clu_DynProp_49);
	write("S4_SRR_RL_Clu_DynProp_49 :%f",signalvalue1);
	write("i_S4_SRR_RL_Clu_DynProp_49 :%o",@ecu_Signals::i_S4_SRR_RL_Clu_DynProp_49);

	testStep("get expect variable value: ","i_S4_SRR_RL_Clu_DynProp_49 :%o",@ecu_Signals::i_S4_SRR_RL_Clu_DynProp_49);

	if(signalvalue1==@ecu_Signals::i_S4_SRR_RL_Clu_DynProp_49)
	{
	testStepPass("Pass","i_S4_SRR_RL_Clu_DynProp_49 :%f",signalvalue1);
	}
	else
	{
	testStepFail("Fail","i_S4_SRR_RL_Clu_DynProp_49 :%f",signalvalue1);
	}
}

testcase S4_SRR_RL_Clu_Mes_7_S4_SRR_RL_Clu_Locationvalid_49()
{
	signalvalue1 = getSignal(S4_SRR_RL_Clu_Locationvalid_49);
	write("S4_SRR_RL_Clu_Locationvalid_49 :%f",signalvalue1);
	write("i_S4_SRR_RL_Clu_Locationvalid_49 :%o",@ecu_Signals::i_S4_SRR_RL_Clu_Locationvalid_49);

	testStep("get expect variable value: ","i_S4_SRR_RL_Clu_Locationvalid_49 :%o",@ecu_Signals::i_S4_SRR_RL_Clu_Locationvalid_49);

	if(signalvalue1==@ecu_Signals::i_S4_SRR_RL_Clu_Locationvalid_49)
	{
	testStepPass("Pass","i_S4_SRR_RL_Clu_Locationvalid_49 :%f",signalvalue1);
	}
	else
	{
	testStepFail("Fail","i_S4_SRR_RL_Clu_Locationvalid_49 :%f",signalvalue1);
	}
}

testcase S4_SRR_RL_Clu_Mes_7_S4_SRR_RL_Clu_Theta_50()
{
	signalvalue1 = getSignal(S4_SRR_RL_Clu_Theta_50);
	write("S4_SRR_RL_Clu_Theta_50 :%f",signalvalue1);
	write("i_S4_SRR_RL_Clu_Theta_50 :%f",@ecu_Signals::i_S4_SRR_RL_Clu_Theta_50);

	testStep("get expect variable value: ","i_S4_SRR_RL_Clu_Theta_50 :%f",@ecu_Signals::i_S4_SRR_RL_Clu_Theta_50);

	if((abs(@ecu_Signals::i_S4_SRR_RL_Clu_Theta_50)*0.9<=abs(signalvalue1))&&(abs(signalvalue1)<=abs(@ecu_Signals::i_S4_SRR_RL_Clu_Theta_50)*1.1))
	{
	testStepPass("Pass","i_S4_SRR_RL_Clu_Theta_50 :%f",signalvalue1);
	}
	else
	{
	testStepFail("Fail","i_S4_SRR_RL_Clu_Theta_50 :%f",signalvalue1);
	}
}

testcase S4_SRR_RL_Clu_Mes_7_S4_SRR_RL_Clu_Dist_50()
{
	signalvalue1 = getSignal(S4_SRR_RL_Clu_Dist_50);
	write("S4_SRR_RL_Clu_Dist_50 :%f",signalvalue1);
	write("i_S4_SRR_RL_Clu_Dist_50 :%f",@ecu_Signals::i_S4_SRR_RL_Clu_Dist_50);

	testStep("get expect variable value: ","i_S4_SRR_RL_Clu_Dist_50 :%f",@ecu_Signals::i_S4_SRR_RL_Clu_Dist_50);

	if((abs(@ecu_Signals::i_S4_SRR_RL_Clu_Dist_50)*0.9<=abs(signalvalue1))&&(abs(signalvalue1)<=abs(@ecu_Signals::i_S4_SRR_RL_Clu_Dist_50)*1.1))
	{
	testStepPass("Pass","i_S4_SRR_RL_Clu_Dist_50 :%f",signalvalue1);
	}
	else
	{
	testStepFail("Fail","i_S4_SRR_RL_Clu_Dist_50 :%f",signalvalue1);
	}
}

testcase S4_SRR_RL_Clu_Mes_7_S4_SRR_RL_Clu_Vel_50()
{
	signalvalue1 = getSignal(S4_SRR_RL_Clu_Vel_50);
	write("S4_SRR_RL_Clu_Vel_50 :%f",signalvalue1);
	write("i_S4_SRR_RL_Clu_Vel_50 :%f",@ecu_Signals::i_S4_SRR_RL_Clu_Vel_50);

	testStep("get expect variable value: ","i_S4_SRR_RL_Clu_Vel_50 :%f",@ecu_Signals::i_S4_SRR_RL_Clu_Vel_50);

	if((abs(@ecu_Signals::i_S4_SRR_RL_Clu_Vel_50)*0.9<=abs(signalvalue1))&&(abs(signalvalue1)<=abs(@ecu_Signals::i_S4_SRR_RL_Clu_Vel_50)*1.1))
	{
	testStepPass("Pass","i_S4_SRR_RL_Clu_Vel_50 :%f",signalvalue1);
	}
	else
	{
	testStepFail("Fail","i_S4_SRR_RL_Clu_Vel_50 :%f",signalvalue1);
	}
}

testcase S4_SRR_RL_Clu_Mes_7_S4_SRR_RL_Clu_SNR_50()
{
	signalvalue1 = getSignal(S4_SRR_RL_Clu_SNR_50);
	write("S4_SRR_RL_Clu_SNR_50 :%f",signalvalue1);
	write("i_S4_SRR_RL_Clu_SNR_50 :%f",@ecu_Signals::i_S4_SRR_RL_Clu_SNR_50);

	testStep("get expect variable value: ","i_S4_SRR_RL_Clu_SNR_50 :%f",@ecu_Signals::i_S4_SRR_RL_Clu_SNR_50);

	if((abs(@ecu_Signals::i_S4_SRR_RL_Clu_SNR_50)*0.9<=abs(signalvalue1))&&(abs(signalvalue1)<=abs(@ecu_Signals::i_S4_SRR_RL_Clu_SNR_50)*1.1))
	{
	testStepPass("Pass","i_S4_SRR_RL_Clu_SNR_50 :%f",signalvalue1);
	}
	else
	{
	testStepFail("Fail","i_S4_SRR_RL_Clu_SNR_50 :%f",signalvalue1);
	}
}

testcase S4_SRR_RL_Clu_Mes_7_S4_SRR_RL_Clu_DynProp_50()
{
	signalvalue1 = getSignal(S4_SRR_RL_Clu_DynProp_50);
	write("S4_SRR_RL_Clu_DynProp_50 :%f",signalvalue1);
	write("i_S4_SRR_RL_Clu_DynProp_50 :%o",@ecu_Signals::i_S4_SRR_RL_Clu_DynProp_50);

	testStep("get expect variable value: ","i_S4_SRR_RL_Clu_DynProp_50 :%o",@ecu_Signals::i_S4_SRR_RL_Clu_DynProp_50);

	if(signalvalue1==@ecu_Signals::i_S4_SRR_RL_Clu_DynProp_50)
	{
	testStepPass("Pass","i_S4_SRR_RL_Clu_DynProp_50 :%f",signalvalue1);
	}
	else
	{
	testStepFail("Fail","i_S4_SRR_RL_Clu_DynProp_50 :%f",signalvalue1);
	}
}

testcase S4_SRR_RL_Clu_Mes_7_S4_SRR_RL_Clu_Locationvalid_50()
{
	signalvalue1 = getSignal(S4_SRR_RL_Clu_Locationvalid_50);
	write("S4_SRR_RL_Clu_Locationvalid_50 :%f",signalvalue1);
	write("i_S4_SRR_RL_Clu_Locationvalid_50 :%o",@ecu_Signals::i_S4_SRR_RL_Clu_Locationvalid_50);

	testStep("get expect variable value: ","i_S4_SRR_RL_Clu_Locationvalid_50 :%o",@ecu_Signals::i_S4_SRR_RL_Clu_Locationvalid_50);

	if(signalvalue1==@ecu_Signals::i_S4_SRR_RL_Clu_Locationvalid_50)
	{
	testStepPass("Pass","i_S4_SRR_RL_Clu_Locationvalid_50 :%f",signalvalue1);
	}
	else
	{
	testStepFail("Fail","i_S4_SRR_RL_Clu_Locationvalid_50 :%f",signalvalue1);
	}
}

testcase S4_SRR_RL_Clu_Mes_7_S4_SRR_RL_Clu_Theta_51()
{
	signalvalue1 = getSignal(S4_SRR_RL_Clu_Theta_51);
	write("S4_SRR_RL_Clu_Theta_51 :%f",signalvalue1);
	write("i_S4_SRR_RL_Clu_Theta_51 :%f",@ecu_Signals::i_S4_SRR_RL_Clu_Theta_51);

	testStep("get expect variable value: ","i_S4_SRR_RL_Clu_Theta_51 :%f",@ecu_Signals::i_S4_SRR_RL_Clu_Theta_51);

	if((abs(@ecu_Signals::i_S4_SRR_RL_Clu_Theta_51)*0.9<=abs(signalvalue1))&&(abs(signalvalue1)<=abs(@ecu_Signals::i_S4_SRR_RL_Clu_Theta_51)*1.1))
	{
	testStepPass("Pass","i_S4_SRR_RL_Clu_Theta_51 :%f",signalvalue1);
	}
	else
	{
	testStepFail("Fail","i_S4_SRR_RL_Clu_Theta_51 :%f",signalvalue1);
	}
}

testcase S4_SRR_RL_Clu_Mes_7_S4_SRR_RL_Clu_Dist_51()
{
	signalvalue1 = getSignal(S4_SRR_RL_Clu_Dist_51);
	write("S4_SRR_RL_Clu_Dist_51 :%f",signalvalue1);
	write("i_S4_SRR_RL_Clu_Dist_51 :%f",@ecu_Signals::i_S4_SRR_RL_Clu_Dist_51);

	testStep("get expect variable value: ","i_S4_SRR_RL_Clu_Dist_51 :%f",@ecu_Signals::i_S4_SRR_RL_Clu_Dist_51);

	if((abs(@ecu_Signals::i_S4_SRR_RL_Clu_Dist_51)*0.9<=abs(signalvalue1))&&(abs(signalvalue1)<=abs(@ecu_Signals::i_S4_SRR_RL_Clu_Dist_51)*1.1))
	{
	testStepPass("Pass","i_S4_SRR_RL_Clu_Dist_51 :%f",signalvalue1);
	}
	else
	{
	testStepFail("Fail","i_S4_SRR_RL_Clu_Dist_51 :%f",signalvalue1);
	}
}

testcase S4_SRR_RL_Clu_Mes_7_S4_SRR_RL_Clu_Vel_51()
{
	signalvalue1 = getSignal(S4_SRR_RL_Clu_Vel_51);
	write("S4_SRR_RL_Clu_Vel_51 :%f",signalvalue1);
	write("i_S4_SRR_RL_Clu_Vel_51 :%f",@ecu_Signals::i_S4_SRR_RL_Clu_Vel_51);

	testStep("get expect variable value: ","i_S4_SRR_RL_Clu_Vel_51 :%f",@ecu_Signals::i_S4_SRR_RL_Clu_Vel_51);

	if((abs(@ecu_Signals::i_S4_SRR_RL_Clu_Vel_51)*0.9<=abs(signalvalue1))&&(abs(signalvalue1)<=abs(@ecu_Signals::i_S4_SRR_RL_Clu_Vel_51)*1.1))
	{
	testStepPass("Pass","i_S4_SRR_RL_Clu_Vel_51 :%f",signalvalue1);
	}
	else
	{
	testStepFail("Fail","i_S4_SRR_RL_Clu_Vel_51 :%f",signalvalue1);
	}
}

testcase S4_SRR_RL_Clu_Mes_7_S4_SRR_RL_Clu_SNR_51()
{
	signalvalue1 = getSignal(S4_SRR_RL_Clu_SNR_51);
	write("S4_SRR_RL_Clu_SNR_51 :%f",signalvalue1);
	write("i_S4_SRR_RL_Clu_SNR_51 :%f",@ecu_Signals::i_S4_SRR_RL_Clu_SNR_51);

	testStep("get expect variable value: ","i_S4_SRR_RL_Clu_SNR_51 :%f",@ecu_Signals::i_S4_SRR_RL_Clu_SNR_51);

	if((abs(@ecu_Signals::i_S4_SRR_RL_Clu_SNR_51)*0.9<=abs(signalvalue1))&&(abs(signalvalue1)<=abs(@ecu_Signals::i_S4_SRR_RL_Clu_SNR_51)*1.1))
	{
	testStepPass("Pass","i_S4_SRR_RL_Clu_SNR_51 :%f",signalvalue1);
	}
	else
	{
	testStepFail("Fail","i_S4_SRR_RL_Clu_SNR_51 :%f",signalvalue1);
	}
}

testcase S4_SRR_RL_Clu_Mes_7_S4_SRR_RL_Clu_DynProp_51()
{
	signalvalue1 = getSignal(S4_SRR_RL_Clu_DynProp_51);
	write("S4_SRR_RL_Clu_DynProp_51 :%f",signalvalue1);
	write("i_S4_SRR_RL_Clu_DynProp_51 :%o",@ecu_Signals::i_S4_SRR_RL_Clu_DynProp_51);

	testStep("get expect variable value: ","i_S4_SRR_RL_Clu_DynProp_51 :%o",@ecu_Signals::i_S4_SRR_RL_Clu_DynProp_51);

	if(signalvalue1==@ecu_Signals::i_S4_SRR_RL_Clu_DynProp_51)
	{
	testStepPass("Pass","i_S4_SRR_RL_Clu_DynProp_51 :%f",signalvalue1);
	}
	else
	{
	testStepFail("Fail","i_S4_SRR_RL_Clu_DynProp_51 :%f",signalvalue1);
	}
}

testcase S4_SRR_RL_Clu_Mes_7_S4_SRR_RL_Clu_Locationvalid_51()
{
	signalvalue1 = getSignal(S4_SRR_RL_Clu_Locationvalid_51);
	write("S4_SRR_RL_Clu_Locationvalid_51 :%f",signalvalue1);
	write("i_S4_SRR_RL_Clu_Locationvalid_51 :%o",@ecu_Signals::i_S4_SRR_RL_Clu_Locationvalid_51);

	testStep("get expect variable value: ","i_S4_SRR_RL_Clu_Locationvalid_51 :%o",@ecu_Signals::i_S4_SRR_RL_Clu_Locationvalid_51);

	if(signalvalue1==@ecu_Signals::i_S4_SRR_RL_Clu_Locationvalid_51)
	{
	testStepPass("Pass","i_S4_SRR_RL_Clu_Locationvalid_51 :%f",signalvalue1);
	}
	else
	{
	testStepFail("Fail","i_S4_SRR_RL_Clu_Locationvalid_51 :%f",signalvalue1);
	}
}

testcase S4_SRR_RL_Clu_Mes_7_S4_SRR_RL_Clu_Theta_52()
{
	signalvalue1 = getSignal(S4_SRR_RL_Clu_Theta_52);
	write("S4_SRR_RL_Clu_Theta_52 :%f",signalvalue1);
	write("i_S4_SRR_RL_Clu_Theta_52 :%f",@ecu_Signals::i_S4_SRR_RL_Clu_Theta_52);

	testStep("get expect variable value: ","i_S4_SRR_RL_Clu_Theta_52 :%f",@ecu_Signals::i_S4_SRR_RL_Clu_Theta_52);

	if((abs(@ecu_Signals::i_S4_SRR_RL_Clu_Theta_52)*0.9<=abs(signalvalue1))&&(abs(signalvalue1)<=abs(@ecu_Signals::i_S4_SRR_RL_Clu_Theta_52)*1.1))
	{
	testStepPass("Pass","i_S4_SRR_RL_Clu_Theta_52 :%f",signalvalue1);
	}
	else
	{
	testStepFail("Fail","i_S4_SRR_RL_Clu_Theta_52 :%f",signalvalue1);
	}
}

testcase S4_SRR_RL_Clu_Mes_7_S4_SRR_RL_Clu_Dist_52()
{
	signalvalue1 = getSignal(S4_SRR_RL_Clu_Dist_52);
	write("S4_SRR_RL_Clu_Dist_52 :%f",signalvalue1);
	write("i_S4_SRR_RL_Clu_Dist_52 :%f",@ecu_Signals::i_S4_SRR_RL_Clu_Dist_52);

	testStep("get expect variable value: ","i_S4_SRR_RL_Clu_Dist_52 :%f",@ecu_Signals::i_S4_SRR_RL_Clu_Dist_52);

	if((abs(@ecu_Signals::i_S4_SRR_RL_Clu_Dist_52)*0.9<=abs(signalvalue1))&&(abs(signalvalue1)<=abs(@ecu_Signals::i_S4_SRR_RL_Clu_Dist_52)*1.1))
	{
	testStepPass("Pass","i_S4_SRR_RL_Clu_Dist_52 :%f",signalvalue1);
	}
	else
	{
	testStepFail("Fail","i_S4_SRR_RL_Clu_Dist_52 :%f",signalvalue1);
	}
}

testcase S4_SRR_RL_Clu_Mes_7_S4_SRR_RL_Clu_Vel_52()
{
	signalvalue1 = getSignal(S4_SRR_RL_Clu_Vel_52);
	write("S4_SRR_RL_Clu_Vel_52 :%f",signalvalue1);
	write("i_S4_SRR_RL_Clu_Vel_52 :%f",@ecu_Signals::i_S4_SRR_RL_Clu_Vel_52);

	testStep("get expect variable value: ","i_S4_SRR_RL_Clu_Vel_52 :%f",@ecu_Signals::i_S4_SRR_RL_Clu_Vel_52);

	if((abs(@ecu_Signals::i_S4_SRR_RL_Clu_Vel_52)*0.9<=abs(signalvalue1))&&(abs(signalvalue1)<=abs(@ecu_Signals::i_S4_SRR_RL_Clu_Vel_52)*1.1))
	{
	testStepPass("Pass","i_S4_SRR_RL_Clu_Vel_52 :%f",signalvalue1);
	}
	else
	{
	testStepFail("Fail","i_S4_SRR_RL_Clu_Vel_52 :%f",signalvalue1);
	}
}

testcase S4_SRR_RL_Clu_Mes_7_S4_SRR_RL_Clu_SNR_52()
{
	signalvalue1 = getSignal(S4_SRR_RL_Clu_SNR_52);
	write("S4_SRR_RL_Clu_SNR_52 :%f",signalvalue1);
	write("i_S4_SRR_RL_Clu_SNR_52 :%f",@ecu_Signals::i_S4_SRR_RL_Clu_SNR_52);

	testStep("get expect variable value: ","i_S4_SRR_RL_Clu_SNR_52 :%f",@ecu_Signals::i_S4_SRR_RL_Clu_SNR_52);

	if((abs(@ecu_Signals::i_S4_SRR_RL_Clu_SNR_52)*0.9<=abs(signalvalue1))&&(abs(signalvalue1)<=abs(@ecu_Signals::i_S4_SRR_RL_Clu_SNR_52)*1.1))
	{
	testStepPass("Pass","i_S4_SRR_RL_Clu_SNR_52 :%f",signalvalue1);
	}
	else
	{
	testStepFail("Fail","i_S4_SRR_RL_Clu_SNR_52 :%f",signalvalue1);
	}
}

testcase S4_SRR_RL_Clu_Mes_7_S4_SRR_RL_Clu_DynProp_52()
{
	signalvalue1 = getSignal(S4_SRR_RL_Clu_DynProp_52);
	write("S4_SRR_RL_Clu_DynProp_52 :%f",signalvalue1);
	write("i_S4_SRR_RL_Clu_DynProp_52 :%o",@ecu_Signals::i_S4_SRR_RL_Clu_DynProp_52);

	testStep("get expect variable value: ","i_S4_SRR_RL_Clu_DynProp_52 :%o",@ecu_Signals::i_S4_SRR_RL_Clu_DynProp_52);

	if(signalvalue1==@ecu_Signals::i_S4_SRR_RL_Clu_DynProp_52)
	{
	testStepPass("Pass","i_S4_SRR_RL_Clu_DynProp_52 :%f",signalvalue1);
	}
	else
	{
	testStepFail("Fail","i_S4_SRR_RL_Clu_DynProp_52 :%f",signalvalue1);
	}
}

testcase S4_SRR_RL_Clu_Mes_7_S4_SRR_RL_Clu_Locationvalid_52()
{
	signalvalue1 = getSignal(S4_SRR_RL_Clu_Locationvalid_52);
	write("S4_SRR_RL_Clu_Locationvalid_52 :%f",signalvalue1);
	write("i_S4_SRR_RL_Clu_Locationvalid_52 :%o",@ecu_Signals::i_S4_SRR_RL_Clu_Locationvalid_52);

	testStep("get expect variable value: ","i_S4_SRR_RL_Clu_Locationvalid_52 :%o",@ecu_Signals::i_S4_SRR_RL_Clu_Locationvalid_52);

	if(signalvalue1==@ecu_Signals::i_S4_SRR_RL_Clu_Locationvalid_52)
	{
	testStepPass("Pass","i_S4_SRR_RL_Clu_Locationvalid_52 :%f",signalvalue1);
	}
	else
	{
	testStepFail("Fail","i_S4_SRR_RL_Clu_Locationvalid_52 :%f",signalvalue1);
	}
}

testcase S4_SRR_RL_Clu_Mes_7_S4_SRR_RL_Clu_Theta_53()
{
	signalvalue1 = getSignal(S4_SRR_RL_Clu_Theta_53);
	write("S4_SRR_RL_Clu_Theta_53 :%f",signalvalue1);
	write("i_S4_SRR_RL_Clu_Theta_53 :%f",@ecu_Signals::i_S4_SRR_RL_Clu_Theta_53);

	testStep("get expect variable value: ","i_S4_SRR_RL_Clu_Theta_53 :%f",@ecu_Signals::i_S4_SRR_RL_Clu_Theta_53);

	if((abs(@ecu_Signals::i_S4_SRR_RL_Clu_Theta_53)*0.9<=abs(signalvalue1))&&(abs(signalvalue1)<=abs(@ecu_Signals::i_S4_SRR_RL_Clu_Theta_53)*1.1))
	{
	testStepPass("Pass","i_S4_SRR_RL_Clu_Theta_53 :%f",signalvalue1);
	}
	else
	{
	testStepFail("Fail","i_S4_SRR_RL_Clu_Theta_53 :%f",signalvalue1);
	}
}

testcase S4_SRR_RL_Clu_Mes_7_S4_SRR_RL_Clu_Dist_53()
{
	signalvalue1 = getSignal(S4_SRR_RL_Clu_Dist_53);
	write("S4_SRR_RL_Clu_Dist_53 :%f",signalvalue1);
	write("i_S4_SRR_RL_Clu_Dist_53 :%f",@ecu_Signals::i_S4_SRR_RL_Clu_Dist_53);

	testStep("get expect variable value: ","i_S4_SRR_RL_Clu_Dist_53 :%f",@ecu_Signals::i_S4_SRR_RL_Clu_Dist_53);

	if((abs(@ecu_Signals::i_S4_SRR_RL_Clu_Dist_53)*0.9<=abs(signalvalue1))&&(abs(signalvalue1)<=abs(@ecu_Signals::i_S4_SRR_RL_Clu_Dist_53)*1.1))
	{
	testStepPass("Pass","i_S4_SRR_RL_Clu_Dist_53 :%f",signalvalue1);
	}
	else
	{
	testStepFail("Fail","i_S4_SRR_RL_Clu_Dist_53 :%f",signalvalue1);
	}
}

testcase S4_SRR_RL_Clu_Mes_7_S4_SRR_RL_Clu_Vel_53()
{
	signalvalue1 = getSignal(S4_SRR_RL_Clu_Vel_53);
	write("S4_SRR_RL_Clu_Vel_53 :%f",signalvalue1);
	write("i_S4_SRR_RL_Clu_Vel_53 :%f",@ecu_Signals::i_S4_SRR_RL_Clu_Vel_53);

	testStep("get expect variable value: ","i_S4_SRR_RL_Clu_Vel_53 :%f",@ecu_Signals::i_S4_SRR_RL_Clu_Vel_53);

	if((abs(@ecu_Signals::i_S4_SRR_RL_Clu_Vel_53)*0.9<=abs(signalvalue1))&&(abs(signalvalue1)<=abs(@ecu_Signals::i_S4_SRR_RL_Clu_Vel_53)*1.1))
	{
	testStepPass("Pass","i_S4_SRR_RL_Clu_Vel_53 :%f",signalvalue1);
	}
	else
	{
	testStepFail("Fail","i_S4_SRR_RL_Clu_Vel_53 :%f",signalvalue1);
	}
}

testcase S4_SRR_RL_Clu_Mes_7_S4_SRR_RL_Clu_SNR_53()
{
	signalvalue1 = getSignal(S4_SRR_RL_Clu_SNR_53);
	write("S4_SRR_RL_Clu_SNR_53 :%f",signalvalue1);
	write("i_S4_SRR_RL_Clu_SNR_53 :%f",@ecu_Signals::i_S4_SRR_RL_Clu_SNR_53);

	testStep("get expect variable value: ","i_S4_SRR_RL_Clu_SNR_53 :%f",@ecu_Signals::i_S4_SRR_RL_Clu_SNR_53);

	if((abs(@ecu_Signals::i_S4_SRR_RL_Clu_SNR_53)*0.9<=abs(signalvalue1))&&(abs(signalvalue1)<=abs(@ecu_Signals::i_S4_SRR_RL_Clu_SNR_53)*1.1))
	{
	testStepPass("Pass","i_S4_SRR_RL_Clu_SNR_53 :%f",signalvalue1);
	}
	else
	{
	testStepFail("Fail","i_S4_SRR_RL_Clu_SNR_53 :%f",signalvalue1);
	}
}

testcase S4_SRR_RL_Clu_Mes_7_S4_SRR_RL_Clu_DynProp_53()
{
	signalvalue1 = getSignal(S4_SRR_RL_Clu_DynProp_53);
	write("S4_SRR_RL_Clu_DynProp_53 :%f",signalvalue1);
	write("i_S4_SRR_RL_Clu_DynProp_53 :%o",@ecu_Signals::i_S4_SRR_RL_Clu_DynProp_53);

	testStep("get expect variable value: ","i_S4_SRR_RL_Clu_DynProp_53 :%o",@ecu_Signals::i_S4_SRR_RL_Clu_DynProp_53);

	if(signalvalue1==@ecu_Signals::i_S4_SRR_RL_Clu_DynProp_53)
	{
	testStepPass("Pass","i_S4_SRR_RL_Clu_DynProp_53 :%f",signalvalue1);
	}
	else
	{
	testStepFail("Fail","i_S4_SRR_RL_Clu_DynProp_53 :%f",signalvalue1);
	}
}

testcase S4_SRR_RL_Clu_Mes_7_S4_SRR_RL_Clu_Locationvalid_53()
{
	signalvalue1 = getSignal(S4_SRR_RL_Clu_Locationvalid_53);
	write("S4_SRR_RL_Clu_Locationvalid_53 :%f",signalvalue1);
	write("i_S4_SRR_RL_Clu_Locationvalid_53 :%o",@ecu_Signals::i_S4_SRR_RL_Clu_Locationvalid_53);

	testStep("get expect variable value: ","i_S4_SRR_RL_Clu_Locationvalid_53 :%o",@ecu_Signals::i_S4_SRR_RL_Clu_Locationvalid_53);

	if(signalvalue1==@ecu_Signals::i_S4_SRR_RL_Clu_Locationvalid_53)
	{
	testStepPass("Pass","i_S4_SRR_RL_Clu_Locationvalid_53 :%f",signalvalue1);
	}
	else
	{
	testStepFail("Fail","i_S4_SRR_RL_Clu_Locationvalid_53 :%f",signalvalue1);
	}
}

testcase S4_SRR_RL_Clu_Mes_7_S4_SRR_RL_Clu_Theta_54()
{
	signalvalue1 = getSignal(S4_SRR_RL_Clu_Theta_54);
	write("S4_SRR_RL_Clu_Theta_54 :%f",signalvalue1);
	write("i_S4_SRR_RL_Clu_Theta_54 :%f",@ecu_Signals::i_S4_SRR_RL_Clu_Theta_54);

	testStep("get expect variable value: ","i_S4_SRR_RL_Clu_Theta_54 :%f",@ecu_Signals::i_S4_SRR_RL_Clu_Theta_54);

	if((abs(@ecu_Signals::i_S4_SRR_RL_Clu_Theta_54)*0.9<=abs(signalvalue1))&&(abs(signalvalue1)<=abs(@ecu_Signals::i_S4_SRR_RL_Clu_Theta_54)*1.1))
	{
	testStepPass("Pass","i_S4_SRR_RL_Clu_Theta_54 :%f",signalvalue1);
	}
	else
	{
	testStepFail("Fail","i_S4_SRR_RL_Clu_Theta_54 :%f",signalvalue1);
	}
}

testcase S4_SRR_RL_Clu_Mes_7_S4_SRR_RL_Clu_Dist_54()
{
	signalvalue1 = getSignal(S4_SRR_RL_Clu_Dist_54);
	write("S4_SRR_RL_Clu_Dist_54 :%f",signalvalue1);
	write("i_S4_SRR_RL_Clu_Dist_54 :%f",@ecu_Signals::i_S4_SRR_RL_Clu_Dist_54);

	testStep("get expect variable value: ","i_S4_SRR_RL_Clu_Dist_54 :%f",@ecu_Signals::i_S4_SRR_RL_Clu_Dist_54);

	if((abs(@ecu_Signals::i_S4_SRR_RL_Clu_Dist_54)*0.9<=abs(signalvalue1))&&(abs(signalvalue1)<=abs(@ecu_Signals::i_S4_SRR_RL_Clu_Dist_54)*1.1))
	{
	testStepPass("Pass","i_S4_SRR_RL_Clu_Dist_54 :%f",signalvalue1);
	}
	else
	{
	testStepFail("Fail","i_S4_SRR_RL_Clu_Dist_54 :%f",signalvalue1);
	}
}

testcase S4_SRR_RL_Clu_Mes_7_S4_SRR_RL_Clu_Vel_54()
{
	signalvalue1 = getSignal(S4_SRR_RL_Clu_Vel_54);
	write("S4_SRR_RL_Clu_Vel_54 :%f",signalvalue1);
	write("i_S4_SRR_RL_Clu_Vel_54 :%f",@ecu_Signals::i_S4_SRR_RL_Clu_Vel_54);

	testStep("get expect variable value: ","i_S4_SRR_RL_Clu_Vel_54 :%f",@ecu_Signals::i_S4_SRR_RL_Clu_Vel_54);

	if((abs(@ecu_Signals::i_S4_SRR_RL_Clu_Vel_54)*0.9<=abs(signalvalue1))&&(abs(signalvalue1)<=abs(@ecu_Signals::i_S4_SRR_RL_Clu_Vel_54)*1.1))
	{
	testStepPass("Pass","i_S4_SRR_RL_Clu_Vel_54 :%f",signalvalue1);
	}
	else
	{
	testStepFail("Fail","i_S4_SRR_RL_Clu_Vel_54 :%f",signalvalue1);
	}
}

testcase S4_SRR_RL_Clu_Mes_7_S4_SRR_RL_Clu_SNR_54()
{
	signalvalue1 = getSignal(S4_SRR_RL_Clu_SNR_54);
	write("S4_SRR_RL_Clu_SNR_54 :%f",signalvalue1);
	write("i_S4_SRR_RL_Clu_SNR_54 :%f",@ecu_Signals::i_S4_SRR_RL_Clu_SNR_54);

	testStep("get expect variable value: ","i_S4_SRR_RL_Clu_SNR_54 :%f",@ecu_Signals::i_S4_SRR_RL_Clu_SNR_54);

	if((abs(@ecu_Signals::i_S4_SRR_RL_Clu_SNR_54)*0.9<=abs(signalvalue1))&&(abs(signalvalue1)<=abs(@ecu_Signals::i_S4_SRR_RL_Clu_SNR_54)*1.1))
	{
	testStepPass("Pass","i_S4_SRR_RL_Clu_SNR_54 :%f",signalvalue1);
	}
	else
	{
	testStepFail("Fail","i_S4_SRR_RL_Clu_SNR_54 :%f",signalvalue1);
	}
}

testcase S4_SRR_RL_Clu_Mes_7_S4_SRR_RL_Clu_DynProp_54()
{
	signalvalue1 = getSignal(S4_SRR_RL_Clu_DynProp_54);
	write("S4_SRR_RL_Clu_DynProp_54 :%f",signalvalue1);
	write("i_S4_SRR_RL_Clu_DynProp_54 :%o",@ecu_Signals::i_S4_SRR_RL_Clu_DynProp_54);

	testStep("get expect variable value: ","i_S4_SRR_RL_Clu_DynProp_54 :%o",@ecu_Signals::i_S4_SRR_RL_Clu_DynProp_54);

	if(signalvalue1==@ecu_Signals::i_S4_SRR_RL_Clu_DynProp_54)
	{
	testStepPass("Pass","i_S4_SRR_RL_Clu_DynProp_54 :%f",signalvalue1);
	}
	else
	{
	testStepFail("Fail","i_S4_SRR_RL_Clu_DynProp_54 :%f",signalvalue1);
	}
}

testcase S4_SRR_RL_Clu_Mes_7_S4_SRR_RL_Clu_Locationvalid_54()
{
	signalvalue1 = getSignal(S4_SRR_RL_Clu_Locationvalid_54);
	write("S4_SRR_RL_Clu_Locationvalid_54 :%f",signalvalue1);
	write("i_S4_SRR_RL_Clu_Locationvalid_54 :%o",@ecu_Signals::i_S4_SRR_RL_Clu_Locationvalid_54);

	testStep("get expect variable value: ","i_S4_SRR_RL_Clu_Locationvalid_54 :%o",@ecu_Signals::i_S4_SRR_RL_Clu_Locationvalid_54);

	if(signalvalue1==@ecu_Signals::i_S4_SRR_RL_Clu_Locationvalid_54)
	{
	testStepPass("Pass","i_S4_SRR_RL_Clu_Locationvalid_54 :%f",signalvalue1);
	}
	else
	{
	testStepFail("Fail","i_S4_SRR_RL_Clu_Locationvalid_54 :%f",signalvalue1);
	}
}

testcase S4_SRR_RL_Clu_Mes_7_S4_SRR_RL_Clu_Theta_55()
{
	signalvalue1 = getSignal(S4_SRR_RL_Clu_Theta_55);
	write("S4_SRR_RL_Clu_Theta_55 :%f",signalvalue1);
	write("i_S4_SRR_RL_Clu_Theta_55 :%f",@ecu_Signals::i_S4_SRR_RL_Clu_Theta_55);

	testStep("get expect variable value: ","i_S4_SRR_RL_Clu_Theta_55 :%f",@ecu_Signals::i_S4_SRR_RL_Clu_Theta_55);

	if((abs(@ecu_Signals::i_S4_SRR_RL_Clu_Theta_55)*0.9<=abs(signalvalue1))&&(abs(signalvalue1)<=abs(@ecu_Signals::i_S4_SRR_RL_Clu_Theta_55)*1.1))
	{
	testStepPass("Pass","i_S4_SRR_RL_Clu_Theta_55 :%f",signalvalue1);
	}
	else
	{
	testStepFail("Fail","i_S4_SRR_RL_Clu_Theta_55 :%f",signalvalue1);
	}
}

testcase S4_SRR_RL_Clu_Mes_7_S4_SRR_RL_Clu_Dist_55()
{
	signalvalue1 = getSignal(S4_SRR_RL_Clu_Dist_55);
	write("S4_SRR_RL_Clu_Dist_55 :%f",signalvalue1);
	write("i_S4_SRR_RL_Clu_Dist_55 :%f",@ecu_Signals::i_S4_SRR_RL_Clu_Dist_55);

	testStep("get expect variable value: ","i_S4_SRR_RL_Clu_Dist_55 :%f",@ecu_Signals::i_S4_SRR_RL_Clu_Dist_55);

	if((abs(@ecu_Signals::i_S4_SRR_RL_Clu_Dist_55)*0.9<=abs(signalvalue1))&&(abs(signalvalue1)<=abs(@ecu_Signals::i_S4_SRR_RL_Clu_Dist_55)*1.1))
	{
	testStepPass("Pass","i_S4_SRR_RL_Clu_Dist_55 :%f",signalvalue1);
	}
	else
	{
	testStepFail("Fail","i_S4_SRR_RL_Clu_Dist_55 :%f",signalvalue1);
	}
}

testcase S4_SRR_RL_Clu_Mes_7_S4_SRR_RL_Clu_Vel_55()
{
	signalvalue1 = getSignal(S4_SRR_RL_Clu_Vel_55);
	write("S4_SRR_RL_Clu_Vel_55 :%f",signalvalue1);
	write("i_S4_SRR_RL_Clu_Vel_55 :%f",@ecu_Signals::i_S4_SRR_RL_Clu_Vel_55);

	testStep("get expect variable value: ","i_S4_SRR_RL_Clu_Vel_55 :%f",@ecu_Signals::i_S4_SRR_RL_Clu_Vel_55);

	if((abs(@ecu_Signals::i_S4_SRR_RL_Clu_Vel_55)*0.9<=abs(signalvalue1))&&(abs(signalvalue1)<=abs(@ecu_Signals::i_S4_SRR_RL_Clu_Vel_55)*1.1))
	{
	testStepPass("Pass","i_S4_SRR_RL_Clu_Vel_55 :%f",signalvalue1);
	}
	else
	{
	testStepFail("Fail","i_S4_SRR_RL_Clu_Vel_55 :%f",signalvalue1);
	}
}

testcase S4_SRR_RL_Clu_Mes_7_S4_SRR_RL_Clu_SNR_55()
{
	signalvalue1 = getSignal(S4_SRR_RL_Clu_SNR_55);
	write("S4_SRR_RL_Clu_SNR_55 :%f",signalvalue1);
	write("i_S4_SRR_RL_Clu_SNR_55 :%f",@ecu_Signals::i_S4_SRR_RL_Clu_SNR_55);

	testStep("get expect variable value: ","i_S4_SRR_RL_Clu_SNR_55 :%f",@ecu_Signals::i_S4_SRR_RL_Clu_SNR_55);

	if((abs(@ecu_Signals::i_S4_SRR_RL_Clu_SNR_55)*0.9<=abs(signalvalue1))&&(abs(signalvalue1)<=abs(@ecu_Signals::i_S4_SRR_RL_Clu_SNR_55)*1.1))
	{
	testStepPass("Pass","i_S4_SRR_RL_Clu_SNR_55 :%f",signalvalue1);
	}
	else
	{
	testStepFail("Fail","i_S4_SRR_RL_Clu_SNR_55 :%f",signalvalue1);
	}
}

testcase S4_SRR_RL_Clu_Mes_7_S4_SRR_RL_Clu_DynProp_55()
{
	signalvalue1 = getSignal(S4_SRR_RL_Clu_DynProp_55);
	write("S4_SRR_RL_Clu_DynProp_55 :%f",signalvalue1);
	write("i_S4_SRR_RL_Clu_DynProp_55 :%o",@ecu_Signals::i_S4_SRR_RL_Clu_DynProp_55);

	testStep("get expect variable value: ","i_S4_SRR_RL_Clu_DynProp_55 :%o",@ecu_Signals::i_S4_SRR_RL_Clu_DynProp_55);

	if(signalvalue1==@ecu_Signals::i_S4_SRR_RL_Clu_DynProp_55)
	{
	testStepPass("Pass","i_S4_SRR_RL_Clu_DynProp_55 :%f",signalvalue1);
	}
	else
	{
	testStepFail("Fail","i_S4_SRR_RL_Clu_DynProp_55 :%f",signalvalue1);
	}
}

testcase S4_SRR_RL_Clu_Mes_7_S4_SRR_RL_Clu_Locationvalid_55()
{
	signalvalue1 = getSignal(S4_SRR_RL_Clu_Locationvalid_55);
	write("S4_SRR_RL_Clu_Locationvalid_55 :%f",signalvalue1);
	write("i_S4_SRR_RL_Clu_Locationvalid_55 :%o",@ecu_Signals::i_S4_SRR_RL_Clu_Locationvalid_55);

	testStep("get expect variable value: ","i_S4_SRR_RL_Clu_Locationvalid_55 :%o",@ecu_Signals::i_S4_SRR_RL_Clu_Locationvalid_55);

	if(signalvalue1==@ecu_Signals::i_S4_SRR_RL_Clu_Locationvalid_55)
	{
	testStepPass("Pass","i_S4_SRR_RL_Clu_Locationvalid_55 :%f",signalvalue1);
	}
	else
	{
	testStepFail("Fail","i_S4_SRR_RL_Clu_Locationvalid_55 :%f",signalvalue1);
	}
}

testcase S4_SRR_RL_Clu_Mes_8_S4_SRR_RL_Clu_Theta_56()
{
	signalvalue1 = getSignal(S4_SRR_RL_Clu_Theta_56);
	write("S4_SRR_RL_Clu_Theta_56 :%f",signalvalue1);
	write("i_S4_SRR_RL_Clu_Theta_56 :%f",@ecu_Signals::i_S4_SRR_RL_Clu_Theta_56);

	testStep("get expect variable value: ","i_S4_SRR_RL_Clu_Theta_56 :%f",@ecu_Signals::i_S4_SRR_RL_Clu_Theta_56);

	if((abs(@ecu_Signals::i_S4_SRR_RL_Clu_Theta_56)*0.9<=abs(signalvalue1))&&(abs(signalvalue1)<=abs(@ecu_Signals::i_S4_SRR_RL_Clu_Theta_56)*1.1))
	{
	testStepPass("Pass","i_S4_SRR_RL_Clu_Theta_56 :%f",signalvalue1);
	}
	else
	{
	testStepFail("Fail","i_S4_SRR_RL_Clu_Theta_56 :%f",signalvalue1);
	}
}

testcase S4_SRR_RL_Clu_Mes_8_S4_SRR_RL_Clu_Dist_56()
{
	signalvalue1 = getSignal(S4_SRR_RL_Clu_Dist_56);
	write("S4_SRR_RL_Clu_Dist_56 :%f",signalvalue1);
	write("i_S4_SRR_RL_Clu_Dist_56 :%f",@ecu_Signals::i_S4_SRR_RL_Clu_Dist_56);

	testStep("get expect variable value: ","i_S4_SRR_RL_Clu_Dist_56 :%f",@ecu_Signals::i_S4_SRR_RL_Clu_Dist_56);

	if((abs(@ecu_Signals::i_S4_SRR_RL_Clu_Dist_56)*0.9<=abs(signalvalue1))&&(abs(signalvalue1)<=abs(@ecu_Signals::i_S4_SRR_RL_Clu_Dist_56)*1.1))
	{
	testStepPass("Pass","i_S4_SRR_RL_Clu_Dist_56 :%f",signalvalue1);
	}
	else
	{
	testStepFail("Fail","i_S4_SRR_RL_Clu_Dist_56 :%f",signalvalue1);
	}
}

testcase S4_SRR_RL_Clu_Mes_8_S4_SRR_RL_Clu_Vel_56()
{
	signalvalue1 = getSignal(S4_SRR_RL_Clu_Vel_56);
	write("S4_SRR_RL_Clu_Vel_56 :%f",signalvalue1);
	write("i_S4_SRR_RL_Clu_Vel_56 :%f",@ecu_Signals::i_S4_SRR_RL_Clu_Vel_56);

	testStep("get expect variable value: ","i_S4_SRR_RL_Clu_Vel_56 :%f",@ecu_Signals::i_S4_SRR_RL_Clu_Vel_56);

	if((abs(@ecu_Signals::i_S4_SRR_RL_Clu_Vel_56)*0.9<=abs(signalvalue1))&&(abs(signalvalue1)<=abs(@ecu_Signals::i_S4_SRR_RL_Clu_Vel_56)*1.1))
	{
	testStepPass("Pass","i_S4_SRR_RL_Clu_Vel_56 :%f",signalvalue1);
	}
	else
	{
	testStepFail("Fail","i_S4_SRR_RL_Clu_Vel_56 :%f",signalvalue1);
	}
}

testcase S4_SRR_RL_Clu_Mes_8_S4_SRR_RL_Clu_SNR_56()
{
	signalvalue1 = getSignal(S4_SRR_RL_Clu_SNR_56);
	write("S4_SRR_RL_Clu_SNR_56 :%f",signalvalue1);
	write("i_S4_SRR_RL_Clu_SNR_56 :%f",@ecu_Signals::i_S4_SRR_RL_Clu_SNR_56);

	testStep("get expect variable value: ","i_S4_SRR_RL_Clu_SNR_56 :%f",@ecu_Signals::i_S4_SRR_RL_Clu_SNR_56);

	if((abs(@ecu_Signals::i_S4_SRR_RL_Clu_SNR_56)*0.9<=abs(signalvalue1))&&(abs(signalvalue1)<=abs(@ecu_Signals::i_S4_SRR_RL_Clu_SNR_56)*1.1))
	{
	testStepPass("Pass","i_S4_SRR_RL_Clu_SNR_56 :%f",signalvalue1);
	}
	else
	{
	testStepFail("Fail","i_S4_SRR_RL_Clu_SNR_56 :%f",signalvalue1);
	}
}

testcase S4_SRR_RL_Clu_Mes_8_S4_SRR_RL_Clu_DynProp_56()
{
	signalvalue1 = getSignal(S4_SRR_RL_Clu_DynProp_56);
	write("S4_SRR_RL_Clu_DynProp_56 :%f",signalvalue1);
	write("i_S4_SRR_RL_Clu_DynProp_56 :%o",@ecu_Signals::i_S4_SRR_RL_Clu_DynProp_56);

	testStep("get expect variable value: ","i_S4_SRR_RL_Clu_DynProp_56 :%o",@ecu_Signals::i_S4_SRR_RL_Clu_DynProp_56);

	if(signalvalue1==@ecu_Signals::i_S4_SRR_RL_Clu_DynProp_56)
	{
	testStepPass("Pass","i_S4_SRR_RL_Clu_DynProp_56 :%f",signalvalue1);
	}
	else
	{
	testStepFail("Fail","i_S4_SRR_RL_Clu_DynProp_56 :%f",signalvalue1);
	}
}

testcase S4_SRR_RL_Clu_Mes_8_S4_SRR_RL_Clu_Locationvalid_56()
{
	signalvalue1 = getSignal(S4_SRR_RL_Clu_Locationvalid_56);
	write("S4_SRR_RL_Clu_Locationvalid_56 :%f",signalvalue1);
	write("i_S4_SRR_RL_Clu_Locationvalid_56 :%o",@ecu_Signals::i_S4_SRR_RL_Clu_Locationvalid_56);

	testStep("get expect variable value: ","i_S4_SRR_RL_Clu_Locationvalid_56 :%o",@ecu_Signals::i_S4_SRR_RL_Clu_Locationvalid_56);

	if(signalvalue1==@ecu_Signals::i_S4_SRR_RL_Clu_Locationvalid_56)
	{
	testStepPass("Pass","i_S4_SRR_RL_Clu_Locationvalid_56 :%f",signalvalue1);
	}
	else
	{
	testStepFail("Fail","i_S4_SRR_RL_Clu_Locationvalid_56 :%f",signalvalue1);
	}
}

testcase S4_SRR_RL_Clu_Mes_8_S4_SRR_RL_Clu_Theta_57()
{
	signalvalue1 = getSignal(S4_SRR_RL_Clu_Theta_57);
	write("S4_SRR_RL_Clu_Theta_57 :%f",signalvalue1);
	write("i_S4_SRR_RL_Clu_Theta_57 :%f",@ecu_Signals::i_S4_SRR_RL_Clu_Theta_57);

	testStep("get expect variable value: ","i_S4_SRR_RL_Clu_Theta_57 :%f",@ecu_Signals::i_S4_SRR_RL_Clu_Theta_57);

	if((abs(@ecu_Signals::i_S4_SRR_RL_Clu_Theta_57)*0.9<=abs(signalvalue1))&&(abs(signalvalue1)<=abs(@ecu_Signals::i_S4_SRR_RL_Clu_Theta_57)*1.1))
	{
	testStepPass("Pass","i_S4_SRR_RL_Clu_Theta_57 :%f",signalvalue1);
	}
	else
	{
	testStepFail("Fail","i_S4_SRR_RL_Clu_Theta_57 :%f",signalvalue1);
	}
}

testcase S4_SRR_RL_Clu_Mes_8_S4_SRR_RL_Clu_Dist_57()
{
	signalvalue1 = getSignal(S4_SRR_RL_Clu_Dist_57);
	write("S4_SRR_RL_Clu_Dist_57 :%f",signalvalue1);
	write("i_S4_SRR_RL_Clu_Dist_57 :%f",@ecu_Signals::i_S4_SRR_RL_Clu_Dist_57);

	testStep("get expect variable value: ","i_S4_SRR_RL_Clu_Dist_57 :%f",@ecu_Signals::i_S4_SRR_RL_Clu_Dist_57);

	if((abs(@ecu_Signals::i_S4_SRR_RL_Clu_Dist_57)*0.9<=abs(signalvalue1))&&(abs(signalvalue1)<=abs(@ecu_Signals::i_S4_SRR_RL_Clu_Dist_57)*1.1))
	{
	testStepPass("Pass","i_S4_SRR_RL_Clu_Dist_57 :%f",signalvalue1);
	}
	else
	{
	testStepFail("Fail","i_S4_SRR_RL_Clu_Dist_57 :%f",signalvalue1);
	}
}

testcase S4_SRR_RL_Clu_Mes_8_S4_SRR_RL_Clu_Vel_57()
{
	signalvalue1 = getSignal(S4_SRR_RL_Clu_Vel_57);
	write("S4_SRR_RL_Clu_Vel_57 :%f",signalvalue1);
	write("i_S4_SRR_RL_Clu_Vel_57 :%f",@ecu_Signals::i_S4_SRR_RL_Clu_Vel_57);

	testStep("get expect variable value: ","i_S4_SRR_RL_Clu_Vel_57 :%f",@ecu_Signals::i_S4_SRR_RL_Clu_Vel_57);

	if((abs(@ecu_Signals::i_S4_SRR_RL_Clu_Vel_57)*0.9<=abs(signalvalue1))&&(abs(signalvalue1)<=abs(@ecu_Signals::i_S4_SRR_RL_Clu_Vel_57)*1.1))
	{
	testStepPass("Pass","i_S4_SRR_RL_Clu_Vel_57 :%f",signalvalue1);
	}
	else
	{
	testStepFail("Fail","i_S4_SRR_RL_Clu_Vel_57 :%f",signalvalue1);
	}
}

testcase S4_SRR_RL_Clu_Mes_8_S4_SRR_RL_Clu_SNR_57()
{
	signalvalue1 = getSignal(S4_SRR_RL_Clu_SNR_57);
	write("S4_SRR_RL_Clu_SNR_57 :%f",signalvalue1);
	write("i_S4_SRR_RL_Clu_SNR_57 :%f",@ecu_Signals::i_S4_SRR_RL_Clu_SNR_57);

	testStep("get expect variable value: ","i_S4_SRR_RL_Clu_SNR_57 :%f",@ecu_Signals::i_S4_SRR_RL_Clu_SNR_57);

	if((abs(@ecu_Signals::i_S4_SRR_RL_Clu_SNR_57)*0.9<=abs(signalvalue1))&&(abs(signalvalue1)<=abs(@ecu_Signals::i_S4_SRR_RL_Clu_SNR_57)*1.1))
	{
	testStepPass("Pass","i_S4_SRR_RL_Clu_SNR_57 :%f",signalvalue1);
	}
	else
	{
	testStepFail("Fail","i_S4_SRR_RL_Clu_SNR_57 :%f",signalvalue1);
	}
}

testcase S4_SRR_RL_Clu_Mes_8_S4_SRR_RL_Clu_DynProp_57()
{
	signalvalue1 = getSignal(S4_SRR_RL_Clu_DynProp_57);
	write("S4_SRR_RL_Clu_DynProp_57 :%f",signalvalue1);
	write("i_S4_SRR_RL_Clu_DynProp_57 :%o",@ecu_Signals::i_S4_SRR_RL_Clu_DynProp_57);

	testStep("get expect variable value: ","i_S4_SRR_RL_Clu_DynProp_57 :%o",@ecu_Signals::i_S4_SRR_RL_Clu_DynProp_57);

	if(signalvalue1==@ecu_Signals::i_S4_SRR_RL_Clu_DynProp_57)
	{
	testStepPass("Pass","i_S4_SRR_RL_Clu_DynProp_57 :%f",signalvalue1);
	}
	else
	{
	testStepFail("Fail","i_S4_SRR_RL_Clu_DynProp_57 :%f",signalvalue1);
	}
}

testcase S4_SRR_RL_Clu_Mes_8_S4_SRR_RL_Clu_Locationvalid_57()
{
	signalvalue1 = getSignal(S4_SRR_RL_Clu_Locationvalid_57);
	write("S4_SRR_RL_Clu_Locationvalid_57 :%f",signalvalue1);
	write("i_S4_SRR_RL_Clu_Locationvalid_57 :%o",@ecu_Signals::i_S4_SRR_RL_Clu_Locationvalid_57);

	testStep("get expect variable value: ","i_S4_SRR_RL_Clu_Locationvalid_57 :%o",@ecu_Signals::i_S4_SRR_RL_Clu_Locationvalid_57);

	if(signalvalue1==@ecu_Signals::i_S4_SRR_RL_Clu_Locationvalid_57)
	{
	testStepPass("Pass","i_S4_SRR_RL_Clu_Locationvalid_57 :%f",signalvalue1);
	}
	else
	{
	testStepFail("Fail","i_S4_SRR_RL_Clu_Locationvalid_57 :%f",signalvalue1);
	}
}

testcase S4_SRR_RL_Clu_Mes_8_S4_SRR_RL_Clu_Theta_58()
{
	signalvalue1 = getSignal(S4_SRR_RL_Clu_Theta_58);
	write("S4_SRR_RL_Clu_Theta_58 :%f",signalvalue1);
	write("i_S4_SRR_RL_Clu_Theta_58 :%f",@ecu_Signals::i_S4_SRR_RL_Clu_Theta_58);

	testStep("get expect variable value: ","i_S4_SRR_RL_Clu_Theta_58 :%f",@ecu_Signals::i_S4_SRR_RL_Clu_Theta_58);

	if((abs(@ecu_Signals::i_S4_SRR_RL_Clu_Theta_58)*0.9<=abs(signalvalue1))&&(abs(signalvalue1)<=abs(@ecu_Signals::i_S4_SRR_RL_Clu_Theta_58)*1.1))
	{
	testStepPass("Pass","i_S4_SRR_RL_Clu_Theta_58 :%f",signalvalue1);
	}
	else
	{
	testStepFail("Fail","i_S4_SRR_RL_Clu_Theta_58 :%f",signalvalue1);
	}
}

testcase S4_SRR_RL_Clu_Mes_8_S4_SRR_RL_Clu_Dist_58()
{
	signalvalue1 = getSignal(S4_SRR_RL_Clu_Dist_58);
	write("S4_SRR_RL_Clu_Dist_58 :%f",signalvalue1);
	write("i_S4_SRR_RL_Clu_Dist_58 :%f",@ecu_Signals::i_S4_SRR_RL_Clu_Dist_58);

	testStep("get expect variable value: ","i_S4_SRR_RL_Clu_Dist_58 :%f",@ecu_Signals::i_S4_SRR_RL_Clu_Dist_58);

	if((abs(@ecu_Signals::i_S4_SRR_RL_Clu_Dist_58)*0.9<=abs(signalvalue1))&&(abs(signalvalue1)<=abs(@ecu_Signals::i_S4_SRR_RL_Clu_Dist_58)*1.1))
	{
	testStepPass("Pass","i_S4_SRR_RL_Clu_Dist_58 :%f",signalvalue1);
	}
	else
	{
	testStepFail("Fail","i_S4_SRR_RL_Clu_Dist_58 :%f",signalvalue1);
	}
}

testcase S4_SRR_RL_Clu_Mes_8_S4_SRR_RL_Clu_Vel_58()
{
	signalvalue1 = getSignal(S4_SRR_RL_Clu_Vel_58);
	write("S4_SRR_RL_Clu_Vel_58 :%f",signalvalue1);
	write("i_S4_SRR_RL_Clu_Vel_58 :%f",@ecu_Signals::i_S4_SRR_RL_Clu_Vel_58);

	testStep("get expect variable value: ","i_S4_SRR_RL_Clu_Vel_58 :%f",@ecu_Signals::i_S4_SRR_RL_Clu_Vel_58);

	if((abs(@ecu_Signals::i_S4_SRR_RL_Clu_Vel_58)*0.9<=abs(signalvalue1))&&(abs(signalvalue1)<=abs(@ecu_Signals::i_S4_SRR_RL_Clu_Vel_58)*1.1))
	{
	testStepPass("Pass","i_S4_SRR_RL_Clu_Vel_58 :%f",signalvalue1);
	}
	else
	{
	testStepFail("Fail","i_S4_SRR_RL_Clu_Vel_58 :%f",signalvalue1);
	}
}

testcase S4_SRR_RL_Clu_Mes_8_S4_SRR_RL_Clu_SNR_58()
{
	signalvalue1 = getSignal(S4_SRR_RL_Clu_SNR_58);
	write("S4_SRR_RL_Clu_SNR_58 :%f",signalvalue1);
	write("i_S4_SRR_RL_Clu_SNR_58 :%f",@ecu_Signals::i_S4_SRR_RL_Clu_SNR_58);

	testStep("get expect variable value: ","i_S4_SRR_RL_Clu_SNR_58 :%f",@ecu_Signals::i_S4_SRR_RL_Clu_SNR_58);

	if((abs(@ecu_Signals::i_S4_SRR_RL_Clu_SNR_58)*0.9<=abs(signalvalue1))&&(abs(signalvalue1)<=abs(@ecu_Signals::i_S4_SRR_RL_Clu_SNR_58)*1.1))
	{
	testStepPass("Pass","i_S4_SRR_RL_Clu_SNR_58 :%f",signalvalue1);
	}
	else
	{
	testStepFail("Fail","i_S4_SRR_RL_Clu_SNR_58 :%f",signalvalue1);
	}
}

testcase S4_SRR_RL_Clu_Mes_8_S4_SRR_RL_Clu_DynProp_58()
{
	signalvalue1 = getSignal(S4_SRR_RL_Clu_DynProp_58);
	write("S4_SRR_RL_Clu_DynProp_58 :%f",signalvalue1);
	write("i_S4_SRR_RL_Clu_DynProp_58 :%o",@ecu_Signals::i_S4_SRR_RL_Clu_DynProp_58);

	testStep("get expect variable value: ","i_S4_SRR_RL_Clu_DynProp_58 :%o",@ecu_Signals::i_S4_SRR_RL_Clu_DynProp_58);

	if(signalvalue1==@ecu_Signals::i_S4_SRR_RL_Clu_DynProp_58)
	{
	testStepPass("Pass","i_S4_SRR_RL_Clu_DynProp_58 :%f",signalvalue1);
	}
	else
	{
	testStepFail("Fail","i_S4_SRR_RL_Clu_DynProp_58 :%f",signalvalue1);
	}
}

testcase S4_SRR_RL_Clu_Mes_8_S4_SRR_RL_Clu_Locationvalid_58()
{
	signalvalue1 = getSignal(S4_SRR_RL_Clu_Locationvalid_58);
	write("S4_SRR_RL_Clu_Locationvalid_58 :%f",signalvalue1);
	write("i_S4_SRR_RL_Clu_Locationvalid_58 :%o",@ecu_Signals::i_S4_SRR_RL_Clu_Locationvalid_58);

	testStep("get expect variable value: ","i_S4_SRR_RL_Clu_Locationvalid_58 :%o",@ecu_Signals::i_S4_SRR_RL_Clu_Locationvalid_58);

	if(signalvalue1==@ecu_Signals::i_S4_SRR_RL_Clu_Locationvalid_58)
	{
	testStepPass("Pass","i_S4_SRR_RL_Clu_Locationvalid_58 :%f",signalvalue1);
	}
	else
	{
	testStepFail("Fail","i_S4_SRR_RL_Clu_Locationvalid_58 :%f",signalvalue1);
	}
}

testcase S4_SRR_RL_Clu_Mes_8_S4_SRR_RL_Clu_Theta_59()
{
	signalvalue1 = getSignal(S4_SRR_RL_Clu_Theta_59);
	write("S4_SRR_RL_Clu_Theta_59 :%f",signalvalue1);
	write("i_S4_SRR_RL_Clu_Theta_59 :%f",@ecu_Signals::i_S4_SRR_RL_Clu_Theta_59);

	testStep("get expect variable value: ","i_S4_SRR_RL_Clu_Theta_59 :%f",@ecu_Signals::i_S4_SRR_RL_Clu_Theta_59);

	if((abs(@ecu_Signals::i_S4_SRR_RL_Clu_Theta_59)*0.9<=abs(signalvalue1))&&(abs(signalvalue1)<=abs(@ecu_Signals::i_S4_SRR_RL_Clu_Theta_59)*1.1))
	{
	testStepPass("Pass","i_S4_SRR_RL_Clu_Theta_59 :%f",signalvalue1);
	}
	else
	{
	testStepFail("Fail","i_S4_SRR_RL_Clu_Theta_59 :%f",signalvalue1);
	}
}

testcase S4_SRR_RL_Clu_Mes_8_S4_SRR_RL_Clu_Dist_59()
{
	signalvalue1 = getSignal(S4_SRR_RL_Clu_Dist_59);
	write("S4_SRR_RL_Clu_Dist_59 :%f",signalvalue1);
	write("i_S4_SRR_RL_Clu_Dist_59 :%f",@ecu_Signals::i_S4_SRR_RL_Clu_Dist_59);

	testStep("get expect variable value: ","i_S4_SRR_RL_Clu_Dist_59 :%f",@ecu_Signals::i_S4_SRR_RL_Clu_Dist_59);

	if((abs(@ecu_Signals::i_S4_SRR_RL_Clu_Dist_59)*0.9<=abs(signalvalue1))&&(abs(signalvalue1)<=abs(@ecu_Signals::i_S4_SRR_RL_Clu_Dist_59)*1.1))
	{
	testStepPass("Pass","i_S4_SRR_RL_Clu_Dist_59 :%f",signalvalue1);
	}
	else
	{
	testStepFail("Fail","i_S4_SRR_RL_Clu_Dist_59 :%f",signalvalue1);
	}
}

testcase S4_SRR_RL_Clu_Mes_8_S4_SRR_RL_Clu_Vel_59()
{
	signalvalue1 = getSignal(S4_SRR_RL_Clu_Vel_59);
	write("S4_SRR_RL_Clu_Vel_59 :%f",signalvalue1);
	write("i_S4_SRR_RL_Clu_Vel_59 :%f",@ecu_Signals::i_S4_SRR_RL_Clu_Vel_59);

	testStep("get expect variable value: ","i_S4_SRR_RL_Clu_Vel_59 :%f",@ecu_Signals::i_S4_SRR_RL_Clu_Vel_59);

	if((abs(@ecu_Signals::i_S4_SRR_RL_Clu_Vel_59)*0.9<=abs(signalvalue1))&&(abs(signalvalue1)<=abs(@ecu_Signals::i_S4_SRR_RL_Clu_Vel_59)*1.1))
	{
	testStepPass("Pass","i_S4_SRR_RL_Clu_Vel_59 :%f",signalvalue1);
	}
	else
	{
	testStepFail("Fail","i_S4_SRR_RL_Clu_Vel_59 :%f",signalvalue1);
	}
}

testcase S4_SRR_RL_Clu_Mes_8_S4_SRR_RL_Clu_SNR_59()
{
	signalvalue1 = getSignal(S4_SRR_RL_Clu_SNR_59);
	write("S4_SRR_RL_Clu_SNR_59 :%f",signalvalue1);
	write("i_S4_SRR_RL_Clu_SNR_59 :%f",@ecu_Signals::i_S4_SRR_RL_Clu_SNR_59);

	testStep("get expect variable value: ","i_S4_SRR_RL_Clu_SNR_59 :%f",@ecu_Signals::i_S4_SRR_RL_Clu_SNR_59);

	if((abs(@ecu_Signals::i_S4_SRR_RL_Clu_SNR_59)*0.9<=abs(signalvalue1))&&(abs(signalvalue1)<=abs(@ecu_Signals::i_S4_SRR_RL_Clu_SNR_59)*1.1))
	{
	testStepPass("Pass","i_S4_SRR_RL_Clu_SNR_59 :%f",signalvalue1);
	}
	else
	{
	testStepFail("Fail","i_S4_SRR_RL_Clu_SNR_59 :%f",signalvalue1);
	}
}

testcase S4_SRR_RL_Clu_Mes_8_S4_SRR_RL_Clu_DynProp_59()
{
	signalvalue1 = getSignal(S4_SRR_RL_Clu_DynProp_59);
	write("S4_SRR_RL_Clu_DynProp_59 :%f",signalvalue1);
	write("i_S4_SRR_RL_Clu_DynProp_59 :%o",@ecu_Signals::i_S4_SRR_RL_Clu_DynProp_59);

	testStep("get expect variable value: ","i_S4_SRR_RL_Clu_DynProp_59 :%o",@ecu_Signals::i_S4_SRR_RL_Clu_DynProp_59);

	if(signalvalue1==@ecu_Signals::i_S4_SRR_RL_Clu_DynProp_59)
	{
	testStepPass("Pass","i_S4_SRR_RL_Clu_DynProp_59 :%f",signalvalue1);
	}
	else
	{
	testStepFail("Fail","i_S4_SRR_RL_Clu_DynProp_59 :%f",signalvalue1);
	}
}

testcase S4_SRR_RL_Clu_Mes_8_S4_SRR_RL_Clu_Locationvalid_59()
{
	signalvalue1 = getSignal(S4_SRR_RL_Clu_Locationvalid_59);
	write("S4_SRR_RL_Clu_Locationvalid_59 :%f",signalvalue1);
	write("i_S4_SRR_RL_Clu_Locationvalid_59 :%o",@ecu_Signals::i_S4_SRR_RL_Clu_Locationvalid_59);

	testStep("get expect variable value: ","i_S4_SRR_RL_Clu_Locationvalid_59 :%o",@ecu_Signals::i_S4_SRR_RL_Clu_Locationvalid_59);

	if(signalvalue1==@ecu_Signals::i_S4_SRR_RL_Clu_Locationvalid_59)
	{
	testStepPass("Pass","i_S4_SRR_RL_Clu_Locationvalid_59 :%f",signalvalue1);
	}
	else
	{
	testStepFail("Fail","i_S4_SRR_RL_Clu_Locationvalid_59 :%f",signalvalue1);
	}
}

testcase S4_SRR_RL_Clu_Mes_8_S4_SRR_RL_Clu_Theta_60()
{
	signalvalue1 = getSignal(S4_SRR_RL_Clu_Theta_60);
	write("S4_SRR_RL_Clu_Theta_60 :%f",signalvalue1);
	write("i_S4_SRR_RL_Clu_Theta_60 :%f",@ecu_Signals::i_S4_SRR_RL_Clu_Theta_60);

	testStep("get expect variable value: ","i_S4_SRR_RL_Clu_Theta_60 :%f",@ecu_Signals::i_S4_SRR_RL_Clu_Theta_60);

	if((abs(@ecu_Signals::i_S4_SRR_RL_Clu_Theta_60)*0.9<=abs(signalvalue1))&&(abs(signalvalue1)<=abs(@ecu_Signals::i_S4_SRR_RL_Clu_Theta_60)*1.1))
	{
	testStepPass("Pass","i_S4_SRR_RL_Clu_Theta_60 :%f",signalvalue1);
	}
	else
	{
	testStepFail("Fail","i_S4_SRR_RL_Clu_Theta_60 :%f",signalvalue1);
	}
}

testcase S4_SRR_RL_Clu_Mes_8_S4_SRR_RL_Clu_Dist_60()
{
	signalvalue1 = getSignal(S4_SRR_RL_Clu_Dist_60);
	write("S4_SRR_RL_Clu_Dist_60 :%f",signalvalue1);
	write("i_S4_SRR_RL_Clu_Dist_60 :%f",@ecu_Signals::i_S4_SRR_RL_Clu_Dist_60);

	testStep("get expect variable value: ","i_S4_SRR_RL_Clu_Dist_60 :%f",@ecu_Signals::i_S4_SRR_RL_Clu_Dist_60);

	if((abs(@ecu_Signals::i_S4_SRR_RL_Clu_Dist_60)*0.9<=abs(signalvalue1))&&(abs(signalvalue1)<=abs(@ecu_Signals::i_S4_SRR_RL_Clu_Dist_60)*1.1))
	{
	testStepPass("Pass","i_S4_SRR_RL_Clu_Dist_60 :%f",signalvalue1);
	}
	else
	{
	testStepFail("Fail","i_S4_SRR_RL_Clu_Dist_60 :%f",signalvalue1);
	}
}

testcase S4_SRR_RL_Clu_Mes_8_S4_SRR_RL_Clu_Vel_60()
{
	signalvalue1 = getSignal(S4_SRR_RL_Clu_Vel_60);
	write("S4_SRR_RL_Clu_Vel_60 :%f",signalvalue1);
	write("i_S4_SRR_RL_Clu_Vel_60 :%f",@ecu_Signals::i_S4_SRR_RL_Clu_Vel_60);

	testStep("get expect variable value: ","i_S4_SRR_RL_Clu_Vel_60 :%f",@ecu_Signals::i_S4_SRR_RL_Clu_Vel_60);

	if((abs(@ecu_Signals::i_S4_SRR_RL_Clu_Vel_60)*0.9<=abs(signalvalue1))&&(abs(signalvalue1)<=abs(@ecu_Signals::i_S4_SRR_RL_Clu_Vel_60)*1.1))
	{
	testStepPass("Pass","i_S4_SRR_RL_Clu_Vel_60 :%f",signalvalue1);
	}
	else
	{
	testStepFail("Fail","i_S4_SRR_RL_Clu_Vel_60 :%f",signalvalue1);
	}
}

testcase S4_SRR_RL_Clu_Mes_8_S4_SRR_RL_Clu_SNR_60()
{
	signalvalue1 = getSignal(S4_SRR_RL_Clu_SNR_60);
	write("S4_SRR_RL_Clu_SNR_60 :%f",signalvalue1);
	write("i_S4_SRR_RL_Clu_SNR_60 :%f",@ecu_Signals::i_S4_SRR_RL_Clu_SNR_60);

	testStep("get expect variable value: ","i_S4_SRR_RL_Clu_SNR_60 :%f",@ecu_Signals::i_S4_SRR_RL_Clu_SNR_60);

	if((abs(@ecu_Signals::i_S4_SRR_RL_Clu_SNR_60)*0.9<=abs(signalvalue1))&&(abs(signalvalue1)<=abs(@ecu_Signals::i_S4_SRR_RL_Clu_SNR_60)*1.1))
	{
	testStepPass("Pass","i_S4_SRR_RL_Clu_SNR_60 :%f",signalvalue1);
	}
	else
	{
	testStepFail("Fail","i_S4_SRR_RL_Clu_SNR_60 :%f",signalvalue1);
	}
}

testcase S4_SRR_RL_Clu_Mes_8_S4_SRR_RL_Clu_DynProp_60()
{
	signalvalue1 = getSignal(S4_SRR_RL_Clu_DynProp_60);
	write("S4_SRR_RL_Clu_DynProp_60 :%f",signalvalue1);
	write("i_S4_SRR_RL_Clu_DynProp_60 :%o",@ecu_Signals::i_S4_SRR_RL_Clu_DynProp_60);

	testStep("get expect variable value: ","i_S4_SRR_RL_Clu_DynProp_60 :%o",@ecu_Signals::i_S4_SRR_RL_Clu_DynProp_60);

	if(signalvalue1==@ecu_Signals::i_S4_SRR_RL_Clu_DynProp_60)
	{
	testStepPass("Pass","i_S4_SRR_RL_Clu_DynProp_60 :%f",signalvalue1);
	}
	else
	{
	testStepFail("Fail","i_S4_SRR_RL_Clu_DynProp_60 :%f",signalvalue1);
	}
}

testcase S4_SRR_RL_Clu_Mes_8_S4_SRR_RL_Clu_Locationvalid_60()
{
	signalvalue1 = getSignal(S4_SRR_RL_Clu_Locationvalid_60);
	write("S4_SRR_RL_Clu_Locationvalid_60 :%f",signalvalue1);
	write("i_S4_SRR_RL_Clu_Locationvalid_60 :%o",@ecu_Signals::i_S4_SRR_RL_Clu_Locationvalid_60);

	testStep("get expect variable value: ","i_S4_SRR_RL_Clu_Locationvalid_60 :%o",@ecu_Signals::i_S4_SRR_RL_Clu_Locationvalid_60);

	if(signalvalue1==@ecu_Signals::i_S4_SRR_RL_Clu_Locationvalid_60)
	{
	testStepPass("Pass","i_S4_SRR_RL_Clu_Locationvalid_60 :%f",signalvalue1);
	}
	else
	{
	testStepFail("Fail","i_S4_SRR_RL_Clu_Locationvalid_60 :%f",signalvalue1);
	}
}

testcase S4_SRR_RL_Clu_Mes_8_S4_SRR_RL_Clu_Theta_61()
{
	signalvalue1 = getSignal(S4_SRR_RL_Clu_Theta_61);
	write("S4_SRR_RL_Clu_Theta_61 :%f",signalvalue1);
	write("i_S4_SRR_RL_Clu_Theta_61 :%f",@ecu_Signals::i_S4_SRR_RL_Clu_Theta_61);

	testStep("get expect variable value: ","i_S4_SRR_RL_Clu_Theta_61 :%f",@ecu_Signals::i_S4_SRR_RL_Clu_Theta_61);

	if((abs(@ecu_Signals::i_S4_SRR_RL_Clu_Theta_61)*0.9<=abs(signalvalue1))&&(abs(signalvalue1)<=abs(@ecu_Signals::i_S4_SRR_RL_Clu_Theta_61)*1.1))
	{
	testStepPass("Pass","i_S4_SRR_RL_Clu_Theta_61 :%f",signalvalue1);
	}
	else
	{
	testStepFail("Fail","i_S4_SRR_RL_Clu_Theta_61 :%f",signalvalue1);
	}
}

testcase S4_SRR_RL_Clu_Mes_8_S4_SRR_RL_Clu_Dist_61()
{
	signalvalue1 = getSignal(S4_SRR_RL_Clu_Dist_61);
	write("S4_SRR_RL_Clu_Dist_61 :%f",signalvalue1);
	write("i_S4_SRR_RL_Clu_Dist_61 :%f",@ecu_Signals::i_S4_SRR_RL_Clu_Dist_61);

	testStep("get expect variable value: ","i_S4_SRR_RL_Clu_Dist_61 :%f",@ecu_Signals::i_S4_SRR_RL_Clu_Dist_61);

	if((abs(@ecu_Signals::i_S4_SRR_RL_Clu_Dist_61)*0.9<=abs(signalvalue1))&&(abs(signalvalue1)<=abs(@ecu_Signals::i_S4_SRR_RL_Clu_Dist_61)*1.1))
	{
	testStepPass("Pass","i_S4_SRR_RL_Clu_Dist_61 :%f",signalvalue1);
	}
	else
	{
	testStepFail("Fail","i_S4_SRR_RL_Clu_Dist_61 :%f",signalvalue1);
	}
}

testcase S4_SRR_RL_Clu_Mes_8_S4_SRR_RL_Clu_Vel_61()
{
	signalvalue1 = getSignal(S4_SRR_RL_Clu_Vel_61);
	write("S4_SRR_RL_Clu_Vel_61 :%f",signalvalue1);
	write("i_S4_SRR_RL_Clu_Vel_61 :%f",@ecu_Signals::i_S4_SRR_RL_Clu_Vel_61);

	testStep("get expect variable value: ","i_S4_SRR_RL_Clu_Vel_61 :%f",@ecu_Signals::i_S4_SRR_RL_Clu_Vel_61);

	if((abs(@ecu_Signals::i_S4_SRR_RL_Clu_Vel_61)*0.9<=abs(signalvalue1))&&(abs(signalvalue1)<=abs(@ecu_Signals::i_S4_SRR_RL_Clu_Vel_61)*1.1))
	{
	testStepPass("Pass","i_S4_SRR_RL_Clu_Vel_61 :%f",signalvalue1);
	}
	else
	{
	testStepFail("Fail","i_S4_SRR_RL_Clu_Vel_61 :%f",signalvalue1);
	}
}

testcase S4_SRR_RL_Clu_Mes_8_S4_SRR_RL_Clu_SNR_61()
{
	signalvalue1 = getSignal(S4_SRR_RL_Clu_SNR_61);
	write("S4_SRR_RL_Clu_SNR_61 :%f",signalvalue1);
	write("i_S4_SRR_RL_Clu_SNR_61 :%f",@ecu_Signals::i_S4_SRR_RL_Clu_SNR_61);

	testStep("get expect variable value: ","i_S4_SRR_RL_Clu_SNR_61 :%f",@ecu_Signals::i_S4_SRR_RL_Clu_SNR_61);

	if((abs(@ecu_Signals::i_S4_SRR_RL_Clu_SNR_61)*0.9<=abs(signalvalue1))&&(abs(signalvalue1)<=abs(@ecu_Signals::i_S4_SRR_RL_Clu_SNR_61)*1.1))
	{
	testStepPass("Pass","i_S4_SRR_RL_Clu_SNR_61 :%f",signalvalue1);
	}
	else
	{
	testStepFail("Fail","i_S4_SRR_RL_Clu_SNR_61 :%f",signalvalue1);
	}
}

testcase S4_SRR_RL_Clu_Mes_8_S4_SRR_RL_Clu_DynProp_61()
{
	signalvalue1 = getSignal(S4_SRR_RL_Clu_DynProp_61);
	write("S4_SRR_RL_Clu_DynProp_61 :%f",signalvalue1);
	write("i_S4_SRR_RL_Clu_DynProp_61 :%o",@ecu_Signals::i_S4_SRR_RL_Clu_DynProp_61);

	testStep("get expect variable value: ","i_S4_SRR_RL_Clu_DynProp_61 :%o",@ecu_Signals::i_S4_SRR_RL_Clu_DynProp_61);

	if(signalvalue1==@ecu_Signals::i_S4_SRR_RL_Clu_DynProp_61)
	{
	testStepPass("Pass","i_S4_SRR_RL_Clu_DynProp_61 :%f",signalvalue1);
	}
	else
	{
	testStepFail("Fail","i_S4_SRR_RL_Clu_DynProp_61 :%f",signalvalue1);
	}
}

testcase S4_SRR_RL_Clu_Mes_8_S4_SRR_RL_Clu_Locationvalid_61()
{
	signalvalue1 = getSignal(S4_SRR_RL_Clu_Locationvalid_61);
	write("S4_SRR_RL_Clu_Locationvalid_61 :%f",signalvalue1);
	write("i_S4_SRR_RL_Clu_Locationvalid_61 :%o",@ecu_Signals::i_S4_SRR_RL_Clu_Locationvalid_61);

	testStep("get expect variable value: ","i_S4_SRR_RL_Clu_Locationvalid_61 :%o",@ecu_Signals::i_S4_SRR_RL_Clu_Locationvalid_61);

	if(signalvalue1==@ecu_Signals::i_S4_SRR_RL_Clu_Locationvalid_61)
	{
	testStepPass("Pass","i_S4_SRR_RL_Clu_Locationvalid_61 :%f",signalvalue1);
	}
	else
	{
	testStepFail("Fail","i_S4_SRR_RL_Clu_Locationvalid_61 :%f",signalvalue1);
	}
}

testcase S4_SRR_RL_Clu_Mes_8_S4_SRR_RL_Clu_Theta_62()
{
	signalvalue1 = getSignal(S4_SRR_RL_Clu_Theta_62);
	write("S4_SRR_RL_Clu_Theta_62 :%f",signalvalue1);
	write("i_S4_SRR_RL_Clu_Theta_62 :%f",@ecu_Signals::i_S4_SRR_RL_Clu_Theta_62);

	testStep("get expect variable value: ","i_S4_SRR_RL_Clu_Theta_62 :%f",@ecu_Signals::i_S4_SRR_RL_Clu_Theta_62);

	if((abs(@ecu_Signals::i_S4_SRR_RL_Clu_Theta_62)*0.9<=abs(signalvalue1))&&(abs(signalvalue1)<=abs(@ecu_Signals::i_S4_SRR_RL_Clu_Theta_62)*1.1))
	{
	testStepPass("Pass","i_S4_SRR_RL_Clu_Theta_62 :%f",signalvalue1);
	}
	else
	{
	testStepFail("Fail","i_S4_SRR_RL_Clu_Theta_62 :%f",signalvalue1);
	}
}

testcase S4_SRR_RL_Clu_Mes_8_S4_SRR_RL_Clu_Dist_62()
{
	signalvalue1 = getSignal(S4_SRR_RL_Clu_Dist_62);
	write("S4_SRR_RL_Clu_Dist_62 :%f",signalvalue1);
	write("i_S4_SRR_RL_Clu_Dist_62 :%f",@ecu_Signals::i_S4_SRR_RL_Clu_Dist_62);

	testStep("get expect variable value: ","i_S4_SRR_RL_Clu_Dist_62 :%f",@ecu_Signals::i_S4_SRR_RL_Clu_Dist_62);

	if((abs(@ecu_Signals::i_S4_SRR_RL_Clu_Dist_62)*0.9<=abs(signalvalue1))&&(abs(signalvalue1)<=abs(@ecu_Signals::i_S4_SRR_RL_Clu_Dist_62)*1.1))
	{
	testStepPass("Pass","i_S4_SRR_RL_Clu_Dist_62 :%f",signalvalue1);
	}
	else
	{
	testStepFail("Fail","i_S4_SRR_RL_Clu_Dist_62 :%f",signalvalue1);
	}
}

testcase S4_SRR_RL_Clu_Mes_8_S4_SRR_RL_Clu_Vel_62()
{
	signalvalue1 = getSignal(S4_SRR_RL_Clu_Vel_62);
	write("S4_SRR_RL_Clu_Vel_62 :%f",signalvalue1);
	write("i_S4_SRR_RL_Clu_Vel_62 :%f",@ecu_Signals::i_S4_SRR_RL_Clu_Vel_62);

	testStep("get expect variable value: ","i_S4_SRR_RL_Clu_Vel_62 :%f",@ecu_Signals::i_S4_SRR_RL_Clu_Vel_62);

	if((abs(@ecu_Signals::i_S4_SRR_RL_Clu_Vel_62)*0.9<=abs(signalvalue1))&&(abs(signalvalue1)<=abs(@ecu_Signals::i_S4_SRR_RL_Clu_Vel_62)*1.1))
	{
	testStepPass("Pass","i_S4_SRR_RL_Clu_Vel_62 :%f",signalvalue1);
	}
	else
	{
	testStepFail("Fail","i_S4_SRR_RL_Clu_Vel_62 :%f",signalvalue1);
	}
}

testcase S4_SRR_RL_Clu_Mes_8_S4_SRR_RL_Clu_SNR_62()
{
	signalvalue1 = getSignal(S4_SRR_RL_Clu_SNR_62);
	write("S4_SRR_RL_Clu_SNR_62 :%f",signalvalue1);
	write("i_S4_SRR_RL_Clu_SNR_62 :%f",@ecu_Signals::i_S4_SRR_RL_Clu_SNR_62);

	testStep("get expect variable value: ","i_S4_SRR_RL_Clu_SNR_62 :%f",@ecu_Signals::i_S4_SRR_RL_Clu_SNR_62);

	if((abs(@ecu_Signals::i_S4_SRR_RL_Clu_SNR_62)*0.9<=abs(signalvalue1))&&(abs(signalvalue1)<=abs(@ecu_Signals::i_S4_SRR_RL_Clu_SNR_62)*1.1))
	{
	testStepPass("Pass","i_S4_SRR_RL_Clu_SNR_62 :%f",signalvalue1);
	}
	else
	{
	testStepFail("Fail","i_S4_SRR_RL_Clu_SNR_62 :%f",signalvalue1);
	}
}

testcase S4_SRR_RL_Clu_Mes_8_S4_SRR_RL_Clu_DynProp_62()
{
	signalvalue1 = getSignal(S4_SRR_RL_Clu_DynProp_62);
	write("S4_SRR_RL_Clu_DynProp_62 :%f",signalvalue1);
	write("i_S4_SRR_RL_Clu_DynProp_62 :%o",@ecu_Signals::i_S4_SRR_RL_Clu_DynProp_62);

	testStep("get expect variable value: ","i_S4_SRR_RL_Clu_DynProp_62 :%o",@ecu_Signals::i_S4_SRR_RL_Clu_DynProp_62);

	if(signalvalue1==@ecu_Signals::i_S4_SRR_RL_Clu_DynProp_62)
	{
	testStepPass("Pass","i_S4_SRR_RL_Clu_DynProp_62 :%f",signalvalue1);
	}
	else
	{
	testStepFail("Fail","i_S4_SRR_RL_Clu_DynProp_62 :%f",signalvalue1);
	}
}

testcase S4_SRR_RL_Clu_Mes_8_S4_SRR_RL_Clu_Locationvalid_62()
{
	signalvalue1 = getSignal(S4_SRR_RL_Clu_Locationvalid_62);
	write("S4_SRR_RL_Clu_Locationvalid_62 :%f",signalvalue1);
	write("i_S4_SRR_RL_Clu_Locationvalid_62 :%o",@ecu_Signals::i_S4_SRR_RL_Clu_Locationvalid_62);

	testStep("get expect variable value: ","i_S4_SRR_RL_Clu_Locationvalid_62 :%o",@ecu_Signals::i_S4_SRR_RL_Clu_Locationvalid_62);

	if(signalvalue1==@ecu_Signals::i_S4_SRR_RL_Clu_Locationvalid_62)
	{
	testStepPass("Pass","i_S4_SRR_RL_Clu_Locationvalid_62 :%f",signalvalue1);
	}
	else
	{
	testStepFail("Fail","i_S4_SRR_RL_Clu_Locationvalid_62 :%f",signalvalue1);
	}
}

testcase S4_SRR_RL_Clu_Mes_9_S4_SRR_RL_Clu_Theta_63()
{
	signalvalue1 = getSignal(S4_SRR_RL_Clu_Theta_63);
	write("S4_SRR_RL_Clu_Theta_63 :%f",signalvalue1);
	write("i_S4_SRR_RL_Clu_Theta_63 :%f",@ecu_Signals::i_S4_SRR_RL_Clu_Theta_63);

	testStep("get expect variable value: ","i_S4_SRR_RL_Clu_Theta_63 :%f",@ecu_Signals::i_S4_SRR_RL_Clu_Theta_63);

	if((abs(@ecu_Signals::i_S4_SRR_RL_Clu_Theta_63)*0.9<=abs(signalvalue1))&&(abs(signalvalue1)<=abs(@ecu_Signals::i_S4_SRR_RL_Clu_Theta_63)*1.1))
	{
	testStepPass("Pass","i_S4_SRR_RL_Clu_Theta_63 :%f",signalvalue1);
	}
	else
	{
	testStepFail("Fail","i_S4_SRR_RL_Clu_Theta_63 :%f",signalvalue1);
	}
}

testcase S4_SRR_RL_Clu_Mes_9_S4_SRR_RL_Clu_Dist_63()
{
	signalvalue1 = getSignal(S4_SRR_RL_Clu_Dist_63);
	write("S4_SRR_RL_Clu_Dist_63 :%f",signalvalue1);
	write("i_S4_SRR_RL_Clu_Dist_63 :%f",@ecu_Signals::i_S4_SRR_RL_Clu_Dist_63);

	testStep("get expect variable value: ","i_S4_SRR_RL_Clu_Dist_63 :%f",@ecu_Signals::i_S4_SRR_RL_Clu_Dist_63);

	if((abs(@ecu_Signals::i_S4_SRR_RL_Clu_Dist_63)*0.9<=abs(signalvalue1))&&(abs(signalvalue1)<=abs(@ecu_Signals::i_S4_SRR_RL_Clu_Dist_63)*1.1))
	{
	testStepPass("Pass","i_S4_SRR_RL_Clu_Dist_63 :%f",signalvalue1);
	}
	else
	{
	testStepFail("Fail","i_S4_SRR_RL_Clu_Dist_63 :%f",signalvalue1);
	}
}

testcase S4_SRR_RL_Clu_Mes_9_S4_SRR_RL_Clu_Vel_63()
{
	signalvalue1 = getSignal(S4_SRR_RL_Clu_Vel_63);
	write("S4_SRR_RL_Clu_Vel_63 :%f",signalvalue1);
	write("i_S4_SRR_RL_Clu_Vel_63 :%f",@ecu_Signals::i_S4_SRR_RL_Clu_Vel_63);

	testStep("get expect variable value: ","i_S4_SRR_RL_Clu_Vel_63 :%f",@ecu_Signals::i_S4_SRR_RL_Clu_Vel_63);

	if((abs(@ecu_Signals::i_S4_SRR_RL_Clu_Vel_63)*0.9<=abs(signalvalue1))&&(abs(signalvalue1)<=abs(@ecu_Signals::i_S4_SRR_RL_Clu_Vel_63)*1.1))
	{
	testStepPass("Pass","i_S4_SRR_RL_Clu_Vel_63 :%f",signalvalue1);
	}
	else
	{
	testStepFail("Fail","i_S4_SRR_RL_Clu_Vel_63 :%f",signalvalue1);
	}
}

testcase S4_SRR_RL_Clu_Mes_9_S4_SRR_RL_Clu_SNR_63()
{
	signalvalue1 = getSignal(S4_SRR_RL_Clu_SNR_63);
	write("S4_SRR_RL_Clu_SNR_63 :%f",signalvalue1);
	write("i_S4_SRR_RL_Clu_SNR_63 :%f",@ecu_Signals::i_S4_SRR_RL_Clu_SNR_63);

	testStep("get expect variable value: ","i_S4_SRR_RL_Clu_SNR_63 :%f",@ecu_Signals::i_S4_SRR_RL_Clu_SNR_63);

	if((abs(@ecu_Signals::i_S4_SRR_RL_Clu_SNR_63)*0.9<=abs(signalvalue1))&&(abs(signalvalue1)<=abs(@ecu_Signals::i_S4_SRR_RL_Clu_SNR_63)*1.1))
	{
	testStepPass("Pass","i_S4_SRR_RL_Clu_SNR_63 :%f",signalvalue1);
	}
	else
	{
	testStepFail("Fail","i_S4_SRR_RL_Clu_SNR_63 :%f",signalvalue1);
	}
}

testcase S4_SRR_RL_Clu_Mes_9_S4_SRR_RL_Clu_DynProp_63()
{
	signalvalue1 = getSignal(S4_SRR_RL_Clu_DynProp_63);
	write("S4_SRR_RL_Clu_DynProp_63 :%f",signalvalue1);
	write("i_S4_SRR_RL_Clu_DynProp_63 :%o",@ecu_Signals::i_S4_SRR_RL_Clu_DynProp_63);

	testStep("get expect variable value: ","i_S4_SRR_RL_Clu_DynProp_63 :%o",@ecu_Signals::i_S4_SRR_RL_Clu_DynProp_63);

	if(signalvalue1==@ecu_Signals::i_S4_SRR_RL_Clu_DynProp_63)
	{
	testStepPass("Pass","i_S4_SRR_RL_Clu_DynProp_63 :%f",signalvalue1);
	}
	else
	{
	testStepFail("Fail","i_S4_SRR_RL_Clu_DynProp_63 :%f",signalvalue1);
	}
}

testcase S4_SRR_RL_Clu_Mes_9_S4_SRR_RL_Clu_Locationvalid_63()
{
	signalvalue1 = getSignal(S4_SRR_RL_Clu_Locationvalid_63);
	write("S4_SRR_RL_Clu_Locationvalid_63 :%f",signalvalue1);
	write("i_S4_SRR_RL_Clu_Locationvalid_63 :%o",@ecu_Signals::i_S4_SRR_RL_Clu_Locationvalid_63);

	testStep("get expect variable value: ","i_S4_SRR_RL_Clu_Locationvalid_63 :%o",@ecu_Signals::i_S4_SRR_RL_Clu_Locationvalid_63);

	if(signalvalue1==@ecu_Signals::i_S4_SRR_RL_Clu_Locationvalid_63)
	{
	testStepPass("Pass","i_S4_SRR_RL_Clu_Locationvalid_63 :%f",signalvalue1);
	}
	else
	{
	testStepFail("Fail","i_S4_SRR_RL_Clu_Locationvalid_63 :%f",signalvalue1);
	}
}

testcase S4_SRR_RL_Clu_Mes_9_S4_SRR_RL_Clu_Theta_64()
{
	signalvalue1 = getSignal(S4_SRR_RL_Clu_Theta_64);
	write("S4_SRR_RL_Clu_Theta_64 :%f",signalvalue1);
	write("i_S4_SRR_RL_Clu_Theta_64 :%f",@ecu_Signals::i_S4_SRR_RL_Clu_Theta_64);

	testStep("get expect variable value: ","i_S4_SRR_RL_Clu_Theta_64 :%f",@ecu_Signals::i_S4_SRR_RL_Clu_Theta_64);

	if((abs(@ecu_Signals::i_S4_SRR_RL_Clu_Theta_64)*0.9<=abs(signalvalue1))&&(abs(signalvalue1)<=abs(@ecu_Signals::i_S4_SRR_RL_Clu_Theta_64)*1.1))
	{
	testStepPass("Pass","i_S4_SRR_RL_Clu_Theta_64 :%f",signalvalue1);
	}
	else
	{
	testStepFail("Fail","i_S4_SRR_RL_Clu_Theta_64 :%f",signalvalue1);
	}
}

testcase S4_SRR_RL_Clu_Mes_9_S4_SRR_RL_Clu_Dist_64()
{
	signalvalue1 = getSignal(S4_SRR_RL_Clu_Dist_64);
	write("S4_SRR_RL_Clu_Dist_64 :%f",signalvalue1);
	write("i_S4_SRR_RL_Clu_Dist_64 :%f",@ecu_Signals::i_S4_SRR_RL_Clu_Dist_64);

	testStep("get expect variable value: ","i_S4_SRR_RL_Clu_Dist_64 :%f",@ecu_Signals::i_S4_SRR_RL_Clu_Dist_64);

	if((abs(@ecu_Signals::i_S4_SRR_RL_Clu_Dist_64)*0.9<=abs(signalvalue1))&&(abs(signalvalue1)<=abs(@ecu_Signals::i_S4_SRR_RL_Clu_Dist_64)*1.1))
	{
	testStepPass("Pass","i_S4_SRR_RL_Clu_Dist_64 :%f",signalvalue1);
	}
	else
	{
	testStepFail("Fail","i_S4_SRR_RL_Clu_Dist_64 :%f",signalvalue1);
	}
}

testcase S4_SRR_RL_Clu_Mes_9_S4_SRR_RL_Clu_Vel_64()
{
	signalvalue1 = getSignal(S4_SRR_RL_Clu_Vel_64);
	write("S4_SRR_RL_Clu_Vel_64 :%f",signalvalue1);
	write("i_S4_SRR_RL_Clu_Vel_64 :%f",@ecu_Signals::i_S4_SRR_RL_Clu_Vel_64);

	testStep("get expect variable value: ","i_S4_SRR_RL_Clu_Vel_64 :%f",@ecu_Signals::i_S4_SRR_RL_Clu_Vel_64);

	if((abs(@ecu_Signals::i_S4_SRR_RL_Clu_Vel_64)*0.9<=abs(signalvalue1))&&(abs(signalvalue1)<=abs(@ecu_Signals::i_S4_SRR_RL_Clu_Vel_64)*1.1))
	{
	testStepPass("Pass","i_S4_SRR_RL_Clu_Vel_64 :%f",signalvalue1);
	}
	else
	{
	testStepFail("Fail","i_S4_SRR_RL_Clu_Vel_64 :%f",signalvalue1);
	}
}

testcase S4_SRR_RL_Clu_Mes_9_S4_SRR_RL_Clu_SNR_64()
{
	signalvalue1 = getSignal(S4_SRR_RL_Clu_SNR_64);
	write("S4_SRR_RL_Clu_SNR_64 :%f",signalvalue1);
	write("i_S4_SRR_RL_Clu_SNR_64 :%f",@ecu_Signals::i_S4_SRR_RL_Clu_SNR_64);

	testStep("get expect variable value: ","i_S4_SRR_RL_Clu_SNR_64 :%f",@ecu_Signals::i_S4_SRR_RL_Clu_SNR_64);

	if((abs(@ecu_Signals::i_S4_SRR_RL_Clu_SNR_64)*0.9<=abs(signalvalue1))&&(abs(signalvalue1)<=abs(@ecu_Signals::i_S4_SRR_RL_Clu_SNR_64)*1.1))
	{
	testStepPass("Pass","i_S4_SRR_RL_Clu_SNR_64 :%f",signalvalue1);
	}
	else
	{
	testStepFail("Fail","i_S4_SRR_RL_Clu_SNR_64 :%f",signalvalue1);
	}
}

testcase S4_SRR_RL_Clu_Mes_9_S4_SRR_RL_Clu_DynProp_64()
{
	signalvalue1 = getSignal(S4_SRR_RL_Clu_DynProp_64);
	write("S4_SRR_RL_Clu_DynProp_64 :%f",signalvalue1);
	write("i_S4_SRR_RL_Clu_DynProp_64 :%o",@ecu_Signals::i_S4_SRR_RL_Clu_DynProp_64);

	testStep("get expect variable value: ","i_S4_SRR_RL_Clu_DynProp_64 :%o",@ecu_Signals::i_S4_SRR_RL_Clu_DynProp_64);

	if(signalvalue1==@ecu_Signals::i_S4_SRR_RL_Clu_DynProp_64)
	{
	testStepPass("Pass","i_S4_SRR_RL_Clu_DynProp_64 :%f",signalvalue1);
	}
	else
	{
	testStepFail("Fail","i_S4_SRR_RL_Clu_DynProp_64 :%f",signalvalue1);
	}
}

testcase S4_SRR_RL_Clu_Mes_9_S4_SRR_RL_Clu_Locationvalid_64()
{
	signalvalue1 = getSignal(S4_SRR_RL_Clu_Locationvalid_64);
	write("S4_SRR_RL_Clu_Locationvalid_64 :%f",signalvalue1);
	write("i_S4_SRR_RL_Clu_Locationvalid_64 :%o",@ecu_Signals::i_S4_SRR_RL_Clu_Locationvalid_64);

	testStep("get expect variable value: ","i_S4_SRR_RL_Clu_Locationvalid_64 :%o",@ecu_Signals::i_S4_SRR_RL_Clu_Locationvalid_64);

	if(signalvalue1==@ecu_Signals::i_S4_SRR_RL_Clu_Locationvalid_64)
	{
	testStepPass("Pass","i_S4_SRR_RL_Clu_Locationvalid_64 :%f",signalvalue1);
	}
	else
	{
	testStepFail("Fail","i_S4_SRR_RL_Clu_Locationvalid_64 :%f",signalvalue1);
	}
}

testcase S4_SRR_RL_Clu_Mes_9_S4_SRR_RL_Clu_Theta_65()
{
	signalvalue1 = getSignal(S4_SRR_RL_Clu_Theta_65);
	write("S4_SRR_RL_Clu_Theta_65 :%f",signalvalue1);
	write("i_S4_SRR_RL_Clu_Theta_65 :%f",@ecu_Signals::i_S4_SRR_RL_Clu_Theta_65);

	testStep("get expect variable value: ","i_S4_SRR_RL_Clu_Theta_65 :%f",@ecu_Signals::i_S4_SRR_RL_Clu_Theta_65);

	if((abs(@ecu_Signals::i_S4_SRR_RL_Clu_Theta_65)*0.9<=abs(signalvalue1))&&(abs(signalvalue1)<=abs(@ecu_Signals::i_S4_SRR_RL_Clu_Theta_65)*1.1))
	{
	testStepPass("Pass","i_S4_SRR_RL_Clu_Theta_65 :%f",signalvalue1);
	}
	else
	{
	testStepFail("Fail","i_S4_SRR_RL_Clu_Theta_65 :%f",signalvalue1);
	}
}

testcase S4_SRR_RL_Clu_Mes_9_S4_SRR_RL_Clu_Dist_65()
{
	signalvalue1 = getSignal(S4_SRR_RL_Clu_Dist_65);
	write("S4_SRR_RL_Clu_Dist_65 :%f",signalvalue1);
	write("i_S4_SRR_RL_Clu_Dist_65 :%f",@ecu_Signals::i_S4_SRR_RL_Clu_Dist_65);

	testStep("get expect variable value: ","i_S4_SRR_RL_Clu_Dist_65 :%f",@ecu_Signals::i_S4_SRR_RL_Clu_Dist_65);

	if((abs(@ecu_Signals::i_S4_SRR_RL_Clu_Dist_65)*0.9<=abs(signalvalue1))&&(abs(signalvalue1)<=abs(@ecu_Signals::i_S4_SRR_RL_Clu_Dist_65)*1.1))
	{
	testStepPass("Pass","i_S4_SRR_RL_Clu_Dist_65 :%f",signalvalue1);
	}
	else
	{
	testStepFail("Fail","i_S4_SRR_RL_Clu_Dist_65 :%f",signalvalue1);
	}
}

testcase S4_SRR_RL_Clu_Mes_9_S4_SRR_RL_Clu_Vel_65()
{
	signalvalue1 = getSignal(S4_SRR_RL_Clu_Vel_65);
	write("S4_SRR_RL_Clu_Vel_65 :%f",signalvalue1);
	write("i_S4_SRR_RL_Clu_Vel_65 :%f",@ecu_Signals::i_S4_SRR_RL_Clu_Vel_65);

	testStep("get expect variable value: ","i_S4_SRR_RL_Clu_Vel_65 :%f",@ecu_Signals::i_S4_SRR_RL_Clu_Vel_65);

	if((abs(@ecu_Signals::i_S4_SRR_RL_Clu_Vel_65)*0.9<=abs(signalvalue1))&&(abs(signalvalue1)<=abs(@ecu_Signals::i_S4_SRR_RL_Clu_Vel_65)*1.1))
	{
	testStepPass("Pass","i_S4_SRR_RL_Clu_Vel_65 :%f",signalvalue1);
	}
	else
	{
	testStepFail("Fail","i_S4_SRR_RL_Clu_Vel_65 :%f",signalvalue1);
	}
}

testcase S4_SRR_RL_Clu_Mes_9_S4_SRR_RL_Clu_SNR_65()
{
	signalvalue1 = getSignal(S4_SRR_RL_Clu_SNR_65);
	write("S4_SRR_RL_Clu_SNR_65 :%f",signalvalue1);
	write("i_S4_SRR_RL_Clu_SNR_65 :%f",@ecu_Signals::i_S4_SRR_RL_Clu_SNR_65);

	testStep("get expect variable value: ","i_S4_SRR_RL_Clu_SNR_65 :%f",@ecu_Signals::i_S4_SRR_RL_Clu_SNR_65);

	if((abs(@ecu_Signals::i_S4_SRR_RL_Clu_SNR_65)*0.9<=abs(signalvalue1))&&(abs(signalvalue1)<=abs(@ecu_Signals::i_S4_SRR_RL_Clu_SNR_65)*1.1))
	{
	testStepPass("Pass","i_S4_SRR_RL_Clu_SNR_65 :%f",signalvalue1);
	}
	else
	{
	testStepFail("Fail","i_S4_SRR_RL_Clu_SNR_65 :%f",signalvalue1);
	}
}

testcase S4_SRR_RL_Clu_Mes_9_S4_SRR_RL_Clu_DynProp_65()
{
	signalvalue1 = getSignal(S4_SRR_RL_Clu_DynProp_65);
	write("S4_SRR_RL_Clu_DynProp_65 :%f",signalvalue1);
	write("i_S4_SRR_RL_Clu_DynProp_65 :%o",@ecu_Signals::i_S4_SRR_RL_Clu_DynProp_65);

	testStep("get expect variable value: ","i_S4_SRR_RL_Clu_DynProp_65 :%o",@ecu_Signals::i_S4_SRR_RL_Clu_DynProp_65);

	if(signalvalue1==@ecu_Signals::i_S4_SRR_RL_Clu_DynProp_65)
	{
	testStepPass("Pass","i_S4_SRR_RL_Clu_DynProp_65 :%f",signalvalue1);
	}
	else
	{
	testStepFail("Fail","i_S4_SRR_RL_Clu_DynProp_65 :%f",signalvalue1);
	}
}

testcase S4_SRR_RL_Clu_Mes_9_S4_SRR_RL_Clu_Locationvalid_65()
{
	signalvalue1 = getSignal(S4_SRR_RL_Clu_Locationvalid_65);
	write("S4_SRR_RL_Clu_Locationvalid_65 :%f",signalvalue1);
	write("i_S4_SRR_RL_Clu_Locationvalid_65 :%o",@ecu_Signals::i_S4_SRR_RL_Clu_Locationvalid_65);

	testStep("get expect variable value: ","i_S4_SRR_RL_Clu_Locationvalid_65 :%o",@ecu_Signals::i_S4_SRR_RL_Clu_Locationvalid_65);

	if(signalvalue1==@ecu_Signals::i_S4_SRR_RL_Clu_Locationvalid_65)
	{
	testStepPass("Pass","i_S4_SRR_RL_Clu_Locationvalid_65 :%f",signalvalue1);
	}
	else
	{
	testStepFail("Fail","i_S4_SRR_RL_Clu_Locationvalid_65 :%f",signalvalue1);
	}
}

testcase S4_SRR_RL_Clu_Mes_9_S4_SRR_RL_Clu_Theta_66()
{
	signalvalue1 = getSignal(S4_SRR_RL_Clu_Theta_66);
	write("S4_SRR_RL_Clu_Theta_66 :%f",signalvalue1);
	write("i_S4_SRR_RL_Clu_Theta_66 :%f",@ecu_Signals::i_S4_SRR_RL_Clu_Theta_66);

	testStep("get expect variable value: ","i_S4_SRR_RL_Clu_Theta_66 :%f",@ecu_Signals::i_S4_SRR_RL_Clu_Theta_66);

	if((abs(@ecu_Signals::i_S4_SRR_RL_Clu_Theta_66)*0.9<=abs(signalvalue1))&&(abs(signalvalue1)<=abs(@ecu_Signals::i_S4_SRR_RL_Clu_Theta_66)*1.1))
	{
	testStepPass("Pass","i_S4_SRR_RL_Clu_Theta_66 :%f",signalvalue1);
	}
	else
	{
	testStepFail("Fail","i_S4_SRR_RL_Clu_Theta_66 :%f",signalvalue1);
	}
}

testcase S4_SRR_RL_Clu_Mes_9_S4_SRR_RL_Clu_Dist_66()
{
	signalvalue1 = getSignal(S4_SRR_RL_Clu_Dist_66);
	write("S4_SRR_RL_Clu_Dist_66 :%f",signalvalue1);
	write("i_S4_SRR_RL_Clu_Dist_66 :%f",@ecu_Signals::i_S4_SRR_RL_Clu_Dist_66);

	testStep("get expect variable value: ","i_S4_SRR_RL_Clu_Dist_66 :%f",@ecu_Signals::i_S4_SRR_RL_Clu_Dist_66);

	if((abs(@ecu_Signals::i_S4_SRR_RL_Clu_Dist_66)*0.9<=abs(signalvalue1))&&(abs(signalvalue1)<=abs(@ecu_Signals::i_S4_SRR_RL_Clu_Dist_66)*1.1))
	{
	testStepPass("Pass","i_S4_SRR_RL_Clu_Dist_66 :%f",signalvalue1);
	}
	else
	{
	testStepFail("Fail","i_S4_SRR_RL_Clu_Dist_66 :%f",signalvalue1);
	}
}

testcase S4_SRR_RL_Clu_Mes_9_S4_SRR_RL_Clu_Vel_66()
{
	signalvalue1 = getSignal(S4_SRR_RL_Clu_Vel_66);
	write("S4_SRR_RL_Clu_Vel_66 :%f",signalvalue1);
	write("i_S4_SRR_RL_Clu_Vel_66 :%f",@ecu_Signals::i_S4_SRR_RL_Clu_Vel_66);

	testStep("get expect variable value: ","i_S4_SRR_RL_Clu_Vel_66 :%f",@ecu_Signals::i_S4_SRR_RL_Clu_Vel_66);

	if((abs(@ecu_Signals::i_S4_SRR_RL_Clu_Vel_66)*0.9<=abs(signalvalue1))&&(abs(signalvalue1)<=abs(@ecu_Signals::i_S4_SRR_RL_Clu_Vel_66)*1.1))
	{
	testStepPass("Pass","i_S4_SRR_RL_Clu_Vel_66 :%f",signalvalue1);
	}
	else
	{
	testStepFail("Fail","i_S4_SRR_RL_Clu_Vel_66 :%f",signalvalue1);
	}
}

testcase S4_SRR_RL_Clu_Mes_9_S4_SRR_RL_Clu_SNR_66()
{
	signalvalue1 = getSignal(S4_SRR_RL_Clu_SNR_66);
	write("S4_SRR_RL_Clu_SNR_66 :%f",signalvalue1);
	write("i_S4_SRR_RL_Clu_SNR_66 :%f",@ecu_Signals::i_S4_SRR_RL_Clu_SNR_66);

	testStep("get expect variable value: ","i_S4_SRR_RL_Clu_SNR_66 :%f",@ecu_Signals::i_S4_SRR_RL_Clu_SNR_66);

	if((abs(@ecu_Signals::i_S4_SRR_RL_Clu_SNR_66)*0.9<=abs(signalvalue1))&&(abs(signalvalue1)<=abs(@ecu_Signals::i_S4_SRR_RL_Clu_SNR_66)*1.1))
	{
	testStepPass("Pass","i_S4_SRR_RL_Clu_SNR_66 :%f",signalvalue1);
	}
	else
	{
	testStepFail("Fail","i_S4_SRR_RL_Clu_SNR_66 :%f",signalvalue1);
	}
}

testcase S4_SRR_RL_Clu_Mes_9_S4_SRR_RL_Clu_DynProp_66()
{
	signalvalue1 = getSignal(S4_SRR_RL_Clu_DynProp_66);
	write("S4_SRR_RL_Clu_DynProp_66 :%f",signalvalue1);
	write("i_S4_SRR_RL_Clu_DynProp_66 :%o",@ecu_Signals::i_S4_SRR_RL_Clu_DynProp_66);

	testStep("get expect variable value: ","i_S4_SRR_RL_Clu_DynProp_66 :%o",@ecu_Signals::i_S4_SRR_RL_Clu_DynProp_66);

	if(signalvalue1==@ecu_Signals::i_S4_SRR_RL_Clu_DynProp_66)
	{
	testStepPass("Pass","i_S4_SRR_RL_Clu_DynProp_66 :%f",signalvalue1);
	}
	else
	{
	testStepFail("Fail","i_S4_SRR_RL_Clu_DynProp_66 :%f",signalvalue1);
	}
}

testcase S4_SRR_RL_Clu_Mes_9_S4_SRR_RL_Clu_Locationvalid_66()
{
	signalvalue1 = getSignal(S4_SRR_RL_Clu_Locationvalid_66);
	write("S4_SRR_RL_Clu_Locationvalid_66 :%f",signalvalue1);
	write("i_S4_SRR_RL_Clu_Locationvalid_66 :%o",@ecu_Signals::i_S4_SRR_RL_Clu_Locationvalid_66);

	testStep("get expect variable value: ","i_S4_SRR_RL_Clu_Locationvalid_66 :%o",@ecu_Signals::i_S4_SRR_RL_Clu_Locationvalid_66);

	if(signalvalue1==@ecu_Signals::i_S4_SRR_RL_Clu_Locationvalid_66)
	{
	testStepPass("Pass","i_S4_SRR_RL_Clu_Locationvalid_66 :%f",signalvalue1);
	}
	else
	{
	testStepFail("Fail","i_S4_SRR_RL_Clu_Locationvalid_66 :%f",signalvalue1);
	}
}

testcase S4_SRR_RL_Clu_Mes_9_S4_SRR_RL_Clu_Theta_67()
{
	signalvalue1 = getSignal(S4_SRR_RL_Clu_Theta_67);
	write("S4_SRR_RL_Clu_Theta_67 :%f",signalvalue1);
	write("i_S4_SRR_RL_Clu_Theta_67 :%f",@ecu_Signals::i_S4_SRR_RL_Clu_Theta_67);

	testStep("get expect variable value: ","i_S4_SRR_RL_Clu_Theta_67 :%f",@ecu_Signals::i_S4_SRR_RL_Clu_Theta_67);

	if((abs(@ecu_Signals::i_S4_SRR_RL_Clu_Theta_67)*0.9<=abs(signalvalue1))&&(abs(signalvalue1)<=abs(@ecu_Signals::i_S4_SRR_RL_Clu_Theta_67)*1.1))
	{
	testStepPass("Pass","i_S4_SRR_RL_Clu_Theta_67 :%f",signalvalue1);
	}
	else
	{
	testStepFail("Fail","i_S4_SRR_RL_Clu_Theta_67 :%f",signalvalue1);
	}
}

testcase S4_SRR_RL_Clu_Mes_9_S4_SRR_RL_Clu_Dist_67()
{
	signalvalue1 = getSignal(S4_SRR_RL_Clu_Dist_67);
	write("S4_SRR_RL_Clu_Dist_67 :%f",signalvalue1);
	write("i_S4_SRR_RL_Clu_Dist_67 :%f",@ecu_Signals::i_S4_SRR_RL_Clu_Dist_67);

	testStep("get expect variable value: ","i_S4_SRR_RL_Clu_Dist_67 :%f",@ecu_Signals::i_S4_SRR_RL_Clu_Dist_67);

	if((abs(@ecu_Signals::i_S4_SRR_RL_Clu_Dist_67)*0.9<=abs(signalvalue1))&&(abs(signalvalue1)<=abs(@ecu_Signals::i_S4_SRR_RL_Clu_Dist_67)*1.1))
	{
	testStepPass("Pass","i_S4_SRR_RL_Clu_Dist_67 :%f",signalvalue1);
	}
	else
	{
	testStepFail("Fail","i_S4_SRR_RL_Clu_Dist_67 :%f",signalvalue1);
	}
}

testcase S4_SRR_RL_Clu_Mes_9_S4_SRR_RL_Clu_Vel_67()
{
	signalvalue1 = getSignal(S4_SRR_RL_Clu_Vel_67);
	write("S4_SRR_RL_Clu_Vel_67 :%f",signalvalue1);
	write("i_S4_SRR_RL_Clu_Vel_67 :%f",@ecu_Signals::i_S4_SRR_RL_Clu_Vel_67);

	testStep("get expect variable value: ","i_S4_SRR_RL_Clu_Vel_67 :%f",@ecu_Signals::i_S4_SRR_RL_Clu_Vel_67);

	if((abs(@ecu_Signals::i_S4_SRR_RL_Clu_Vel_67)*0.9<=abs(signalvalue1))&&(abs(signalvalue1)<=abs(@ecu_Signals::i_S4_SRR_RL_Clu_Vel_67)*1.1))
	{
	testStepPass("Pass","i_S4_SRR_RL_Clu_Vel_67 :%f",signalvalue1);
	}
	else
	{
	testStepFail("Fail","i_S4_SRR_RL_Clu_Vel_67 :%f",signalvalue1);
	}
}

testcase S4_SRR_RL_Clu_Mes_9_S4_SRR_RL_Clu_SNR_67()
{
	signalvalue1 = getSignal(S4_SRR_RL_Clu_SNR_67);
	write("S4_SRR_RL_Clu_SNR_67 :%f",signalvalue1);
	write("i_S4_SRR_RL_Clu_SNR_67 :%f",@ecu_Signals::i_S4_SRR_RL_Clu_SNR_67);

	testStep("get expect variable value: ","i_S4_SRR_RL_Clu_SNR_67 :%f",@ecu_Signals::i_S4_SRR_RL_Clu_SNR_67);

	if((abs(@ecu_Signals::i_S4_SRR_RL_Clu_SNR_67)*0.9<=abs(signalvalue1))&&(abs(signalvalue1)<=abs(@ecu_Signals::i_S4_SRR_RL_Clu_SNR_67)*1.1))
	{
	testStepPass("Pass","i_S4_SRR_RL_Clu_SNR_67 :%f",signalvalue1);
	}
	else
	{
	testStepFail("Fail","i_S4_SRR_RL_Clu_SNR_67 :%f",signalvalue1);
	}
}

testcase S4_SRR_RL_Clu_Mes_9_S4_SRR_RL_Clu_DynProp_67()
{
	signalvalue1 = getSignal(S4_SRR_RL_Clu_DynProp_67);
	write("S4_SRR_RL_Clu_DynProp_67 :%f",signalvalue1);
	write("i_S4_SRR_RL_Clu_DynProp_67 :%o",@ecu_Signals::i_S4_SRR_RL_Clu_DynProp_67);

	testStep("get expect variable value: ","i_S4_SRR_RL_Clu_DynProp_67 :%o",@ecu_Signals::i_S4_SRR_RL_Clu_DynProp_67);

	if(signalvalue1==@ecu_Signals::i_S4_SRR_RL_Clu_DynProp_67)
	{
	testStepPass("Pass","i_S4_SRR_RL_Clu_DynProp_67 :%f",signalvalue1);
	}
	else
	{
	testStepFail("Fail","i_S4_SRR_RL_Clu_DynProp_67 :%f",signalvalue1);
	}
}

testcase S4_SRR_RL_Clu_Mes_9_S4_SRR_RL_Clu_Locationvalid_67()
{
	signalvalue1 = getSignal(S4_SRR_RL_Clu_Locationvalid_67);
	write("S4_SRR_RL_Clu_Locationvalid_67 :%f",signalvalue1);
	write("i_S4_SRR_RL_Clu_Locationvalid_67 :%o",@ecu_Signals::i_S4_SRR_RL_Clu_Locationvalid_67);

	testStep("get expect variable value: ","i_S4_SRR_RL_Clu_Locationvalid_67 :%o",@ecu_Signals::i_S4_SRR_RL_Clu_Locationvalid_67);

	if(signalvalue1==@ecu_Signals::i_S4_SRR_RL_Clu_Locationvalid_67)
	{
	testStepPass("Pass","i_S4_SRR_RL_Clu_Locationvalid_67 :%f",signalvalue1);
	}
	else
	{
	testStepFail("Fail","i_S4_SRR_RL_Clu_Locationvalid_67 :%f",signalvalue1);
	}
}

testcase S4_SRR_RL_Clu_Mes_9_S4_SRR_RL_Clu_Theta_68()
{
	signalvalue1 = getSignal(S4_SRR_RL_Clu_Theta_68);
	write("S4_SRR_RL_Clu_Theta_68 :%f",signalvalue1);
	write("i_S4_SRR_RL_Clu_Theta_68 :%f",@ecu_Signals::i_S4_SRR_RL_Clu_Theta_68);

	testStep("get expect variable value: ","i_S4_SRR_RL_Clu_Theta_68 :%f",@ecu_Signals::i_S4_SRR_RL_Clu_Theta_68);

	if((abs(@ecu_Signals::i_S4_SRR_RL_Clu_Theta_68)*0.9<=abs(signalvalue1))&&(abs(signalvalue1)<=abs(@ecu_Signals::i_S4_SRR_RL_Clu_Theta_68)*1.1))
	{
	testStepPass("Pass","i_S4_SRR_RL_Clu_Theta_68 :%f",signalvalue1);
	}
	else
	{
	testStepFail("Fail","i_S4_SRR_RL_Clu_Theta_68 :%f",signalvalue1);
	}
}

testcase S4_SRR_RL_Clu_Mes_9_S4_SRR_RL_Clu_Dist_68()
{
	signalvalue1 = getSignal(S4_SRR_RL_Clu_Dist_68);
	write("S4_SRR_RL_Clu_Dist_68 :%f",signalvalue1);
	write("i_S4_SRR_RL_Clu_Dist_68 :%f",@ecu_Signals::i_S4_SRR_RL_Clu_Dist_68);

	testStep("get expect variable value: ","i_S4_SRR_RL_Clu_Dist_68 :%f",@ecu_Signals::i_S4_SRR_RL_Clu_Dist_68);

	if((abs(@ecu_Signals::i_S4_SRR_RL_Clu_Dist_68)*0.9<=abs(signalvalue1))&&(abs(signalvalue1)<=abs(@ecu_Signals::i_S4_SRR_RL_Clu_Dist_68)*1.1))
	{
	testStepPass("Pass","i_S4_SRR_RL_Clu_Dist_68 :%f",signalvalue1);
	}
	else
	{
	testStepFail("Fail","i_S4_SRR_RL_Clu_Dist_68 :%f",signalvalue1);
	}
}

testcase S4_SRR_RL_Clu_Mes_9_S4_SRR_RL_Clu_Vel_68()
{
	signalvalue1 = getSignal(S4_SRR_RL_Clu_Vel_68);
	write("S4_SRR_RL_Clu_Vel_68 :%f",signalvalue1);
	write("i_S4_SRR_RL_Clu_Vel_68 :%f",@ecu_Signals::i_S4_SRR_RL_Clu_Vel_68);

	testStep("get expect variable value: ","i_S4_SRR_RL_Clu_Vel_68 :%f",@ecu_Signals::i_S4_SRR_RL_Clu_Vel_68);

	if((abs(@ecu_Signals::i_S4_SRR_RL_Clu_Vel_68)*0.9<=abs(signalvalue1))&&(abs(signalvalue1)<=abs(@ecu_Signals::i_S4_SRR_RL_Clu_Vel_68)*1.1))
	{
	testStepPass("Pass","i_S4_SRR_RL_Clu_Vel_68 :%f",signalvalue1);
	}
	else
	{
	testStepFail("Fail","i_S4_SRR_RL_Clu_Vel_68 :%f",signalvalue1);
	}
}

testcase S4_SRR_RL_Clu_Mes_9_S4_SRR_RL_Clu_SNR_68()
{
	signalvalue1 = getSignal(S4_SRR_RL_Clu_SNR_68);
	write("S4_SRR_RL_Clu_SNR_68 :%f",signalvalue1);
	write("i_S4_SRR_RL_Clu_SNR_68 :%f",@ecu_Signals::i_S4_SRR_RL_Clu_SNR_68);

	testStep("get expect variable value: ","i_S4_SRR_RL_Clu_SNR_68 :%f",@ecu_Signals::i_S4_SRR_RL_Clu_SNR_68);

	if((abs(@ecu_Signals::i_S4_SRR_RL_Clu_SNR_68)*0.9<=abs(signalvalue1))&&(abs(signalvalue1)<=abs(@ecu_Signals::i_S4_SRR_RL_Clu_SNR_68)*1.1))
	{
	testStepPass("Pass","i_S4_SRR_RL_Clu_SNR_68 :%f",signalvalue1);
	}
	else
	{
	testStepFail("Fail","i_S4_SRR_RL_Clu_SNR_68 :%f",signalvalue1);
	}
}

testcase S4_SRR_RL_Clu_Mes_9_S4_SRR_RL_Clu_DynProp_68()
{
	signalvalue1 = getSignal(S4_SRR_RL_Clu_DynProp_68);
	write("S4_SRR_RL_Clu_DynProp_68 :%f",signalvalue1);
	write("i_S4_SRR_RL_Clu_DynProp_68 :%o",@ecu_Signals::i_S4_SRR_RL_Clu_DynProp_68);

	testStep("get expect variable value: ","i_S4_SRR_RL_Clu_DynProp_68 :%o",@ecu_Signals::i_S4_SRR_RL_Clu_DynProp_68);

	if(signalvalue1==@ecu_Signals::i_S4_SRR_RL_Clu_DynProp_68)
	{
	testStepPass("Pass","i_S4_SRR_RL_Clu_DynProp_68 :%f",signalvalue1);
	}
	else
	{
	testStepFail("Fail","i_S4_SRR_RL_Clu_DynProp_68 :%f",signalvalue1);
	}
}

testcase S4_SRR_RL_Clu_Mes_9_S4_SRR_RL_Clu_Locationvalid_68()
{
	signalvalue1 = getSignal(S4_SRR_RL_Clu_Locationvalid_68);
	write("S4_SRR_RL_Clu_Locationvalid_68 :%f",signalvalue1);
	write("i_S4_SRR_RL_Clu_Locationvalid_68 :%o",@ecu_Signals::i_S4_SRR_RL_Clu_Locationvalid_68);

	testStep("get expect variable value: ","i_S4_SRR_RL_Clu_Locationvalid_68 :%o",@ecu_Signals::i_S4_SRR_RL_Clu_Locationvalid_68);

	if(signalvalue1==@ecu_Signals::i_S4_SRR_RL_Clu_Locationvalid_68)
	{
	testStepPass("Pass","i_S4_SRR_RL_Clu_Locationvalid_68 :%f",signalvalue1);
	}
	else
	{
	testStepFail("Fail","i_S4_SRR_RL_Clu_Locationvalid_68 :%f",signalvalue1);
	}
}

testcase S4_SRR_RL_Clu_Mes_9_S4_SRR_RL_Clu_Theta_69()
{
	signalvalue1 = getSignal(S4_SRR_RL_Clu_Theta_69);
	write("S4_SRR_RL_Clu_Theta_69 :%f",signalvalue1);
	write("i_S4_SRR_RL_Clu_Theta_69 :%f",@ecu_Signals::i_S4_SRR_RL_Clu_Theta_69);

	testStep("get expect variable value: ","i_S4_SRR_RL_Clu_Theta_69 :%f",@ecu_Signals::i_S4_SRR_RL_Clu_Theta_69);

	if((abs(@ecu_Signals::i_S4_SRR_RL_Clu_Theta_69)*0.9<=abs(signalvalue1))&&(abs(signalvalue1)<=abs(@ecu_Signals::i_S4_SRR_RL_Clu_Theta_69)*1.1))
	{
	testStepPass("Pass","i_S4_SRR_RL_Clu_Theta_69 :%f",signalvalue1);
	}
	else
	{
	testStepFail("Fail","i_S4_SRR_RL_Clu_Theta_69 :%f",signalvalue1);
	}
}

testcase S4_SRR_RL_Clu_Mes_9_S4_SRR_RL_Clu_Dist_69()
{
	signalvalue1 = getSignal(S4_SRR_RL_Clu_Dist_69);
	write("S4_SRR_RL_Clu_Dist_69 :%f",signalvalue1);
	write("i_S4_SRR_RL_Clu_Dist_69 :%f",@ecu_Signals::i_S4_SRR_RL_Clu_Dist_69);

	testStep("get expect variable value: ","i_S4_SRR_RL_Clu_Dist_69 :%f",@ecu_Signals::i_S4_SRR_RL_Clu_Dist_69);

	if((abs(@ecu_Signals::i_S4_SRR_RL_Clu_Dist_69)*0.9<=abs(signalvalue1))&&(abs(signalvalue1)<=abs(@ecu_Signals::i_S4_SRR_RL_Clu_Dist_69)*1.1))
	{
	testStepPass("Pass","i_S4_SRR_RL_Clu_Dist_69 :%f",signalvalue1);
	}
	else
	{
	testStepFail("Fail","i_S4_SRR_RL_Clu_Dist_69 :%f",signalvalue1);
	}
}

testcase S4_SRR_RL_Clu_Mes_9_S4_SRR_RL_Clu_Vel_69()
{
	signalvalue1 = getSignal(S4_SRR_RL_Clu_Vel_69);
	write("S4_SRR_RL_Clu_Vel_69 :%f",signalvalue1);
	write("i_S4_SRR_RL_Clu_Vel_69 :%f",@ecu_Signals::i_S4_SRR_RL_Clu_Vel_69);

	testStep("get expect variable value: ","i_S4_SRR_RL_Clu_Vel_69 :%f",@ecu_Signals::i_S4_SRR_RL_Clu_Vel_69);

	if((abs(@ecu_Signals::i_S4_SRR_RL_Clu_Vel_69)*0.9<=abs(signalvalue1))&&(abs(signalvalue1)<=abs(@ecu_Signals::i_S4_SRR_RL_Clu_Vel_69)*1.1))
	{
	testStepPass("Pass","i_S4_SRR_RL_Clu_Vel_69 :%f",signalvalue1);
	}
	else
	{
	testStepFail("Fail","i_S4_SRR_RL_Clu_Vel_69 :%f",signalvalue1);
	}
}

testcase S4_SRR_RL_Clu_Mes_9_S4_SRR_RL_Clu_SNR_69()
{
	signalvalue1 = getSignal(S4_SRR_RL_Clu_SNR_69);
	write("S4_SRR_RL_Clu_SNR_69 :%f",signalvalue1);
	write("i_S4_SRR_RL_Clu_SNR_69 :%f",@ecu_Signals::i_S4_SRR_RL_Clu_SNR_69);

	testStep("get expect variable value: ","i_S4_SRR_RL_Clu_SNR_69 :%f",@ecu_Signals::i_S4_SRR_RL_Clu_SNR_69);

	if((abs(@ecu_Signals::i_S4_SRR_RL_Clu_SNR_69)*0.9<=abs(signalvalue1))&&(abs(signalvalue1)<=abs(@ecu_Signals::i_S4_SRR_RL_Clu_SNR_69)*1.1))
	{
	testStepPass("Pass","i_S4_SRR_RL_Clu_SNR_69 :%f",signalvalue1);
	}
	else
	{
	testStepFail("Fail","i_S4_SRR_RL_Clu_SNR_69 :%f",signalvalue1);
	}
}

testcase S4_SRR_RL_Clu_Mes_9_S4_SRR_RL_Clu_DynProp_69()
{
	signalvalue1 = getSignal(S4_SRR_RL_Clu_DynProp_69);
	write("S4_SRR_RL_Clu_DynProp_69 :%f",signalvalue1);
	write("i_S4_SRR_RL_Clu_DynProp_69 :%o",@ecu_Signals::i_S4_SRR_RL_Clu_DynProp_69);

	testStep("get expect variable value: ","i_S4_SRR_RL_Clu_DynProp_69 :%o",@ecu_Signals::i_S4_SRR_RL_Clu_DynProp_69);

	if(signalvalue1==@ecu_Signals::i_S4_SRR_RL_Clu_DynProp_69)
	{
	testStepPass("Pass","i_S4_SRR_RL_Clu_DynProp_69 :%f",signalvalue1);
	}
	else
	{
	testStepFail("Fail","i_S4_SRR_RL_Clu_DynProp_69 :%f",signalvalue1);
	}
}

testcase S4_SRR_RL_Clu_Mes_9_S4_SRR_RL_Clu_Locationvalid_69()
{
	signalvalue1 = getSignal(S4_SRR_RL_Clu_Locationvalid_69);
	write("S4_SRR_RL_Clu_Locationvalid_69 :%f",signalvalue1);
	write("i_S4_SRR_RL_Clu_Locationvalid_69 :%o",@ecu_Signals::i_S4_SRR_RL_Clu_Locationvalid_69);

	testStep("get expect variable value: ","i_S4_SRR_RL_Clu_Locationvalid_69 :%o",@ecu_Signals::i_S4_SRR_RL_Clu_Locationvalid_69);

	if(signalvalue1==@ecu_Signals::i_S4_SRR_RL_Clu_Locationvalid_69)
	{
	testStepPass("Pass","i_S4_SRR_RL_Clu_Locationvalid_69 :%f",signalvalue1);
	}
	else
	{
	testStepFail("Fail","i_S4_SRR_RL_Clu_Locationvalid_69 :%f",signalvalue1);
	}
}

testcase S4_SRR_RL_Clu_Mes_10_S4_SRR_RL_Clu_Theta_70()
{
	signalvalue1 = getSignal(S4_SRR_RL_Clu_Theta_70);
	write("S4_SRR_RL_Clu_Theta_70 :%f",signalvalue1);
	write("i_S4_SRR_RL_Clu_Theta_70 :%f",@ecu_Signals::i_S4_SRR_RL_Clu_Theta_70);

	testStep("get expect variable value: ","i_S4_SRR_RL_Clu_Theta_70 :%f",@ecu_Signals::i_S4_SRR_RL_Clu_Theta_70);

	if((abs(@ecu_Signals::i_S4_SRR_RL_Clu_Theta_70)*0.9<=abs(signalvalue1))&&(abs(signalvalue1)<=abs(@ecu_Signals::i_S4_SRR_RL_Clu_Theta_70)*1.1))
	{
	testStepPass("Pass","i_S4_SRR_RL_Clu_Theta_70 :%f",signalvalue1);
	}
	else
	{
	testStepFail("Fail","i_S4_SRR_RL_Clu_Theta_70 :%f",signalvalue1);
	}
}

testcase S4_SRR_RL_Clu_Mes_10_S4_SRR_RL_Clu_Dist_70()
{
	signalvalue1 = getSignal(S4_SRR_RL_Clu_Dist_70);
	write("S4_SRR_RL_Clu_Dist_70 :%f",signalvalue1);
	write("i_S4_SRR_RL_Clu_Dist_70 :%f",@ecu_Signals::i_S4_SRR_RL_Clu_Dist_70);

	testStep("get expect variable value: ","i_S4_SRR_RL_Clu_Dist_70 :%f",@ecu_Signals::i_S4_SRR_RL_Clu_Dist_70);

	if((abs(@ecu_Signals::i_S4_SRR_RL_Clu_Dist_70)*0.9<=abs(signalvalue1))&&(abs(signalvalue1)<=abs(@ecu_Signals::i_S4_SRR_RL_Clu_Dist_70)*1.1))
	{
	testStepPass("Pass","i_S4_SRR_RL_Clu_Dist_70 :%f",signalvalue1);
	}
	else
	{
	testStepFail("Fail","i_S4_SRR_RL_Clu_Dist_70 :%f",signalvalue1);
	}
}

testcase S4_SRR_RL_Clu_Mes_10_S4_SRR_RL_Clu_Vel_70()
{
	signalvalue1 = getSignal(S4_SRR_RL_Clu_Vel_70);
	write("S4_SRR_RL_Clu_Vel_70 :%f",signalvalue1);
	write("i_S4_SRR_RL_Clu_Vel_70 :%f",@ecu_Signals::i_S4_SRR_RL_Clu_Vel_70);

	testStep("get expect variable value: ","i_S4_SRR_RL_Clu_Vel_70 :%f",@ecu_Signals::i_S4_SRR_RL_Clu_Vel_70);

	if((abs(@ecu_Signals::i_S4_SRR_RL_Clu_Vel_70)*0.9<=abs(signalvalue1))&&(abs(signalvalue1)<=abs(@ecu_Signals::i_S4_SRR_RL_Clu_Vel_70)*1.1))
	{
	testStepPass("Pass","i_S4_SRR_RL_Clu_Vel_70 :%f",signalvalue1);
	}
	else
	{
	testStepFail("Fail","i_S4_SRR_RL_Clu_Vel_70 :%f",signalvalue1);
	}
}

testcase S4_SRR_RL_Clu_Mes_10_S4_SRR_RL_Clu_SNR_70()
{
	signalvalue1 = getSignal(S4_SRR_RL_Clu_SNR_70);
	write("S4_SRR_RL_Clu_SNR_70 :%f",signalvalue1);
	write("i_S4_SRR_RL_Clu_SNR_70 :%f",@ecu_Signals::i_S4_SRR_RL_Clu_SNR_70);

	testStep("get expect variable value: ","i_S4_SRR_RL_Clu_SNR_70 :%f",@ecu_Signals::i_S4_SRR_RL_Clu_SNR_70);

	if((abs(@ecu_Signals::i_S4_SRR_RL_Clu_SNR_70)*0.9<=abs(signalvalue1))&&(abs(signalvalue1)<=abs(@ecu_Signals::i_S4_SRR_RL_Clu_SNR_70)*1.1))
	{
	testStepPass("Pass","i_S4_SRR_RL_Clu_SNR_70 :%f",signalvalue1);
	}
	else
	{
	testStepFail("Fail","i_S4_SRR_RL_Clu_SNR_70 :%f",signalvalue1);
	}
}

testcase S4_SRR_RL_Clu_Mes_10_S4_SRR_RL_Clu_DynProp_70()
{
	signalvalue1 = getSignal(S4_SRR_RL_Clu_DynProp_70);
	write("S4_SRR_RL_Clu_DynProp_70 :%f",signalvalue1);
	write("i_S4_SRR_RL_Clu_DynProp_70 :%o",@ecu_Signals::i_S4_SRR_RL_Clu_DynProp_70);

	testStep("get expect variable value: ","i_S4_SRR_RL_Clu_DynProp_70 :%o",@ecu_Signals::i_S4_SRR_RL_Clu_DynProp_70);

	if(signalvalue1==@ecu_Signals::i_S4_SRR_RL_Clu_DynProp_70)
	{
	testStepPass("Pass","i_S4_SRR_RL_Clu_DynProp_70 :%f",signalvalue1);
	}
	else
	{
	testStepFail("Fail","i_S4_SRR_RL_Clu_DynProp_70 :%f",signalvalue1);
	}
}

testcase S4_SRR_RL_Clu_Mes_10_S4_SRR_RL_Clu_Locationvalid_70()
{
	signalvalue1 = getSignal(S4_SRR_RL_Clu_Locationvalid_70);
	write("S4_SRR_RL_Clu_Locationvalid_70 :%f",signalvalue1);
	write("i_S4_SRR_RL_Clu_Locationvalid_70 :%o",@ecu_Signals::i_S4_SRR_RL_Clu_Locationvalid_70);

	testStep("get expect variable value: ","i_S4_SRR_RL_Clu_Locationvalid_70 :%o",@ecu_Signals::i_S4_SRR_RL_Clu_Locationvalid_70);

	if(signalvalue1==@ecu_Signals::i_S4_SRR_RL_Clu_Locationvalid_70)
	{
	testStepPass("Pass","i_S4_SRR_RL_Clu_Locationvalid_70 :%f",signalvalue1);
	}
	else
	{
	testStepFail("Fail","i_S4_SRR_RL_Clu_Locationvalid_70 :%f",signalvalue1);
	}
}

testcase S4_SRR_RL_Clu_Mes_10_S4_SRR_RL_Clu_Theta_71()
{
	signalvalue1 = getSignal(S4_SRR_RL_Clu_Theta_71);
	write("S4_SRR_RL_Clu_Theta_71 :%f",signalvalue1);
	write("i_S4_SRR_RL_Clu_Theta_71 :%f",@ecu_Signals::i_S4_SRR_RL_Clu_Theta_71);

	testStep("get expect variable value: ","i_S4_SRR_RL_Clu_Theta_71 :%f",@ecu_Signals::i_S4_SRR_RL_Clu_Theta_71);

	if((abs(@ecu_Signals::i_S4_SRR_RL_Clu_Theta_71)*0.9<=abs(signalvalue1))&&(abs(signalvalue1)<=abs(@ecu_Signals::i_S4_SRR_RL_Clu_Theta_71)*1.1))
	{
	testStepPass("Pass","i_S4_SRR_RL_Clu_Theta_71 :%f",signalvalue1);
	}
	else
	{
	testStepFail("Fail","i_S4_SRR_RL_Clu_Theta_71 :%f",signalvalue1);
	}
}

testcase S4_SRR_RL_Clu_Mes_10_S4_SRR_RL_Clu_Dist_71()
{
	signalvalue1 = getSignal(S4_SRR_RL_Clu_Dist_71);
	write("S4_SRR_RL_Clu_Dist_71 :%f",signalvalue1);
	write("i_S4_SRR_RL_Clu_Dist_71 :%f",@ecu_Signals::i_S4_SRR_RL_Clu_Dist_71);

	testStep("get expect variable value: ","i_S4_SRR_RL_Clu_Dist_71 :%f",@ecu_Signals::i_S4_SRR_RL_Clu_Dist_71);

	if((abs(@ecu_Signals::i_S4_SRR_RL_Clu_Dist_71)*0.9<=abs(signalvalue1))&&(abs(signalvalue1)<=abs(@ecu_Signals::i_S4_SRR_RL_Clu_Dist_71)*1.1))
	{
	testStepPass("Pass","i_S4_SRR_RL_Clu_Dist_71 :%f",signalvalue1);
	}
	else
	{
	testStepFail("Fail","i_S4_SRR_RL_Clu_Dist_71 :%f",signalvalue1);
	}
}

testcase S4_SRR_RL_Clu_Mes_10_S4_SRR_RL_Clu_Vel_71()
{
	signalvalue1 = getSignal(S4_SRR_RL_Clu_Vel_71);
	write("S4_SRR_RL_Clu_Vel_71 :%f",signalvalue1);
	write("i_S4_SRR_RL_Clu_Vel_71 :%f",@ecu_Signals::i_S4_SRR_RL_Clu_Vel_71);

	testStep("get expect variable value: ","i_S4_SRR_RL_Clu_Vel_71 :%f",@ecu_Signals::i_S4_SRR_RL_Clu_Vel_71);

	if((abs(@ecu_Signals::i_S4_SRR_RL_Clu_Vel_71)*0.9<=abs(signalvalue1))&&(abs(signalvalue1)<=abs(@ecu_Signals::i_S4_SRR_RL_Clu_Vel_71)*1.1))
	{
	testStepPass("Pass","i_S4_SRR_RL_Clu_Vel_71 :%f",signalvalue1);
	}
	else
	{
	testStepFail("Fail","i_S4_SRR_RL_Clu_Vel_71 :%f",signalvalue1);
	}
}

testcase S4_SRR_RL_Clu_Mes_10_S4_SRR_RL_Clu_SNR_71()
{
	signalvalue1 = getSignal(S4_SRR_RL_Clu_SNR_71);
	write("S4_SRR_RL_Clu_SNR_71 :%f",signalvalue1);
	write("i_S4_SRR_RL_Clu_SNR_71 :%f",@ecu_Signals::i_S4_SRR_RL_Clu_SNR_71);

	testStep("get expect variable value: ","i_S4_SRR_RL_Clu_SNR_71 :%f",@ecu_Signals::i_S4_SRR_RL_Clu_SNR_71);

	if((abs(@ecu_Signals::i_S4_SRR_RL_Clu_SNR_71)*0.9<=abs(signalvalue1))&&(abs(signalvalue1)<=abs(@ecu_Signals::i_S4_SRR_RL_Clu_SNR_71)*1.1))
	{
	testStepPass("Pass","i_S4_SRR_RL_Clu_SNR_71 :%f",signalvalue1);
	}
	else
	{
	testStepFail("Fail","i_S4_SRR_RL_Clu_SNR_71 :%f",signalvalue1);
	}
}

testcase S4_SRR_RL_Clu_Mes_10_S4_SRR_RL_Clu_DynProp_71()
{
	signalvalue1 = getSignal(S4_SRR_RL_Clu_DynProp_71);
	write("S4_SRR_RL_Clu_DynProp_71 :%f",signalvalue1);
	write("i_S4_SRR_RL_Clu_DynProp_71 :%o",@ecu_Signals::i_S4_SRR_RL_Clu_DynProp_71);

	testStep("get expect variable value: ","i_S4_SRR_RL_Clu_DynProp_71 :%o",@ecu_Signals::i_S4_SRR_RL_Clu_DynProp_71);

	if(signalvalue1==@ecu_Signals::i_S4_SRR_RL_Clu_DynProp_71)
	{
	testStepPass("Pass","i_S4_SRR_RL_Clu_DynProp_71 :%f",signalvalue1);
	}
	else
	{
	testStepFail("Fail","i_S4_SRR_RL_Clu_DynProp_71 :%f",signalvalue1);
	}
}

testcase S4_SRR_RL_Clu_Mes_10_S4_SRR_RL_Clu_Locationvalid_71()
{
	signalvalue1 = getSignal(S4_SRR_RL_Clu_Locationvalid_71);
	write("S4_SRR_RL_Clu_Locationvalid_71 :%f",signalvalue1);
	write("i_S4_SRR_RL_Clu_Locationvalid_71 :%o",@ecu_Signals::i_S4_SRR_RL_Clu_Locationvalid_71);

	testStep("get expect variable value: ","i_S4_SRR_RL_Clu_Locationvalid_71 :%o",@ecu_Signals::i_S4_SRR_RL_Clu_Locationvalid_71);

	if(signalvalue1==@ecu_Signals::i_S4_SRR_RL_Clu_Locationvalid_71)
	{
	testStepPass("Pass","i_S4_SRR_RL_Clu_Locationvalid_71 :%f",signalvalue1);
	}
	else
	{
	testStepFail("Fail","i_S4_SRR_RL_Clu_Locationvalid_71 :%f",signalvalue1);
	}
}

testcase S4_SRR_RL_Clu_Mes_10_S4_SRR_RL_Clu_Theta_72()
{
	signalvalue1 = getSignal(S4_SRR_RL_Clu_Theta_72);
	write("S4_SRR_RL_Clu_Theta_72 :%f",signalvalue1);
	write("i_S4_SRR_RL_Clu_Theta_72 :%f",@ecu_Signals::i_S4_SRR_RL_Clu_Theta_72);

	testStep("get expect variable value: ","i_S4_SRR_RL_Clu_Theta_72 :%f",@ecu_Signals::i_S4_SRR_RL_Clu_Theta_72);

	if((abs(@ecu_Signals::i_S4_SRR_RL_Clu_Theta_72)*0.9<=abs(signalvalue1))&&(abs(signalvalue1)<=abs(@ecu_Signals::i_S4_SRR_RL_Clu_Theta_72)*1.1))
	{
	testStepPass("Pass","i_S4_SRR_RL_Clu_Theta_72 :%f",signalvalue1);
	}
	else
	{
	testStepFail("Fail","i_S4_SRR_RL_Clu_Theta_72 :%f",signalvalue1);
	}
}

testcase S4_SRR_RL_Clu_Mes_10_S4_SRR_RL_Clu_Dist_72()
{
	signalvalue1 = getSignal(S4_SRR_RL_Clu_Dist_72);
	write("S4_SRR_RL_Clu_Dist_72 :%f",signalvalue1);
	write("i_S4_SRR_RL_Clu_Dist_72 :%f",@ecu_Signals::i_S4_SRR_RL_Clu_Dist_72);

	testStep("get expect variable value: ","i_S4_SRR_RL_Clu_Dist_72 :%f",@ecu_Signals::i_S4_SRR_RL_Clu_Dist_72);

	if((abs(@ecu_Signals::i_S4_SRR_RL_Clu_Dist_72)*0.9<=abs(signalvalue1))&&(abs(signalvalue1)<=abs(@ecu_Signals::i_S4_SRR_RL_Clu_Dist_72)*1.1))
	{
	testStepPass("Pass","i_S4_SRR_RL_Clu_Dist_72 :%f",signalvalue1);
	}
	else
	{
	testStepFail("Fail","i_S4_SRR_RL_Clu_Dist_72 :%f",signalvalue1);
	}
}

testcase S4_SRR_RL_Clu_Mes_10_S4_SRR_RL_Clu_Vel_72()
{
	signalvalue1 = getSignal(S4_SRR_RL_Clu_Vel_72);
	write("S4_SRR_RL_Clu_Vel_72 :%f",signalvalue1);
	write("i_S4_SRR_RL_Clu_Vel_72 :%f",@ecu_Signals::i_S4_SRR_RL_Clu_Vel_72);

	testStep("get expect variable value: ","i_S4_SRR_RL_Clu_Vel_72 :%f",@ecu_Signals::i_S4_SRR_RL_Clu_Vel_72);

	if((abs(@ecu_Signals::i_S4_SRR_RL_Clu_Vel_72)*0.9<=abs(signalvalue1))&&(abs(signalvalue1)<=abs(@ecu_Signals::i_S4_SRR_RL_Clu_Vel_72)*1.1))
	{
	testStepPass("Pass","i_S4_SRR_RL_Clu_Vel_72 :%f",signalvalue1);
	}
	else
	{
	testStepFail("Fail","i_S4_SRR_RL_Clu_Vel_72 :%f",signalvalue1);
	}
}

testcase S4_SRR_RL_Clu_Mes_10_S4_SRR_RL_Clu_SNR_72()
{
	signalvalue1 = getSignal(S4_SRR_RL_Clu_SNR_72);
	write("S4_SRR_RL_Clu_SNR_72 :%f",signalvalue1);
	write("i_S4_SRR_RL_Clu_SNR_72 :%f",@ecu_Signals::i_S4_SRR_RL_Clu_SNR_72);

	testStep("get expect variable value: ","i_S4_SRR_RL_Clu_SNR_72 :%f",@ecu_Signals::i_S4_SRR_RL_Clu_SNR_72);

	if((abs(@ecu_Signals::i_S4_SRR_RL_Clu_SNR_72)*0.9<=abs(signalvalue1))&&(abs(signalvalue1)<=abs(@ecu_Signals::i_S4_SRR_RL_Clu_SNR_72)*1.1))
	{
	testStepPass("Pass","i_S4_SRR_RL_Clu_SNR_72 :%f",signalvalue1);
	}
	else
	{
	testStepFail("Fail","i_S4_SRR_RL_Clu_SNR_72 :%f",signalvalue1);
	}
}

testcase S4_SRR_RL_Clu_Mes_10_S4_SRR_RL_Clu_DynProp_72()
{
	signalvalue1 = getSignal(S4_SRR_RL_Clu_DynProp_72);
	write("S4_SRR_RL_Clu_DynProp_72 :%f",signalvalue1);
	write("i_S4_SRR_RL_Clu_DynProp_72 :%o",@ecu_Signals::i_S4_SRR_RL_Clu_DynProp_72);

	testStep("get expect variable value: ","i_S4_SRR_RL_Clu_DynProp_72 :%o",@ecu_Signals::i_S4_SRR_RL_Clu_DynProp_72);

	if(signalvalue1==@ecu_Signals::i_S4_SRR_RL_Clu_DynProp_72)
	{
	testStepPass("Pass","i_S4_SRR_RL_Clu_DynProp_72 :%f",signalvalue1);
	}
	else
	{
	testStepFail("Fail","i_S4_SRR_RL_Clu_DynProp_72 :%f",signalvalue1);
	}
}

testcase S4_SRR_RL_Clu_Mes_10_S4_SRR_RL_Clu_Locationvalid_72()
{
	signalvalue1 = getSignal(S4_SRR_RL_Clu_Locationvalid_72);
	write("S4_SRR_RL_Clu_Locationvalid_72 :%f",signalvalue1);
	write("i_S4_SRR_RL_Clu_Locationvalid_72 :%o",@ecu_Signals::i_S4_SRR_RL_Clu_Locationvalid_72);

	testStep("get expect variable value: ","i_S4_SRR_RL_Clu_Locationvalid_72 :%o",@ecu_Signals::i_S4_SRR_RL_Clu_Locationvalid_72);

	if(signalvalue1==@ecu_Signals::i_S4_SRR_RL_Clu_Locationvalid_72)
	{
	testStepPass("Pass","i_S4_SRR_RL_Clu_Locationvalid_72 :%f",signalvalue1);
	}
	else
	{
	testStepFail("Fail","i_S4_SRR_RL_Clu_Locationvalid_72 :%f",signalvalue1);
	}
}

testcase S4_SRR_RL_Clu_Mes_10_S4_SRR_RL_Clu_Theta_73()
{
	signalvalue1 = getSignal(S4_SRR_RL_Clu_Theta_73);
	write("S4_SRR_RL_Clu_Theta_73 :%f",signalvalue1);
	write("i_S4_SRR_RL_Clu_Theta_73 :%f",@ecu_Signals::i_S4_SRR_RL_Clu_Theta_73);

	testStep("get expect variable value: ","i_S4_SRR_RL_Clu_Theta_73 :%f",@ecu_Signals::i_S4_SRR_RL_Clu_Theta_73);

	if((abs(@ecu_Signals::i_S4_SRR_RL_Clu_Theta_73)*0.9<=abs(signalvalue1))&&(abs(signalvalue1)<=abs(@ecu_Signals::i_S4_SRR_RL_Clu_Theta_73)*1.1))
	{
	testStepPass("Pass","i_S4_SRR_RL_Clu_Theta_73 :%f",signalvalue1);
	}
	else
	{
	testStepFail("Fail","i_S4_SRR_RL_Clu_Theta_73 :%f",signalvalue1);
	}
}

testcase S4_SRR_RL_Clu_Mes_10_S4_SRR_RL_Clu_Dist_73()
{
	signalvalue1 = getSignal(S4_SRR_RL_Clu_Dist_73);
	write("S4_SRR_RL_Clu_Dist_73 :%f",signalvalue1);
	write("i_S4_SRR_RL_Clu_Dist_73 :%f",@ecu_Signals::i_S4_SRR_RL_Clu_Dist_73);

	testStep("get expect variable value: ","i_S4_SRR_RL_Clu_Dist_73 :%f",@ecu_Signals::i_S4_SRR_RL_Clu_Dist_73);

	if((abs(@ecu_Signals::i_S4_SRR_RL_Clu_Dist_73)*0.9<=abs(signalvalue1))&&(abs(signalvalue1)<=abs(@ecu_Signals::i_S4_SRR_RL_Clu_Dist_73)*1.1))
	{
	testStepPass("Pass","i_S4_SRR_RL_Clu_Dist_73 :%f",signalvalue1);
	}
	else
	{
	testStepFail("Fail","i_S4_SRR_RL_Clu_Dist_73 :%f",signalvalue1);
	}
}

testcase S4_SRR_RL_Clu_Mes_10_S4_SRR_RL_Clu_Vel_73()
{
	signalvalue1 = getSignal(S4_SRR_RL_Clu_Vel_73);
	write("S4_SRR_RL_Clu_Vel_73 :%f",signalvalue1);
	write("i_S4_SRR_RL_Clu_Vel_73 :%f",@ecu_Signals::i_S4_SRR_RL_Clu_Vel_73);

	testStep("get expect variable value: ","i_S4_SRR_RL_Clu_Vel_73 :%f",@ecu_Signals::i_S4_SRR_RL_Clu_Vel_73);

	if((abs(@ecu_Signals::i_S4_SRR_RL_Clu_Vel_73)*0.9<=abs(signalvalue1))&&(abs(signalvalue1)<=abs(@ecu_Signals::i_S4_SRR_RL_Clu_Vel_73)*1.1))
	{
	testStepPass("Pass","i_S4_SRR_RL_Clu_Vel_73 :%f",signalvalue1);
	}
	else
	{
	testStepFail("Fail","i_S4_SRR_RL_Clu_Vel_73 :%f",signalvalue1);
	}
}

testcase S4_SRR_RL_Clu_Mes_10_S4_SRR_RL_Clu_SNR_73()
{
	signalvalue1 = getSignal(S4_SRR_RL_Clu_SNR_73);
	write("S4_SRR_RL_Clu_SNR_73 :%f",signalvalue1);
	write("i_S4_SRR_RL_Clu_SNR_73 :%f",@ecu_Signals::i_S4_SRR_RL_Clu_SNR_73);

	testStep("get expect variable value: ","i_S4_SRR_RL_Clu_SNR_73 :%f",@ecu_Signals::i_S4_SRR_RL_Clu_SNR_73);

	if((abs(@ecu_Signals::i_S4_SRR_RL_Clu_SNR_73)*0.9<=abs(signalvalue1))&&(abs(signalvalue1)<=abs(@ecu_Signals::i_S4_SRR_RL_Clu_SNR_73)*1.1))
	{
	testStepPass("Pass","i_S4_SRR_RL_Clu_SNR_73 :%f",signalvalue1);
	}
	else
	{
	testStepFail("Fail","i_S4_SRR_RL_Clu_SNR_73 :%f",signalvalue1);
	}
}

testcase S4_SRR_RL_Clu_Mes_10_S4_SRR_RL_Clu_DynProp_73()
{
	signalvalue1 = getSignal(S4_SRR_RL_Clu_DynProp_73);
	write("S4_SRR_RL_Clu_DynProp_73 :%f",signalvalue1);
	write("i_S4_SRR_RL_Clu_DynProp_73 :%o",@ecu_Signals::i_S4_SRR_RL_Clu_DynProp_73);

	testStep("get expect variable value: ","i_S4_SRR_RL_Clu_DynProp_73 :%o",@ecu_Signals::i_S4_SRR_RL_Clu_DynProp_73);

	if(signalvalue1==@ecu_Signals::i_S4_SRR_RL_Clu_DynProp_73)
	{
	testStepPass("Pass","i_S4_SRR_RL_Clu_DynProp_73 :%f",signalvalue1);
	}
	else
	{
	testStepFail("Fail","i_S4_SRR_RL_Clu_DynProp_73 :%f",signalvalue1);
	}
}

testcase S4_SRR_RL_Clu_Mes_10_S4_SRR_RL_Clu_Locationvalid_73()
{
	signalvalue1 = getSignal(S4_SRR_RL_Clu_Locationvalid_73);
	write("S4_SRR_RL_Clu_Locationvalid_73 :%f",signalvalue1);
	write("i_S4_SRR_RL_Clu_Locationvalid_73 :%o",@ecu_Signals::i_S4_SRR_RL_Clu_Locationvalid_73);

	testStep("get expect variable value: ","i_S4_SRR_RL_Clu_Locationvalid_73 :%o",@ecu_Signals::i_S4_SRR_RL_Clu_Locationvalid_73);

	if(signalvalue1==@ecu_Signals::i_S4_SRR_RL_Clu_Locationvalid_73)
	{
	testStepPass("Pass","i_S4_SRR_RL_Clu_Locationvalid_73 :%f",signalvalue1);
	}
	else
	{
	testStepFail("Fail","i_S4_SRR_RL_Clu_Locationvalid_73 :%f",signalvalue1);
	}
}

testcase S4_SRR_RL_Clu_Mes_10_S4_SRR_RL_Clu_Theta_74()
{
	signalvalue1 = getSignal(S4_SRR_RL_Clu_Theta_74);
	write("S4_SRR_RL_Clu_Theta_74 :%f",signalvalue1);
	write("i_S4_SRR_RL_Clu_Theta_74 :%f",@ecu_Signals::i_S4_SRR_RL_Clu_Theta_74);

	testStep("get expect variable value: ","i_S4_SRR_RL_Clu_Theta_74 :%f",@ecu_Signals::i_S4_SRR_RL_Clu_Theta_74);

	if((abs(@ecu_Signals::i_S4_SRR_RL_Clu_Theta_74)*0.9<=abs(signalvalue1))&&(abs(signalvalue1)<=abs(@ecu_Signals::i_S4_SRR_RL_Clu_Theta_74)*1.1))
	{
	testStepPass("Pass","i_S4_SRR_RL_Clu_Theta_74 :%f",signalvalue1);
	}
	else
	{
	testStepFail("Fail","i_S4_SRR_RL_Clu_Theta_74 :%f",signalvalue1);
	}
}

testcase S4_SRR_RL_Clu_Mes_10_S4_SRR_RL_Clu_Dist_74()
{
	signalvalue1 = getSignal(S4_SRR_RL_Clu_Dist_74);
	write("S4_SRR_RL_Clu_Dist_74 :%f",signalvalue1);
	write("i_S4_SRR_RL_Clu_Dist_74 :%f",@ecu_Signals::i_S4_SRR_RL_Clu_Dist_74);

	testStep("get expect variable value: ","i_S4_SRR_RL_Clu_Dist_74 :%f",@ecu_Signals::i_S4_SRR_RL_Clu_Dist_74);

	if((abs(@ecu_Signals::i_S4_SRR_RL_Clu_Dist_74)*0.9<=abs(signalvalue1))&&(abs(signalvalue1)<=abs(@ecu_Signals::i_S4_SRR_RL_Clu_Dist_74)*1.1))
	{
	testStepPass("Pass","i_S4_SRR_RL_Clu_Dist_74 :%f",signalvalue1);
	}
	else
	{
	testStepFail("Fail","i_S4_SRR_RL_Clu_Dist_74 :%f",signalvalue1);
	}
}

testcase S4_SRR_RL_Clu_Mes_10_S4_SRR_RL_Clu_Vel_74()
{
	signalvalue1 = getSignal(S4_SRR_RL_Clu_Vel_74);
	write("S4_SRR_RL_Clu_Vel_74 :%f",signalvalue1);
	write("i_S4_SRR_RL_Clu_Vel_74 :%f",@ecu_Signals::i_S4_SRR_RL_Clu_Vel_74);

	testStep("get expect variable value: ","i_S4_SRR_RL_Clu_Vel_74 :%f",@ecu_Signals::i_S4_SRR_RL_Clu_Vel_74);

	if((abs(@ecu_Signals::i_S4_SRR_RL_Clu_Vel_74)*0.9<=abs(signalvalue1))&&(abs(signalvalue1)<=abs(@ecu_Signals::i_S4_SRR_RL_Clu_Vel_74)*1.1))
	{
	testStepPass("Pass","i_S4_SRR_RL_Clu_Vel_74 :%f",signalvalue1);
	}
	else
	{
	testStepFail("Fail","i_S4_SRR_RL_Clu_Vel_74 :%f",signalvalue1);
	}
}

testcase S4_SRR_RL_Clu_Mes_10_S4_SRR_RL_Clu_SNR_74()
{
	signalvalue1 = getSignal(S4_SRR_RL_Clu_SNR_74);
	write("S4_SRR_RL_Clu_SNR_74 :%f",signalvalue1);
	write("i_S4_SRR_RL_Clu_SNR_74 :%f",@ecu_Signals::i_S4_SRR_RL_Clu_SNR_74);

	testStep("get expect variable value: ","i_S4_SRR_RL_Clu_SNR_74 :%f",@ecu_Signals::i_S4_SRR_RL_Clu_SNR_74);

	if((abs(@ecu_Signals::i_S4_SRR_RL_Clu_SNR_74)*0.9<=abs(signalvalue1))&&(abs(signalvalue1)<=abs(@ecu_Signals::i_S4_SRR_RL_Clu_SNR_74)*1.1))
	{
	testStepPass("Pass","i_S4_SRR_RL_Clu_SNR_74 :%f",signalvalue1);
	}
	else
	{
	testStepFail("Fail","i_S4_SRR_RL_Clu_SNR_74 :%f",signalvalue1);
	}
}

testcase S4_SRR_RL_Clu_Mes_10_S4_SRR_RL_Clu_DynProp_74()
{
	signalvalue1 = getSignal(S4_SRR_RL_Clu_DynProp_74);
	write("S4_SRR_RL_Clu_DynProp_74 :%f",signalvalue1);
	write("i_S4_SRR_RL_Clu_DynProp_74 :%o",@ecu_Signals::i_S4_SRR_RL_Clu_DynProp_74);

	testStep("get expect variable value: ","i_S4_SRR_RL_Clu_DynProp_74 :%o",@ecu_Signals::i_S4_SRR_RL_Clu_DynProp_74);

	if(signalvalue1==@ecu_Signals::i_S4_SRR_RL_Clu_DynProp_74)
	{
	testStepPass("Pass","i_S4_SRR_RL_Clu_DynProp_74 :%f",signalvalue1);
	}
	else
	{
	testStepFail("Fail","i_S4_SRR_RL_Clu_DynProp_74 :%f",signalvalue1);
	}
}

testcase S4_SRR_RL_Clu_Mes_10_S4_SRR_RL_Clu_Locationvalid_74()
{
	signalvalue1 = getSignal(S4_SRR_RL_Clu_Locationvalid_74);
	write("S4_SRR_RL_Clu_Locationvalid_74 :%f",signalvalue1);
	write("i_S4_SRR_RL_Clu_Locationvalid_74 :%o",@ecu_Signals::i_S4_SRR_RL_Clu_Locationvalid_74);

	testStep("get expect variable value: ","i_S4_SRR_RL_Clu_Locationvalid_74 :%o",@ecu_Signals::i_S4_SRR_RL_Clu_Locationvalid_74);

	if(signalvalue1==@ecu_Signals::i_S4_SRR_RL_Clu_Locationvalid_74)
	{
	testStepPass("Pass","i_S4_SRR_RL_Clu_Locationvalid_74 :%f",signalvalue1);
	}
	else
	{
	testStepFail("Fail","i_S4_SRR_RL_Clu_Locationvalid_74 :%f",signalvalue1);
	}
}

testcase S4_SRR_RL_Clu_Mes_10_S4_SRR_RL_Clu_Theta_75()
{
	signalvalue1 = getSignal(S4_SRR_RL_Clu_Theta_75);
	write("S4_SRR_RL_Clu_Theta_75 :%f",signalvalue1);
	write("i_S4_SRR_RL_Clu_Theta_75 :%f",@ecu_Signals::i_S4_SRR_RL_Clu_Theta_75);

	testStep("get expect variable value: ","i_S4_SRR_RL_Clu_Theta_75 :%f",@ecu_Signals::i_S4_SRR_RL_Clu_Theta_75);

	if((abs(@ecu_Signals::i_S4_SRR_RL_Clu_Theta_75)*0.9<=abs(signalvalue1))&&(abs(signalvalue1)<=abs(@ecu_Signals::i_S4_SRR_RL_Clu_Theta_75)*1.1))
	{
	testStepPass("Pass","i_S4_SRR_RL_Clu_Theta_75 :%f",signalvalue1);
	}
	else
	{
	testStepFail("Fail","i_S4_SRR_RL_Clu_Theta_75 :%f",signalvalue1);
	}
}

testcase S4_SRR_RL_Clu_Mes_10_S4_SRR_RL_Clu_Dist_75()
{
	signalvalue1 = getSignal(S4_SRR_RL_Clu_Dist_75);
	write("S4_SRR_RL_Clu_Dist_75 :%f",signalvalue1);
	write("i_S4_SRR_RL_Clu_Dist_75 :%f",@ecu_Signals::i_S4_SRR_RL_Clu_Dist_75);

	testStep("get expect variable value: ","i_S4_SRR_RL_Clu_Dist_75 :%f",@ecu_Signals::i_S4_SRR_RL_Clu_Dist_75);

	if((abs(@ecu_Signals::i_S4_SRR_RL_Clu_Dist_75)*0.9<=abs(signalvalue1))&&(abs(signalvalue1)<=abs(@ecu_Signals::i_S4_SRR_RL_Clu_Dist_75)*1.1))
	{
	testStepPass("Pass","i_S4_SRR_RL_Clu_Dist_75 :%f",signalvalue1);
	}
	else
	{
	testStepFail("Fail","i_S4_SRR_RL_Clu_Dist_75 :%f",signalvalue1);
	}
}

testcase S4_SRR_RL_Clu_Mes_10_S4_SRR_RL_Clu_Vel_75()
{
	signalvalue1 = getSignal(S4_SRR_RL_Clu_Vel_75);
	write("S4_SRR_RL_Clu_Vel_75 :%f",signalvalue1);
	write("i_S4_SRR_RL_Clu_Vel_75 :%f",@ecu_Signals::i_S4_SRR_RL_Clu_Vel_75);

	testStep("get expect variable value: ","i_S4_SRR_RL_Clu_Vel_75 :%f",@ecu_Signals::i_S4_SRR_RL_Clu_Vel_75);

	if((abs(@ecu_Signals::i_S4_SRR_RL_Clu_Vel_75)*0.9<=abs(signalvalue1))&&(abs(signalvalue1)<=abs(@ecu_Signals::i_S4_SRR_RL_Clu_Vel_75)*1.1))
	{
	testStepPass("Pass","i_S4_SRR_RL_Clu_Vel_75 :%f",signalvalue1);
	}
	else
	{
	testStepFail("Fail","i_S4_SRR_RL_Clu_Vel_75 :%f",signalvalue1);
	}
}

testcase S4_SRR_RL_Clu_Mes_10_S4_SRR_RL_Clu_SNR_75()
{
	signalvalue1 = getSignal(S4_SRR_RL_Clu_SNR_75);
	write("S4_SRR_RL_Clu_SNR_75 :%f",signalvalue1);
	write("i_S4_SRR_RL_Clu_SNR_75 :%f",@ecu_Signals::i_S4_SRR_RL_Clu_SNR_75);

	testStep("get expect variable value: ","i_S4_SRR_RL_Clu_SNR_75 :%f",@ecu_Signals::i_S4_SRR_RL_Clu_SNR_75);

	if((abs(@ecu_Signals::i_S4_SRR_RL_Clu_SNR_75)*0.9<=abs(signalvalue1))&&(abs(signalvalue1)<=abs(@ecu_Signals::i_S4_SRR_RL_Clu_SNR_75)*1.1))
	{
	testStepPass("Pass","i_S4_SRR_RL_Clu_SNR_75 :%f",signalvalue1);
	}
	else
	{
	testStepFail("Fail","i_S4_SRR_RL_Clu_SNR_75 :%f",signalvalue1);
	}
}

testcase S4_SRR_RL_Clu_Mes_10_S4_SRR_RL_Clu_DynProp_75()
{
	signalvalue1 = getSignal(S4_SRR_RL_Clu_DynProp_75);
	write("S4_SRR_RL_Clu_DynProp_75 :%f",signalvalue1);
	write("i_S4_SRR_RL_Clu_DynProp_75 :%o",@ecu_Signals::i_S4_SRR_RL_Clu_DynProp_75);

	testStep("get expect variable value: ","i_S4_SRR_RL_Clu_DynProp_75 :%o",@ecu_Signals::i_S4_SRR_RL_Clu_DynProp_75);

	if(signalvalue1==@ecu_Signals::i_S4_SRR_RL_Clu_DynProp_75)
	{
	testStepPass("Pass","i_S4_SRR_RL_Clu_DynProp_75 :%f",signalvalue1);
	}
	else
	{
	testStepFail("Fail","i_S4_SRR_RL_Clu_DynProp_75 :%f",signalvalue1);
	}
}

testcase S4_SRR_RL_Clu_Mes_10_S4_SRR_RL_Clu_Locationvalid_75()
{
	signalvalue1 = getSignal(S4_SRR_RL_Clu_Locationvalid_75);
	write("S4_SRR_RL_Clu_Locationvalid_75 :%f",signalvalue1);
	write("i_S4_SRR_RL_Clu_Locationvalid_75 :%o",@ecu_Signals::i_S4_SRR_RL_Clu_Locationvalid_75);

	testStep("get expect variable value: ","i_S4_SRR_RL_Clu_Locationvalid_75 :%o",@ecu_Signals::i_S4_SRR_RL_Clu_Locationvalid_75);

	if(signalvalue1==@ecu_Signals::i_S4_SRR_RL_Clu_Locationvalid_75)
	{
	testStepPass("Pass","i_S4_SRR_RL_Clu_Locationvalid_75 :%f",signalvalue1);
	}
	else
	{
	testStepFail("Fail","i_S4_SRR_RL_Clu_Locationvalid_75 :%f",signalvalue1);
	}
}

testcase S4_SRR_RL_Clu_Mes_10_S4_SRR_RL_Clu_Theta_76()
{
	signalvalue1 = getSignal(S4_SRR_RL_Clu_Theta_76);
	write("S4_SRR_RL_Clu_Theta_76 :%f",signalvalue1);
	write("i_S4_SRR_RL_Clu_Theta_76 :%f",@ecu_Signals::i_S4_SRR_RL_Clu_Theta_76);

	testStep("get expect variable value: ","i_S4_SRR_RL_Clu_Theta_76 :%f",@ecu_Signals::i_S4_SRR_RL_Clu_Theta_76);

	if((abs(@ecu_Signals::i_S4_SRR_RL_Clu_Theta_76)*0.9<=abs(signalvalue1))&&(abs(signalvalue1)<=abs(@ecu_Signals::i_S4_SRR_RL_Clu_Theta_76)*1.1))
	{
	testStepPass("Pass","i_S4_SRR_RL_Clu_Theta_76 :%f",signalvalue1);
	}
	else
	{
	testStepFail("Fail","i_S4_SRR_RL_Clu_Theta_76 :%f",signalvalue1);
	}
}

testcase S4_SRR_RL_Clu_Mes_10_S4_SRR_RL_Clu_Dist_76()
{
	signalvalue1 = getSignal(S4_SRR_RL_Clu_Dist_76);
	write("S4_SRR_RL_Clu_Dist_76 :%f",signalvalue1);
	write("i_S4_SRR_RL_Clu_Dist_76 :%f",@ecu_Signals::i_S4_SRR_RL_Clu_Dist_76);

	testStep("get expect variable value: ","i_S4_SRR_RL_Clu_Dist_76 :%f",@ecu_Signals::i_S4_SRR_RL_Clu_Dist_76);

	if((abs(@ecu_Signals::i_S4_SRR_RL_Clu_Dist_76)*0.9<=abs(signalvalue1))&&(abs(signalvalue1)<=abs(@ecu_Signals::i_S4_SRR_RL_Clu_Dist_76)*1.1))
	{
	testStepPass("Pass","i_S4_SRR_RL_Clu_Dist_76 :%f",signalvalue1);
	}
	else
	{
	testStepFail("Fail","i_S4_SRR_RL_Clu_Dist_76 :%f",signalvalue1);
	}
}

testcase S4_SRR_RL_Clu_Mes_10_S4_SRR_RL_Clu_Vel_76()
{
	signalvalue1 = getSignal(S4_SRR_RL_Clu_Vel_76);
	write("S4_SRR_RL_Clu_Vel_76 :%f",signalvalue1);
	write("i_S4_SRR_RL_Clu_Vel_76 :%f",@ecu_Signals::i_S4_SRR_RL_Clu_Vel_76);

	testStep("get expect variable value: ","i_S4_SRR_RL_Clu_Vel_76 :%f",@ecu_Signals::i_S4_SRR_RL_Clu_Vel_76);

	if((abs(@ecu_Signals::i_S4_SRR_RL_Clu_Vel_76)*0.9<=abs(signalvalue1))&&(abs(signalvalue1)<=abs(@ecu_Signals::i_S4_SRR_RL_Clu_Vel_76)*1.1))
	{
	testStepPass("Pass","i_S4_SRR_RL_Clu_Vel_76 :%f",signalvalue1);
	}
	else
	{
	testStepFail("Fail","i_S4_SRR_RL_Clu_Vel_76 :%f",signalvalue1);
	}
}

testcase S4_SRR_RL_Clu_Mes_10_S4_SRR_RL_Clu_SNR_76()
{
	signalvalue1 = getSignal(S4_SRR_RL_Clu_SNR_76);
	write("S4_SRR_RL_Clu_SNR_76 :%f",signalvalue1);
	write("i_S4_SRR_RL_Clu_SNR_76 :%f",@ecu_Signals::i_S4_SRR_RL_Clu_SNR_76);

	testStep("get expect variable value: ","i_S4_SRR_RL_Clu_SNR_76 :%f",@ecu_Signals::i_S4_SRR_RL_Clu_SNR_76);

	if((abs(@ecu_Signals::i_S4_SRR_RL_Clu_SNR_76)*0.9<=abs(signalvalue1))&&(abs(signalvalue1)<=abs(@ecu_Signals::i_S4_SRR_RL_Clu_SNR_76)*1.1))
	{
	testStepPass("Pass","i_S4_SRR_RL_Clu_SNR_76 :%f",signalvalue1);
	}
	else
	{
	testStepFail("Fail","i_S4_SRR_RL_Clu_SNR_76 :%f",signalvalue1);
	}
}

testcase S4_SRR_RL_Clu_Mes_10_S4_SRR_RL_Clu_DynProp_76()
{
	signalvalue1 = getSignal(S4_SRR_RL_Clu_DynProp_76);
	write("S4_SRR_RL_Clu_DynProp_76 :%f",signalvalue1);
	write("i_S4_SRR_RL_Clu_DynProp_76 :%o",@ecu_Signals::i_S4_SRR_RL_Clu_DynProp_76);

	testStep("get expect variable value: ","i_S4_SRR_RL_Clu_DynProp_76 :%o",@ecu_Signals::i_S4_SRR_RL_Clu_DynProp_76);

	if(signalvalue1==@ecu_Signals::i_S4_SRR_RL_Clu_DynProp_76)
	{
	testStepPass("Pass","i_S4_SRR_RL_Clu_DynProp_76 :%f",signalvalue1);
	}
	else
	{
	testStepFail("Fail","i_S4_SRR_RL_Clu_DynProp_76 :%f",signalvalue1);
	}
}

testcase S4_SRR_RL_Clu_Mes_10_S4_SRR_RL_Clu_Locationvalid_76()
{
	signalvalue1 = getSignal(S4_SRR_RL_Clu_Locationvalid_76);
	write("S4_SRR_RL_Clu_Locationvalid_76 :%f",signalvalue1);
	write("i_S4_SRR_RL_Clu_Locationvalid_76 :%o",@ecu_Signals::i_S4_SRR_RL_Clu_Locationvalid_76);

	testStep("get expect variable value: ","i_S4_SRR_RL_Clu_Locationvalid_76 :%o",@ecu_Signals::i_S4_SRR_RL_Clu_Locationvalid_76);

	if(signalvalue1==@ecu_Signals::i_S4_SRR_RL_Clu_Locationvalid_76)
	{
	testStepPass("Pass","i_S4_SRR_RL_Clu_Locationvalid_76 :%f",signalvalue1);
	}
	else
	{
	testStepFail("Fail","i_S4_SRR_RL_Clu_Locationvalid_76 :%f",signalvalue1);
	}
}

testcase S4_SRR_RL_Clu_Mes_11_S4_SRR_RL_Clu_Theta_77()
{
	signalvalue1 = getSignal(S4_SRR_RL_Clu_Theta_77);
	write("S4_SRR_RL_Clu_Theta_77 :%f",signalvalue1);
	write("i_S4_SRR_RL_Clu_Theta_77 :%f",@ecu_Signals::i_S4_SRR_RL_Clu_Theta_77);

	testStep("get expect variable value: ","i_S4_SRR_RL_Clu_Theta_77 :%f",@ecu_Signals::i_S4_SRR_RL_Clu_Theta_77);

	if((abs(@ecu_Signals::i_S4_SRR_RL_Clu_Theta_77)*0.9<=abs(signalvalue1))&&(abs(signalvalue1)<=abs(@ecu_Signals::i_S4_SRR_RL_Clu_Theta_77)*1.1))
	{
	testStepPass("Pass","i_S4_SRR_RL_Clu_Theta_77 :%f",signalvalue1);
	}
	else
	{
	testStepFail("Fail","i_S4_SRR_RL_Clu_Theta_77 :%f",signalvalue1);
	}
}

testcase S4_SRR_RL_Clu_Mes_11_S4_SRR_RL_Clu_Dist_77()
{
	signalvalue1 = getSignal(S4_SRR_RL_Clu_Dist_77);
	write("S4_SRR_RL_Clu_Dist_77 :%f",signalvalue1);
	write("i_S4_SRR_RL_Clu_Dist_77 :%f",@ecu_Signals::i_S4_SRR_RL_Clu_Dist_77);

	testStep("get expect variable value: ","i_S4_SRR_RL_Clu_Dist_77 :%f",@ecu_Signals::i_S4_SRR_RL_Clu_Dist_77);

	if((abs(@ecu_Signals::i_S4_SRR_RL_Clu_Dist_77)*0.9<=abs(signalvalue1))&&(abs(signalvalue1)<=abs(@ecu_Signals::i_S4_SRR_RL_Clu_Dist_77)*1.1))
	{
	testStepPass("Pass","i_S4_SRR_RL_Clu_Dist_77 :%f",signalvalue1);
	}
	else
	{
	testStepFail("Fail","i_S4_SRR_RL_Clu_Dist_77 :%f",signalvalue1);
	}
}

testcase S4_SRR_RL_Clu_Mes_11_S4_SRR_RL_Clu_Vel_77()
{
	signalvalue1 = getSignal(S4_SRR_RL_Clu_Vel_77);
	write("S4_SRR_RL_Clu_Vel_77 :%f",signalvalue1);
	write("i_S4_SRR_RL_Clu_Vel_77 :%f",@ecu_Signals::i_S4_SRR_RL_Clu_Vel_77);

	testStep("get expect variable value: ","i_S4_SRR_RL_Clu_Vel_77 :%f",@ecu_Signals::i_S4_SRR_RL_Clu_Vel_77);

	if((abs(@ecu_Signals::i_S4_SRR_RL_Clu_Vel_77)*0.9<=abs(signalvalue1))&&(abs(signalvalue1)<=abs(@ecu_Signals::i_S4_SRR_RL_Clu_Vel_77)*1.1))
	{
	testStepPass("Pass","i_S4_SRR_RL_Clu_Vel_77 :%f",signalvalue1);
	}
	else
	{
	testStepFail("Fail","i_S4_SRR_RL_Clu_Vel_77 :%f",signalvalue1);
	}
}

testcase S4_SRR_RL_Clu_Mes_11_S4_SRR_RL_Clu_SNR_77()
{
	signalvalue1 = getSignal(S4_SRR_RL_Clu_SNR_77);
	write("S4_SRR_RL_Clu_SNR_77 :%f",signalvalue1);
	write("i_S4_SRR_RL_Clu_SNR_77 :%f",@ecu_Signals::i_S4_SRR_RL_Clu_SNR_77);

	testStep("get expect variable value: ","i_S4_SRR_RL_Clu_SNR_77 :%f",@ecu_Signals::i_S4_SRR_RL_Clu_SNR_77);

	if((abs(@ecu_Signals::i_S4_SRR_RL_Clu_SNR_77)*0.9<=abs(signalvalue1))&&(abs(signalvalue1)<=abs(@ecu_Signals::i_S4_SRR_RL_Clu_SNR_77)*1.1))
	{
	testStepPass("Pass","i_S4_SRR_RL_Clu_SNR_77 :%f",signalvalue1);
	}
	else
	{
	testStepFail("Fail","i_S4_SRR_RL_Clu_SNR_77 :%f",signalvalue1);
	}
}

testcase S4_SRR_RL_Clu_Mes_11_S4_SRR_RL_Clu_DynProp_77()
{
	signalvalue1 = getSignal(S4_SRR_RL_Clu_DynProp_77);
	write("S4_SRR_RL_Clu_DynProp_77 :%f",signalvalue1);
	write("i_S4_SRR_RL_Clu_DynProp_77 :%o",@ecu_Signals::i_S4_SRR_RL_Clu_DynProp_77);

	testStep("get expect variable value: ","i_S4_SRR_RL_Clu_DynProp_77 :%o",@ecu_Signals::i_S4_SRR_RL_Clu_DynProp_77);

	if(signalvalue1==@ecu_Signals::i_S4_SRR_RL_Clu_DynProp_77)
	{
	testStepPass("Pass","i_S4_SRR_RL_Clu_DynProp_77 :%f",signalvalue1);
	}
	else
	{
	testStepFail("Fail","i_S4_SRR_RL_Clu_DynProp_77 :%f",signalvalue1);
	}
}

testcase S4_SRR_RL_Clu_Mes_11_S4_SRR_RL_Clu_Locationvalid_77()
{
	signalvalue1 = getSignal(S4_SRR_RL_Clu_Locationvalid_77);
	write("S4_SRR_RL_Clu_Locationvalid_77 :%f",signalvalue1);
	write("i_S4_SRR_RL_Clu_Locationvalid_77 :%o",@ecu_Signals::i_S4_SRR_RL_Clu_Locationvalid_77);

	testStep("get expect variable value: ","i_S4_SRR_RL_Clu_Locationvalid_77 :%o",@ecu_Signals::i_S4_SRR_RL_Clu_Locationvalid_77);

	if(signalvalue1==@ecu_Signals::i_S4_SRR_RL_Clu_Locationvalid_77)
	{
	testStepPass("Pass","i_S4_SRR_RL_Clu_Locationvalid_77 :%f",signalvalue1);
	}
	else
	{
	testStepFail("Fail","i_S4_SRR_RL_Clu_Locationvalid_77 :%f",signalvalue1);
	}
}

testcase S4_SRR_RL_Clu_Mes_11_S4_SRR_RL_Clu_Theta_78()
{
	signalvalue1 = getSignal(S4_SRR_RL_Clu_Theta_78);
	write("S4_SRR_RL_Clu_Theta_78 :%f",signalvalue1);
	write("i_S4_SRR_RL_Clu_Theta_78 :%f",@ecu_Signals::i_S4_SRR_RL_Clu_Theta_78);

	testStep("get expect variable value: ","i_S4_SRR_RL_Clu_Theta_78 :%f",@ecu_Signals::i_S4_SRR_RL_Clu_Theta_78);

	if((abs(@ecu_Signals::i_S4_SRR_RL_Clu_Theta_78)*0.9<=abs(signalvalue1))&&(abs(signalvalue1)<=abs(@ecu_Signals::i_S4_SRR_RL_Clu_Theta_78)*1.1))
	{
	testStepPass("Pass","i_S4_SRR_RL_Clu_Theta_78 :%f",signalvalue1);
	}
	else
	{
	testStepFail("Fail","i_S4_SRR_RL_Clu_Theta_78 :%f",signalvalue1);
	}
}

testcase S4_SRR_RL_Clu_Mes_11_S4_SRR_RL_Clu_Dist_78()
{
	signalvalue1 = getSignal(S4_SRR_RL_Clu_Dist_78);
	write("S4_SRR_RL_Clu_Dist_78 :%f",signalvalue1);
	write("i_S4_SRR_RL_Clu_Dist_78 :%f",@ecu_Signals::i_S4_SRR_RL_Clu_Dist_78);

	testStep("get expect variable value: ","i_S4_SRR_RL_Clu_Dist_78 :%f",@ecu_Signals::i_S4_SRR_RL_Clu_Dist_78);

	if((abs(@ecu_Signals::i_S4_SRR_RL_Clu_Dist_78)*0.9<=abs(signalvalue1))&&(abs(signalvalue1)<=abs(@ecu_Signals::i_S4_SRR_RL_Clu_Dist_78)*1.1))
	{
	testStepPass("Pass","i_S4_SRR_RL_Clu_Dist_78 :%f",signalvalue1);
	}
	else
	{
	testStepFail("Fail","i_S4_SRR_RL_Clu_Dist_78 :%f",signalvalue1);
	}
}

testcase S4_SRR_RL_Clu_Mes_11_S4_SRR_RL_Clu_Vel_78()
{
	signalvalue1 = getSignal(S4_SRR_RL_Clu_Vel_78);
	write("S4_SRR_RL_Clu_Vel_78 :%f",signalvalue1);
	write("i_S4_SRR_RL_Clu_Vel_78 :%f",@ecu_Signals::i_S4_SRR_RL_Clu_Vel_78);

	testStep("get expect variable value: ","i_S4_SRR_RL_Clu_Vel_78 :%f",@ecu_Signals::i_S4_SRR_RL_Clu_Vel_78);

	if((abs(@ecu_Signals::i_S4_SRR_RL_Clu_Vel_78)*0.9<=abs(signalvalue1))&&(abs(signalvalue1)<=abs(@ecu_Signals::i_S4_SRR_RL_Clu_Vel_78)*1.1))
	{
	testStepPass("Pass","i_S4_SRR_RL_Clu_Vel_78 :%f",signalvalue1);
	}
	else
	{
	testStepFail("Fail","i_S4_SRR_RL_Clu_Vel_78 :%f",signalvalue1);
	}
}

testcase S4_SRR_RL_Clu_Mes_11_S4_SRR_RL_Clu_SNR_78()
{
	signalvalue1 = getSignal(S4_SRR_RL_Clu_SNR_78);
	write("S4_SRR_RL_Clu_SNR_78 :%f",signalvalue1);
	write("i_S4_SRR_RL_Clu_SNR_78 :%f",@ecu_Signals::i_S4_SRR_RL_Clu_SNR_78);

	testStep("get expect variable value: ","i_S4_SRR_RL_Clu_SNR_78 :%f",@ecu_Signals::i_S4_SRR_RL_Clu_SNR_78);

	if((abs(@ecu_Signals::i_S4_SRR_RL_Clu_SNR_78)*0.9<=abs(signalvalue1))&&(abs(signalvalue1)<=abs(@ecu_Signals::i_S4_SRR_RL_Clu_SNR_78)*1.1))
	{
	testStepPass("Pass","i_S4_SRR_RL_Clu_SNR_78 :%f",signalvalue1);
	}
	else
	{
	testStepFail("Fail","i_S4_SRR_RL_Clu_SNR_78 :%f",signalvalue1);
	}
}

testcase S4_SRR_RL_Clu_Mes_11_S4_SRR_RL_Clu_DynProp_78()
{
	signalvalue1 = getSignal(S4_SRR_RL_Clu_DynProp_78);
	write("S4_SRR_RL_Clu_DynProp_78 :%f",signalvalue1);
	write("i_S4_SRR_RL_Clu_DynProp_78 :%o",@ecu_Signals::i_S4_SRR_RL_Clu_DynProp_78);

	testStep("get expect variable value: ","i_S4_SRR_RL_Clu_DynProp_78 :%o",@ecu_Signals::i_S4_SRR_RL_Clu_DynProp_78);

	if(signalvalue1==@ecu_Signals::i_S4_SRR_RL_Clu_DynProp_78)
	{
	testStepPass("Pass","i_S4_SRR_RL_Clu_DynProp_78 :%f",signalvalue1);
	}
	else
	{
	testStepFail("Fail","i_S4_SRR_RL_Clu_DynProp_78 :%f",signalvalue1);
	}
}

testcase S4_SRR_RL_Clu_Mes_11_S4_SRR_RL_Clu_Locationvalid_78()
{
	signalvalue1 = getSignal(S4_SRR_RL_Clu_Locationvalid_78);
	write("S4_SRR_RL_Clu_Locationvalid_78 :%f",signalvalue1);
	write("i_S4_SRR_RL_Clu_Locationvalid_78 :%o",@ecu_Signals::i_S4_SRR_RL_Clu_Locationvalid_78);

	testStep("get expect variable value: ","i_S4_SRR_RL_Clu_Locationvalid_78 :%o",@ecu_Signals::i_S4_SRR_RL_Clu_Locationvalid_78);

	if(signalvalue1==@ecu_Signals::i_S4_SRR_RL_Clu_Locationvalid_78)
	{
	testStepPass("Pass","i_S4_SRR_RL_Clu_Locationvalid_78 :%f",signalvalue1);
	}
	else
	{
	testStepFail("Fail","i_S4_SRR_RL_Clu_Locationvalid_78 :%f",signalvalue1);
	}
}

testcase S4_SRR_RL_Clu_Mes_11_S4_SRR_RL_Clu_Theta_79()
{
	signalvalue1 = getSignal(S4_SRR_RL_Clu_Theta_79);
	write("S4_SRR_RL_Clu_Theta_79 :%f",signalvalue1);
	write("i_S4_SRR_RL_Clu_Theta_79 :%f",@ecu_Signals::i_S4_SRR_RL_Clu_Theta_79);

	testStep("get expect variable value: ","i_S4_SRR_RL_Clu_Theta_79 :%f",@ecu_Signals::i_S4_SRR_RL_Clu_Theta_79);

	if((abs(@ecu_Signals::i_S4_SRR_RL_Clu_Theta_79)*0.9<=abs(signalvalue1))&&(abs(signalvalue1)<=abs(@ecu_Signals::i_S4_SRR_RL_Clu_Theta_79)*1.1))
	{
	testStepPass("Pass","i_S4_SRR_RL_Clu_Theta_79 :%f",signalvalue1);
	}
	else
	{
	testStepFail("Fail","i_S4_SRR_RL_Clu_Theta_79 :%f",signalvalue1);
	}
}

testcase S4_SRR_RL_Clu_Mes_11_S4_SRR_RL_Clu_Dist_79()
{
	signalvalue1 = getSignal(S4_SRR_RL_Clu_Dist_79);
	write("S4_SRR_RL_Clu_Dist_79 :%f",signalvalue1);
	write("i_S4_SRR_RL_Clu_Dist_79 :%f",@ecu_Signals::i_S4_SRR_RL_Clu_Dist_79);

	testStep("get expect variable value: ","i_S4_SRR_RL_Clu_Dist_79 :%f",@ecu_Signals::i_S4_SRR_RL_Clu_Dist_79);

	if((abs(@ecu_Signals::i_S4_SRR_RL_Clu_Dist_79)*0.9<=abs(signalvalue1))&&(abs(signalvalue1)<=abs(@ecu_Signals::i_S4_SRR_RL_Clu_Dist_79)*1.1))
	{
	testStepPass("Pass","i_S4_SRR_RL_Clu_Dist_79 :%f",signalvalue1);
	}
	else
	{
	testStepFail("Fail","i_S4_SRR_RL_Clu_Dist_79 :%f",signalvalue1);
	}
}

testcase S4_SRR_RL_Clu_Mes_11_S4_SRR_RL_Clu_Vel_79()
{
	signalvalue1 = getSignal(S4_SRR_RL_Clu_Vel_79);
	write("S4_SRR_RL_Clu_Vel_79 :%f",signalvalue1);
	write("i_S4_SRR_RL_Clu_Vel_79 :%f",@ecu_Signals::i_S4_SRR_RL_Clu_Vel_79);

	testStep("get expect variable value: ","i_S4_SRR_RL_Clu_Vel_79 :%f",@ecu_Signals::i_S4_SRR_RL_Clu_Vel_79);

	if((abs(@ecu_Signals::i_S4_SRR_RL_Clu_Vel_79)*0.9<=abs(signalvalue1))&&(abs(signalvalue1)<=abs(@ecu_Signals::i_S4_SRR_RL_Clu_Vel_79)*1.1))
	{
	testStepPass("Pass","i_S4_SRR_RL_Clu_Vel_79 :%f",signalvalue1);
	}
	else
	{
	testStepFail("Fail","i_S4_SRR_RL_Clu_Vel_79 :%f",signalvalue1);
	}
}

testcase S4_SRR_RL_Clu_Mes_11_S4_SRR_RL_Clu_SNR_79()
{
	signalvalue1 = getSignal(S4_SRR_RL_Clu_SNR_79);
	write("S4_SRR_RL_Clu_SNR_79 :%f",signalvalue1);
	write("i_S4_SRR_RL_Clu_SNR_79 :%f",@ecu_Signals::i_S4_SRR_RL_Clu_SNR_79);

	testStep("get expect variable value: ","i_S4_SRR_RL_Clu_SNR_79 :%f",@ecu_Signals::i_S4_SRR_RL_Clu_SNR_79);

	if((abs(@ecu_Signals::i_S4_SRR_RL_Clu_SNR_79)*0.9<=abs(signalvalue1))&&(abs(signalvalue1)<=abs(@ecu_Signals::i_S4_SRR_RL_Clu_SNR_79)*1.1))
	{
	testStepPass("Pass","i_S4_SRR_RL_Clu_SNR_79 :%f",signalvalue1);
	}
	else
	{
	testStepFail("Fail","i_S4_SRR_RL_Clu_SNR_79 :%f",signalvalue1);
	}
}

testcase S4_SRR_RL_Clu_Mes_11_S4_SRR_RL_Clu_DynProp_79()
{
	signalvalue1 = getSignal(S4_SRR_RL_Clu_DynProp_79);
	write("S4_SRR_RL_Clu_DynProp_79 :%f",signalvalue1);
	write("i_S4_SRR_RL_Clu_DynProp_79 :%o",@ecu_Signals::i_S4_SRR_RL_Clu_DynProp_79);

	testStep("get expect variable value: ","i_S4_SRR_RL_Clu_DynProp_79 :%o",@ecu_Signals::i_S4_SRR_RL_Clu_DynProp_79);

	if(signalvalue1==@ecu_Signals::i_S4_SRR_RL_Clu_DynProp_79)
	{
	testStepPass("Pass","i_S4_SRR_RL_Clu_DynProp_79 :%f",signalvalue1);
	}
	else
	{
	testStepFail("Fail","i_S4_SRR_RL_Clu_DynProp_79 :%f",signalvalue1);
	}
}

testcase S4_SRR_RL_Clu_Mes_11_S4_SRR_RL_Clu_Locationvalid_79()
{
	signalvalue1 = getSignal(S4_SRR_RL_Clu_Locationvalid_79);
	write("S4_SRR_RL_Clu_Locationvalid_79 :%f",signalvalue1);
	write("i_S4_SRR_RL_Clu_Locationvalid_79 :%o",@ecu_Signals::i_S4_SRR_RL_Clu_Locationvalid_79);

	testStep("get expect variable value: ","i_S4_SRR_RL_Clu_Locationvalid_79 :%o",@ecu_Signals::i_S4_SRR_RL_Clu_Locationvalid_79);

	if(signalvalue1==@ecu_Signals::i_S4_SRR_RL_Clu_Locationvalid_79)
	{
	testStepPass("Pass","i_S4_SRR_RL_Clu_Locationvalid_79 :%f",signalvalue1);
	}
	else
	{
	testStepFail("Fail","i_S4_SRR_RL_Clu_Locationvalid_79 :%f",signalvalue1);
	}
}

testcase S4_SRR_RL_Clu_Mes_11_S4_SRR_RL_Clu_Theta_80()
{
	signalvalue1 = getSignal(S4_SRR_RL_Clu_Theta_80);
	write("S4_SRR_RL_Clu_Theta_80 :%f",signalvalue1);
	write("i_S4_SRR_RL_Clu_Theta_80 :%f",@ecu_Signals::i_S4_SRR_RL_Clu_Theta_80);

	testStep("get expect variable value: ","i_S4_SRR_RL_Clu_Theta_80 :%f",@ecu_Signals::i_S4_SRR_RL_Clu_Theta_80);

	if((abs(@ecu_Signals::i_S4_SRR_RL_Clu_Theta_80)*0.9<=abs(signalvalue1))&&(abs(signalvalue1)<=abs(@ecu_Signals::i_S4_SRR_RL_Clu_Theta_80)*1.1))
	{
	testStepPass("Pass","i_S4_SRR_RL_Clu_Theta_80 :%f",signalvalue1);
	}
	else
	{
	testStepFail("Fail","i_S4_SRR_RL_Clu_Theta_80 :%f",signalvalue1);
	}
}

testcase S4_SRR_RL_Clu_Mes_11_S4_SRR_RL_Clu_Dist_80()
{
	signalvalue1 = getSignal(S4_SRR_RL_Clu_Dist_80);
	write("S4_SRR_RL_Clu_Dist_80 :%f",signalvalue1);
	write("i_S4_SRR_RL_Clu_Dist_80 :%f",@ecu_Signals::i_S4_SRR_RL_Clu_Dist_80);

	testStep("get expect variable value: ","i_S4_SRR_RL_Clu_Dist_80 :%f",@ecu_Signals::i_S4_SRR_RL_Clu_Dist_80);

	if((abs(@ecu_Signals::i_S4_SRR_RL_Clu_Dist_80)*0.9<=abs(signalvalue1))&&(abs(signalvalue1)<=abs(@ecu_Signals::i_S4_SRR_RL_Clu_Dist_80)*1.1))
	{
	testStepPass("Pass","i_S4_SRR_RL_Clu_Dist_80 :%f",signalvalue1);
	}
	else
	{
	testStepFail("Fail","i_S4_SRR_RL_Clu_Dist_80 :%f",signalvalue1);
	}
}

testcase S4_SRR_RL_Clu_Mes_11_S4_SRR_RL_Clu_Vel_80()
{
	signalvalue1 = getSignal(S4_SRR_RL_Clu_Vel_80);
	write("S4_SRR_RL_Clu_Vel_80 :%f",signalvalue1);
	write("i_S4_SRR_RL_Clu_Vel_80 :%f",@ecu_Signals::i_S4_SRR_RL_Clu_Vel_80);

	testStep("get expect variable value: ","i_S4_SRR_RL_Clu_Vel_80 :%f",@ecu_Signals::i_S4_SRR_RL_Clu_Vel_80);

	if((abs(@ecu_Signals::i_S4_SRR_RL_Clu_Vel_80)*0.9<=abs(signalvalue1))&&(abs(signalvalue1)<=abs(@ecu_Signals::i_S4_SRR_RL_Clu_Vel_80)*1.1))
	{
	testStepPass("Pass","i_S4_SRR_RL_Clu_Vel_80 :%f",signalvalue1);
	}
	else
	{
	testStepFail("Fail","i_S4_SRR_RL_Clu_Vel_80 :%f",signalvalue1);
	}
}

testcase S4_SRR_RL_Clu_Mes_11_S4_SRR_RL_Clu_SNR_80()
{
	signalvalue1 = getSignal(S4_SRR_RL_Clu_SNR_80);
	write("S4_SRR_RL_Clu_SNR_80 :%f",signalvalue1);
	write("i_S4_SRR_RL_Clu_SNR_80 :%f",@ecu_Signals::i_S4_SRR_RL_Clu_SNR_80);

	testStep("get expect variable value: ","i_S4_SRR_RL_Clu_SNR_80 :%f",@ecu_Signals::i_S4_SRR_RL_Clu_SNR_80);

	if((abs(@ecu_Signals::i_S4_SRR_RL_Clu_SNR_80)*0.9<=abs(signalvalue1))&&(abs(signalvalue1)<=abs(@ecu_Signals::i_S4_SRR_RL_Clu_SNR_80)*1.1))
	{
	testStepPass("Pass","i_S4_SRR_RL_Clu_SNR_80 :%f",signalvalue1);
	}
	else
	{
	testStepFail("Fail","i_S4_SRR_RL_Clu_SNR_80 :%f",signalvalue1);
	}
}

testcase S4_SRR_RL_Clu_Mes_11_S4_SRR_RL_Clu_DynProp_80()
{
	signalvalue1 = getSignal(S4_SRR_RL_Clu_DynProp_80);
	write("S4_SRR_RL_Clu_DynProp_80 :%f",signalvalue1);
	write("i_S4_SRR_RL_Clu_DynProp_80 :%o",@ecu_Signals::i_S4_SRR_RL_Clu_DynProp_80);

	testStep("get expect variable value: ","i_S4_SRR_RL_Clu_DynProp_80 :%o",@ecu_Signals::i_S4_SRR_RL_Clu_DynProp_80);

	if(signalvalue1==@ecu_Signals::i_S4_SRR_RL_Clu_DynProp_80)
	{
	testStepPass("Pass","i_S4_SRR_RL_Clu_DynProp_80 :%f",signalvalue1);
	}
	else
	{
	testStepFail("Fail","i_S4_SRR_RL_Clu_DynProp_80 :%f",signalvalue1);
	}
}

testcase S4_SRR_RL_Clu_Mes_11_S4_SRR_RL_Clu_Locationvalid_80()
{
	signalvalue1 = getSignal(S4_SRR_RL_Clu_Locationvalid_80);
	write("S4_SRR_RL_Clu_Locationvalid_80 :%f",signalvalue1);
	write("i_S4_SRR_RL_Clu_Locationvalid_80 :%o",@ecu_Signals::i_S4_SRR_RL_Clu_Locationvalid_80);

	testStep("get expect variable value: ","i_S4_SRR_RL_Clu_Locationvalid_80 :%o",@ecu_Signals::i_S4_SRR_RL_Clu_Locationvalid_80);

	if(signalvalue1==@ecu_Signals::i_S4_SRR_RL_Clu_Locationvalid_80)
	{
	testStepPass("Pass","i_S4_SRR_RL_Clu_Locationvalid_80 :%f",signalvalue1);
	}
	else
	{
	testStepFail("Fail","i_S4_SRR_RL_Clu_Locationvalid_80 :%f",signalvalue1);
	}
}

testcase S4_SRR_RL_Clu_Mes_11_S4_SRR_RL_Clu_Theta_81()
{
	signalvalue1 = getSignal(S4_SRR_RL_Clu_Theta_81);
	write("S4_SRR_RL_Clu_Theta_81 :%f",signalvalue1);
	write("i_S4_SRR_RL_Clu_Theta_81 :%f",@ecu_Signals::i_S4_SRR_RL_Clu_Theta_81);

	testStep("get expect variable value: ","i_S4_SRR_RL_Clu_Theta_81 :%f",@ecu_Signals::i_S4_SRR_RL_Clu_Theta_81);

	if((abs(@ecu_Signals::i_S4_SRR_RL_Clu_Theta_81)*0.9<=abs(signalvalue1))&&(abs(signalvalue1)<=abs(@ecu_Signals::i_S4_SRR_RL_Clu_Theta_81)*1.1))
	{
	testStepPass("Pass","i_S4_SRR_RL_Clu_Theta_81 :%f",signalvalue1);
	}
	else
	{
	testStepFail("Fail","i_S4_SRR_RL_Clu_Theta_81 :%f",signalvalue1);
	}
}

testcase S4_SRR_RL_Clu_Mes_11_S4_SRR_RL_Clu_Dist_81()
{
	signalvalue1 = getSignal(S4_SRR_RL_Clu_Dist_81);
	write("S4_SRR_RL_Clu_Dist_81 :%f",signalvalue1);
	write("i_S4_SRR_RL_Clu_Dist_81 :%f",@ecu_Signals::i_S4_SRR_RL_Clu_Dist_81);

	testStep("get expect variable value: ","i_S4_SRR_RL_Clu_Dist_81 :%f",@ecu_Signals::i_S4_SRR_RL_Clu_Dist_81);

	if((abs(@ecu_Signals::i_S4_SRR_RL_Clu_Dist_81)*0.9<=abs(signalvalue1))&&(abs(signalvalue1)<=abs(@ecu_Signals::i_S4_SRR_RL_Clu_Dist_81)*1.1))
	{
	testStepPass("Pass","i_S4_SRR_RL_Clu_Dist_81 :%f",signalvalue1);
	}
	else
	{
	testStepFail("Fail","i_S4_SRR_RL_Clu_Dist_81 :%f",signalvalue1);
	}
}

testcase S4_SRR_RL_Clu_Mes_11_S4_SRR_RL_Clu_Vel_81()
{
	signalvalue1 = getSignal(S4_SRR_RL_Clu_Vel_81);
	write("S4_SRR_RL_Clu_Vel_81 :%f",signalvalue1);
	write("i_S4_SRR_RL_Clu_Vel_81 :%f",@ecu_Signals::i_S4_SRR_RL_Clu_Vel_81);

	testStep("get expect variable value: ","i_S4_SRR_RL_Clu_Vel_81 :%f",@ecu_Signals::i_S4_SRR_RL_Clu_Vel_81);

	if((abs(@ecu_Signals::i_S4_SRR_RL_Clu_Vel_81)*0.9<=abs(signalvalue1))&&(abs(signalvalue1)<=abs(@ecu_Signals::i_S4_SRR_RL_Clu_Vel_81)*1.1))
	{
	testStepPass("Pass","i_S4_SRR_RL_Clu_Vel_81 :%f",signalvalue1);
	}
	else
	{
	testStepFail("Fail","i_S4_SRR_RL_Clu_Vel_81 :%f",signalvalue1);
	}
}

testcase S4_SRR_RL_Clu_Mes_11_S4_SRR_RL_Clu_SNR_81()
{
	signalvalue1 = getSignal(S4_SRR_RL_Clu_SNR_81);
	write("S4_SRR_RL_Clu_SNR_81 :%f",signalvalue1);
	write("i_S4_SRR_RL_Clu_SNR_81 :%f",@ecu_Signals::i_S4_SRR_RL_Clu_SNR_81);

	testStep("get expect variable value: ","i_S4_SRR_RL_Clu_SNR_81 :%f",@ecu_Signals::i_S4_SRR_RL_Clu_SNR_81);

	if((abs(@ecu_Signals::i_S4_SRR_RL_Clu_SNR_81)*0.9<=abs(signalvalue1))&&(abs(signalvalue1)<=abs(@ecu_Signals::i_S4_SRR_RL_Clu_SNR_81)*1.1))
	{
	testStepPass("Pass","i_S4_SRR_RL_Clu_SNR_81 :%f",signalvalue1);
	}
	else
	{
	testStepFail("Fail","i_S4_SRR_RL_Clu_SNR_81 :%f",signalvalue1);
	}
}

testcase S4_SRR_RL_Clu_Mes_11_S4_SRR_RL_Clu_DynProp_81()
{
	signalvalue1 = getSignal(S4_SRR_RL_Clu_DynProp_81);
	write("S4_SRR_RL_Clu_DynProp_81 :%f",signalvalue1);
	write("i_S4_SRR_RL_Clu_DynProp_81 :%o",@ecu_Signals::i_S4_SRR_RL_Clu_DynProp_81);

	testStep("get expect variable value: ","i_S4_SRR_RL_Clu_DynProp_81 :%o",@ecu_Signals::i_S4_SRR_RL_Clu_DynProp_81);

	if(signalvalue1==@ecu_Signals::i_S4_SRR_RL_Clu_DynProp_81)
	{
	testStepPass("Pass","i_S4_SRR_RL_Clu_DynProp_81 :%f",signalvalue1);
	}
	else
	{
	testStepFail("Fail","i_S4_SRR_RL_Clu_DynProp_81 :%f",signalvalue1);
	}
}

testcase S4_SRR_RL_Clu_Mes_11_S4_SRR_RL_Clu_Locationvalid_81()
{
	signalvalue1 = getSignal(S4_SRR_RL_Clu_Locationvalid_81);
	write("S4_SRR_RL_Clu_Locationvalid_81 :%f",signalvalue1);
	write("i_S4_SRR_RL_Clu_Locationvalid_81 :%o",@ecu_Signals::i_S4_SRR_RL_Clu_Locationvalid_81);

	testStep("get expect variable value: ","i_S4_SRR_RL_Clu_Locationvalid_81 :%o",@ecu_Signals::i_S4_SRR_RL_Clu_Locationvalid_81);

	if(signalvalue1==@ecu_Signals::i_S4_SRR_RL_Clu_Locationvalid_81)
	{
	testStepPass("Pass","i_S4_SRR_RL_Clu_Locationvalid_81 :%f",signalvalue1);
	}
	else
	{
	testStepFail("Fail","i_S4_SRR_RL_Clu_Locationvalid_81 :%f",signalvalue1);
	}
}

testcase S4_SRR_RL_Clu_Mes_11_S4_SRR_RL_Clu_Theta_82()
{
	signalvalue1 = getSignal(S4_SRR_RL_Clu_Theta_82);
	write("S4_SRR_RL_Clu_Theta_82 :%f",signalvalue1);
	write("i_S4_SRR_RL_Clu_Theta_82 :%f",@ecu_Signals::i_S4_SRR_RL_Clu_Theta_82);

	testStep("get expect variable value: ","i_S4_SRR_RL_Clu_Theta_82 :%f",@ecu_Signals::i_S4_SRR_RL_Clu_Theta_82);

	if((abs(@ecu_Signals::i_S4_SRR_RL_Clu_Theta_82)*0.9<=abs(signalvalue1))&&(abs(signalvalue1)<=abs(@ecu_Signals::i_S4_SRR_RL_Clu_Theta_82)*1.1))
	{
	testStepPass("Pass","i_S4_SRR_RL_Clu_Theta_82 :%f",signalvalue1);
	}
	else
	{
	testStepFail("Fail","i_S4_SRR_RL_Clu_Theta_82 :%f",signalvalue1);
	}
}

testcase S4_SRR_RL_Clu_Mes_11_S4_SRR_RL_Clu_Dist_82()
{
	signalvalue1 = getSignal(S4_SRR_RL_Clu_Dist_82);
	write("S4_SRR_RL_Clu_Dist_82 :%f",signalvalue1);
	write("i_S4_SRR_RL_Clu_Dist_82 :%f",@ecu_Signals::i_S4_SRR_RL_Clu_Dist_82);

	testStep("get expect variable value: ","i_S4_SRR_RL_Clu_Dist_82 :%f",@ecu_Signals::i_S4_SRR_RL_Clu_Dist_82);

	if((abs(@ecu_Signals::i_S4_SRR_RL_Clu_Dist_82)*0.9<=abs(signalvalue1))&&(abs(signalvalue1)<=abs(@ecu_Signals::i_S4_SRR_RL_Clu_Dist_82)*1.1))
	{
	testStepPass("Pass","i_S4_SRR_RL_Clu_Dist_82 :%f",signalvalue1);
	}
	else
	{
	testStepFail("Fail","i_S4_SRR_RL_Clu_Dist_82 :%f",signalvalue1);
	}
}

testcase S4_SRR_RL_Clu_Mes_11_S4_SRR_RL_Clu_Vel_82()
{
	signalvalue1 = getSignal(S4_SRR_RL_Clu_Vel_82);
	write("S4_SRR_RL_Clu_Vel_82 :%f",signalvalue1);
	write("i_S4_SRR_RL_Clu_Vel_82 :%f",@ecu_Signals::i_S4_SRR_RL_Clu_Vel_82);

	testStep("get expect variable value: ","i_S4_SRR_RL_Clu_Vel_82 :%f",@ecu_Signals::i_S4_SRR_RL_Clu_Vel_82);

	if((abs(@ecu_Signals::i_S4_SRR_RL_Clu_Vel_82)*0.9<=abs(signalvalue1))&&(abs(signalvalue1)<=abs(@ecu_Signals::i_S4_SRR_RL_Clu_Vel_82)*1.1))
	{
	testStepPass("Pass","i_S4_SRR_RL_Clu_Vel_82 :%f",signalvalue1);
	}
	else
	{
	testStepFail("Fail","i_S4_SRR_RL_Clu_Vel_82 :%f",signalvalue1);
	}
}

testcase S4_SRR_RL_Clu_Mes_11_S4_SRR_RL_Clu_SNR_82()
{
	signalvalue1 = getSignal(S4_SRR_RL_Clu_SNR_82);
	write("S4_SRR_RL_Clu_SNR_82 :%f",signalvalue1);
	write("i_S4_SRR_RL_Clu_SNR_82 :%f",@ecu_Signals::i_S4_SRR_RL_Clu_SNR_82);

	testStep("get expect variable value: ","i_S4_SRR_RL_Clu_SNR_82 :%f",@ecu_Signals::i_S4_SRR_RL_Clu_SNR_82);

	if((abs(@ecu_Signals::i_S4_SRR_RL_Clu_SNR_82)*0.9<=abs(signalvalue1))&&(abs(signalvalue1)<=abs(@ecu_Signals::i_S4_SRR_RL_Clu_SNR_82)*1.1))
	{
	testStepPass("Pass","i_S4_SRR_RL_Clu_SNR_82 :%f",signalvalue1);
	}
	else
	{
	testStepFail("Fail","i_S4_SRR_RL_Clu_SNR_82 :%f",signalvalue1);
	}
}

testcase S4_SRR_RL_Clu_Mes_11_S4_SRR_RL_Clu_DynProp_82()
{
	signalvalue1 = getSignal(S4_SRR_RL_Clu_DynProp_82);
	write("S4_SRR_RL_Clu_DynProp_82 :%f",signalvalue1);
	write("i_S4_SRR_RL_Clu_DynProp_82 :%o",@ecu_Signals::i_S4_SRR_RL_Clu_DynProp_82);

	testStep("get expect variable value: ","i_S4_SRR_RL_Clu_DynProp_82 :%o",@ecu_Signals::i_S4_SRR_RL_Clu_DynProp_82);

	if(signalvalue1==@ecu_Signals::i_S4_SRR_RL_Clu_DynProp_82)
	{
	testStepPass("Pass","i_S4_SRR_RL_Clu_DynProp_82 :%f",signalvalue1);
	}
	else
	{
	testStepFail("Fail","i_S4_SRR_RL_Clu_DynProp_82 :%f",signalvalue1);
	}
}

testcase S4_SRR_RL_Clu_Mes_11_S4_SRR_RL_Clu_Locationvalid_82()
{
	signalvalue1 = getSignal(S4_SRR_RL_Clu_Locationvalid_82);
	write("S4_SRR_RL_Clu_Locationvalid_82 :%f",signalvalue1);
	write("i_S4_SRR_RL_Clu_Locationvalid_82 :%o",@ecu_Signals::i_S4_SRR_RL_Clu_Locationvalid_82);

	testStep("get expect variable value: ","i_S4_SRR_RL_Clu_Locationvalid_82 :%o",@ecu_Signals::i_S4_SRR_RL_Clu_Locationvalid_82);

	if(signalvalue1==@ecu_Signals::i_S4_SRR_RL_Clu_Locationvalid_82)
	{
	testStepPass("Pass","i_S4_SRR_RL_Clu_Locationvalid_82 :%f",signalvalue1);
	}
	else
	{
	testStepFail("Fail","i_S4_SRR_RL_Clu_Locationvalid_82 :%f",signalvalue1);
	}
}

testcase S4_SRR_RL_Clu_Mes_11_S4_SRR_RL_Clu_Theta_83()
{
	signalvalue1 = getSignal(S4_SRR_RL_Clu_Theta_83);
	write("S4_SRR_RL_Clu_Theta_83 :%f",signalvalue1);
	write("i_S4_SRR_RL_Clu_Theta_83 :%f",@ecu_Signals::i_S4_SRR_RL_Clu_Theta_83);

	testStep("get expect variable value: ","i_S4_SRR_RL_Clu_Theta_83 :%f",@ecu_Signals::i_S4_SRR_RL_Clu_Theta_83);

	if((abs(@ecu_Signals::i_S4_SRR_RL_Clu_Theta_83)*0.9<=abs(signalvalue1))&&(abs(signalvalue1)<=abs(@ecu_Signals::i_S4_SRR_RL_Clu_Theta_83)*1.1))
	{
	testStepPass("Pass","i_S4_SRR_RL_Clu_Theta_83 :%f",signalvalue1);
	}
	else
	{
	testStepFail("Fail","i_S4_SRR_RL_Clu_Theta_83 :%f",signalvalue1);
	}
}

testcase S4_SRR_RL_Clu_Mes_11_S4_SRR_RL_Clu_Dist_83()
{
	signalvalue1 = getSignal(S4_SRR_RL_Clu_Dist_83);
	write("S4_SRR_RL_Clu_Dist_83 :%f",signalvalue1);
	write("i_S4_SRR_RL_Clu_Dist_83 :%f",@ecu_Signals::i_S4_SRR_RL_Clu_Dist_83);

	testStep("get expect variable value: ","i_S4_SRR_RL_Clu_Dist_83 :%f",@ecu_Signals::i_S4_SRR_RL_Clu_Dist_83);

	if((abs(@ecu_Signals::i_S4_SRR_RL_Clu_Dist_83)*0.9<=abs(signalvalue1))&&(abs(signalvalue1)<=abs(@ecu_Signals::i_S4_SRR_RL_Clu_Dist_83)*1.1))
	{
	testStepPass("Pass","i_S4_SRR_RL_Clu_Dist_83 :%f",signalvalue1);
	}
	else
	{
	testStepFail("Fail","i_S4_SRR_RL_Clu_Dist_83 :%f",signalvalue1);
	}
}

testcase S4_SRR_RL_Clu_Mes_11_S4_SRR_RL_Clu_Vel_83()
{
	signalvalue1 = getSignal(S4_SRR_RL_Clu_Vel_83);
	write("S4_SRR_RL_Clu_Vel_83 :%f",signalvalue1);
	write("i_S4_SRR_RL_Clu_Vel_83 :%f",@ecu_Signals::i_S4_SRR_RL_Clu_Vel_83);

	testStep("get expect variable value: ","i_S4_SRR_RL_Clu_Vel_83 :%f",@ecu_Signals::i_S4_SRR_RL_Clu_Vel_83);

	if((abs(@ecu_Signals::i_S4_SRR_RL_Clu_Vel_83)*0.9<=abs(signalvalue1))&&(abs(signalvalue1)<=abs(@ecu_Signals::i_S4_SRR_RL_Clu_Vel_83)*1.1))
	{
	testStepPass("Pass","i_S4_SRR_RL_Clu_Vel_83 :%f",signalvalue1);
	}
	else
	{
	testStepFail("Fail","i_S4_SRR_RL_Clu_Vel_83 :%f",signalvalue1);
	}
}

testcase S4_SRR_RL_Clu_Mes_11_S4_SRR_RL_Clu_SNR_83()
{
	signalvalue1 = getSignal(S4_SRR_RL_Clu_SNR_83);
	write("S4_SRR_RL_Clu_SNR_83 :%f",signalvalue1);
	write("i_S4_SRR_RL_Clu_SNR_83 :%f",@ecu_Signals::i_S4_SRR_RL_Clu_SNR_83);

	testStep("get expect variable value: ","i_S4_SRR_RL_Clu_SNR_83 :%f",@ecu_Signals::i_S4_SRR_RL_Clu_SNR_83);

	if((abs(@ecu_Signals::i_S4_SRR_RL_Clu_SNR_83)*0.9<=abs(signalvalue1))&&(abs(signalvalue1)<=abs(@ecu_Signals::i_S4_SRR_RL_Clu_SNR_83)*1.1))
	{
	testStepPass("Pass","i_S4_SRR_RL_Clu_SNR_83 :%f",signalvalue1);
	}
	else
	{
	testStepFail("Fail","i_S4_SRR_RL_Clu_SNR_83 :%f",signalvalue1);
	}
}

testcase S4_SRR_RL_Clu_Mes_11_S4_SRR_RL_Clu_DynProp_83()
{
	signalvalue1 = getSignal(S4_SRR_RL_Clu_DynProp_83);
	write("S4_SRR_RL_Clu_DynProp_83 :%f",signalvalue1);
	write("i_S4_SRR_RL_Clu_DynProp_83 :%o",@ecu_Signals::i_S4_SRR_RL_Clu_DynProp_83);

	testStep("get expect variable value: ","i_S4_SRR_RL_Clu_DynProp_83 :%o",@ecu_Signals::i_S4_SRR_RL_Clu_DynProp_83);

	if(signalvalue1==@ecu_Signals::i_S4_SRR_RL_Clu_DynProp_83)
	{
	testStepPass("Pass","i_S4_SRR_RL_Clu_DynProp_83 :%f",signalvalue1);
	}
	else
	{
	testStepFail("Fail","i_S4_SRR_RL_Clu_DynProp_83 :%f",signalvalue1);
	}
}

testcase S4_SRR_RL_Clu_Mes_11_S4_SRR_RL_Clu_Locationvalid_83()
{
	signalvalue1 = getSignal(S4_SRR_RL_Clu_Locationvalid_83);
	write("S4_SRR_RL_Clu_Locationvalid_83 :%f",signalvalue1);
	write("i_S4_SRR_RL_Clu_Locationvalid_83 :%o",@ecu_Signals::i_S4_SRR_RL_Clu_Locationvalid_83);

	testStep("get expect variable value: ","i_S4_SRR_RL_Clu_Locationvalid_83 :%o",@ecu_Signals::i_S4_SRR_RL_Clu_Locationvalid_83);

	if(signalvalue1==@ecu_Signals::i_S4_SRR_RL_Clu_Locationvalid_83)
	{
	testStepPass("Pass","i_S4_SRR_RL_Clu_Locationvalid_83 :%f",signalvalue1);
	}
	else
	{
	testStepFail("Fail","i_S4_SRR_RL_Clu_Locationvalid_83 :%f",signalvalue1);
	}
}

testcase S4_SRR_RL_Clu_Mes_12_S4_SRR_RL_Clu_Theta_84()
{
	signalvalue1 = getSignal(S4_SRR_RL_Clu_Theta_84);
	write("S4_SRR_RL_Clu_Theta_84 :%f",signalvalue1);
	write("i_S4_SRR_RL_Clu_Theta_84 :%f",@ecu_Signals::i_S4_SRR_RL_Clu_Theta_84);

	testStep("get expect variable value: ","i_S4_SRR_RL_Clu_Theta_84 :%f",@ecu_Signals::i_S4_SRR_RL_Clu_Theta_84);

	if((abs(@ecu_Signals::i_S4_SRR_RL_Clu_Theta_84)*0.9<=abs(signalvalue1))&&(abs(signalvalue1)<=abs(@ecu_Signals::i_S4_SRR_RL_Clu_Theta_84)*1.1))
	{
	testStepPass("Pass","i_S4_SRR_RL_Clu_Theta_84 :%f",signalvalue1);
	}
	else
	{
	testStepFail("Fail","i_S4_SRR_RL_Clu_Theta_84 :%f",signalvalue1);
	}
}

testcase S4_SRR_RL_Clu_Mes_12_S4_SRR_RL_Clu_Dist_84()
{
	signalvalue1 = getSignal(S4_SRR_RL_Clu_Dist_84);
	write("S4_SRR_RL_Clu_Dist_84 :%f",signalvalue1);
	write("i_S4_SRR_RL_Clu_Dist_84 :%f",@ecu_Signals::i_S4_SRR_RL_Clu_Dist_84);

	testStep("get expect variable value: ","i_S4_SRR_RL_Clu_Dist_84 :%f",@ecu_Signals::i_S4_SRR_RL_Clu_Dist_84);

	if((abs(@ecu_Signals::i_S4_SRR_RL_Clu_Dist_84)*0.9<=abs(signalvalue1))&&(abs(signalvalue1)<=abs(@ecu_Signals::i_S4_SRR_RL_Clu_Dist_84)*1.1))
	{
	testStepPass("Pass","i_S4_SRR_RL_Clu_Dist_84 :%f",signalvalue1);
	}
	else
	{
	testStepFail("Fail","i_S4_SRR_RL_Clu_Dist_84 :%f",signalvalue1);
	}
}

testcase S4_SRR_RL_Clu_Mes_12_S4_SRR_RL_Clu_Vel_84()
{
	signalvalue1 = getSignal(S4_SRR_RL_Clu_Vel_84);
	write("S4_SRR_RL_Clu_Vel_84 :%f",signalvalue1);
	write("i_S4_SRR_RL_Clu_Vel_84 :%f",@ecu_Signals::i_S4_SRR_RL_Clu_Vel_84);

	testStep("get expect variable value: ","i_S4_SRR_RL_Clu_Vel_84 :%f",@ecu_Signals::i_S4_SRR_RL_Clu_Vel_84);

	if((abs(@ecu_Signals::i_S4_SRR_RL_Clu_Vel_84)*0.9<=abs(signalvalue1))&&(abs(signalvalue1)<=abs(@ecu_Signals::i_S4_SRR_RL_Clu_Vel_84)*1.1))
	{
	testStepPass("Pass","i_S4_SRR_RL_Clu_Vel_84 :%f",signalvalue1);
	}
	else
	{
	testStepFail("Fail","i_S4_SRR_RL_Clu_Vel_84 :%f",signalvalue1);
	}
}

testcase S4_SRR_RL_Clu_Mes_12_S4_SRR_RL_Clu_SNR_84()
{
	signalvalue1 = getSignal(S4_SRR_RL_Clu_SNR_84);
	write("S4_SRR_RL_Clu_SNR_84 :%f",signalvalue1);
	write("i_S4_SRR_RL_Clu_SNR_84 :%f",@ecu_Signals::i_S4_SRR_RL_Clu_SNR_84);

	testStep("get expect variable value: ","i_S4_SRR_RL_Clu_SNR_84 :%f",@ecu_Signals::i_S4_SRR_RL_Clu_SNR_84);

	if((abs(@ecu_Signals::i_S4_SRR_RL_Clu_SNR_84)*0.9<=abs(signalvalue1))&&(abs(signalvalue1)<=abs(@ecu_Signals::i_S4_SRR_RL_Clu_SNR_84)*1.1))
	{
	testStepPass("Pass","i_S4_SRR_RL_Clu_SNR_84 :%f",signalvalue1);
	}
	else
	{
	testStepFail("Fail","i_S4_SRR_RL_Clu_SNR_84 :%f",signalvalue1);
	}
}

testcase S4_SRR_RL_Clu_Mes_12_S4_SRR_RL_Clu_DynProp_84()
{
	signalvalue1 = getSignal(S4_SRR_RL_Clu_DynProp_84);
	write("S4_SRR_RL_Clu_DynProp_84 :%f",signalvalue1);
	write("i_S4_SRR_RL_Clu_DynProp_84 :%o",@ecu_Signals::i_S4_SRR_RL_Clu_DynProp_84);

	testStep("get expect variable value: ","i_S4_SRR_RL_Clu_DynProp_84 :%o",@ecu_Signals::i_S4_SRR_RL_Clu_DynProp_84);

	if(signalvalue1==@ecu_Signals::i_S4_SRR_RL_Clu_DynProp_84)
	{
	testStepPass("Pass","i_S4_SRR_RL_Clu_DynProp_84 :%f",signalvalue1);
	}
	else
	{
	testStepFail("Fail","i_S4_SRR_RL_Clu_DynProp_84 :%f",signalvalue1);
	}
}

testcase S4_SRR_RL_Clu_Mes_12_S4_SRR_RL_Clu_Locationvalid_84()
{
	signalvalue1 = getSignal(S4_SRR_RL_Clu_Locationvalid_84);
	write("S4_SRR_RL_Clu_Locationvalid_84 :%f",signalvalue1);
	write("i_S4_SRR_RL_Clu_Locationvalid_84 :%o",@ecu_Signals::i_S4_SRR_RL_Clu_Locationvalid_84);

	testStep("get expect variable value: ","i_S4_SRR_RL_Clu_Locationvalid_84 :%o",@ecu_Signals::i_S4_SRR_RL_Clu_Locationvalid_84);

	if(signalvalue1==@ecu_Signals::i_S4_SRR_RL_Clu_Locationvalid_84)
	{
	testStepPass("Pass","i_S4_SRR_RL_Clu_Locationvalid_84 :%f",signalvalue1);
	}
	else
	{
	testStepFail("Fail","i_S4_SRR_RL_Clu_Locationvalid_84 :%f",signalvalue1);
	}
}

testcase S4_SRR_RL_Clu_Mes_12_S4_SRR_RL_Clu_Theta_85()
{
	signalvalue1 = getSignal(S4_SRR_RL_Clu_Theta_85);
	write("S4_SRR_RL_Clu_Theta_85 :%f",signalvalue1);
	write("i_S4_SRR_RL_Clu_Theta_85 :%f",@ecu_Signals::i_S4_SRR_RL_Clu_Theta_85);

	testStep("get expect variable value: ","i_S4_SRR_RL_Clu_Theta_85 :%f",@ecu_Signals::i_S4_SRR_RL_Clu_Theta_85);

	if((abs(@ecu_Signals::i_S4_SRR_RL_Clu_Theta_85)*0.9<=abs(signalvalue1))&&(abs(signalvalue1)<=abs(@ecu_Signals::i_S4_SRR_RL_Clu_Theta_85)*1.1))
	{
	testStepPass("Pass","i_S4_SRR_RL_Clu_Theta_85 :%f",signalvalue1);
	}
	else
	{
	testStepFail("Fail","i_S4_SRR_RL_Clu_Theta_85 :%f",signalvalue1);
	}
}

testcase S4_SRR_RL_Clu_Mes_12_S4_SRR_RL_Clu_Dist_85()
{
	signalvalue1 = getSignal(S4_SRR_RL_Clu_Dist_85);
	write("S4_SRR_RL_Clu_Dist_85 :%f",signalvalue1);
	write("i_S4_SRR_RL_Clu_Dist_85 :%f",@ecu_Signals::i_S4_SRR_RL_Clu_Dist_85);

	testStep("get expect variable value: ","i_S4_SRR_RL_Clu_Dist_85 :%f",@ecu_Signals::i_S4_SRR_RL_Clu_Dist_85);

	if((abs(@ecu_Signals::i_S4_SRR_RL_Clu_Dist_85)*0.9<=abs(signalvalue1))&&(abs(signalvalue1)<=abs(@ecu_Signals::i_S4_SRR_RL_Clu_Dist_85)*1.1))
	{
	testStepPass("Pass","i_S4_SRR_RL_Clu_Dist_85 :%f",signalvalue1);
	}
	else
	{
	testStepFail("Fail","i_S4_SRR_RL_Clu_Dist_85 :%f",signalvalue1);
	}
}

testcase S4_SRR_RL_Clu_Mes_12_S4_SRR_RL_Clu_Vel_85()
{
	signalvalue1 = getSignal(S4_SRR_RL_Clu_Vel_85);
	write("S4_SRR_RL_Clu_Vel_85 :%f",signalvalue1);
	write("i_S4_SRR_RL_Clu_Vel_85 :%f",@ecu_Signals::i_S4_SRR_RL_Clu_Vel_85);

	testStep("get expect variable value: ","i_S4_SRR_RL_Clu_Vel_85 :%f",@ecu_Signals::i_S4_SRR_RL_Clu_Vel_85);

	if((abs(@ecu_Signals::i_S4_SRR_RL_Clu_Vel_85)*0.9<=abs(signalvalue1))&&(abs(signalvalue1)<=abs(@ecu_Signals::i_S4_SRR_RL_Clu_Vel_85)*1.1))
	{
	testStepPass("Pass","i_S4_SRR_RL_Clu_Vel_85 :%f",signalvalue1);
	}
	else
	{
	testStepFail("Fail","i_S4_SRR_RL_Clu_Vel_85 :%f",signalvalue1);
	}
}

testcase S4_SRR_RL_Clu_Mes_12_S4_SRR_RL_Clu_SNR_85()
{
	signalvalue1 = getSignal(S4_SRR_RL_Clu_SNR_85);
	write("S4_SRR_RL_Clu_SNR_85 :%f",signalvalue1);
	write("i_S4_SRR_RL_Clu_SNR_85 :%f",@ecu_Signals::i_S4_SRR_RL_Clu_SNR_85);

	testStep("get expect variable value: ","i_S4_SRR_RL_Clu_SNR_85 :%f",@ecu_Signals::i_S4_SRR_RL_Clu_SNR_85);

	if((abs(@ecu_Signals::i_S4_SRR_RL_Clu_SNR_85)*0.9<=abs(signalvalue1))&&(abs(signalvalue1)<=abs(@ecu_Signals::i_S4_SRR_RL_Clu_SNR_85)*1.1))
	{
	testStepPass("Pass","i_S4_SRR_RL_Clu_SNR_85 :%f",signalvalue1);
	}
	else
	{
	testStepFail("Fail","i_S4_SRR_RL_Clu_SNR_85 :%f",signalvalue1);
	}
}

testcase S4_SRR_RL_Clu_Mes_12_S4_SRR_RL_Clu_DynProp_85()
{
	signalvalue1 = getSignal(S4_SRR_RL_Clu_DynProp_85);
	write("S4_SRR_RL_Clu_DynProp_85 :%f",signalvalue1);
	write("i_S4_SRR_RL_Clu_DynProp_85 :%o",@ecu_Signals::i_S4_SRR_RL_Clu_DynProp_85);

	testStep("get expect variable value: ","i_S4_SRR_RL_Clu_DynProp_85 :%o",@ecu_Signals::i_S4_SRR_RL_Clu_DynProp_85);

	if(signalvalue1==@ecu_Signals::i_S4_SRR_RL_Clu_DynProp_85)
	{
	testStepPass("Pass","i_S4_SRR_RL_Clu_DynProp_85 :%f",signalvalue1);
	}
	else
	{
	testStepFail("Fail","i_S4_SRR_RL_Clu_DynProp_85 :%f",signalvalue1);
	}
}

testcase S4_SRR_RL_Clu_Mes_12_S4_SRR_RL_Clu_Locationvalid_85()
{
	signalvalue1 = getSignal(S4_SRR_RL_Clu_Locationvalid_85);
	write("S4_SRR_RL_Clu_Locationvalid_85 :%f",signalvalue1);
	write("i_S4_SRR_RL_Clu_Locationvalid_85 :%o",@ecu_Signals::i_S4_SRR_RL_Clu_Locationvalid_85);

	testStep("get expect variable value: ","i_S4_SRR_RL_Clu_Locationvalid_85 :%o",@ecu_Signals::i_S4_SRR_RL_Clu_Locationvalid_85);

	if(signalvalue1==@ecu_Signals::i_S4_SRR_RL_Clu_Locationvalid_85)
	{
	testStepPass("Pass","i_S4_SRR_RL_Clu_Locationvalid_85 :%f",signalvalue1);
	}
	else
	{
	testStepFail("Fail","i_S4_SRR_RL_Clu_Locationvalid_85 :%f",signalvalue1);
	}
}

testcase S4_SRR_RL_Clu_Mes_12_S4_SRR_RL_Clu_Theta_86()
{
	signalvalue1 = getSignal(S4_SRR_RL_Clu_Theta_86);
	write("S4_SRR_RL_Clu_Theta_86 :%f",signalvalue1);
	write("i_S4_SRR_RL_Clu_Theta_86 :%f",@ecu_Signals::i_S4_SRR_RL_Clu_Theta_86);

	testStep("get expect variable value: ","i_S4_SRR_RL_Clu_Theta_86 :%f",@ecu_Signals::i_S4_SRR_RL_Clu_Theta_86);

	if((abs(@ecu_Signals::i_S4_SRR_RL_Clu_Theta_86)*0.9<=abs(signalvalue1))&&(abs(signalvalue1)<=abs(@ecu_Signals::i_S4_SRR_RL_Clu_Theta_86)*1.1))
	{
	testStepPass("Pass","i_S4_SRR_RL_Clu_Theta_86 :%f",signalvalue1);
	}
	else
	{
	testStepFail("Fail","i_S4_SRR_RL_Clu_Theta_86 :%f",signalvalue1);
	}
}

testcase S4_SRR_RL_Clu_Mes_12_S4_SRR_RL_Clu_Dist_86()
{
	signalvalue1 = getSignal(S4_SRR_RL_Clu_Dist_86);
	write("S4_SRR_RL_Clu_Dist_86 :%f",signalvalue1);
	write("i_S4_SRR_RL_Clu_Dist_86 :%f",@ecu_Signals::i_S4_SRR_RL_Clu_Dist_86);

	testStep("get expect variable value: ","i_S4_SRR_RL_Clu_Dist_86 :%f",@ecu_Signals::i_S4_SRR_RL_Clu_Dist_86);

	if((abs(@ecu_Signals::i_S4_SRR_RL_Clu_Dist_86)*0.9<=abs(signalvalue1))&&(abs(signalvalue1)<=abs(@ecu_Signals::i_S4_SRR_RL_Clu_Dist_86)*1.1))
	{
	testStepPass("Pass","i_S4_SRR_RL_Clu_Dist_86 :%f",signalvalue1);
	}
	else
	{
	testStepFail("Fail","i_S4_SRR_RL_Clu_Dist_86 :%f",signalvalue1);
	}
}

testcase S4_SRR_RL_Clu_Mes_12_S4_SRR_RL_Clu_Vel_86()
{
	signalvalue1 = getSignal(S4_SRR_RL_Clu_Vel_86);
	write("S4_SRR_RL_Clu_Vel_86 :%f",signalvalue1);
	write("i_S4_SRR_RL_Clu_Vel_86 :%f",@ecu_Signals::i_S4_SRR_RL_Clu_Vel_86);

	testStep("get expect variable value: ","i_S4_SRR_RL_Clu_Vel_86 :%f",@ecu_Signals::i_S4_SRR_RL_Clu_Vel_86);

	if((abs(@ecu_Signals::i_S4_SRR_RL_Clu_Vel_86)*0.9<=abs(signalvalue1))&&(abs(signalvalue1)<=abs(@ecu_Signals::i_S4_SRR_RL_Clu_Vel_86)*1.1))
	{
	testStepPass("Pass","i_S4_SRR_RL_Clu_Vel_86 :%f",signalvalue1);
	}
	else
	{
	testStepFail("Fail","i_S4_SRR_RL_Clu_Vel_86 :%f",signalvalue1);
	}
}

testcase S4_SRR_RL_Clu_Mes_12_S4_SRR_RL_Clu_SNR_86()
{
	signalvalue1 = getSignal(S4_SRR_RL_Clu_SNR_86);
	write("S4_SRR_RL_Clu_SNR_86 :%f",signalvalue1);
	write("i_S4_SRR_RL_Clu_SNR_86 :%f",@ecu_Signals::i_S4_SRR_RL_Clu_SNR_86);

	testStep("get expect variable value: ","i_S4_SRR_RL_Clu_SNR_86 :%f",@ecu_Signals::i_S4_SRR_RL_Clu_SNR_86);

	if((abs(@ecu_Signals::i_S4_SRR_RL_Clu_SNR_86)*0.9<=abs(signalvalue1))&&(abs(signalvalue1)<=abs(@ecu_Signals::i_S4_SRR_RL_Clu_SNR_86)*1.1))
	{
	testStepPass("Pass","i_S4_SRR_RL_Clu_SNR_86 :%f",signalvalue1);
	}
	else
	{
	testStepFail("Fail","i_S4_SRR_RL_Clu_SNR_86 :%f",signalvalue1);
	}
}

testcase S4_SRR_RL_Clu_Mes_12_S4_SRR_RL_Clu_DynProp_86()
{
	signalvalue1 = getSignal(S4_SRR_RL_Clu_DynProp_86);
	write("S4_SRR_RL_Clu_DynProp_86 :%f",signalvalue1);
	write("i_S4_SRR_RL_Clu_DynProp_86 :%o",@ecu_Signals::i_S4_SRR_RL_Clu_DynProp_86);

	testStep("get expect variable value: ","i_S4_SRR_RL_Clu_DynProp_86 :%o",@ecu_Signals::i_S4_SRR_RL_Clu_DynProp_86);

	if(signalvalue1==@ecu_Signals::i_S4_SRR_RL_Clu_DynProp_86)
	{
	testStepPass("Pass","i_S4_SRR_RL_Clu_DynProp_86 :%f",signalvalue1);
	}
	else
	{
	testStepFail("Fail","i_S4_SRR_RL_Clu_DynProp_86 :%f",signalvalue1);
	}
}

testcase S4_SRR_RL_Clu_Mes_12_S4_SRR_RL_Clu_Locationvalid_86()
{
	signalvalue1 = getSignal(S4_SRR_RL_Clu_Locationvalid_86);
	write("S4_SRR_RL_Clu_Locationvalid_86 :%f",signalvalue1);
	write("i_S4_SRR_RL_Clu_Locationvalid_86 :%o",@ecu_Signals::i_S4_SRR_RL_Clu_Locationvalid_86);

	testStep("get expect variable value: ","i_S4_SRR_RL_Clu_Locationvalid_86 :%o",@ecu_Signals::i_S4_SRR_RL_Clu_Locationvalid_86);

	if(signalvalue1==@ecu_Signals::i_S4_SRR_RL_Clu_Locationvalid_86)
	{
	testStepPass("Pass","i_S4_SRR_RL_Clu_Locationvalid_86 :%f",signalvalue1);
	}
	else
	{
	testStepFail("Fail","i_S4_SRR_RL_Clu_Locationvalid_86 :%f",signalvalue1);
	}
}

testcase S4_SRR_RL_Clu_Mes_12_S4_SRR_RL_Clu_Theta_87()
{
	signalvalue1 = getSignal(S4_SRR_RL_Clu_Theta_87);
	write("S4_SRR_RL_Clu_Theta_87 :%f",signalvalue1);
	write("i_S4_SRR_RL_Clu_Theta_87 :%f",@ecu_Signals::i_S4_SRR_RL_Clu_Theta_87);

	testStep("get expect variable value: ","i_S4_SRR_RL_Clu_Theta_87 :%f",@ecu_Signals::i_S4_SRR_RL_Clu_Theta_87);

	if((abs(@ecu_Signals::i_S4_SRR_RL_Clu_Theta_87)*0.9<=abs(signalvalue1))&&(abs(signalvalue1)<=abs(@ecu_Signals::i_S4_SRR_RL_Clu_Theta_87)*1.1))
	{
	testStepPass("Pass","i_S4_SRR_RL_Clu_Theta_87 :%f",signalvalue1);
	}
	else
	{
	testStepFail("Fail","i_S4_SRR_RL_Clu_Theta_87 :%f",signalvalue1);
	}
}

testcase S4_SRR_RL_Clu_Mes_12_S4_SRR_RL_Clu_Dist_87()
{
	signalvalue1 = getSignal(S4_SRR_RL_Clu_Dist_87);
	write("S4_SRR_RL_Clu_Dist_87 :%f",signalvalue1);
	write("i_S4_SRR_RL_Clu_Dist_87 :%f",@ecu_Signals::i_S4_SRR_RL_Clu_Dist_87);

	testStep("get expect variable value: ","i_S4_SRR_RL_Clu_Dist_87 :%f",@ecu_Signals::i_S4_SRR_RL_Clu_Dist_87);

	if((abs(@ecu_Signals::i_S4_SRR_RL_Clu_Dist_87)*0.9<=abs(signalvalue1))&&(abs(signalvalue1)<=abs(@ecu_Signals::i_S4_SRR_RL_Clu_Dist_87)*1.1))
	{
	testStepPass("Pass","i_S4_SRR_RL_Clu_Dist_87 :%f",signalvalue1);
	}
	else
	{
	testStepFail("Fail","i_S4_SRR_RL_Clu_Dist_87 :%f",signalvalue1);
	}
}

testcase S4_SRR_RL_Clu_Mes_12_S4_SRR_RL_Clu_Vel_87()
{
	signalvalue1 = getSignal(S4_SRR_RL_Clu_Vel_87);
	write("S4_SRR_RL_Clu_Vel_87 :%f",signalvalue1);
	write("i_S4_SRR_RL_Clu_Vel_87 :%f",@ecu_Signals::i_S4_SRR_RL_Clu_Vel_87);

	testStep("get expect variable value: ","i_S4_SRR_RL_Clu_Vel_87 :%f",@ecu_Signals::i_S4_SRR_RL_Clu_Vel_87);

	if((abs(@ecu_Signals::i_S4_SRR_RL_Clu_Vel_87)*0.9<=abs(signalvalue1))&&(abs(signalvalue1)<=abs(@ecu_Signals::i_S4_SRR_RL_Clu_Vel_87)*1.1))
	{
	testStepPass("Pass","i_S4_SRR_RL_Clu_Vel_87 :%f",signalvalue1);
	}
	else
	{
	testStepFail("Fail","i_S4_SRR_RL_Clu_Vel_87 :%f",signalvalue1);
	}
}

testcase S4_SRR_RL_Clu_Mes_12_S4_SRR_RL_Clu_SNR_87()
{
	signalvalue1 = getSignal(S4_SRR_RL_Clu_SNR_87);
	write("S4_SRR_RL_Clu_SNR_87 :%f",signalvalue1);
	write("i_S4_SRR_RL_Clu_SNR_87 :%f",@ecu_Signals::i_S4_SRR_RL_Clu_SNR_87);

	testStep("get expect variable value: ","i_S4_SRR_RL_Clu_SNR_87 :%f",@ecu_Signals::i_S4_SRR_RL_Clu_SNR_87);

	if((abs(@ecu_Signals::i_S4_SRR_RL_Clu_SNR_87)*0.9<=abs(signalvalue1))&&(abs(signalvalue1)<=abs(@ecu_Signals::i_S4_SRR_RL_Clu_SNR_87)*1.1))
	{
	testStepPass("Pass","i_S4_SRR_RL_Clu_SNR_87 :%f",signalvalue1);
	}
	else
	{
	testStepFail("Fail","i_S4_SRR_RL_Clu_SNR_87 :%f",signalvalue1);
	}
}

testcase S4_SRR_RL_Clu_Mes_12_S4_SRR_RL_Clu_DynProp_87()
{
	signalvalue1 = getSignal(S4_SRR_RL_Clu_DynProp_87);
	write("S4_SRR_RL_Clu_DynProp_87 :%f",signalvalue1);
	write("i_S4_SRR_RL_Clu_DynProp_87 :%o",@ecu_Signals::i_S4_SRR_RL_Clu_DynProp_87);

	testStep("get expect variable value: ","i_S4_SRR_RL_Clu_DynProp_87 :%o",@ecu_Signals::i_S4_SRR_RL_Clu_DynProp_87);

	if(signalvalue1==@ecu_Signals::i_S4_SRR_RL_Clu_DynProp_87)
	{
	testStepPass("Pass","i_S4_SRR_RL_Clu_DynProp_87 :%f",signalvalue1);
	}
	else
	{
	testStepFail("Fail","i_S4_SRR_RL_Clu_DynProp_87 :%f",signalvalue1);
	}
}

testcase S4_SRR_RL_Clu_Mes_12_S4_SRR_RL_Clu_Locationvalid_87()
{
	signalvalue1 = getSignal(S4_SRR_RL_Clu_Locationvalid_87);
	write("S4_SRR_RL_Clu_Locationvalid_87 :%f",signalvalue1);
	write("i_S4_SRR_RL_Clu_Locationvalid_87 :%o",@ecu_Signals::i_S4_SRR_RL_Clu_Locationvalid_87);

	testStep("get expect variable value: ","i_S4_SRR_RL_Clu_Locationvalid_87 :%o",@ecu_Signals::i_S4_SRR_RL_Clu_Locationvalid_87);

	if(signalvalue1==@ecu_Signals::i_S4_SRR_RL_Clu_Locationvalid_87)
	{
	testStepPass("Pass","i_S4_SRR_RL_Clu_Locationvalid_87 :%f",signalvalue1);
	}
	else
	{
	testStepFail("Fail","i_S4_SRR_RL_Clu_Locationvalid_87 :%f",signalvalue1);
	}
}

testcase S4_SRR_RL_Clu_Mes_12_S4_SRR_RL_Clu_Theta_88()
{
	signalvalue1 = getSignal(S4_SRR_RL_Clu_Theta_88);
	write("S4_SRR_RL_Clu_Theta_88 :%f",signalvalue1);
	write("i_S4_SRR_RL_Clu_Theta_88 :%f",@ecu_Signals::i_S4_SRR_RL_Clu_Theta_88);

	testStep("get expect variable value: ","i_S4_SRR_RL_Clu_Theta_88 :%f",@ecu_Signals::i_S4_SRR_RL_Clu_Theta_88);

	if((abs(@ecu_Signals::i_S4_SRR_RL_Clu_Theta_88)*0.9<=abs(signalvalue1))&&(abs(signalvalue1)<=abs(@ecu_Signals::i_S4_SRR_RL_Clu_Theta_88)*1.1))
	{
	testStepPass("Pass","i_S4_SRR_RL_Clu_Theta_88 :%f",signalvalue1);
	}
	else
	{
	testStepFail("Fail","i_S4_SRR_RL_Clu_Theta_88 :%f",signalvalue1);
	}
}

testcase S4_SRR_RL_Clu_Mes_12_S4_SRR_RL_Clu_Dist_88()
{
	signalvalue1 = getSignal(S4_SRR_RL_Clu_Dist_88);
	write("S4_SRR_RL_Clu_Dist_88 :%f",signalvalue1);
	write("i_S4_SRR_RL_Clu_Dist_88 :%f",@ecu_Signals::i_S4_SRR_RL_Clu_Dist_88);

	testStep("get expect variable value: ","i_S4_SRR_RL_Clu_Dist_88 :%f",@ecu_Signals::i_S4_SRR_RL_Clu_Dist_88);

	if((abs(@ecu_Signals::i_S4_SRR_RL_Clu_Dist_88)*0.9<=abs(signalvalue1))&&(abs(signalvalue1)<=abs(@ecu_Signals::i_S4_SRR_RL_Clu_Dist_88)*1.1))
	{
	testStepPass("Pass","i_S4_SRR_RL_Clu_Dist_88 :%f",signalvalue1);
	}
	else
	{
	testStepFail("Fail","i_S4_SRR_RL_Clu_Dist_88 :%f",signalvalue1);
	}
}

testcase S4_SRR_RL_Clu_Mes_12_S4_SRR_RL_Clu_Vel_88()
{
	signalvalue1 = getSignal(S4_SRR_RL_Clu_Vel_88);
	write("S4_SRR_RL_Clu_Vel_88 :%f",signalvalue1);
	write("i_S4_SRR_RL_Clu_Vel_88 :%f",@ecu_Signals::i_S4_SRR_RL_Clu_Vel_88);

	testStep("get expect variable value: ","i_S4_SRR_RL_Clu_Vel_88 :%f",@ecu_Signals::i_S4_SRR_RL_Clu_Vel_88);

	if((abs(@ecu_Signals::i_S4_SRR_RL_Clu_Vel_88)*0.9<=abs(signalvalue1))&&(abs(signalvalue1)<=abs(@ecu_Signals::i_S4_SRR_RL_Clu_Vel_88)*1.1))
	{
	testStepPass("Pass","i_S4_SRR_RL_Clu_Vel_88 :%f",signalvalue1);
	}
	else
	{
	testStepFail("Fail","i_S4_SRR_RL_Clu_Vel_88 :%f",signalvalue1);
	}
}

testcase S4_SRR_RL_Clu_Mes_12_S4_SRR_RL_Clu_SNR_88()
{
	signalvalue1 = getSignal(S4_SRR_RL_Clu_SNR_88);
	write("S4_SRR_RL_Clu_SNR_88 :%f",signalvalue1);
	write("i_S4_SRR_RL_Clu_SNR_88 :%f",@ecu_Signals::i_S4_SRR_RL_Clu_SNR_88);

	testStep("get expect variable value: ","i_S4_SRR_RL_Clu_SNR_88 :%f",@ecu_Signals::i_S4_SRR_RL_Clu_SNR_88);

	if((abs(@ecu_Signals::i_S4_SRR_RL_Clu_SNR_88)*0.9<=abs(signalvalue1))&&(abs(signalvalue1)<=abs(@ecu_Signals::i_S4_SRR_RL_Clu_SNR_88)*1.1))
	{
	testStepPass("Pass","i_S4_SRR_RL_Clu_SNR_88 :%f",signalvalue1);
	}
	else
	{
	testStepFail("Fail","i_S4_SRR_RL_Clu_SNR_88 :%f",signalvalue1);
	}
}

testcase S4_SRR_RL_Clu_Mes_12_S4_SRR_RL_Clu_DynProp_88()
{
	signalvalue1 = getSignal(S4_SRR_RL_Clu_DynProp_88);
	write("S4_SRR_RL_Clu_DynProp_88 :%f",signalvalue1);
	write("i_S4_SRR_RL_Clu_DynProp_88 :%o",@ecu_Signals::i_S4_SRR_RL_Clu_DynProp_88);

	testStep("get expect variable value: ","i_S4_SRR_RL_Clu_DynProp_88 :%o",@ecu_Signals::i_S4_SRR_RL_Clu_DynProp_88);

	if(signalvalue1==@ecu_Signals::i_S4_SRR_RL_Clu_DynProp_88)
	{
	testStepPass("Pass","i_S4_SRR_RL_Clu_DynProp_88 :%f",signalvalue1);
	}
	else
	{
	testStepFail("Fail","i_S4_SRR_RL_Clu_DynProp_88 :%f",signalvalue1);
	}
}

testcase S4_SRR_RL_Clu_Mes_12_S4_SRR_RL_Clu_Locationvalid_88()
{
	signalvalue1 = getSignal(S4_SRR_RL_Clu_Locationvalid_88);
	write("S4_SRR_RL_Clu_Locationvalid_88 :%f",signalvalue1);
	write("i_S4_SRR_RL_Clu_Locationvalid_88 :%o",@ecu_Signals::i_S4_SRR_RL_Clu_Locationvalid_88);

	testStep("get expect variable value: ","i_S4_SRR_RL_Clu_Locationvalid_88 :%o",@ecu_Signals::i_S4_SRR_RL_Clu_Locationvalid_88);

	if(signalvalue1==@ecu_Signals::i_S4_SRR_RL_Clu_Locationvalid_88)
	{
	testStepPass("Pass","i_S4_SRR_RL_Clu_Locationvalid_88 :%f",signalvalue1);
	}
	else
	{
	testStepFail("Fail","i_S4_SRR_RL_Clu_Locationvalid_88 :%f",signalvalue1);
	}
}

testcase S4_SRR_RL_Clu_Mes_12_S4_SRR_RL_Clu_Theta_89()
{
	signalvalue1 = getSignal(S4_SRR_RL_Clu_Theta_89);
	write("S4_SRR_RL_Clu_Theta_89 :%f",signalvalue1);
	write("i_S4_SRR_RL_Clu_Theta_89 :%f",@ecu_Signals::i_S4_SRR_RL_Clu_Theta_89);

	testStep("get expect variable value: ","i_S4_SRR_RL_Clu_Theta_89 :%f",@ecu_Signals::i_S4_SRR_RL_Clu_Theta_89);

	if((abs(@ecu_Signals::i_S4_SRR_RL_Clu_Theta_89)*0.9<=abs(signalvalue1))&&(abs(signalvalue1)<=abs(@ecu_Signals::i_S4_SRR_RL_Clu_Theta_89)*1.1))
	{
	testStepPass("Pass","i_S4_SRR_RL_Clu_Theta_89 :%f",signalvalue1);
	}
	else
	{
	testStepFail("Fail","i_S4_SRR_RL_Clu_Theta_89 :%f",signalvalue1);
	}
}

testcase S4_SRR_RL_Clu_Mes_12_S4_SRR_RL_Clu_Dist_89()
{
	signalvalue1 = getSignal(S4_SRR_RL_Clu_Dist_89);
	write("S4_SRR_RL_Clu_Dist_89 :%f",signalvalue1);
	write("i_S4_SRR_RL_Clu_Dist_89 :%f",@ecu_Signals::i_S4_SRR_RL_Clu_Dist_89);

	testStep("get expect variable value: ","i_S4_SRR_RL_Clu_Dist_89 :%f",@ecu_Signals::i_S4_SRR_RL_Clu_Dist_89);

	if((abs(@ecu_Signals::i_S4_SRR_RL_Clu_Dist_89)*0.9<=abs(signalvalue1))&&(abs(signalvalue1)<=abs(@ecu_Signals::i_S4_SRR_RL_Clu_Dist_89)*1.1))
	{
	testStepPass("Pass","i_S4_SRR_RL_Clu_Dist_89 :%f",signalvalue1);
	}
	else
	{
	testStepFail("Fail","i_S4_SRR_RL_Clu_Dist_89 :%f",signalvalue1);
	}
}

testcase S4_SRR_RL_Clu_Mes_12_S4_SRR_RL_Clu_Vel_89()
{
	signalvalue1 = getSignal(S4_SRR_RL_Clu_Vel_89);
	write("S4_SRR_RL_Clu_Vel_89 :%f",signalvalue1);
	write("i_S4_SRR_RL_Clu_Vel_89 :%f",@ecu_Signals::i_S4_SRR_RL_Clu_Vel_89);

	testStep("get expect variable value: ","i_S4_SRR_RL_Clu_Vel_89 :%f",@ecu_Signals::i_S4_SRR_RL_Clu_Vel_89);

	if((abs(@ecu_Signals::i_S4_SRR_RL_Clu_Vel_89)*0.9<=abs(signalvalue1))&&(abs(signalvalue1)<=abs(@ecu_Signals::i_S4_SRR_RL_Clu_Vel_89)*1.1))
	{
	testStepPass("Pass","i_S4_SRR_RL_Clu_Vel_89 :%f",signalvalue1);
	}
	else
	{
	testStepFail("Fail","i_S4_SRR_RL_Clu_Vel_89 :%f",signalvalue1);
	}
}

testcase S4_SRR_RL_Clu_Mes_12_S4_SRR_RL_Clu_SNR_89()
{
	signalvalue1 = getSignal(S4_SRR_RL_Clu_SNR_89);
	write("S4_SRR_RL_Clu_SNR_89 :%f",signalvalue1);
	write("i_S4_SRR_RL_Clu_SNR_89 :%f",@ecu_Signals::i_S4_SRR_RL_Clu_SNR_89);

	testStep("get expect variable value: ","i_S4_SRR_RL_Clu_SNR_89 :%f",@ecu_Signals::i_S4_SRR_RL_Clu_SNR_89);

	if((abs(@ecu_Signals::i_S4_SRR_RL_Clu_SNR_89)*0.9<=abs(signalvalue1))&&(abs(signalvalue1)<=abs(@ecu_Signals::i_S4_SRR_RL_Clu_SNR_89)*1.1))
	{
	testStepPass("Pass","i_S4_SRR_RL_Clu_SNR_89 :%f",signalvalue1);
	}
	else
	{
	testStepFail("Fail","i_S4_SRR_RL_Clu_SNR_89 :%f",signalvalue1);
	}
}

testcase S4_SRR_RL_Clu_Mes_12_S4_SRR_RL_Clu_DynProp_89()
{
	signalvalue1 = getSignal(S4_SRR_RL_Clu_DynProp_89);
	write("S4_SRR_RL_Clu_DynProp_89 :%f",signalvalue1);
	write("i_S4_SRR_RL_Clu_DynProp_89 :%o",@ecu_Signals::i_S4_SRR_RL_Clu_DynProp_89);

	testStep("get expect variable value: ","i_S4_SRR_RL_Clu_DynProp_89 :%o",@ecu_Signals::i_S4_SRR_RL_Clu_DynProp_89);

	if(signalvalue1==@ecu_Signals::i_S4_SRR_RL_Clu_DynProp_89)
	{
	testStepPass("Pass","i_S4_SRR_RL_Clu_DynProp_89 :%f",signalvalue1);
	}
	else
	{
	testStepFail("Fail","i_S4_SRR_RL_Clu_DynProp_89 :%f",signalvalue1);
	}
}

testcase S4_SRR_RL_Clu_Mes_12_S4_SRR_RL_Clu_Locationvalid_89()
{
	signalvalue1 = getSignal(S4_SRR_RL_Clu_Locationvalid_89);
	write("S4_SRR_RL_Clu_Locationvalid_89 :%f",signalvalue1);
	write("i_S4_SRR_RL_Clu_Locationvalid_89 :%o",@ecu_Signals::i_S4_SRR_RL_Clu_Locationvalid_89);

	testStep("get expect variable value: ","i_S4_SRR_RL_Clu_Locationvalid_89 :%o",@ecu_Signals::i_S4_SRR_RL_Clu_Locationvalid_89);

	if(signalvalue1==@ecu_Signals::i_S4_SRR_RL_Clu_Locationvalid_89)
	{
	testStepPass("Pass","i_S4_SRR_RL_Clu_Locationvalid_89 :%f",signalvalue1);
	}
	else
	{
	testStepFail("Fail","i_S4_SRR_RL_Clu_Locationvalid_89 :%f",signalvalue1);
	}
}

testcase S4_SRR_RL_Clu_Mes_12_S4_SRR_RL_Clu_Theta_90()
{
	signalvalue1 = getSignal(S4_SRR_RL_Clu_Theta_90);
	write("S4_SRR_RL_Clu_Theta_90 :%f",signalvalue1);
	write("i_S4_SRR_RL_Clu_Theta_90 :%f",@ecu_Signals::i_S4_SRR_RL_Clu_Theta_90);

	testStep("get expect variable value: ","i_S4_SRR_RL_Clu_Theta_90 :%f",@ecu_Signals::i_S4_SRR_RL_Clu_Theta_90);

	if((abs(@ecu_Signals::i_S4_SRR_RL_Clu_Theta_90)*0.9<=abs(signalvalue1))&&(abs(signalvalue1)<=abs(@ecu_Signals::i_S4_SRR_RL_Clu_Theta_90)*1.1))
	{
	testStepPass("Pass","i_S4_SRR_RL_Clu_Theta_90 :%f",signalvalue1);
	}
	else
	{
	testStepFail("Fail","i_S4_SRR_RL_Clu_Theta_90 :%f",signalvalue1);
	}
}

testcase S4_SRR_RL_Clu_Mes_12_S4_SRR_RL_Clu_Dist_90()
{
	signalvalue1 = getSignal(S4_SRR_RL_Clu_Dist_90);
	write("S4_SRR_RL_Clu_Dist_90 :%f",signalvalue1);
	write("i_S4_SRR_RL_Clu_Dist_90 :%f",@ecu_Signals::i_S4_SRR_RL_Clu_Dist_90);

	testStep("get expect variable value: ","i_S4_SRR_RL_Clu_Dist_90 :%f",@ecu_Signals::i_S4_SRR_RL_Clu_Dist_90);

	if((abs(@ecu_Signals::i_S4_SRR_RL_Clu_Dist_90)*0.9<=abs(signalvalue1))&&(abs(signalvalue1)<=abs(@ecu_Signals::i_S4_SRR_RL_Clu_Dist_90)*1.1))
	{
	testStepPass("Pass","i_S4_SRR_RL_Clu_Dist_90 :%f",signalvalue1);
	}
	else
	{
	testStepFail("Fail","i_S4_SRR_RL_Clu_Dist_90 :%f",signalvalue1);
	}
}

testcase S4_SRR_RL_Clu_Mes_12_S4_SRR_RL_Clu_Vel_90()
{
	signalvalue1 = getSignal(S4_SRR_RL_Clu_Vel_90);
	write("S4_SRR_RL_Clu_Vel_90 :%f",signalvalue1);
	write("i_S4_SRR_RL_Clu_Vel_90 :%f",@ecu_Signals::i_S4_SRR_RL_Clu_Vel_90);

	testStep("get expect variable value: ","i_S4_SRR_RL_Clu_Vel_90 :%f",@ecu_Signals::i_S4_SRR_RL_Clu_Vel_90);

	if((abs(@ecu_Signals::i_S4_SRR_RL_Clu_Vel_90)*0.9<=abs(signalvalue1))&&(abs(signalvalue1)<=abs(@ecu_Signals::i_S4_SRR_RL_Clu_Vel_90)*1.1))
	{
	testStepPass("Pass","i_S4_SRR_RL_Clu_Vel_90 :%f",signalvalue1);
	}
	else
	{
	testStepFail("Fail","i_S4_SRR_RL_Clu_Vel_90 :%f",signalvalue1);
	}
}

testcase S4_SRR_RL_Clu_Mes_12_S4_SRR_RL_Clu_SNR_90()
{
	signalvalue1 = getSignal(S4_SRR_RL_Clu_SNR_90);
	write("S4_SRR_RL_Clu_SNR_90 :%f",signalvalue1);
	write("i_S4_SRR_RL_Clu_SNR_90 :%f",@ecu_Signals::i_S4_SRR_RL_Clu_SNR_90);

	testStep("get expect variable value: ","i_S4_SRR_RL_Clu_SNR_90 :%f",@ecu_Signals::i_S4_SRR_RL_Clu_SNR_90);

	if((abs(@ecu_Signals::i_S4_SRR_RL_Clu_SNR_90)*0.9<=abs(signalvalue1))&&(abs(signalvalue1)<=abs(@ecu_Signals::i_S4_SRR_RL_Clu_SNR_90)*1.1))
	{
	testStepPass("Pass","i_S4_SRR_RL_Clu_SNR_90 :%f",signalvalue1);
	}
	else
	{
	testStepFail("Fail","i_S4_SRR_RL_Clu_SNR_90 :%f",signalvalue1);
	}
}

testcase S4_SRR_RL_Clu_Mes_12_S4_SRR_RL_Clu_DynProp_90()
{
	signalvalue1 = getSignal(S4_SRR_RL_Clu_DynProp_90);
	write("S4_SRR_RL_Clu_DynProp_90 :%f",signalvalue1);
	write("i_S4_SRR_RL_Clu_DynProp_90 :%o",@ecu_Signals::i_S4_SRR_RL_Clu_DynProp_90);

	testStep("get expect variable value: ","i_S4_SRR_RL_Clu_DynProp_90 :%o",@ecu_Signals::i_S4_SRR_RL_Clu_DynProp_90);

	if(signalvalue1==@ecu_Signals::i_S4_SRR_RL_Clu_DynProp_90)
	{
	testStepPass("Pass","i_S4_SRR_RL_Clu_DynProp_90 :%f",signalvalue1);
	}
	else
	{
	testStepFail("Fail","i_S4_SRR_RL_Clu_DynProp_90 :%f",signalvalue1);
	}
}

testcase S4_SRR_RL_Clu_Mes_12_S4_SRR_RL_Clu_Locationvalid_90()
{
	signalvalue1 = getSignal(S4_SRR_RL_Clu_Locationvalid_90);
	write("S4_SRR_RL_Clu_Locationvalid_90 :%f",signalvalue1);
	write("i_S4_SRR_RL_Clu_Locationvalid_90 :%o",@ecu_Signals::i_S4_SRR_RL_Clu_Locationvalid_90);

	testStep("get expect variable value: ","i_S4_SRR_RL_Clu_Locationvalid_90 :%o",@ecu_Signals::i_S4_SRR_RL_Clu_Locationvalid_90);

	if(signalvalue1==@ecu_Signals::i_S4_SRR_RL_Clu_Locationvalid_90)
	{
	testStepPass("Pass","i_S4_SRR_RL_Clu_Locationvalid_90 :%f",signalvalue1);
	}
	else
	{
	testStepFail("Fail","i_S4_SRR_RL_Clu_Locationvalid_90 :%f",signalvalue1);
	}
}

testcase S4_SRR_RL_Clu_Mes_13_S4_SRR_RL_Clu_Theta_91()
{
	signalvalue1 = getSignal(S4_SRR_RL_Clu_Theta_91);
	write("S4_SRR_RL_Clu_Theta_91 :%f",signalvalue1);
	write("i_S4_SRR_RL_Clu_Theta_91 :%f",@ecu_Signals::i_S4_SRR_RL_Clu_Theta_91);

	testStep("get expect variable value: ","i_S4_SRR_RL_Clu_Theta_91 :%f",@ecu_Signals::i_S4_SRR_RL_Clu_Theta_91);

	if((abs(@ecu_Signals::i_S4_SRR_RL_Clu_Theta_91)*0.9<=abs(signalvalue1))&&(abs(signalvalue1)<=abs(@ecu_Signals::i_S4_SRR_RL_Clu_Theta_91)*1.1))
	{
	testStepPass("Pass","i_S4_SRR_RL_Clu_Theta_91 :%f",signalvalue1);
	}
	else
	{
	testStepFail("Fail","i_S4_SRR_RL_Clu_Theta_91 :%f",signalvalue1);
	}
}

testcase S4_SRR_RL_Clu_Mes_13_S4_SRR_RL_Clu_Dist_91()
{
	signalvalue1 = getSignal(S4_SRR_RL_Clu_Dist_91);
	write("S4_SRR_RL_Clu_Dist_91 :%f",signalvalue1);
	write("i_S4_SRR_RL_Clu_Dist_91 :%f",@ecu_Signals::i_S4_SRR_RL_Clu_Dist_91);

	testStep("get expect variable value: ","i_S4_SRR_RL_Clu_Dist_91 :%f",@ecu_Signals::i_S4_SRR_RL_Clu_Dist_91);

	if((abs(@ecu_Signals::i_S4_SRR_RL_Clu_Dist_91)*0.9<=abs(signalvalue1))&&(abs(signalvalue1)<=abs(@ecu_Signals::i_S4_SRR_RL_Clu_Dist_91)*1.1))
	{
	testStepPass("Pass","i_S4_SRR_RL_Clu_Dist_91 :%f",signalvalue1);
	}
	else
	{
	testStepFail("Fail","i_S4_SRR_RL_Clu_Dist_91 :%f",signalvalue1);
	}
}

testcase S4_SRR_RL_Clu_Mes_13_S4_SRR_RL_Clu_Vel_91()
{
	signalvalue1 = getSignal(S4_SRR_RL_Clu_Vel_91);
	write("S4_SRR_RL_Clu_Vel_91 :%f",signalvalue1);
	write("i_S4_SRR_RL_Clu_Vel_91 :%f",@ecu_Signals::i_S4_SRR_RL_Clu_Vel_91);

	testStep("get expect variable value: ","i_S4_SRR_RL_Clu_Vel_91 :%f",@ecu_Signals::i_S4_SRR_RL_Clu_Vel_91);

	if((abs(@ecu_Signals::i_S4_SRR_RL_Clu_Vel_91)*0.9<=abs(signalvalue1))&&(abs(signalvalue1)<=abs(@ecu_Signals::i_S4_SRR_RL_Clu_Vel_91)*1.1))
	{
	testStepPass("Pass","i_S4_SRR_RL_Clu_Vel_91 :%f",signalvalue1);
	}
	else
	{
	testStepFail("Fail","i_S4_SRR_RL_Clu_Vel_91 :%f",signalvalue1);
	}
}

testcase S4_SRR_RL_Clu_Mes_13_S4_SRR_RL_Clu_SNR_91()
{
	signalvalue1 = getSignal(S4_SRR_RL_Clu_SNR_91);
	write("S4_SRR_RL_Clu_SNR_91 :%f",signalvalue1);
	write("i_S4_SRR_RL_Clu_SNR_91 :%f",@ecu_Signals::i_S4_SRR_RL_Clu_SNR_91);

	testStep("get expect variable value: ","i_S4_SRR_RL_Clu_SNR_91 :%f",@ecu_Signals::i_S4_SRR_RL_Clu_SNR_91);

	if((abs(@ecu_Signals::i_S4_SRR_RL_Clu_SNR_91)*0.9<=abs(signalvalue1))&&(abs(signalvalue1)<=abs(@ecu_Signals::i_S4_SRR_RL_Clu_SNR_91)*1.1))
	{
	testStepPass("Pass","i_S4_SRR_RL_Clu_SNR_91 :%f",signalvalue1);
	}
	else
	{
	testStepFail("Fail","i_S4_SRR_RL_Clu_SNR_91 :%f",signalvalue1);
	}
}

testcase S4_SRR_RL_Clu_Mes_13_S4_SRR_RL_Clu_DynProp_91()
{
	signalvalue1 = getSignal(S4_SRR_RL_Clu_DynProp_91);
	write("S4_SRR_RL_Clu_DynProp_91 :%f",signalvalue1);
	write("i_S4_SRR_RL_Clu_DynProp_91 :%o",@ecu_Signals::i_S4_SRR_RL_Clu_DynProp_91);

	testStep("get expect variable value: ","i_S4_SRR_RL_Clu_DynProp_91 :%o",@ecu_Signals::i_S4_SRR_RL_Clu_DynProp_91);

	if(signalvalue1==@ecu_Signals::i_S4_SRR_RL_Clu_DynProp_91)
	{
	testStepPass("Pass","i_S4_SRR_RL_Clu_DynProp_91 :%f",signalvalue1);
	}
	else
	{
	testStepFail("Fail","i_S4_SRR_RL_Clu_DynProp_91 :%f",signalvalue1);
	}
}

testcase S4_SRR_RL_Clu_Mes_13_S4_SRR_RL_Clu_Locationvalid_91()
{
	signalvalue1 = getSignal(S4_SRR_RL_Clu_Locationvalid_91);
	write("S4_SRR_RL_Clu_Locationvalid_91 :%f",signalvalue1);
	write("i_S4_SRR_RL_Clu_Locationvalid_91 :%o",@ecu_Signals::i_S4_SRR_RL_Clu_Locationvalid_91);

	testStep("get expect variable value: ","i_S4_SRR_RL_Clu_Locationvalid_91 :%o",@ecu_Signals::i_S4_SRR_RL_Clu_Locationvalid_91);

	if(signalvalue1==@ecu_Signals::i_S4_SRR_RL_Clu_Locationvalid_91)
	{
	testStepPass("Pass","i_S4_SRR_RL_Clu_Locationvalid_91 :%f",signalvalue1);
	}
	else
	{
	testStepFail("Fail","i_S4_SRR_RL_Clu_Locationvalid_91 :%f",signalvalue1);
	}
}

testcase S4_SRR_RL_Clu_Mes_13_S4_SRR_RL_Clu_Theta_92()
{
	signalvalue1 = getSignal(S4_SRR_RL_Clu_Theta_92);
	write("S4_SRR_RL_Clu_Theta_92 :%f",signalvalue1);
	write("i_S4_SRR_RL_Clu_Theta_92 :%f",@ecu_Signals::i_S4_SRR_RL_Clu_Theta_92);

	testStep("get expect variable value: ","i_S4_SRR_RL_Clu_Theta_92 :%f",@ecu_Signals::i_S4_SRR_RL_Clu_Theta_92);

	if((abs(@ecu_Signals::i_S4_SRR_RL_Clu_Theta_92)*0.9<=abs(signalvalue1))&&(abs(signalvalue1)<=abs(@ecu_Signals::i_S4_SRR_RL_Clu_Theta_92)*1.1))
	{
	testStepPass("Pass","i_S4_SRR_RL_Clu_Theta_92 :%f",signalvalue1);
	}
	else
	{
	testStepFail("Fail","i_S4_SRR_RL_Clu_Theta_92 :%f",signalvalue1);
	}
}

testcase S4_SRR_RL_Clu_Mes_13_S4_SRR_RL_Clu_Dist_92()
{
	signalvalue1 = getSignal(S4_SRR_RL_Clu_Dist_92);
	write("S4_SRR_RL_Clu_Dist_92 :%f",signalvalue1);
	write("i_S4_SRR_RL_Clu_Dist_92 :%f",@ecu_Signals::i_S4_SRR_RL_Clu_Dist_92);

	testStep("get expect variable value: ","i_S4_SRR_RL_Clu_Dist_92 :%f",@ecu_Signals::i_S4_SRR_RL_Clu_Dist_92);

	if((abs(@ecu_Signals::i_S4_SRR_RL_Clu_Dist_92)*0.9<=abs(signalvalue1))&&(abs(signalvalue1)<=abs(@ecu_Signals::i_S4_SRR_RL_Clu_Dist_92)*1.1))
	{
	testStepPass("Pass","i_S4_SRR_RL_Clu_Dist_92 :%f",signalvalue1);
	}
	else
	{
	testStepFail("Fail","i_S4_SRR_RL_Clu_Dist_92 :%f",signalvalue1);
	}
}

testcase S4_SRR_RL_Clu_Mes_13_S4_SRR_RL_Clu_Vel_92()
{
	signalvalue1 = getSignal(S4_SRR_RL_Clu_Vel_92);
	write("S4_SRR_RL_Clu_Vel_92 :%f",signalvalue1);
	write("i_S4_SRR_RL_Clu_Vel_92 :%f",@ecu_Signals::i_S4_SRR_RL_Clu_Vel_92);

	testStep("get expect variable value: ","i_S4_SRR_RL_Clu_Vel_92 :%f",@ecu_Signals::i_S4_SRR_RL_Clu_Vel_92);

	if((abs(@ecu_Signals::i_S4_SRR_RL_Clu_Vel_92)*0.9<=abs(signalvalue1))&&(abs(signalvalue1)<=abs(@ecu_Signals::i_S4_SRR_RL_Clu_Vel_92)*1.1))
	{
	testStepPass("Pass","i_S4_SRR_RL_Clu_Vel_92 :%f",signalvalue1);
	}
	else
	{
	testStepFail("Fail","i_S4_SRR_RL_Clu_Vel_92 :%f",signalvalue1);
	}
}

testcase S4_SRR_RL_Clu_Mes_13_S4_SRR_RL_Clu_SNR_92()
{
	signalvalue1 = getSignal(S4_SRR_RL_Clu_SNR_92);
	write("S4_SRR_RL_Clu_SNR_92 :%f",signalvalue1);
	write("i_S4_SRR_RL_Clu_SNR_92 :%f",@ecu_Signals::i_S4_SRR_RL_Clu_SNR_92);

	testStep("get expect variable value: ","i_S4_SRR_RL_Clu_SNR_92 :%f",@ecu_Signals::i_S4_SRR_RL_Clu_SNR_92);

	if((abs(@ecu_Signals::i_S4_SRR_RL_Clu_SNR_92)*0.9<=abs(signalvalue1))&&(abs(signalvalue1)<=abs(@ecu_Signals::i_S4_SRR_RL_Clu_SNR_92)*1.1))
	{
	testStepPass("Pass","i_S4_SRR_RL_Clu_SNR_92 :%f",signalvalue1);
	}
	else
	{
	testStepFail("Fail","i_S4_SRR_RL_Clu_SNR_92 :%f",signalvalue1);
	}
}

testcase S4_SRR_RL_Clu_Mes_13_S4_SRR_RL_Clu_DynProp_92()
{
	signalvalue1 = getSignal(S4_SRR_RL_Clu_DynProp_92);
	write("S4_SRR_RL_Clu_DynProp_92 :%f",signalvalue1);
	write("i_S4_SRR_RL_Clu_DynProp_92 :%o",@ecu_Signals::i_S4_SRR_RL_Clu_DynProp_92);

	testStep("get expect variable value: ","i_S4_SRR_RL_Clu_DynProp_92 :%o",@ecu_Signals::i_S4_SRR_RL_Clu_DynProp_92);

	if(signalvalue1==@ecu_Signals::i_S4_SRR_RL_Clu_DynProp_92)
	{
	testStepPass("Pass","i_S4_SRR_RL_Clu_DynProp_92 :%f",signalvalue1);
	}
	else
	{
	testStepFail("Fail","i_S4_SRR_RL_Clu_DynProp_92 :%f",signalvalue1);
	}
}

testcase S4_SRR_RL_Clu_Mes_13_S4_SRR_RL_Clu_Locationvalid_92()
{
	signalvalue1 = getSignal(S4_SRR_RL_Clu_Locationvalid_92);
	write("S4_SRR_RL_Clu_Locationvalid_92 :%f",signalvalue1);
	write("i_S4_SRR_RL_Clu_Locationvalid_92 :%o",@ecu_Signals::i_S4_SRR_RL_Clu_Locationvalid_92);

	testStep("get expect variable value: ","i_S4_SRR_RL_Clu_Locationvalid_92 :%o",@ecu_Signals::i_S4_SRR_RL_Clu_Locationvalid_92);

	if(signalvalue1==@ecu_Signals::i_S4_SRR_RL_Clu_Locationvalid_92)
	{
	testStepPass("Pass","i_S4_SRR_RL_Clu_Locationvalid_92 :%f",signalvalue1);
	}
	else
	{
	testStepFail("Fail","i_S4_SRR_RL_Clu_Locationvalid_92 :%f",signalvalue1);
	}
}

testcase S4_SRR_RL_Clu_Mes_13_S4_SRR_RL_Clu_Theta_93()
{
	signalvalue1 = getSignal(S4_SRR_RL_Clu_Theta_93);
	write("S4_SRR_RL_Clu_Theta_93 :%f",signalvalue1);
	write("i_S4_SRR_RL_Clu_Theta_93 :%f",@ecu_Signals::i_S4_SRR_RL_Clu_Theta_93);

	testStep("get expect variable value: ","i_S4_SRR_RL_Clu_Theta_93 :%f",@ecu_Signals::i_S4_SRR_RL_Clu_Theta_93);

	if((abs(@ecu_Signals::i_S4_SRR_RL_Clu_Theta_93)*0.9<=abs(signalvalue1))&&(abs(signalvalue1)<=abs(@ecu_Signals::i_S4_SRR_RL_Clu_Theta_93)*1.1))
	{
	testStepPass("Pass","i_S4_SRR_RL_Clu_Theta_93 :%f",signalvalue1);
	}
	else
	{
	testStepFail("Fail","i_S4_SRR_RL_Clu_Theta_93 :%f",signalvalue1);
	}
}

testcase S4_SRR_RL_Clu_Mes_13_S4_SRR_RL_Clu_Dist_93()
{
	signalvalue1 = getSignal(S4_SRR_RL_Clu_Dist_93);
	write("S4_SRR_RL_Clu_Dist_93 :%f",signalvalue1);
	write("i_S4_SRR_RL_Clu_Dist_93 :%f",@ecu_Signals::i_S4_SRR_RL_Clu_Dist_93);

	testStep("get expect variable value: ","i_S4_SRR_RL_Clu_Dist_93 :%f",@ecu_Signals::i_S4_SRR_RL_Clu_Dist_93);

	if((abs(@ecu_Signals::i_S4_SRR_RL_Clu_Dist_93)*0.9<=abs(signalvalue1))&&(abs(signalvalue1)<=abs(@ecu_Signals::i_S4_SRR_RL_Clu_Dist_93)*1.1))
	{
	testStepPass("Pass","i_S4_SRR_RL_Clu_Dist_93 :%f",signalvalue1);
	}
	else
	{
	testStepFail("Fail","i_S4_SRR_RL_Clu_Dist_93 :%f",signalvalue1);
	}
}

testcase S4_SRR_RL_Clu_Mes_13_S4_SRR_RL_Clu_Vel_93()
{
	signalvalue1 = getSignal(S4_SRR_RL_Clu_Vel_93);
	write("S4_SRR_RL_Clu_Vel_93 :%f",signalvalue1);
	write("i_S4_SRR_RL_Clu_Vel_93 :%f",@ecu_Signals::i_S4_SRR_RL_Clu_Vel_93);

	testStep("get expect variable value: ","i_S4_SRR_RL_Clu_Vel_93 :%f",@ecu_Signals::i_S4_SRR_RL_Clu_Vel_93);

	if((abs(@ecu_Signals::i_S4_SRR_RL_Clu_Vel_93)*0.9<=abs(signalvalue1))&&(abs(signalvalue1)<=abs(@ecu_Signals::i_S4_SRR_RL_Clu_Vel_93)*1.1))
	{
	testStepPass("Pass","i_S4_SRR_RL_Clu_Vel_93 :%f",signalvalue1);
	}
	else
	{
	testStepFail("Fail","i_S4_SRR_RL_Clu_Vel_93 :%f",signalvalue1);
	}
}

testcase S4_SRR_RL_Clu_Mes_13_S4_SRR_RL_Clu_SNR_93()
{
	signalvalue1 = getSignal(S4_SRR_RL_Clu_SNR_93);
	write("S4_SRR_RL_Clu_SNR_93 :%f",signalvalue1);
	write("i_S4_SRR_RL_Clu_SNR_93 :%f",@ecu_Signals::i_S4_SRR_RL_Clu_SNR_93);

	testStep("get expect variable value: ","i_S4_SRR_RL_Clu_SNR_93 :%f",@ecu_Signals::i_S4_SRR_RL_Clu_SNR_93);

	if((abs(@ecu_Signals::i_S4_SRR_RL_Clu_SNR_93)*0.9<=abs(signalvalue1))&&(abs(signalvalue1)<=abs(@ecu_Signals::i_S4_SRR_RL_Clu_SNR_93)*1.1))
	{
	testStepPass("Pass","i_S4_SRR_RL_Clu_SNR_93 :%f",signalvalue1);
	}
	else
	{
	testStepFail("Fail","i_S4_SRR_RL_Clu_SNR_93 :%f",signalvalue1);
	}
}

testcase S4_SRR_RL_Clu_Mes_13_S4_SRR_RL_Clu_DynProp_93()
{
	signalvalue1 = getSignal(S4_SRR_RL_Clu_DynProp_93);
	write("S4_SRR_RL_Clu_DynProp_93 :%f",signalvalue1);
	write("i_S4_SRR_RL_Clu_DynProp_93 :%o",@ecu_Signals::i_S4_SRR_RL_Clu_DynProp_93);

	testStep("get expect variable value: ","i_S4_SRR_RL_Clu_DynProp_93 :%o",@ecu_Signals::i_S4_SRR_RL_Clu_DynProp_93);

	if(signalvalue1==@ecu_Signals::i_S4_SRR_RL_Clu_DynProp_93)
	{
	testStepPass("Pass","i_S4_SRR_RL_Clu_DynProp_93 :%f",signalvalue1);
	}
	else
	{
	testStepFail("Fail","i_S4_SRR_RL_Clu_DynProp_93 :%f",signalvalue1);
	}
}

testcase S4_SRR_RL_Clu_Mes_13_S4_SRR_RL_Clu_Locationvalid_93()
{
	signalvalue1 = getSignal(S4_SRR_RL_Clu_Locationvalid_93);
	write("S4_SRR_RL_Clu_Locationvalid_93 :%f",signalvalue1);
	write("i_S4_SRR_RL_Clu_Locationvalid_93 :%o",@ecu_Signals::i_S4_SRR_RL_Clu_Locationvalid_93);

	testStep("get expect variable value: ","i_S4_SRR_RL_Clu_Locationvalid_93 :%o",@ecu_Signals::i_S4_SRR_RL_Clu_Locationvalid_93);

	if(signalvalue1==@ecu_Signals::i_S4_SRR_RL_Clu_Locationvalid_93)
	{
	testStepPass("Pass","i_S4_SRR_RL_Clu_Locationvalid_93 :%f",signalvalue1);
	}
	else
	{
	testStepFail("Fail","i_S4_SRR_RL_Clu_Locationvalid_93 :%f",signalvalue1);
	}
}

testcase S4_SRR_RL_Clu_Mes_13_S4_SRR_RL_Clu_Theta_94()
{
	signalvalue1 = getSignal(S4_SRR_RL_Clu_Theta_94);
	write("S4_SRR_RL_Clu_Theta_94 :%f",signalvalue1);
	write("i_S4_SRR_RL_Clu_Theta_94 :%f",@ecu_Signals::i_S4_SRR_RL_Clu_Theta_94);

	testStep("get expect variable value: ","i_S4_SRR_RL_Clu_Theta_94 :%f",@ecu_Signals::i_S4_SRR_RL_Clu_Theta_94);

	if((abs(@ecu_Signals::i_S4_SRR_RL_Clu_Theta_94)*0.9<=abs(signalvalue1))&&(abs(signalvalue1)<=abs(@ecu_Signals::i_S4_SRR_RL_Clu_Theta_94)*1.1))
	{
	testStepPass("Pass","i_S4_SRR_RL_Clu_Theta_94 :%f",signalvalue1);
	}
	else
	{
	testStepFail("Fail","i_S4_SRR_RL_Clu_Theta_94 :%f",signalvalue1);
	}
}

testcase S4_SRR_RL_Clu_Mes_13_S4_SRR_RL_Clu_Dist_94()
{
	signalvalue1 = getSignal(S4_SRR_RL_Clu_Dist_94);
	write("S4_SRR_RL_Clu_Dist_94 :%f",signalvalue1);
	write("i_S4_SRR_RL_Clu_Dist_94 :%f",@ecu_Signals::i_S4_SRR_RL_Clu_Dist_94);

	testStep("get expect variable value: ","i_S4_SRR_RL_Clu_Dist_94 :%f",@ecu_Signals::i_S4_SRR_RL_Clu_Dist_94);

	if((abs(@ecu_Signals::i_S4_SRR_RL_Clu_Dist_94)*0.9<=abs(signalvalue1))&&(abs(signalvalue1)<=abs(@ecu_Signals::i_S4_SRR_RL_Clu_Dist_94)*1.1))
	{
	testStepPass("Pass","i_S4_SRR_RL_Clu_Dist_94 :%f",signalvalue1);
	}
	else
	{
	testStepFail("Fail","i_S4_SRR_RL_Clu_Dist_94 :%f",signalvalue1);
	}
}

testcase S4_SRR_RL_Clu_Mes_13_S4_SRR_RL_Clu_Vel_94()
{
	signalvalue1 = getSignal(S4_SRR_RL_Clu_Vel_94);
	write("S4_SRR_RL_Clu_Vel_94 :%f",signalvalue1);
	write("i_S4_SRR_RL_Clu_Vel_94 :%f",@ecu_Signals::i_S4_SRR_RL_Clu_Vel_94);

	testStep("get expect variable value: ","i_S4_SRR_RL_Clu_Vel_94 :%f",@ecu_Signals::i_S4_SRR_RL_Clu_Vel_94);

	if((abs(@ecu_Signals::i_S4_SRR_RL_Clu_Vel_94)*0.9<=abs(signalvalue1))&&(abs(signalvalue1)<=abs(@ecu_Signals::i_S4_SRR_RL_Clu_Vel_94)*1.1))
	{
	testStepPass("Pass","i_S4_SRR_RL_Clu_Vel_94 :%f",signalvalue1);
	}
	else
	{
	testStepFail("Fail","i_S4_SRR_RL_Clu_Vel_94 :%f",signalvalue1);
	}
}

testcase S4_SRR_RL_Clu_Mes_13_S4_SRR_RL_Clu_SNR_94()
{
	signalvalue1 = getSignal(S4_SRR_RL_Clu_SNR_94);
	write("S4_SRR_RL_Clu_SNR_94 :%f",signalvalue1);
	write("i_S4_SRR_RL_Clu_SNR_94 :%f",@ecu_Signals::i_S4_SRR_RL_Clu_SNR_94);

	testStep("get expect variable value: ","i_S4_SRR_RL_Clu_SNR_94 :%f",@ecu_Signals::i_S4_SRR_RL_Clu_SNR_94);

	if((abs(@ecu_Signals::i_S4_SRR_RL_Clu_SNR_94)*0.9<=abs(signalvalue1))&&(abs(signalvalue1)<=abs(@ecu_Signals::i_S4_SRR_RL_Clu_SNR_94)*1.1))
	{
	testStepPass("Pass","i_S4_SRR_RL_Clu_SNR_94 :%f",signalvalue1);
	}
	else
	{
	testStepFail("Fail","i_S4_SRR_RL_Clu_SNR_94 :%f",signalvalue1);
	}
}

testcase S4_SRR_RL_Clu_Mes_13_S4_SRR_RL_Clu_DynProp_94()
{
	signalvalue1 = getSignal(S4_SRR_RL_Clu_DynProp_94);
	write("S4_SRR_RL_Clu_DynProp_94 :%f",signalvalue1);
	write("i_S4_SRR_RL_Clu_DynProp_94 :%o",@ecu_Signals::i_S4_SRR_RL_Clu_DynProp_94);

	testStep("get expect variable value: ","i_S4_SRR_RL_Clu_DynProp_94 :%o",@ecu_Signals::i_S4_SRR_RL_Clu_DynProp_94);

	if(signalvalue1==@ecu_Signals::i_S4_SRR_RL_Clu_DynProp_94)
	{
	testStepPass("Pass","i_S4_SRR_RL_Clu_DynProp_94 :%f",signalvalue1);
	}
	else
	{
	testStepFail("Fail","i_S4_SRR_RL_Clu_DynProp_94 :%f",signalvalue1);
	}
}

testcase S4_SRR_RL_Clu_Mes_13_S4_SRR_RL_Clu_Locationvalid_94()
{
	signalvalue1 = getSignal(S4_SRR_RL_Clu_Locationvalid_94);
	write("S4_SRR_RL_Clu_Locationvalid_94 :%f",signalvalue1);
	write("i_S4_SRR_RL_Clu_Locationvalid_94 :%o",@ecu_Signals::i_S4_SRR_RL_Clu_Locationvalid_94);

	testStep("get expect variable value: ","i_S4_SRR_RL_Clu_Locationvalid_94 :%o",@ecu_Signals::i_S4_SRR_RL_Clu_Locationvalid_94);

	if(signalvalue1==@ecu_Signals::i_S4_SRR_RL_Clu_Locationvalid_94)
	{
	testStepPass("Pass","i_S4_SRR_RL_Clu_Locationvalid_94 :%f",signalvalue1);
	}
	else
	{
	testStepFail("Fail","i_S4_SRR_RL_Clu_Locationvalid_94 :%f",signalvalue1);
	}
}

testcase S4_SRR_RL_Clu_Mes_13_S4_SRR_RL_Clu_Theta_95()
{
	signalvalue1 = getSignal(S4_SRR_RL_Clu_Theta_95);
	write("S4_SRR_RL_Clu_Theta_95 :%f",signalvalue1);
	write("i_S4_SRR_RL_Clu_Theta_95 :%f",@ecu_Signals::i_S4_SRR_RL_Clu_Theta_95);

	testStep("get expect variable value: ","i_S4_SRR_RL_Clu_Theta_95 :%f",@ecu_Signals::i_S4_SRR_RL_Clu_Theta_95);

	if((abs(@ecu_Signals::i_S4_SRR_RL_Clu_Theta_95)*0.9<=abs(signalvalue1))&&(abs(signalvalue1)<=abs(@ecu_Signals::i_S4_SRR_RL_Clu_Theta_95)*1.1))
	{
	testStepPass("Pass","i_S4_SRR_RL_Clu_Theta_95 :%f",signalvalue1);
	}
	else
	{
	testStepFail("Fail","i_S4_SRR_RL_Clu_Theta_95 :%f",signalvalue1);
	}
}

testcase S4_SRR_RL_Clu_Mes_13_S4_SRR_RL_Clu_Dist_95()
{
	signalvalue1 = getSignal(S4_SRR_RL_Clu_Dist_95);
	write("S4_SRR_RL_Clu_Dist_95 :%f",signalvalue1);
	write("i_S4_SRR_RL_Clu_Dist_95 :%f",@ecu_Signals::i_S4_SRR_RL_Clu_Dist_95);

	testStep("get expect variable value: ","i_S4_SRR_RL_Clu_Dist_95 :%f",@ecu_Signals::i_S4_SRR_RL_Clu_Dist_95);

	if((abs(@ecu_Signals::i_S4_SRR_RL_Clu_Dist_95)*0.9<=abs(signalvalue1))&&(abs(signalvalue1)<=abs(@ecu_Signals::i_S4_SRR_RL_Clu_Dist_95)*1.1))
	{
	testStepPass("Pass","i_S4_SRR_RL_Clu_Dist_95 :%f",signalvalue1);
	}
	else
	{
	testStepFail("Fail","i_S4_SRR_RL_Clu_Dist_95 :%f",signalvalue1);
	}
}

testcase S4_SRR_RL_Clu_Mes_13_S4_SRR_RL_Clu_Vel_95()
{
	signalvalue1 = getSignal(S4_SRR_RL_Clu_Vel_95);
	write("S4_SRR_RL_Clu_Vel_95 :%f",signalvalue1);
	write("i_S4_SRR_RL_Clu_Vel_95 :%f",@ecu_Signals::i_S4_SRR_RL_Clu_Vel_95);

	testStep("get expect variable value: ","i_S4_SRR_RL_Clu_Vel_95 :%f",@ecu_Signals::i_S4_SRR_RL_Clu_Vel_95);

	if((abs(@ecu_Signals::i_S4_SRR_RL_Clu_Vel_95)*0.9<=abs(signalvalue1))&&(abs(signalvalue1)<=abs(@ecu_Signals::i_S4_SRR_RL_Clu_Vel_95)*1.1))
	{
	testStepPass("Pass","i_S4_SRR_RL_Clu_Vel_95 :%f",signalvalue1);
	}
	else
	{
	testStepFail("Fail","i_S4_SRR_RL_Clu_Vel_95 :%f",signalvalue1);
	}
}

testcase S4_SRR_RL_Clu_Mes_13_S4_SRR_RL_Clu_SNR_95()
{
	signalvalue1 = getSignal(S4_SRR_RL_Clu_SNR_95);
	write("S4_SRR_RL_Clu_SNR_95 :%f",signalvalue1);
	write("i_S4_SRR_RL_Clu_SNR_95 :%f",@ecu_Signals::i_S4_SRR_RL_Clu_SNR_95);

	testStep("get expect variable value: ","i_S4_SRR_RL_Clu_SNR_95 :%f",@ecu_Signals::i_S4_SRR_RL_Clu_SNR_95);

	if((abs(@ecu_Signals::i_S4_SRR_RL_Clu_SNR_95)*0.9<=abs(signalvalue1))&&(abs(signalvalue1)<=abs(@ecu_Signals::i_S4_SRR_RL_Clu_SNR_95)*1.1))
	{
	testStepPass("Pass","i_S4_SRR_RL_Clu_SNR_95 :%f",signalvalue1);
	}
	else
	{
	testStepFail("Fail","i_S4_SRR_RL_Clu_SNR_95 :%f",signalvalue1);
	}
}

testcase S4_SRR_RL_Clu_Mes_13_S4_SRR_RL_Clu_DynProp_95()
{
	signalvalue1 = getSignal(S4_SRR_RL_Clu_DynProp_95);
	write("S4_SRR_RL_Clu_DynProp_95 :%f",signalvalue1);
	write("i_S4_SRR_RL_Clu_DynProp_95 :%o",@ecu_Signals::i_S4_SRR_RL_Clu_DynProp_95);

	testStep("get expect variable value: ","i_S4_SRR_RL_Clu_DynProp_95 :%o",@ecu_Signals::i_S4_SRR_RL_Clu_DynProp_95);

	if(signalvalue1==@ecu_Signals::i_S4_SRR_RL_Clu_DynProp_95)
	{
	testStepPass("Pass","i_S4_SRR_RL_Clu_DynProp_95 :%f",signalvalue1);
	}
	else
	{
	testStepFail("Fail","i_S4_SRR_RL_Clu_DynProp_95 :%f",signalvalue1);
	}
}

testcase S4_SRR_RL_Clu_Mes_13_S4_SRR_RL_Clu_Locationvalid_95()
{
	signalvalue1 = getSignal(S4_SRR_RL_Clu_Locationvalid_95);
	write("S4_SRR_RL_Clu_Locationvalid_95 :%f",signalvalue1);
	write("i_S4_SRR_RL_Clu_Locationvalid_95 :%o",@ecu_Signals::i_S4_SRR_RL_Clu_Locationvalid_95);

	testStep("get expect variable value: ","i_S4_SRR_RL_Clu_Locationvalid_95 :%o",@ecu_Signals::i_S4_SRR_RL_Clu_Locationvalid_95);

	if(signalvalue1==@ecu_Signals::i_S4_SRR_RL_Clu_Locationvalid_95)
	{
	testStepPass("Pass","i_S4_SRR_RL_Clu_Locationvalid_95 :%f",signalvalue1);
	}
	else
	{
	testStepFail("Fail","i_S4_SRR_RL_Clu_Locationvalid_95 :%f",signalvalue1);
	}
}

testcase S4_SRR_RL_Clu_Mes_13_S4_SRR_RL_Clu_Theta_96()
{
	signalvalue1 = getSignal(S4_SRR_RL_Clu_Theta_96);
	write("S4_SRR_RL_Clu_Theta_96 :%f",signalvalue1);
	write("i_S4_SRR_RL_Clu_Theta_96 :%f",@ecu_Signals::i_S4_SRR_RL_Clu_Theta_96);

	testStep("get expect variable value: ","i_S4_SRR_RL_Clu_Theta_96 :%f",@ecu_Signals::i_S4_SRR_RL_Clu_Theta_96);

	if((abs(@ecu_Signals::i_S4_SRR_RL_Clu_Theta_96)*0.9<=abs(signalvalue1))&&(abs(signalvalue1)<=abs(@ecu_Signals::i_S4_SRR_RL_Clu_Theta_96)*1.1))
	{
	testStepPass("Pass","i_S4_SRR_RL_Clu_Theta_96 :%f",signalvalue1);
	}
	else
	{
	testStepFail("Fail","i_S4_SRR_RL_Clu_Theta_96 :%f",signalvalue1);
	}
}

testcase S4_SRR_RL_Clu_Mes_13_S4_SRR_RL_Clu_Dist_96()
{
	signalvalue1 = getSignal(S4_SRR_RL_Clu_Dist_96);
	write("S4_SRR_RL_Clu_Dist_96 :%f",signalvalue1);
	write("i_S4_SRR_RL_Clu_Dist_96 :%f",@ecu_Signals::i_S4_SRR_RL_Clu_Dist_96);

	testStep("get expect variable value: ","i_S4_SRR_RL_Clu_Dist_96 :%f",@ecu_Signals::i_S4_SRR_RL_Clu_Dist_96);

	if((abs(@ecu_Signals::i_S4_SRR_RL_Clu_Dist_96)*0.9<=abs(signalvalue1))&&(abs(signalvalue1)<=abs(@ecu_Signals::i_S4_SRR_RL_Clu_Dist_96)*1.1))
	{
	testStepPass("Pass","i_S4_SRR_RL_Clu_Dist_96 :%f",signalvalue1);
	}
	else
	{
	testStepFail("Fail","i_S4_SRR_RL_Clu_Dist_96 :%f",signalvalue1);
	}
}

testcase S4_SRR_RL_Clu_Mes_13_S4_SRR_RL_Clu_Vel_96()
{
	signalvalue1 = getSignal(S4_SRR_RL_Clu_Vel_96);
	write("S4_SRR_RL_Clu_Vel_96 :%f",signalvalue1);
	write("i_S4_SRR_RL_Clu_Vel_96 :%f",@ecu_Signals::i_S4_SRR_RL_Clu_Vel_96);

	testStep("get expect variable value: ","i_S4_SRR_RL_Clu_Vel_96 :%f",@ecu_Signals::i_S4_SRR_RL_Clu_Vel_96);

	if((abs(@ecu_Signals::i_S4_SRR_RL_Clu_Vel_96)*0.9<=abs(signalvalue1))&&(abs(signalvalue1)<=abs(@ecu_Signals::i_S4_SRR_RL_Clu_Vel_96)*1.1))
	{
	testStepPass("Pass","i_S4_SRR_RL_Clu_Vel_96 :%f",signalvalue1);
	}
	else
	{
	testStepFail("Fail","i_S4_SRR_RL_Clu_Vel_96 :%f",signalvalue1);
	}
}

testcase S4_SRR_RL_Clu_Mes_13_S4_SRR_RL_Clu_SNR_96()
{
	signalvalue1 = getSignal(S4_SRR_RL_Clu_SNR_96);
	write("S4_SRR_RL_Clu_SNR_96 :%f",signalvalue1);
	write("i_S4_SRR_RL_Clu_SNR_96 :%f",@ecu_Signals::i_S4_SRR_RL_Clu_SNR_96);

	testStep("get expect variable value: ","i_S4_SRR_RL_Clu_SNR_96 :%f",@ecu_Signals::i_S4_SRR_RL_Clu_SNR_96);

	if((abs(@ecu_Signals::i_S4_SRR_RL_Clu_SNR_96)*0.9<=abs(signalvalue1))&&(abs(signalvalue1)<=abs(@ecu_Signals::i_S4_SRR_RL_Clu_SNR_96)*1.1))
	{
	testStepPass("Pass","i_S4_SRR_RL_Clu_SNR_96 :%f",signalvalue1);
	}
	else
	{
	testStepFail("Fail","i_S4_SRR_RL_Clu_SNR_96 :%f",signalvalue1);
	}
}

testcase S4_SRR_RL_Clu_Mes_13_S4_SRR_RL_Clu_DynProp_96()
{
	signalvalue1 = getSignal(S4_SRR_RL_Clu_DynProp_96);
	write("S4_SRR_RL_Clu_DynProp_96 :%f",signalvalue1);
	write("i_S4_SRR_RL_Clu_DynProp_96 :%o",@ecu_Signals::i_S4_SRR_RL_Clu_DynProp_96);

	testStep("get expect variable value: ","i_S4_SRR_RL_Clu_DynProp_96 :%o",@ecu_Signals::i_S4_SRR_RL_Clu_DynProp_96);

	if(signalvalue1==@ecu_Signals::i_S4_SRR_RL_Clu_DynProp_96)
	{
	testStepPass("Pass","i_S4_SRR_RL_Clu_DynProp_96 :%f",signalvalue1);
	}
	else
	{
	testStepFail("Fail","i_S4_SRR_RL_Clu_DynProp_96 :%f",signalvalue1);
	}
}

testcase S4_SRR_RL_Clu_Mes_13_S4_SRR_RL_Clu_Locationvalid_96()
{
	signalvalue1 = getSignal(S4_SRR_RL_Clu_Locationvalid_96);
	write("S4_SRR_RL_Clu_Locationvalid_96 :%f",signalvalue1);
	write("i_S4_SRR_RL_Clu_Locationvalid_96 :%o",@ecu_Signals::i_S4_SRR_RL_Clu_Locationvalid_96);

	testStep("get expect variable value: ","i_S4_SRR_RL_Clu_Locationvalid_96 :%o",@ecu_Signals::i_S4_SRR_RL_Clu_Locationvalid_96);

	if(signalvalue1==@ecu_Signals::i_S4_SRR_RL_Clu_Locationvalid_96)
	{
	testStepPass("Pass","i_S4_SRR_RL_Clu_Locationvalid_96 :%f",signalvalue1);
	}
	else
	{
	testStepFail("Fail","i_S4_SRR_RL_Clu_Locationvalid_96 :%f",signalvalue1);
	}
}

testcase S4_SRR_RL_Clu_Mes_13_S4_SRR_RL_Clu_Theta_97()
{
	signalvalue1 = getSignal(S4_SRR_RL_Clu_Theta_97);
	write("S4_SRR_RL_Clu_Theta_97 :%f",signalvalue1);
	write("i_S4_SRR_RL_Clu_Theta_97 :%f",@ecu_Signals::i_S4_SRR_RL_Clu_Theta_97);

	testStep("get expect variable value: ","i_S4_SRR_RL_Clu_Theta_97 :%f",@ecu_Signals::i_S4_SRR_RL_Clu_Theta_97);

	if((abs(@ecu_Signals::i_S4_SRR_RL_Clu_Theta_97)*0.9<=abs(signalvalue1))&&(abs(signalvalue1)<=abs(@ecu_Signals::i_S4_SRR_RL_Clu_Theta_97)*1.1))
	{
	testStepPass("Pass","i_S4_SRR_RL_Clu_Theta_97 :%f",signalvalue1);
	}
	else
	{
	testStepFail("Fail","i_S4_SRR_RL_Clu_Theta_97 :%f",signalvalue1);
	}
}

testcase S4_SRR_RL_Clu_Mes_13_S4_SRR_RL_Clu_Dist_97()
{
	signalvalue1 = getSignal(S4_SRR_RL_Clu_Dist_97);
	write("S4_SRR_RL_Clu_Dist_97 :%f",signalvalue1);
	write("i_S4_SRR_RL_Clu_Dist_97 :%f",@ecu_Signals::i_S4_SRR_RL_Clu_Dist_97);

	testStep("get expect variable value: ","i_S4_SRR_RL_Clu_Dist_97 :%f",@ecu_Signals::i_S4_SRR_RL_Clu_Dist_97);

	if((abs(@ecu_Signals::i_S4_SRR_RL_Clu_Dist_97)*0.9<=abs(signalvalue1))&&(abs(signalvalue1)<=abs(@ecu_Signals::i_S4_SRR_RL_Clu_Dist_97)*1.1))
	{
	testStepPass("Pass","i_S4_SRR_RL_Clu_Dist_97 :%f",signalvalue1);
	}
	else
	{
	testStepFail("Fail","i_S4_SRR_RL_Clu_Dist_97 :%f",signalvalue1);
	}
}

testcase S4_SRR_RL_Clu_Mes_13_S4_SRR_RL_Clu_Vel_97()
{
	signalvalue1 = getSignal(S4_SRR_RL_Clu_Vel_97);
	write("S4_SRR_RL_Clu_Vel_97 :%f",signalvalue1);
	write("i_S4_SRR_RL_Clu_Vel_97 :%f",@ecu_Signals::i_S4_SRR_RL_Clu_Vel_97);

	testStep("get expect variable value: ","i_S4_SRR_RL_Clu_Vel_97 :%f",@ecu_Signals::i_S4_SRR_RL_Clu_Vel_97);

	if((abs(@ecu_Signals::i_S4_SRR_RL_Clu_Vel_97)*0.9<=abs(signalvalue1))&&(abs(signalvalue1)<=abs(@ecu_Signals::i_S4_SRR_RL_Clu_Vel_97)*1.1))
	{
	testStepPass("Pass","i_S4_SRR_RL_Clu_Vel_97 :%f",signalvalue1);
	}
	else
	{
	testStepFail("Fail","i_S4_SRR_RL_Clu_Vel_97 :%f",signalvalue1);
	}
}

testcase S4_SRR_RL_Clu_Mes_13_S4_SRR_RL_Clu_SNR_97()
{
	signalvalue1 = getSignal(S4_SRR_RL_Clu_SNR_97);
	write("S4_SRR_RL_Clu_SNR_97 :%f",signalvalue1);
	write("i_S4_SRR_RL_Clu_SNR_97 :%f",@ecu_Signals::i_S4_SRR_RL_Clu_SNR_97);

	testStep("get expect variable value: ","i_S4_SRR_RL_Clu_SNR_97 :%f",@ecu_Signals::i_S4_SRR_RL_Clu_SNR_97);

	if((abs(@ecu_Signals::i_S4_SRR_RL_Clu_SNR_97)*0.9<=abs(signalvalue1))&&(abs(signalvalue1)<=abs(@ecu_Signals::i_S4_SRR_RL_Clu_SNR_97)*1.1))
	{
	testStepPass("Pass","i_S4_SRR_RL_Clu_SNR_97 :%f",signalvalue1);
	}
	else
	{
	testStepFail("Fail","i_S4_SRR_RL_Clu_SNR_97 :%f",signalvalue1);
	}
}

testcase S4_SRR_RL_Clu_Mes_13_S4_SRR_RL_Clu_DynProp_97()
{
	signalvalue1 = getSignal(S4_SRR_RL_Clu_DynProp_97);
	write("S4_SRR_RL_Clu_DynProp_97 :%f",signalvalue1);
	write("i_S4_SRR_RL_Clu_DynProp_97 :%o",@ecu_Signals::i_S4_SRR_RL_Clu_DynProp_97);

	testStep("get expect variable value: ","i_S4_SRR_RL_Clu_DynProp_97 :%o",@ecu_Signals::i_S4_SRR_RL_Clu_DynProp_97);

	if(signalvalue1==@ecu_Signals::i_S4_SRR_RL_Clu_DynProp_97)
	{
	testStepPass("Pass","i_S4_SRR_RL_Clu_DynProp_97 :%f",signalvalue1);
	}
	else
	{
	testStepFail("Fail","i_S4_SRR_RL_Clu_DynProp_97 :%f",signalvalue1);
	}
}

testcase S4_SRR_RL_Clu_Mes_13_S4_SRR_RL_Clu_Locationvalid_97()
{
	signalvalue1 = getSignal(S4_SRR_RL_Clu_Locationvalid_97);
	write("S4_SRR_RL_Clu_Locationvalid_97 :%f",signalvalue1);
	write("i_S4_SRR_RL_Clu_Locationvalid_97 :%o",@ecu_Signals::i_S4_SRR_RL_Clu_Locationvalid_97);

	testStep("get expect variable value: ","i_S4_SRR_RL_Clu_Locationvalid_97 :%o",@ecu_Signals::i_S4_SRR_RL_Clu_Locationvalid_97);

	if(signalvalue1==@ecu_Signals::i_S4_SRR_RL_Clu_Locationvalid_97)
	{
	testStepPass("Pass","i_S4_SRR_RL_Clu_Locationvalid_97 :%f",signalvalue1);
	}
	else
	{
	testStepFail("Fail","i_S4_SRR_RL_Clu_Locationvalid_97 :%f",signalvalue1);
	}
}

testcase S4_SRR_RL_Clu_Mes_14_S4_SRR_RL_Clu_Theta_98()
{
	signalvalue1 = getSignal(S4_SRR_RL_Clu_Theta_98);
	write("S4_SRR_RL_Clu_Theta_98 :%f",signalvalue1);
	write("i_S4_SRR_RL_Clu_Theta_98 :%f",@ecu_Signals::i_S4_SRR_RL_Clu_Theta_98);

	testStep("get expect variable value: ","i_S4_SRR_RL_Clu_Theta_98 :%f",@ecu_Signals::i_S4_SRR_RL_Clu_Theta_98);

	if((abs(@ecu_Signals::i_S4_SRR_RL_Clu_Theta_98)*0.9<=abs(signalvalue1))&&(abs(signalvalue1)<=abs(@ecu_Signals::i_S4_SRR_RL_Clu_Theta_98)*1.1))
	{
	testStepPass("Pass","i_S4_SRR_RL_Clu_Theta_98 :%f",signalvalue1);
	}
	else
	{
	testStepFail("Fail","i_S4_SRR_RL_Clu_Theta_98 :%f",signalvalue1);
	}
}

testcase S4_SRR_RL_Clu_Mes_14_S4_SRR_RL_Clu_Dist_98()
{
	signalvalue1 = getSignal(S4_SRR_RL_Clu_Dist_98);
	write("S4_SRR_RL_Clu_Dist_98 :%f",signalvalue1);
	write("i_S4_SRR_RL_Clu_Dist_98 :%f",@ecu_Signals::i_S4_SRR_RL_Clu_Dist_98);

	testStep("get expect variable value: ","i_S4_SRR_RL_Clu_Dist_98 :%f",@ecu_Signals::i_S4_SRR_RL_Clu_Dist_98);

	if((abs(@ecu_Signals::i_S4_SRR_RL_Clu_Dist_98)*0.9<=abs(signalvalue1))&&(abs(signalvalue1)<=abs(@ecu_Signals::i_S4_SRR_RL_Clu_Dist_98)*1.1))
	{
	testStepPass("Pass","i_S4_SRR_RL_Clu_Dist_98 :%f",signalvalue1);
	}
	else
	{
	testStepFail("Fail","i_S4_SRR_RL_Clu_Dist_98 :%f",signalvalue1);
	}
}

testcase S4_SRR_RL_Clu_Mes_14_S4_SRR_RL_Clu_Vel_98()
{
	signalvalue1 = getSignal(S4_SRR_RL_Clu_Vel_98);
	write("S4_SRR_RL_Clu_Vel_98 :%f",signalvalue1);
	write("i_S4_SRR_RL_Clu_Vel_98 :%f",@ecu_Signals::i_S4_SRR_RL_Clu_Vel_98);

	testStep("get expect variable value: ","i_S4_SRR_RL_Clu_Vel_98 :%f",@ecu_Signals::i_S4_SRR_RL_Clu_Vel_98);

	if((abs(@ecu_Signals::i_S4_SRR_RL_Clu_Vel_98)*0.9<=abs(signalvalue1))&&(abs(signalvalue1)<=abs(@ecu_Signals::i_S4_SRR_RL_Clu_Vel_98)*1.1))
	{
	testStepPass("Pass","i_S4_SRR_RL_Clu_Vel_98 :%f",signalvalue1);
	}
	else
	{
	testStepFail("Fail","i_S4_SRR_RL_Clu_Vel_98 :%f",signalvalue1);
	}
}

testcase S4_SRR_RL_Clu_Mes_14_S4_SRR_RL_Clu_SNR_98()
{
	signalvalue1 = getSignal(S4_SRR_RL_Clu_SNR_98);
	write("S4_SRR_RL_Clu_SNR_98 :%f",signalvalue1);
	write("i_S4_SRR_RL_Clu_SNR_98 :%f",@ecu_Signals::i_S4_SRR_RL_Clu_SNR_98);

	testStep("get expect variable value: ","i_S4_SRR_RL_Clu_SNR_98 :%f",@ecu_Signals::i_S4_SRR_RL_Clu_SNR_98);

	if((abs(@ecu_Signals::i_S4_SRR_RL_Clu_SNR_98)*0.9<=abs(signalvalue1))&&(abs(signalvalue1)<=abs(@ecu_Signals::i_S4_SRR_RL_Clu_SNR_98)*1.1))
	{
	testStepPass("Pass","i_S4_SRR_RL_Clu_SNR_98 :%f",signalvalue1);
	}
	else
	{
	testStepFail("Fail","i_S4_SRR_RL_Clu_SNR_98 :%f",signalvalue1);
	}
}

testcase S4_SRR_RL_Clu_Mes_14_S4_SRR_RL_Clu_DynProp_98()
{
	signalvalue1 = getSignal(S4_SRR_RL_Clu_DynProp_98);
	write("S4_SRR_RL_Clu_DynProp_98 :%f",signalvalue1);
	write("i_S4_SRR_RL_Clu_DynProp_98 :%o",@ecu_Signals::i_S4_SRR_RL_Clu_DynProp_98);

	testStep("get expect variable value: ","i_S4_SRR_RL_Clu_DynProp_98 :%o",@ecu_Signals::i_S4_SRR_RL_Clu_DynProp_98);

	if(signalvalue1==@ecu_Signals::i_S4_SRR_RL_Clu_DynProp_98)
	{
	testStepPass("Pass","i_S4_SRR_RL_Clu_DynProp_98 :%f",signalvalue1);
	}
	else
	{
	testStepFail("Fail","i_S4_SRR_RL_Clu_DynProp_98 :%f",signalvalue1);
	}
}

testcase S4_SRR_RL_Clu_Mes_14_S4_SRR_RL_Clu_Locationvalid_98()
{
	signalvalue1 = getSignal(S4_SRR_RL_Clu_Locationvalid_98);
	write("S4_SRR_RL_Clu_Locationvalid_98 :%f",signalvalue1);
	write("i_S4_SRR_RL_Clu_Locationvalid_98 :%o",@ecu_Signals::i_S4_SRR_RL_Clu_Locationvalid_98);

	testStep("get expect variable value: ","i_S4_SRR_RL_Clu_Locationvalid_98 :%o",@ecu_Signals::i_S4_SRR_RL_Clu_Locationvalid_98);

	if(signalvalue1==@ecu_Signals::i_S4_SRR_RL_Clu_Locationvalid_98)
	{
	testStepPass("Pass","i_S4_SRR_RL_Clu_Locationvalid_98 :%f",signalvalue1);
	}
	else
	{
	testStepFail("Fail","i_S4_SRR_RL_Clu_Locationvalid_98 :%f",signalvalue1);
	}
}

testcase S4_SRR_RL_Clu_Mes_14_S4_SRR_RL_Clu_Theta_99()
{
	signalvalue1 = getSignal(S4_SRR_RL_Clu_Theta_99);
	write("S4_SRR_RL_Clu_Theta_99 :%f",signalvalue1);
	write("i_S4_SRR_RL_Clu_Theta_99 :%f",@ecu_Signals::i_S4_SRR_RL_Clu_Theta_99);

	testStep("get expect variable value: ","i_S4_SRR_RL_Clu_Theta_99 :%f",@ecu_Signals::i_S4_SRR_RL_Clu_Theta_99);

	if((abs(@ecu_Signals::i_S4_SRR_RL_Clu_Theta_99)*0.9<=abs(signalvalue1))&&(abs(signalvalue1)<=abs(@ecu_Signals::i_S4_SRR_RL_Clu_Theta_99)*1.1))
	{
	testStepPass("Pass","i_S4_SRR_RL_Clu_Theta_99 :%f",signalvalue1);
	}
	else
	{
	testStepFail("Fail","i_S4_SRR_RL_Clu_Theta_99 :%f",signalvalue1);
	}
}

testcase S4_SRR_RL_Clu_Mes_14_S4_SRR_RL_Clu_Dist_99()
{
	signalvalue1 = getSignal(S4_SRR_RL_Clu_Dist_99);
	write("S4_SRR_RL_Clu_Dist_99 :%f",signalvalue1);
	write("i_S4_SRR_RL_Clu_Dist_99 :%f",@ecu_Signals::i_S4_SRR_RL_Clu_Dist_99);

	testStep("get expect variable value: ","i_S4_SRR_RL_Clu_Dist_99 :%f",@ecu_Signals::i_S4_SRR_RL_Clu_Dist_99);

	if((abs(@ecu_Signals::i_S4_SRR_RL_Clu_Dist_99)*0.9<=abs(signalvalue1))&&(abs(signalvalue1)<=abs(@ecu_Signals::i_S4_SRR_RL_Clu_Dist_99)*1.1))
	{
	testStepPass("Pass","i_S4_SRR_RL_Clu_Dist_99 :%f",signalvalue1);
	}
	else
	{
	testStepFail("Fail","i_S4_SRR_RL_Clu_Dist_99 :%f",signalvalue1);
	}
}

testcase S4_SRR_RL_Clu_Mes_14_S4_SRR_RL_Clu_Vel_99()
{
	signalvalue1 = getSignal(S4_SRR_RL_Clu_Vel_99);
	write("S4_SRR_RL_Clu_Vel_99 :%f",signalvalue1);
	write("i_S4_SRR_RL_Clu_Vel_99 :%f",@ecu_Signals::i_S4_SRR_RL_Clu_Vel_99);

	testStep("get expect variable value: ","i_S4_SRR_RL_Clu_Vel_99 :%f",@ecu_Signals::i_S4_SRR_RL_Clu_Vel_99);

	if((abs(@ecu_Signals::i_S4_SRR_RL_Clu_Vel_99)*0.9<=abs(signalvalue1))&&(abs(signalvalue1)<=abs(@ecu_Signals::i_S4_SRR_RL_Clu_Vel_99)*1.1))
	{
	testStepPass("Pass","i_S4_SRR_RL_Clu_Vel_99 :%f",signalvalue1);
	}
	else
	{
	testStepFail("Fail","i_S4_SRR_RL_Clu_Vel_99 :%f",signalvalue1);
	}
}

testcase S4_SRR_RL_Clu_Mes_14_S4_SRR_RL_Clu_SNR_99()
{
	signalvalue1 = getSignal(S4_SRR_RL_Clu_SNR_99);
	write("S4_SRR_RL_Clu_SNR_99 :%f",signalvalue1);
	write("i_S4_SRR_RL_Clu_SNR_99 :%f",@ecu_Signals::i_S4_SRR_RL_Clu_SNR_99);

	testStep("get expect variable value: ","i_S4_SRR_RL_Clu_SNR_99 :%f",@ecu_Signals::i_S4_SRR_RL_Clu_SNR_99);

	if((abs(@ecu_Signals::i_S4_SRR_RL_Clu_SNR_99)*0.9<=abs(signalvalue1))&&(abs(signalvalue1)<=abs(@ecu_Signals::i_S4_SRR_RL_Clu_SNR_99)*1.1))
	{
	testStepPass("Pass","i_S4_SRR_RL_Clu_SNR_99 :%f",signalvalue1);
	}
	else
	{
	testStepFail("Fail","i_S4_SRR_RL_Clu_SNR_99 :%f",signalvalue1);
	}
}

testcase S4_SRR_RL_Clu_Mes_14_S4_SRR_RL_Clu_DynProp_99()
{
	signalvalue1 = getSignal(S4_SRR_RL_Clu_DynProp_99);
	write("S4_SRR_RL_Clu_DynProp_99 :%f",signalvalue1);
	write("i_S4_SRR_RL_Clu_DynProp_99 :%o",@ecu_Signals::i_S4_SRR_RL_Clu_DynProp_99);

	testStep("get expect variable value: ","i_S4_SRR_RL_Clu_DynProp_99 :%o",@ecu_Signals::i_S4_SRR_RL_Clu_DynProp_99);

	if(signalvalue1==@ecu_Signals::i_S4_SRR_RL_Clu_DynProp_99)
	{
	testStepPass("Pass","i_S4_SRR_RL_Clu_DynProp_99 :%f",signalvalue1);
	}
	else
	{
	testStepFail("Fail","i_S4_SRR_RL_Clu_DynProp_99 :%f",signalvalue1);
	}
}

testcase S4_SRR_RL_Clu_Mes_14_S4_SRR_RL_Clu_Locationvalid_99()
{
	signalvalue1 = getSignal(S4_SRR_RL_Clu_Locationvalid_99);
	write("S4_SRR_RL_Clu_Locationvalid_99 :%f",signalvalue1);
	write("i_S4_SRR_RL_Clu_Locationvalid_99 :%o",@ecu_Signals::i_S4_SRR_RL_Clu_Locationvalid_99);

	testStep("get expect variable value: ","i_S4_SRR_RL_Clu_Locationvalid_99 :%o",@ecu_Signals::i_S4_SRR_RL_Clu_Locationvalid_99);

	if(signalvalue1==@ecu_Signals::i_S4_SRR_RL_Clu_Locationvalid_99)
	{
	testStepPass("Pass","i_S4_SRR_RL_Clu_Locationvalid_99 :%f",signalvalue1);
	}
	else
	{
	testStepFail("Fail","i_S4_SRR_RL_Clu_Locationvalid_99 :%f",signalvalue1);
	}
}

testcase S4_SRR_RL_Clu_Mes_14_S4_SRR_RL_Clu_Theta_100()
{
	signalvalue1 = getSignal(S4_SRR_RL_Clu_Theta_100);
	write("S4_SRR_RL_Clu_Theta_100 :%f",signalvalue1);
	write("i_S4_SRR_RL_Clu_Theta_100 :%f",@ecu_Signals::i_S4_SRR_RL_Clu_Theta_100);

	testStep("get expect variable value: ","i_S4_SRR_RL_Clu_Theta_100 :%f",@ecu_Signals::i_S4_SRR_RL_Clu_Theta_100);

	if((abs(@ecu_Signals::i_S4_SRR_RL_Clu_Theta_100)*0.9<=abs(signalvalue1))&&(abs(signalvalue1)<=abs(@ecu_Signals::i_S4_SRR_RL_Clu_Theta_100)*1.1))
	{
	testStepPass("Pass","i_S4_SRR_RL_Clu_Theta_100 :%f",signalvalue1);
	}
	else
	{
	testStepFail("Fail","i_S4_SRR_RL_Clu_Theta_100 :%f",signalvalue1);
	}
}

testcase S4_SRR_RL_Clu_Mes_14_S4_SRR_RL_Clu_Dist_100()
{
	signalvalue1 = getSignal(S4_SRR_RL_Clu_Dist_100);
	write("S4_SRR_RL_Clu_Dist_100 :%f",signalvalue1);
	write("i_S4_SRR_RL_Clu_Dist_100 :%f",@ecu_Signals::i_S4_SRR_RL_Clu_Dist_100);

	testStep("get expect variable value: ","i_S4_SRR_RL_Clu_Dist_100 :%f",@ecu_Signals::i_S4_SRR_RL_Clu_Dist_100);

	if((abs(@ecu_Signals::i_S4_SRR_RL_Clu_Dist_100)*0.9<=abs(signalvalue1))&&(abs(signalvalue1)<=abs(@ecu_Signals::i_S4_SRR_RL_Clu_Dist_100)*1.1))
	{
	testStepPass("Pass","i_S4_SRR_RL_Clu_Dist_100 :%f",signalvalue1);
	}
	else
	{
	testStepFail("Fail","i_S4_SRR_RL_Clu_Dist_100 :%f",signalvalue1);
	}
}

testcase S4_SRR_RL_Clu_Mes_14_S4_SRR_RL_Clu_Vel_100()
{
	signalvalue1 = getSignal(S4_SRR_RL_Clu_Vel_100);
	write("S4_SRR_RL_Clu_Vel_100 :%f",signalvalue1);
	write("i_S4_SRR_RL_Clu_Vel_100 :%f",@ecu_Signals::i_S4_SRR_RL_Clu_Vel_100);

	testStep("get expect variable value: ","i_S4_SRR_RL_Clu_Vel_100 :%f",@ecu_Signals::i_S4_SRR_RL_Clu_Vel_100);

	if((abs(@ecu_Signals::i_S4_SRR_RL_Clu_Vel_100)*0.9<=abs(signalvalue1))&&(abs(signalvalue1)<=abs(@ecu_Signals::i_S4_SRR_RL_Clu_Vel_100)*1.1))
	{
	testStepPass("Pass","i_S4_SRR_RL_Clu_Vel_100 :%f",signalvalue1);
	}
	else
	{
	testStepFail("Fail","i_S4_SRR_RL_Clu_Vel_100 :%f",signalvalue1);
	}
}

testcase S4_SRR_RL_Clu_Mes_14_S4_SRR_RL_Clu_SNR_100()
{
	signalvalue1 = getSignal(S4_SRR_RL_Clu_SNR_100);
	write("S4_SRR_RL_Clu_SNR_100 :%f",signalvalue1);
	write("i_S4_SRR_RL_Clu_SNR_100 :%f",@ecu_Signals::i_S4_SRR_RL_Clu_SNR_100);

	testStep("get expect variable value: ","i_S4_SRR_RL_Clu_SNR_100 :%f",@ecu_Signals::i_S4_SRR_RL_Clu_SNR_100);

	if((abs(@ecu_Signals::i_S4_SRR_RL_Clu_SNR_100)*0.9<=abs(signalvalue1))&&(abs(signalvalue1)<=abs(@ecu_Signals::i_S4_SRR_RL_Clu_SNR_100)*1.1))
	{
	testStepPass("Pass","i_S4_SRR_RL_Clu_SNR_100 :%f",signalvalue1);
	}
	else
	{
	testStepFail("Fail","i_S4_SRR_RL_Clu_SNR_100 :%f",signalvalue1);
	}
}

testcase S4_SRR_RL_Clu_Mes_14_S4_SRR_RL_Clu_DynProp_100()
{
	signalvalue1 = getSignal(S4_SRR_RL_Clu_DynProp_100);
	write("S4_SRR_RL_Clu_DynProp_100 :%f",signalvalue1);
	write("i_S4_SRR_RL_Clu_DynProp_100 :%o",@ecu_Signals::i_S4_SRR_RL_Clu_DynProp_100);

	testStep("get expect variable value: ","i_S4_SRR_RL_Clu_DynProp_100 :%o",@ecu_Signals::i_S4_SRR_RL_Clu_DynProp_100);

	if(signalvalue1==@ecu_Signals::i_S4_SRR_RL_Clu_DynProp_100)
	{
	testStepPass("Pass","i_S4_SRR_RL_Clu_DynProp_100 :%f",signalvalue1);
	}
	else
	{
	testStepFail("Fail","i_S4_SRR_RL_Clu_DynProp_100 :%f",signalvalue1);
	}
}

testcase S4_SRR_RL_Clu_Mes_14_S4_SRR_RL_Clu_Locationvalid_100()
{
	signalvalue1 = getSignal(S4_SRR_RL_Clu_Locationvalid_100);
	write("S4_SRR_RL_Clu_Locationvalid_100 :%f",signalvalue1);
	write("i_S4_SRR_RL_Clu_Locationvalid_100 :%o",@ecu_Signals::i_S4_SRR_RL_Clu_Locationvalid_100);

	testStep("get expect variable value: ","i_S4_SRR_RL_Clu_Locationvalid_100 :%o",@ecu_Signals::i_S4_SRR_RL_Clu_Locationvalid_100);

	if(signalvalue1==@ecu_Signals::i_S4_SRR_RL_Clu_Locationvalid_100)
	{
	testStepPass("Pass","i_S4_SRR_RL_Clu_Locationvalid_100 :%f",signalvalue1);
	}
	else
	{
	testStepFail("Fail","i_S4_SRR_RL_Clu_Locationvalid_100 :%f",signalvalue1);
	}
}

testcase S4_SRR_RL_Clu_Mes_14_S4_SRR_RL_Clu_Theta_101()
{
	signalvalue1 = getSignal(S4_SRR_RL_Clu_Theta_101);
	write("S4_SRR_RL_Clu_Theta_101 :%f",signalvalue1);
	write("i_S4_SRR_RL_Clu_Theta_101 :%f",@ecu_Signals::i_S4_SRR_RL_Clu_Theta_101);

	testStep("get expect variable value: ","i_S4_SRR_RL_Clu_Theta_101 :%f",@ecu_Signals::i_S4_SRR_RL_Clu_Theta_101);

	if((abs(@ecu_Signals::i_S4_SRR_RL_Clu_Theta_101)*0.9<=abs(signalvalue1))&&(abs(signalvalue1)<=abs(@ecu_Signals::i_S4_SRR_RL_Clu_Theta_101)*1.1))
	{
	testStepPass("Pass","i_S4_SRR_RL_Clu_Theta_101 :%f",signalvalue1);
	}
	else
	{
	testStepFail("Fail","i_S4_SRR_RL_Clu_Theta_101 :%f",signalvalue1);
	}
}

testcase S4_SRR_RL_Clu_Mes_14_S4_SRR_RL_Clu_Dist_101()
{
	signalvalue1 = getSignal(S4_SRR_RL_Clu_Dist_101);
	write("S4_SRR_RL_Clu_Dist_101 :%f",signalvalue1);
	write("i_S4_SRR_RL_Clu_Dist_101 :%f",@ecu_Signals::i_S4_SRR_RL_Clu_Dist_101);

	testStep("get expect variable value: ","i_S4_SRR_RL_Clu_Dist_101 :%f",@ecu_Signals::i_S4_SRR_RL_Clu_Dist_101);

	if((abs(@ecu_Signals::i_S4_SRR_RL_Clu_Dist_101)*0.9<=abs(signalvalue1))&&(abs(signalvalue1)<=abs(@ecu_Signals::i_S4_SRR_RL_Clu_Dist_101)*1.1))
	{
	testStepPass("Pass","i_S4_SRR_RL_Clu_Dist_101 :%f",signalvalue1);
	}
	else
	{
	testStepFail("Fail","i_S4_SRR_RL_Clu_Dist_101 :%f",signalvalue1);
	}
}

testcase S4_SRR_RL_Clu_Mes_14_S4_SRR_RL_Clu_Vel_101()
{
	signalvalue1 = getSignal(S4_SRR_RL_Clu_Vel_101);
	write("S4_SRR_RL_Clu_Vel_101 :%f",signalvalue1);
	write("i_S4_SRR_RL_Clu_Vel_101 :%f",@ecu_Signals::i_S4_SRR_RL_Clu_Vel_101);

	testStep("get expect variable value: ","i_S4_SRR_RL_Clu_Vel_101 :%f",@ecu_Signals::i_S4_SRR_RL_Clu_Vel_101);

	if((abs(@ecu_Signals::i_S4_SRR_RL_Clu_Vel_101)*0.9<=abs(signalvalue1))&&(abs(signalvalue1)<=abs(@ecu_Signals::i_S4_SRR_RL_Clu_Vel_101)*1.1))
	{
	testStepPass("Pass","i_S4_SRR_RL_Clu_Vel_101 :%f",signalvalue1);
	}
	else
	{
	testStepFail("Fail","i_S4_SRR_RL_Clu_Vel_101 :%f",signalvalue1);
	}
}

testcase S4_SRR_RL_Clu_Mes_14_S4_SRR_RL_Clu_SNR_101()
{
	signalvalue1 = getSignal(S4_SRR_RL_Clu_SNR_101);
	write("S4_SRR_RL_Clu_SNR_101 :%f",signalvalue1);
	write("i_S4_SRR_RL_Clu_SNR_101 :%f",@ecu_Signals::i_S4_SRR_RL_Clu_SNR_101);

	testStep("get expect variable value: ","i_S4_SRR_RL_Clu_SNR_101 :%f",@ecu_Signals::i_S4_SRR_RL_Clu_SNR_101);

	if((abs(@ecu_Signals::i_S4_SRR_RL_Clu_SNR_101)*0.9<=abs(signalvalue1))&&(abs(signalvalue1)<=abs(@ecu_Signals::i_S4_SRR_RL_Clu_SNR_101)*1.1))
	{
	testStepPass("Pass","i_S4_SRR_RL_Clu_SNR_101 :%f",signalvalue1);
	}
	else
	{
	testStepFail("Fail","i_S4_SRR_RL_Clu_SNR_101 :%f",signalvalue1);
	}
}

testcase S4_SRR_RL_Clu_Mes_14_S4_SRR_RL_Clu_DynProp_101()
{
	signalvalue1 = getSignal(S4_SRR_RL_Clu_DynProp_101);
	write("S4_SRR_RL_Clu_DynProp_101 :%f",signalvalue1);
	write("i_S4_SRR_RL_Clu_DynProp_101 :%o",@ecu_Signals::i_S4_SRR_RL_Clu_DynProp_101);

	testStep("get expect variable value: ","i_S4_SRR_RL_Clu_DynProp_101 :%o",@ecu_Signals::i_S4_SRR_RL_Clu_DynProp_101);

	if(signalvalue1==@ecu_Signals::i_S4_SRR_RL_Clu_DynProp_101)
	{
	testStepPass("Pass","i_S4_SRR_RL_Clu_DynProp_101 :%f",signalvalue1);
	}
	else
	{
	testStepFail("Fail","i_S4_SRR_RL_Clu_DynProp_101 :%f",signalvalue1);
	}
}

testcase S4_SRR_RL_Clu_Mes_14_S4_SRR_RL_Clu_Locationvalid_101()
{
	signalvalue1 = getSignal(S4_SRR_RL_Clu_Locationvalid_101);
	write("S4_SRR_RL_Clu_Locationvalid_101 :%f",signalvalue1);
	write("i_S4_SRR_RL_Clu_Locationvalid_101 :%o",@ecu_Signals::i_S4_SRR_RL_Clu_Locationvalid_101);

	testStep("get expect variable value: ","i_S4_SRR_RL_Clu_Locationvalid_101 :%o",@ecu_Signals::i_S4_SRR_RL_Clu_Locationvalid_101);

	if(signalvalue1==@ecu_Signals::i_S4_SRR_RL_Clu_Locationvalid_101)
	{
	testStepPass("Pass","i_S4_SRR_RL_Clu_Locationvalid_101 :%f",signalvalue1);
	}
	else
	{
	testStepFail("Fail","i_S4_SRR_RL_Clu_Locationvalid_101 :%f",signalvalue1);
	}
}

testcase S4_SRR_RL_Clu_Mes_14_S4_SRR_RL_Clu_Theta_102()
{
	signalvalue1 = getSignal(S4_SRR_RL_Clu_Theta_102);
	write("S4_SRR_RL_Clu_Theta_102 :%f",signalvalue1);
	write("i_S4_SRR_RL_Clu_Theta_102 :%f",@ecu_Signals::i_S4_SRR_RL_Clu_Theta_102);

	testStep("get expect variable value: ","i_S4_SRR_RL_Clu_Theta_102 :%f",@ecu_Signals::i_S4_SRR_RL_Clu_Theta_102);

	if((abs(@ecu_Signals::i_S4_SRR_RL_Clu_Theta_102)*0.9<=abs(signalvalue1))&&(abs(signalvalue1)<=abs(@ecu_Signals::i_S4_SRR_RL_Clu_Theta_102)*1.1))
	{
	testStepPass("Pass","i_S4_SRR_RL_Clu_Theta_102 :%f",signalvalue1);
	}
	else
	{
	testStepFail("Fail","i_S4_SRR_RL_Clu_Theta_102 :%f",signalvalue1);
	}
}

testcase S4_SRR_RL_Clu_Mes_14_S4_SRR_RL_Clu_Dist_102()
{
	signalvalue1 = getSignal(S4_SRR_RL_Clu_Dist_102);
	write("S4_SRR_RL_Clu_Dist_102 :%f",signalvalue1);
	write("i_S4_SRR_RL_Clu_Dist_102 :%f",@ecu_Signals::i_S4_SRR_RL_Clu_Dist_102);

	testStep("get expect variable value: ","i_S4_SRR_RL_Clu_Dist_102 :%f",@ecu_Signals::i_S4_SRR_RL_Clu_Dist_102);

	if((abs(@ecu_Signals::i_S4_SRR_RL_Clu_Dist_102)*0.9<=abs(signalvalue1))&&(abs(signalvalue1)<=abs(@ecu_Signals::i_S4_SRR_RL_Clu_Dist_102)*1.1))
	{
	testStepPass("Pass","i_S4_SRR_RL_Clu_Dist_102 :%f",signalvalue1);
	}
	else
	{
	testStepFail("Fail","i_S4_SRR_RL_Clu_Dist_102 :%f",signalvalue1);
	}
}

testcase S4_SRR_RL_Clu_Mes_14_S4_SRR_RL_Clu_Vel_102()
{
	signalvalue1 = getSignal(S4_SRR_RL_Clu_Vel_102);
	write("S4_SRR_RL_Clu_Vel_102 :%f",signalvalue1);
	write("i_S4_SRR_RL_Clu_Vel_102 :%f",@ecu_Signals::i_S4_SRR_RL_Clu_Vel_102);

	testStep("get expect variable value: ","i_S4_SRR_RL_Clu_Vel_102 :%f",@ecu_Signals::i_S4_SRR_RL_Clu_Vel_102);

	if((abs(@ecu_Signals::i_S4_SRR_RL_Clu_Vel_102)*0.9<=abs(signalvalue1))&&(abs(signalvalue1)<=abs(@ecu_Signals::i_S4_SRR_RL_Clu_Vel_102)*1.1))
	{
	testStepPass("Pass","i_S4_SRR_RL_Clu_Vel_102 :%f",signalvalue1);
	}
	else
	{
	testStepFail("Fail","i_S4_SRR_RL_Clu_Vel_102 :%f",signalvalue1);
	}
}

testcase S4_SRR_RL_Clu_Mes_14_S4_SRR_RL_Clu_SNR_102()
{
	signalvalue1 = getSignal(S4_SRR_RL_Clu_SNR_102);
	write("S4_SRR_RL_Clu_SNR_102 :%f",signalvalue1);
	write("i_S4_SRR_RL_Clu_SNR_102 :%f",@ecu_Signals::i_S4_SRR_RL_Clu_SNR_102);

	testStep("get expect variable value: ","i_S4_SRR_RL_Clu_SNR_102 :%f",@ecu_Signals::i_S4_SRR_RL_Clu_SNR_102);

	if((abs(@ecu_Signals::i_S4_SRR_RL_Clu_SNR_102)*0.9<=abs(signalvalue1))&&(abs(signalvalue1)<=abs(@ecu_Signals::i_S4_SRR_RL_Clu_SNR_102)*1.1))
	{
	testStepPass("Pass","i_S4_SRR_RL_Clu_SNR_102 :%f",signalvalue1);
	}
	else
	{
	testStepFail("Fail","i_S4_SRR_RL_Clu_SNR_102 :%f",signalvalue1);
	}
}

testcase S4_SRR_RL_Clu_Mes_14_S4_SRR_RL_Clu_DynProp_102()
{
	signalvalue1 = getSignal(S4_SRR_RL_Clu_DynProp_102);
	write("S4_SRR_RL_Clu_DynProp_102 :%f",signalvalue1);
	write("i_S4_SRR_RL_Clu_DynProp_102 :%o",@ecu_Signals::i_S4_SRR_RL_Clu_DynProp_102);

	testStep("get expect variable value: ","i_S4_SRR_RL_Clu_DynProp_102 :%o",@ecu_Signals::i_S4_SRR_RL_Clu_DynProp_102);

	if(signalvalue1==@ecu_Signals::i_S4_SRR_RL_Clu_DynProp_102)
	{
	testStepPass("Pass","i_S4_SRR_RL_Clu_DynProp_102 :%f",signalvalue1);
	}
	else
	{
	testStepFail("Fail","i_S4_SRR_RL_Clu_DynProp_102 :%f",signalvalue1);
	}
}

testcase S4_SRR_RL_Clu_Mes_14_S4_SRR_RL_Clu_Locationvalid_102()
{
	signalvalue1 = getSignal(S4_SRR_RL_Clu_Locationvalid_102);
	write("S4_SRR_RL_Clu_Locationvalid_102 :%f",signalvalue1);
	write("i_S4_SRR_RL_Clu_Locationvalid_102 :%o",@ecu_Signals::i_S4_SRR_RL_Clu_Locationvalid_102);

	testStep("get expect variable value: ","i_S4_SRR_RL_Clu_Locationvalid_102 :%o",@ecu_Signals::i_S4_SRR_RL_Clu_Locationvalid_102);

	if(signalvalue1==@ecu_Signals::i_S4_SRR_RL_Clu_Locationvalid_102)
	{
	testStepPass("Pass","i_S4_SRR_RL_Clu_Locationvalid_102 :%f",signalvalue1);
	}
	else
	{
	testStepFail("Fail","i_S4_SRR_RL_Clu_Locationvalid_102 :%f",signalvalue1);
	}
}

testcase S4_SRR_RL_Clu_Mes_14_S4_SRR_RL_Clu_Theta_103()
{
	signalvalue1 = getSignal(S4_SRR_RL_Clu_Theta_103);
	write("S4_SRR_RL_Clu_Theta_103 :%f",signalvalue1);
	write("i_S4_SRR_RL_Clu_Theta_103 :%f",@ecu_Signals::i_S4_SRR_RL_Clu_Theta_103);

	testStep("get expect variable value: ","i_S4_SRR_RL_Clu_Theta_103 :%f",@ecu_Signals::i_S4_SRR_RL_Clu_Theta_103);

	if((abs(@ecu_Signals::i_S4_SRR_RL_Clu_Theta_103)*0.9<=abs(signalvalue1))&&(abs(signalvalue1)<=abs(@ecu_Signals::i_S4_SRR_RL_Clu_Theta_103)*1.1))
	{
	testStepPass("Pass","i_S4_SRR_RL_Clu_Theta_103 :%f",signalvalue1);
	}
	else
	{
	testStepFail("Fail","i_S4_SRR_RL_Clu_Theta_103 :%f",signalvalue1);
	}
}

testcase S4_SRR_RL_Clu_Mes_14_S4_SRR_RL_Clu_Dist_103()
{
	signalvalue1 = getSignal(S4_SRR_RL_Clu_Dist_103);
	write("S4_SRR_RL_Clu_Dist_103 :%f",signalvalue1);
	write("i_S4_SRR_RL_Clu_Dist_103 :%f",@ecu_Signals::i_S4_SRR_RL_Clu_Dist_103);

	testStep("get expect variable value: ","i_S4_SRR_RL_Clu_Dist_103 :%f",@ecu_Signals::i_S4_SRR_RL_Clu_Dist_103);

	if((abs(@ecu_Signals::i_S4_SRR_RL_Clu_Dist_103)*0.9<=abs(signalvalue1))&&(abs(signalvalue1)<=abs(@ecu_Signals::i_S4_SRR_RL_Clu_Dist_103)*1.1))
	{
	testStepPass("Pass","i_S4_SRR_RL_Clu_Dist_103 :%f",signalvalue1);
	}
	else
	{
	testStepFail("Fail","i_S4_SRR_RL_Clu_Dist_103 :%f",signalvalue1);
	}
}

testcase S4_SRR_RL_Clu_Mes_14_S4_SRR_RL_Clu_Vel_103()
{
	signalvalue1 = getSignal(S4_SRR_RL_Clu_Vel_103);
	write("S4_SRR_RL_Clu_Vel_103 :%f",signalvalue1);
	write("i_S4_SRR_RL_Clu_Vel_103 :%f",@ecu_Signals::i_S4_SRR_RL_Clu_Vel_103);

	testStep("get expect variable value: ","i_S4_SRR_RL_Clu_Vel_103 :%f",@ecu_Signals::i_S4_SRR_RL_Clu_Vel_103);

	if((abs(@ecu_Signals::i_S4_SRR_RL_Clu_Vel_103)*0.9<=abs(signalvalue1))&&(abs(signalvalue1)<=abs(@ecu_Signals::i_S4_SRR_RL_Clu_Vel_103)*1.1))
	{
	testStepPass("Pass","i_S4_SRR_RL_Clu_Vel_103 :%f",signalvalue1);
	}
	else
	{
	testStepFail("Fail","i_S4_SRR_RL_Clu_Vel_103 :%f",signalvalue1);
	}
}

testcase S4_SRR_RL_Clu_Mes_14_S4_SRR_RL_Clu_SNR_103()
{
	signalvalue1 = getSignal(S4_SRR_RL_Clu_SNR_103);
	write("S4_SRR_RL_Clu_SNR_103 :%f",signalvalue1);
	write("i_S4_SRR_RL_Clu_SNR_103 :%f",@ecu_Signals::i_S4_SRR_RL_Clu_SNR_103);

	testStep("get expect variable value: ","i_S4_SRR_RL_Clu_SNR_103 :%f",@ecu_Signals::i_S4_SRR_RL_Clu_SNR_103);

	if((abs(@ecu_Signals::i_S4_SRR_RL_Clu_SNR_103)*0.9<=abs(signalvalue1))&&(abs(signalvalue1)<=abs(@ecu_Signals::i_S4_SRR_RL_Clu_SNR_103)*1.1))
	{
	testStepPass("Pass","i_S4_SRR_RL_Clu_SNR_103 :%f",signalvalue1);
	}
	else
	{
	testStepFail("Fail","i_S4_SRR_RL_Clu_SNR_103 :%f",signalvalue1);
	}
}

testcase S4_SRR_RL_Clu_Mes_14_S4_SRR_RL_Clu_DynProp_103()
{
	signalvalue1 = getSignal(S4_SRR_RL_Clu_DynProp_103);
	write("S4_SRR_RL_Clu_DynProp_103 :%f",signalvalue1);
	write("i_S4_SRR_RL_Clu_DynProp_103 :%o",@ecu_Signals::i_S4_SRR_RL_Clu_DynProp_103);

	testStep("get expect variable value: ","i_S4_SRR_RL_Clu_DynProp_103 :%o",@ecu_Signals::i_S4_SRR_RL_Clu_DynProp_103);

	if(signalvalue1==@ecu_Signals::i_S4_SRR_RL_Clu_DynProp_103)
	{
	testStepPass("Pass","i_S4_SRR_RL_Clu_DynProp_103 :%f",signalvalue1);
	}
	else
	{
	testStepFail("Fail","i_S4_SRR_RL_Clu_DynProp_103 :%f",signalvalue1);
	}
}

testcase S4_SRR_RL_Clu_Mes_14_S4_SRR_RL_Clu_Locationvalid_103()
{
	signalvalue1 = getSignal(S4_SRR_RL_Clu_Locationvalid_103);
	write("S4_SRR_RL_Clu_Locationvalid_103 :%f",signalvalue1);
	write("i_S4_SRR_RL_Clu_Locationvalid_103 :%o",@ecu_Signals::i_S4_SRR_RL_Clu_Locationvalid_103);

	testStep("get expect variable value: ","i_S4_SRR_RL_Clu_Locationvalid_103 :%o",@ecu_Signals::i_S4_SRR_RL_Clu_Locationvalid_103);

	if(signalvalue1==@ecu_Signals::i_S4_SRR_RL_Clu_Locationvalid_103)
	{
	testStepPass("Pass","i_S4_SRR_RL_Clu_Locationvalid_103 :%f",signalvalue1);
	}
	else
	{
	testStepFail("Fail","i_S4_SRR_RL_Clu_Locationvalid_103 :%f",signalvalue1);
	}
}

testcase S4_SRR_RL_Clu_Mes_14_S4_SRR_RL_Clu_Theta_104()
{
	signalvalue1 = getSignal(S4_SRR_RL_Clu_Theta_104);
	write("S4_SRR_RL_Clu_Theta_104 :%f",signalvalue1);
	write("i_S4_SRR_RL_Clu_Theta_104 :%f",@ecu_Signals::i_S4_SRR_RL_Clu_Theta_104);

	testStep("get expect variable value: ","i_S4_SRR_RL_Clu_Theta_104 :%f",@ecu_Signals::i_S4_SRR_RL_Clu_Theta_104);

	if((abs(@ecu_Signals::i_S4_SRR_RL_Clu_Theta_104)*0.9<=abs(signalvalue1))&&(abs(signalvalue1)<=abs(@ecu_Signals::i_S4_SRR_RL_Clu_Theta_104)*1.1))
	{
	testStepPass("Pass","i_S4_SRR_RL_Clu_Theta_104 :%f",signalvalue1);
	}
	else
	{
	testStepFail("Fail","i_S4_SRR_RL_Clu_Theta_104 :%f",signalvalue1);
	}
}

testcase S4_SRR_RL_Clu_Mes_14_S4_SRR_RL_Clu_Dist_104()
{
	signalvalue1 = getSignal(S4_SRR_RL_Clu_Dist_104);
	write("S4_SRR_RL_Clu_Dist_104 :%f",signalvalue1);
	write("i_S4_SRR_RL_Clu_Dist_104 :%f",@ecu_Signals::i_S4_SRR_RL_Clu_Dist_104);

	testStep("get expect variable value: ","i_S4_SRR_RL_Clu_Dist_104 :%f",@ecu_Signals::i_S4_SRR_RL_Clu_Dist_104);

	if((abs(@ecu_Signals::i_S4_SRR_RL_Clu_Dist_104)*0.9<=abs(signalvalue1))&&(abs(signalvalue1)<=abs(@ecu_Signals::i_S4_SRR_RL_Clu_Dist_104)*1.1))
	{
	testStepPass("Pass","i_S4_SRR_RL_Clu_Dist_104 :%f",signalvalue1);
	}
	else
	{
	testStepFail("Fail","i_S4_SRR_RL_Clu_Dist_104 :%f",signalvalue1);
	}
}

testcase S4_SRR_RL_Clu_Mes_14_S4_SRR_RL_Clu_Vel_104()
{
	signalvalue1 = getSignal(S4_SRR_RL_Clu_Vel_104);
	write("S4_SRR_RL_Clu_Vel_104 :%f",signalvalue1);
	write("i_S4_SRR_RL_Clu_Vel_104 :%f",@ecu_Signals::i_S4_SRR_RL_Clu_Vel_104);

	testStep("get expect variable value: ","i_S4_SRR_RL_Clu_Vel_104 :%f",@ecu_Signals::i_S4_SRR_RL_Clu_Vel_104);

	if((abs(@ecu_Signals::i_S4_SRR_RL_Clu_Vel_104)*0.9<=abs(signalvalue1))&&(abs(signalvalue1)<=abs(@ecu_Signals::i_S4_SRR_RL_Clu_Vel_104)*1.1))
	{
	testStepPass("Pass","i_S4_SRR_RL_Clu_Vel_104 :%f",signalvalue1);
	}
	else
	{
	testStepFail("Fail","i_S4_SRR_RL_Clu_Vel_104 :%f",signalvalue1);
	}
}

testcase S4_SRR_RL_Clu_Mes_14_S4_SRR_RL_Clu_SNR_104()
{
	signalvalue1 = getSignal(S4_SRR_RL_Clu_SNR_104);
	write("S4_SRR_RL_Clu_SNR_104 :%f",signalvalue1);
	write("i_S4_SRR_RL_Clu_SNR_104 :%f",@ecu_Signals::i_S4_SRR_RL_Clu_SNR_104);

	testStep("get expect variable value: ","i_S4_SRR_RL_Clu_SNR_104 :%f",@ecu_Signals::i_S4_SRR_RL_Clu_SNR_104);

	if((abs(@ecu_Signals::i_S4_SRR_RL_Clu_SNR_104)*0.9<=abs(signalvalue1))&&(abs(signalvalue1)<=abs(@ecu_Signals::i_S4_SRR_RL_Clu_SNR_104)*1.1))
	{
	testStepPass("Pass","i_S4_SRR_RL_Clu_SNR_104 :%f",signalvalue1);
	}
	else
	{
	testStepFail("Fail","i_S4_SRR_RL_Clu_SNR_104 :%f",signalvalue1);
	}
}

testcase S4_SRR_RL_Clu_Mes_14_S4_SRR_RL_Clu_DynProp_104()
{
	signalvalue1 = getSignal(S4_SRR_RL_Clu_DynProp_104);
	write("S4_SRR_RL_Clu_DynProp_104 :%f",signalvalue1);
	write("i_S4_SRR_RL_Clu_DynProp_104 :%o",@ecu_Signals::i_S4_SRR_RL_Clu_DynProp_104);

	testStep("get expect variable value: ","i_S4_SRR_RL_Clu_DynProp_104 :%o",@ecu_Signals::i_S4_SRR_RL_Clu_DynProp_104);

	if(signalvalue1==@ecu_Signals::i_S4_SRR_RL_Clu_DynProp_104)
	{
	testStepPass("Pass","i_S4_SRR_RL_Clu_DynProp_104 :%f",signalvalue1);
	}
	else
	{
	testStepFail("Fail","i_S4_SRR_RL_Clu_DynProp_104 :%f",signalvalue1);
	}
}

testcase S4_SRR_RL_Clu_Mes_14_S4_SRR_RL_Clu_Locationvalid_104()
{
	signalvalue1 = getSignal(S4_SRR_RL_Clu_Locationvalid_104);
	write("S4_SRR_RL_Clu_Locationvalid_104 :%f",signalvalue1);
	write("i_S4_SRR_RL_Clu_Locationvalid_104 :%o",@ecu_Signals::i_S4_SRR_RL_Clu_Locationvalid_104);

	testStep("get expect variable value: ","i_S4_SRR_RL_Clu_Locationvalid_104 :%o",@ecu_Signals::i_S4_SRR_RL_Clu_Locationvalid_104);

	if(signalvalue1==@ecu_Signals::i_S4_SRR_RL_Clu_Locationvalid_104)
	{
	testStepPass("Pass","i_S4_SRR_RL_Clu_Locationvalid_104 :%f",signalvalue1);
	}
	else
	{
	testStepFail("Fail","i_S4_SRR_RL_Clu_Locationvalid_104 :%f",signalvalue1);
	}
}

testcase S4_SRR_RL_Clu_Mes_15_S4_SRR_RL_Clu_Theta_105()
{
	signalvalue1 = getSignal(S4_SRR_RL_Clu_Theta_105);
	write("S4_SRR_RL_Clu_Theta_105 :%f",signalvalue1);
	write("i_S4_SRR_RL_Clu_Theta_105 :%f",@ecu_Signals::i_S4_SRR_RL_Clu_Theta_105);

	testStep("get expect variable value: ","i_S4_SRR_RL_Clu_Theta_105 :%f",@ecu_Signals::i_S4_SRR_RL_Clu_Theta_105);

	if((abs(@ecu_Signals::i_S4_SRR_RL_Clu_Theta_105)*0.9<=abs(signalvalue1))&&(abs(signalvalue1)<=abs(@ecu_Signals::i_S4_SRR_RL_Clu_Theta_105)*1.1))
	{
	testStepPass("Pass","i_S4_SRR_RL_Clu_Theta_105 :%f",signalvalue1);
	}
	else
	{
	testStepFail("Fail","i_S4_SRR_RL_Clu_Theta_105 :%f",signalvalue1);
	}
}

testcase S4_SRR_RL_Clu_Mes_15_S4_SRR_RL_Clu_Dist_105()
{
	signalvalue1 = getSignal(S4_SRR_RL_Clu_Dist_105);
	write("S4_SRR_RL_Clu_Dist_105 :%f",signalvalue1);
	write("i_S4_SRR_RL_Clu_Dist_105 :%f",@ecu_Signals::i_S4_SRR_RL_Clu_Dist_105);

	testStep("get expect variable value: ","i_S4_SRR_RL_Clu_Dist_105 :%f",@ecu_Signals::i_S4_SRR_RL_Clu_Dist_105);

	if((abs(@ecu_Signals::i_S4_SRR_RL_Clu_Dist_105)*0.9<=abs(signalvalue1))&&(abs(signalvalue1)<=abs(@ecu_Signals::i_S4_SRR_RL_Clu_Dist_105)*1.1))
	{
	testStepPass("Pass","i_S4_SRR_RL_Clu_Dist_105 :%f",signalvalue1);
	}
	else
	{
	testStepFail("Fail","i_S4_SRR_RL_Clu_Dist_105 :%f",signalvalue1);
	}
}

testcase S4_SRR_RL_Clu_Mes_15_S4_SRR_RL_Clu_Vel_105()
{
	signalvalue1 = getSignal(S4_SRR_RL_Clu_Vel_105);
	write("S4_SRR_RL_Clu_Vel_105 :%f",signalvalue1);
	write("i_S4_SRR_RL_Clu_Vel_105 :%f",@ecu_Signals::i_S4_SRR_RL_Clu_Vel_105);

	testStep("get expect variable value: ","i_S4_SRR_RL_Clu_Vel_105 :%f",@ecu_Signals::i_S4_SRR_RL_Clu_Vel_105);

	if((abs(@ecu_Signals::i_S4_SRR_RL_Clu_Vel_105)*0.9<=abs(signalvalue1))&&(abs(signalvalue1)<=abs(@ecu_Signals::i_S4_SRR_RL_Clu_Vel_105)*1.1))
	{
	testStepPass("Pass","i_S4_SRR_RL_Clu_Vel_105 :%f",signalvalue1);
	}
	else
	{
	testStepFail("Fail","i_S4_SRR_RL_Clu_Vel_105 :%f",signalvalue1);
	}
}

testcase S4_SRR_RL_Clu_Mes_15_S4_SRR_RL_Clu_SNR_105()
{
	signalvalue1 = getSignal(S4_SRR_RL_Clu_SNR_105);
	write("S4_SRR_RL_Clu_SNR_105 :%f",signalvalue1);
	write("i_S4_SRR_RL_Clu_SNR_105 :%f",@ecu_Signals::i_S4_SRR_RL_Clu_SNR_105);

	testStep("get expect variable value: ","i_S4_SRR_RL_Clu_SNR_105 :%f",@ecu_Signals::i_S4_SRR_RL_Clu_SNR_105);

	if((abs(@ecu_Signals::i_S4_SRR_RL_Clu_SNR_105)*0.9<=abs(signalvalue1))&&(abs(signalvalue1)<=abs(@ecu_Signals::i_S4_SRR_RL_Clu_SNR_105)*1.1))
	{
	testStepPass("Pass","i_S4_SRR_RL_Clu_SNR_105 :%f",signalvalue1);
	}
	else
	{
	testStepFail("Fail","i_S4_SRR_RL_Clu_SNR_105 :%f",signalvalue1);
	}
}

testcase S4_SRR_RL_Clu_Mes_15_S4_SRR_RL_Clu_DynProp_105()
{
	signalvalue1 = getSignal(S4_SRR_RL_Clu_DynProp_105);
	write("S4_SRR_RL_Clu_DynProp_105 :%f",signalvalue1);
	write("i_S4_SRR_RL_Clu_DynProp_105 :%o",@ecu_Signals::i_S4_SRR_RL_Clu_DynProp_105);

	testStep("get expect variable value: ","i_S4_SRR_RL_Clu_DynProp_105 :%o",@ecu_Signals::i_S4_SRR_RL_Clu_DynProp_105);

	if(signalvalue1==@ecu_Signals::i_S4_SRR_RL_Clu_DynProp_105)
	{
	testStepPass("Pass","i_S4_SRR_RL_Clu_DynProp_105 :%f",signalvalue1);
	}
	else
	{
	testStepFail("Fail","i_S4_SRR_RL_Clu_DynProp_105 :%f",signalvalue1);
	}
}

testcase S4_SRR_RL_Clu_Mes_15_S4_SRR_RL_Clu_Locationvalid_105()
{
	signalvalue1 = getSignal(S4_SRR_RL_Clu_Locationvalid_105);
	write("S4_SRR_RL_Clu_Locationvalid_105 :%f",signalvalue1);
	write("i_S4_SRR_RL_Clu_Locationvalid_105 :%o",@ecu_Signals::i_S4_SRR_RL_Clu_Locationvalid_105);

	testStep("get expect variable value: ","i_S4_SRR_RL_Clu_Locationvalid_105 :%o",@ecu_Signals::i_S4_SRR_RL_Clu_Locationvalid_105);

	if(signalvalue1==@ecu_Signals::i_S4_SRR_RL_Clu_Locationvalid_105)
	{
	testStepPass("Pass","i_S4_SRR_RL_Clu_Locationvalid_105 :%f",signalvalue1);
	}
	else
	{
	testStepFail("Fail","i_S4_SRR_RL_Clu_Locationvalid_105 :%f",signalvalue1);
	}
}

testcase S4_SRR_RL_Clu_Mes_15_S4_SRR_RL_Clu_Theta_106()
{
	signalvalue1 = getSignal(S4_SRR_RL_Clu_Theta_106);
	write("S4_SRR_RL_Clu_Theta_106 :%f",signalvalue1);
	write("i_S4_SRR_RL_Clu_Theta_106 :%f",@ecu_Signals::i_S4_SRR_RL_Clu_Theta_106);

	testStep("get expect variable value: ","i_S4_SRR_RL_Clu_Theta_106 :%f",@ecu_Signals::i_S4_SRR_RL_Clu_Theta_106);

	if((abs(@ecu_Signals::i_S4_SRR_RL_Clu_Theta_106)*0.9<=abs(signalvalue1))&&(abs(signalvalue1)<=abs(@ecu_Signals::i_S4_SRR_RL_Clu_Theta_106)*1.1))
	{
	testStepPass("Pass","i_S4_SRR_RL_Clu_Theta_106 :%f",signalvalue1);
	}
	else
	{
	testStepFail("Fail","i_S4_SRR_RL_Clu_Theta_106 :%f",signalvalue1);
	}
}

testcase S4_SRR_RL_Clu_Mes_15_S4_SRR_RL_Clu_Dist_106()
{
	signalvalue1 = getSignal(S4_SRR_RL_Clu_Dist_106);
	write("S4_SRR_RL_Clu_Dist_106 :%f",signalvalue1);
	write("i_S4_SRR_RL_Clu_Dist_106 :%f",@ecu_Signals::i_S4_SRR_RL_Clu_Dist_106);

	testStep("get expect variable value: ","i_S4_SRR_RL_Clu_Dist_106 :%f",@ecu_Signals::i_S4_SRR_RL_Clu_Dist_106);

	if((abs(@ecu_Signals::i_S4_SRR_RL_Clu_Dist_106)*0.9<=abs(signalvalue1))&&(abs(signalvalue1)<=abs(@ecu_Signals::i_S4_SRR_RL_Clu_Dist_106)*1.1))
	{
	testStepPass("Pass","i_S4_SRR_RL_Clu_Dist_106 :%f",signalvalue1);
	}
	else
	{
	testStepFail("Fail","i_S4_SRR_RL_Clu_Dist_106 :%f",signalvalue1);
	}
}

testcase S4_SRR_RL_Clu_Mes_15_S4_SRR_RL_Clu_Vel_106()
{
	signalvalue1 = getSignal(S4_SRR_RL_Clu_Vel_106);
	write("S4_SRR_RL_Clu_Vel_106 :%f",signalvalue1);
	write("i_S4_SRR_RL_Clu_Vel_106 :%f",@ecu_Signals::i_S4_SRR_RL_Clu_Vel_106);

	testStep("get expect variable value: ","i_S4_SRR_RL_Clu_Vel_106 :%f",@ecu_Signals::i_S4_SRR_RL_Clu_Vel_106);

	if((abs(@ecu_Signals::i_S4_SRR_RL_Clu_Vel_106)*0.9<=abs(signalvalue1))&&(abs(signalvalue1)<=abs(@ecu_Signals::i_S4_SRR_RL_Clu_Vel_106)*1.1))
	{
	testStepPass("Pass","i_S4_SRR_RL_Clu_Vel_106 :%f",signalvalue1);
	}
	else
	{
	testStepFail("Fail","i_S4_SRR_RL_Clu_Vel_106 :%f",signalvalue1);
	}
}

testcase S4_SRR_RL_Clu_Mes_15_S4_SRR_RL_Clu_SNR_106()
{
	signalvalue1 = getSignal(S4_SRR_RL_Clu_SNR_106);
	write("S4_SRR_RL_Clu_SNR_106 :%f",signalvalue1);
	write("i_S4_SRR_RL_Clu_SNR_106 :%f",@ecu_Signals::i_S4_SRR_RL_Clu_SNR_106);

	testStep("get expect variable value: ","i_S4_SRR_RL_Clu_SNR_106 :%f",@ecu_Signals::i_S4_SRR_RL_Clu_SNR_106);

	if((abs(@ecu_Signals::i_S4_SRR_RL_Clu_SNR_106)*0.9<=abs(signalvalue1))&&(abs(signalvalue1)<=abs(@ecu_Signals::i_S4_SRR_RL_Clu_SNR_106)*1.1))
	{
	testStepPass("Pass","i_S4_SRR_RL_Clu_SNR_106 :%f",signalvalue1);
	}
	else
	{
	testStepFail("Fail","i_S4_SRR_RL_Clu_SNR_106 :%f",signalvalue1);
	}
}

testcase S4_SRR_RL_Clu_Mes_15_S4_SRR_RL_Clu_DynProp_106()
{
	signalvalue1 = getSignal(S4_SRR_RL_Clu_DynProp_106);
	write("S4_SRR_RL_Clu_DynProp_106 :%f",signalvalue1);
	write("i_S4_SRR_RL_Clu_DynProp_106 :%o",@ecu_Signals::i_S4_SRR_RL_Clu_DynProp_106);

	testStep("get expect variable value: ","i_S4_SRR_RL_Clu_DynProp_106 :%o",@ecu_Signals::i_S4_SRR_RL_Clu_DynProp_106);

	if(signalvalue1==@ecu_Signals::i_S4_SRR_RL_Clu_DynProp_106)
	{
	testStepPass("Pass","i_S4_SRR_RL_Clu_DynProp_106 :%f",signalvalue1);
	}
	else
	{
	testStepFail("Fail","i_S4_SRR_RL_Clu_DynProp_106 :%f",signalvalue1);
	}
}

testcase S4_SRR_RL_Clu_Mes_15_S4_SRR_RL_Clu_Locationvalid_106()
{
	signalvalue1 = getSignal(S4_SRR_RL_Clu_Locationvalid_106);
	write("S4_SRR_RL_Clu_Locationvalid_106 :%f",signalvalue1);
	write("i_S4_SRR_RL_Clu_Locationvalid_106 :%o",@ecu_Signals::i_S4_SRR_RL_Clu_Locationvalid_106);

	testStep("get expect variable value: ","i_S4_SRR_RL_Clu_Locationvalid_106 :%o",@ecu_Signals::i_S4_SRR_RL_Clu_Locationvalid_106);

	if(signalvalue1==@ecu_Signals::i_S4_SRR_RL_Clu_Locationvalid_106)
	{
	testStepPass("Pass","i_S4_SRR_RL_Clu_Locationvalid_106 :%f",signalvalue1);
	}
	else
	{
	testStepFail("Fail","i_S4_SRR_RL_Clu_Locationvalid_106 :%f",signalvalue1);
	}
}

testcase S4_SRR_RL_Clu_Mes_15_S4_SRR_RL_Clu_Theta_107()
{
	signalvalue1 = getSignal(S4_SRR_RL_Clu_Theta_107);
	write("S4_SRR_RL_Clu_Theta_107 :%f",signalvalue1);
	write("i_S4_SRR_RL_Clu_Theta_107 :%f",@ecu_Signals::i_S4_SRR_RL_Clu_Theta_107);

	testStep("get expect variable value: ","i_S4_SRR_RL_Clu_Theta_107 :%f",@ecu_Signals::i_S4_SRR_RL_Clu_Theta_107);

	if((abs(@ecu_Signals::i_S4_SRR_RL_Clu_Theta_107)*0.9<=abs(signalvalue1))&&(abs(signalvalue1)<=abs(@ecu_Signals::i_S4_SRR_RL_Clu_Theta_107)*1.1))
	{
	testStepPass("Pass","i_S4_SRR_RL_Clu_Theta_107 :%f",signalvalue1);
	}
	else
	{
	testStepFail("Fail","i_S4_SRR_RL_Clu_Theta_107 :%f",signalvalue1);
	}
}

testcase S4_SRR_RL_Clu_Mes_15_S4_SRR_RL_Clu_Dist_107()
{
	signalvalue1 = getSignal(S4_SRR_RL_Clu_Dist_107);
	write("S4_SRR_RL_Clu_Dist_107 :%f",signalvalue1);
	write("i_S4_SRR_RL_Clu_Dist_107 :%f",@ecu_Signals::i_S4_SRR_RL_Clu_Dist_107);

	testStep("get expect variable value: ","i_S4_SRR_RL_Clu_Dist_107 :%f",@ecu_Signals::i_S4_SRR_RL_Clu_Dist_107);

	if((abs(@ecu_Signals::i_S4_SRR_RL_Clu_Dist_107)*0.9<=abs(signalvalue1))&&(abs(signalvalue1)<=abs(@ecu_Signals::i_S4_SRR_RL_Clu_Dist_107)*1.1))
	{
	testStepPass("Pass","i_S4_SRR_RL_Clu_Dist_107 :%f",signalvalue1);
	}
	else
	{
	testStepFail("Fail","i_S4_SRR_RL_Clu_Dist_107 :%f",signalvalue1);
	}
}

testcase S4_SRR_RL_Clu_Mes_15_S4_SRR_RL_Clu_Vel_107()
{
	signalvalue1 = getSignal(S4_SRR_RL_Clu_Vel_107);
	write("S4_SRR_RL_Clu_Vel_107 :%f",signalvalue1);
	write("i_S4_SRR_RL_Clu_Vel_107 :%f",@ecu_Signals::i_S4_SRR_RL_Clu_Vel_107);

	testStep("get expect variable value: ","i_S4_SRR_RL_Clu_Vel_107 :%f",@ecu_Signals::i_S4_SRR_RL_Clu_Vel_107);

	if((abs(@ecu_Signals::i_S4_SRR_RL_Clu_Vel_107)*0.9<=abs(signalvalue1))&&(abs(signalvalue1)<=abs(@ecu_Signals::i_S4_SRR_RL_Clu_Vel_107)*1.1))
	{
	testStepPass("Pass","i_S4_SRR_RL_Clu_Vel_107 :%f",signalvalue1);
	}
	else
	{
	testStepFail("Fail","i_S4_SRR_RL_Clu_Vel_107 :%f",signalvalue1);
	}
}

testcase S4_SRR_RL_Clu_Mes_15_S4_SRR_RL_Clu_SNR_107()
{
	signalvalue1 = getSignal(S4_SRR_RL_Clu_SNR_107);
	write("S4_SRR_RL_Clu_SNR_107 :%f",signalvalue1);
	write("i_S4_SRR_RL_Clu_SNR_107 :%f",@ecu_Signals::i_S4_SRR_RL_Clu_SNR_107);

	testStep("get expect variable value: ","i_S4_SRR_RL_Clu_SNR_107 :%f",@ecu_Signals::i_S4_SRR_RL_Clu_SNR_107);

	if((abs(@ecu_Signals::i_S4_SRR_RL_Clu_SNR_107)*0.9<=abs(signalvalue1))&&(abs(signalvalue1)<=abs(@ecu_Signals::i_S4_SRR_RL_Clu_SNR_107)*1.1))
	{
	testStepPass("Pass","i_S4_SRR_RL_Clu_SNR_107 :%f",signalvalue1);
	}
	else
	{
	testStepFail("Fail","i_S4_SRR_RL_Clu_SNR_107 :%f",signalvalue1);
	}
}

testcase S4_SRR_RL_Clu_Mes_15_S4_SRR_RL_Clu_DynProp_107()
{
	signalvalue1 = getSignal(S4_SRR_RL_Clu_DynProp_107);
	write("S4_SRR_RL_Clu_DynProp_107 :%f",signalvalue1);
	write("i_S4_SRR_RL_Clu_DynProp_107 :%o",@ecu_Signals::i_S4_SRR_RL_Clu_DynProp_107);

	testStep("get expect variable value: ","i_S4_SRR_RL_Clu_DynProp_107 :%o",@ecu_Signals::i_S4_SRR_RL_Clu_DynProp_107);

	if(signalvalue1==@ecu_Signals::i_S4_SRR_RL_Clu_DynProp_107)
	{
	testStepPass("Pass","i_S4_SRR_RL_Clu_DynProp_107 :%f",signalvalue1);
	}
	else
	{
	testStepFail("Fail","i_S4_SRR_RL_Clu_DynProp_107 :%f",signalvalue1);
	}
}

testcase S4_SRR_RL_Clu_Mes_15_S4_SRR_RL_Clu_Locationvalid_107()
{
	signalvalue1 = getSignal(S4_SRR_RL_Clu_Locationvalid_107);
	write("S4_SRR_RL_Clu_Locationvalid_107 :%f",signalvalue1);
	write("i_S4_SRR_RL_Clu_Locationvalid_107 :%o",@ecu_Signals::i_S4_SRR_RL_Clu_Locationvalid_107);

	testStep("get expect variable value: ","i_S4_SRR_RL_Clu_Locationvalid_107 :%o",@ecu_Signals::i_S4_SRR_RL_Clu_Locationvalid_107);

	if(signalvalue1==@ecu_Signals::i_S4_SRR_RL_Clu_Locationvalid_107)
	{
	testStepPass("Pass","i_S4_SRR_RL_Clu_Locationvalid_107 :%f",signalvalue1);
	}
	else
	{
	testStepFail("Fail","i_S4_SRR_RL_Clu_Locationvalid_107 :%f",signalvalue1);
	}
}

testcase S4_SRR_RL_Clu_Mes_15_S4_SRR_RL_Clu_Theta_108()
{
	signalvalue1 = getSignal(S4_SRR_RL_Clu_Theta_108);
	write("S4_SRR_RL_Clu_Theta_108 :%f",signalvalue1);
	write("i_S4_SRR_RL_Clu_Theta_108 :%f",@ecu_Signals::i_S4_SRR_RL_Clu_Theta_108);

	testStep("get expect variable value: ","i_S4_SRR_RL_Clu_Theta_108 :%f",@ecu_Signals::i_S4_SRR_RL_Clu_Theta_108);

	if((abs(@ecu_Signals::i_S4_SRR_RL_Clu_Theta_108)*0.9<=abs(signalvalue1))&&(abs(signalvalue1)<=abs(@ecu_Signals::i_S4_SRR_RL_Clu_Theta_108)*1.1))
	{
	testStepPass("Pass","i_S4_SRR_RL_Clu_Theta_108 :%f",signalvalue1);
	}
	else
	{
	testStepFail("Fail","i_S4_SRR_RL_Clu_Theta_108 :%f",signalvalue1);
	}
}

testcase S4_SRR_RL_Clu_Mes_15_S4_SRR_RL_Clu_Dist_108()
{
	signalvalue1 = getSignal(S4_SRR_RL_Clu_Dist_108);
	write("S4_SRR_RL_Clu_Dist_108 :%f",signalvalue1);
	write("i_S4_SRR_RL_Clu_Dist_108 :%f",@ecu_Signals::i_S4_SRR_RL_Clu_Dist_108);

	testStep("get expect variable value: ","i_S4_SRR_RL_Clu_Dist_108 :%f",@ecu_Signals::i_S4_SRR_RL_Clu_Dist_108);

	if((abs(@ecu_Signals::i_S4_SRR_RL_Clu_Dist_108)*0.9<=abs(signalvalue1))&&(abs(signalvalue1)<=abs(@ecu_Signals::i_S4_SRR_RL_Clu_Dist_108)*1.1))
	{
	testStepPass("Pass","i_S4_SRR_RL_Clu_Dist_108 :%f",signalvalue1);
	}
	else
	{
	testStepFail("Fail","i_S4_SRR_RL_Clu_Dist_108 :%f",signalvalue1);
	}
}

testcase S4_SRR_RL_Clu_Mes_15_S4_SRR_RL_Clu_Vel_108()
{
	signalvalue1 = getSignal(S4_SRR_RL_Clu_Vel_108);
	write("S4_SRR_RL_Clu_Vel_108 :%f",signalvalue1);
	write("i_S4_SRR_RL_Clu_Vel_108 :%f",@ecu_Signals::i_S4_SRR_RL_Clu_Vel_108);

	testStep("get expect variable value: ","i_S4_SRR_RL_Clu_Vel_108 :%f",@ecu_Signals::i_S4_SRR_RL_Clu_Vel_108);

	if((abs(@ecu_Signals::i_S4_SRR_RL_Clu_Vel_108)*0.9<=abs(signalvalue1))&&(abs(signalvalue1)<=abs(@ecu_Signals::i_S4_SRR_RL_Clu_Vel_108)*1.1))
	{
	testStepPass("Pass","i_S4_SRR_RL_Clu_Vel_108 :%f",signalvalue1);
	}
	else
	{
	testStepFail("Fail","i_S4_SRR_RL_Clu_Vel_108 :%f",signalvalue1);
	}
}

testcase S4_SRR_RL_Clu_Mes_15_S4_SRR_RL_Clu_SNR_108()
{
	signalvalue1 = getSignal(S4_SRR_RL_Clu_SNR_108);
	write("S4_SRR_RL_Clu_SNR_108 :%f",signalvalue1);
	write("i_S4_SRR_RL_Clu_SNR_108 :%f",@ecu_Signals::i_S4_SRR_RL_Clu_SNR_108);

	testStep("get expect variable value: ","i_S4_SRR_RL_Clu_SNR_108 :%f",@ecu_Signals::i_S4_SRR_RL_Clu_SNR_108);

	if((abs(@ecu_Signals::i_S4_SRR_RL_Clu_SNR_108)*0.9<=abs(signalvalue1))&&(abs(signalvalue1)<=abs(@ecu_Signals::i_S4_SRR_RL_Clu_SNR_108)*1.1))
	{
	testStepPass("Pass","i_S4_SRR_RL_Clu_SNR_108 :%f",signalvalue1);
	}
	else
	{
	testStepFail("Fail","i_S4_SRR_RL_Clu_SNR_108 :%f",signalvalue1);
	}
}

testcase S4_SRR_RL_Clu_Mes_15_S4_SRR_RL_Clu_DynProp_108()
{
	signalvalue1 = getSignal(S4_SRR_RL_Clu_DynProp_108);
	write("S4_SRR_RL_Clu_DynProp_108 :%f",signalvalue1);
	write("i_S4_SRR_RL_Clu_DynProp_108 :%o",@ecu_Signals::i_S4_SRR_RL_Clu_DynProp_108);

	testStep("get expect variable value: ","i_S4_SRR_RL_Clu_DynProp_108 :%o",@ecu_Signals::i_S4_SRR_RL_Clu_DynProp_108);

	if(signalvalue1==@ecu_Signals::i_S4_SRR_RL_Clu_DynProp_108)
	{
	testStepPass("Pass","i_S4_SRR_RL_Clu_DynProp_108 :%f",signalvalue1);
	}
	else
	{
	testStepFail("Fail","i_S4_SRR_RL_Clu_DynProp_108 :%f",signalvalue1);
	}
}

testcase S4_SRR_RL_Clu_Mes_15_S4_SRR_RL_Clu_Locationvalid_108()
{
	signalvalue1 = getSignal(S4_SRR_RL_Clu_Locationvalid_108);
	write("S4_SRR_RL_Clu_Locationvalid_108 :%f",signalvalue1);
	write("i_S4_SRR_RL_Clu_Locationvalid_108 :%o",@ecu_Signals::i_S4_SRR_RL_Clu_Locationvalid_108);

	testStep("get expect variable value: ","i_S4_SRR_RL_Clu_Locationvalid_108 :%o",@ecu_Signals::i_S4_SRR_RL_Clu_Locationvalid_108);

	if(signalvalue1==@ecu_Signals::i_S4_SRR_RL_Clu_Locationvalid_108)
	{
	testStepPass("Pass","i_S4_SRR_RL_Clu_Locationvalid_108 :%f",signalvalue1);
	}
	else
	{
	testStepFail("Fail","i_S4_SRR_RL_Clu_Locationvalid_108 :%f",signalvalue1);
	}
}

testcase S4_SRR_RL_Clu_Mes_15_S4_SRR_RL_Clu_Theta_109()
{
	signalvalue1 = getSignal(S4_SRR_RL_Clu_Theta_109);
	write("S4_SRR_RL_Clu_Theta_109 :%f",signalvalue1);
	write("i_S4_SRR_RL_Clu_Theta_109 :%f",@ecu_Signals::i_S4_SRR_RL_Clu_Theta_109);

	testStep("get expect variable value: ","i_S4_SRR_RL_Clu_Theta_109 :%f",@ecu_Signals::i_S4_SRR_RL_Clu_Theta_109);

	if((abs(@ecu_Signals::i_S4_SRR_RL_Clu_Theta_109)*0.9<=abs(signalvalue1))&&(abs(signalvalue1)<=abs(@ecu_Signals::i_S4_SRR_RL_Clu_Theta_109)*1.1))
	{
	testStepPass("Pass","i_S4_SRR_RL_Clu_Theta_109 :%f",signalvalue1);
	}
	else
	{
	testStepFail("Fail","i_S4_SRR_RL_Clu_Theta_109 :%f",signalvalue1);
	}
}

testcase S4_SRR_RL_Clu_Mes_15_S4_SRR_RL_Clu_Dist_109()
{
	signalvalue1 = getSignal(S4_SRR_RL_Clu_Dist_109);
	write("S4_SRR_RL_Clu_Dist_109 :%f",signalvalue1);
	write("i_S4_SRR_RL_Clu_Dist_109 :%f",@ecu_Signals::i_S4_SRR_RL_Clu_Dist_109);

	testStep("get expect variable value: ","i_S4_SRR_RL_Clu_Dist_109 :%f",@ecu_Signals::i_S4_SRR_RL_Clu_Dist_109);

	if((abs(@ecu_Signals::i_S4_SRR_RL_Clu_Dist_109)*0.9<=abs(signalvalue1))&&(abs(signalvalue1)<=abs(@ecu_Signals::i_S4_SRR_RL_Clu_Dist_109)*1.1))
	{
	testStepPass("Pass","i_S4_SRR_RL_Clu_Dist_109 :%f",signalvalue1);
	}
	else
	{
	testStepFail("Fail","i_S4_SRR_RL_Clu_Dist_109 :%f",signalvalue1);
	}
}

testcase S4_SRR_RL_Clu_Mes_15_S4_SRR_RL_Clu_Vel_109()
{
	signalvalue1 = getSignal(S4_SRR_RL_Clu_Vel_109);
	write("S4_SRR_RL_Clu_Vel_109 :%f",signalvalue1);
	write("i_S4_SRR_RL_Clu_Vel_109 :%f",@ecu_Signals::i_S4_SRR_RL_Clu_Vel_109);

	testStep("get expect variable value: ","i_S4_SRR_RL_Clu_Vel_109 :%f",@ecu_Signals::i_S4_SRR_RL_Clu_Vel_109);

	if((abs(@ecu_Signals::i_S4_SRR_RL_Clu_Vel_109)*0.9<=abs(signalvalue1))&&(abs(signalvalue1)<=abs(@ecu_Signals::i_S4_SRR_RL_Clu_Vel_109)*1.1))
	{
	testStepPass("Pass","i_S4_SRR_RL_Clu_Vel_109 :%f",signalvalue1);
	}
	else
	{
	testStepFail("Fail","i_S4_SRR_RL_Clu_Vel_109 :%f",signalvalue1);
	}
}

testcase S4_SRR_RL_Clu_Mes_15_S4_SRR_RL_Clu_SNR_109()
{
	signalvalue1 = getSignal(S4_SRR_RL_Clu_SNR_109);
	write("S4_SRR_RL_Clu_SNR_109 :%f",signalvalue1);
	write("i_S4_SRR_RL_Clu_SNR_109 :%f",@ecu_Signals::i_S4_SRR_RL_Clu_SNR_109);

	testStep("get expect variable value: ","i_S4_SRR_RL_Clu_SNR_109 :%f",@ecu_Signals::i_S4_SRR_RL_Clu_SNR_109);

	if((abs(@ecu_Signals::i_S4_SRR_RL_Clu_SNR_109)*0.9<=abs(signalvalue1))&&(abs(signalvalue1)<=abs(@ecu_Signals::i_S4_SRR_RL_Clu_SNR_109)*1.1))
	{
	testStepPass("Pass","i_S4_SRR_RL_Clu_SNR_109 :%f",signalvalue1);
	}
	else
	{
	testStepFail("Fail","i_S4_SRR_RL_Clu_SNR_109 :%f",signalvalue1);
	}
}

testcase S4_SRR_RL_Clu_Mes_15_S4_SRR_RL_Clu_DynProp_109()
{
	signalvalue1 = getSignal(S4_SRR_RL_Clu_DynProp_109);
	write("S4_SRR_RL_Clu_DynProp_109 :%f",signalvalue1);
	write("i_S4_SRR_RL_Clu_DynProp_109 :%o",@ecu_Signals::i_S4_SRR_RL_Clu_DynProp_109);

	testStep("get expect variable value: ","i_S4_SRR_RL_Clu_DynProp_109 :%o",@ecu_Signals::i_S4_SRR_RL_Clu_DynProp_109);

	if(signalvalue1==@ecu_Signals::i_S4_SRR_RL_Clu_DynProp_109)
	{
	testStepPass("Pass","i_S4_SRR_RL_Clu_DynProp_109 :%f",signalvalue1);
	}
	else
	{
	testStepFail("Fail","i_S4_SRR_RL_Clu_DynProp_109 :%f",signalvalue1);
	}
}

testcase S4_SRR_RL_Clu_Mes_15_S4_SRR_RL_Clu_Locationvalid_109()
{
	signalvalue1 = getSignal(S4_SRR_RL_Clu_Locationvalid_109);
	write("S4_SRR_RL_Clu_Locationvalid_109 :%f",signalvalue1);
	write("i_S4_SRR_RL_Clu_Locationvalid_109 :%o",@ecu_Signals::i_S4_SRR_RL_Clu_Locationvalid_109);

	testStep("get expect variable value: ","i_S4_SRR_RL_Clu_Locationvalid_109 :%o",@ecu_Signals::i_S4_SRR_RL_Clu_Locationvalid_109);

	if(signalvalue1==@ecu_Signals::i_S4_SRR_RL_Clu_Locationvalid_109)
	{
	testStepPass("Pass","i_S4_SRR_RL_Clu_Locationvalid_109 :%f",signalvalue1);
	}
	else
	{
	testStepFail("Fail","i_S4_SRR_RL_Clu_Locationvalid_109 :%f",signalvalue1);
	}
}

testcase S4_SRR_RL_Clu_Mes_15_S4_SRR_RL_Clu_Theta_110()
{
	signalvalue1 = getSignal(S4_SRR_RL_Clu_Theta_110);
	write("S4_SRR_RL_Clu_Theta_110 :%f",signalvalue1);
	write("i_S4_SRR_RL_Clu_Theta_110 :%f",@ecu_Signals::i_S4_SRR_RL_Clu_Theta_110);

	testStep("get expect variable value: ","i_S4_SRR_RL_Clu_Theta_110 :%f",@ecu_Signals::i_S4_SRR_RL_Clu_Theta_110);

	if((abs(@ecu_Signals::i_S4_SRR_RL_Clu_Theta_110)*0.9<=abs(signalvalue1))&&(abs(signalvalue1)<=abs(@ecu_Signals::i_S4_SRR_RL_Clu_Theta_110)*1.1))
	{
	testStepPass("Pass","i_S4_SRR_RL_Clu_Theta_110 :%f",signalvalue1);
	}
	else
	{
	testStepFail("Fail","i_S4_SRR_RL_Clu_Theta_110 :%f",signalvalue1);
	}
}

testcase S4_SRR_RL_Clu_Mes_15_S4_SRR_RL_Clu_Dist_110()
{
	signalvalue1 = getSignal(S4_SRR_RL_Clu_Dist_110);
	write("S4_SRR_RL_Clu_Dist_110 :%f",signalvalue1);
	write("i_S4_SRR_RL_Clu_Dist_110 :%f",@ecu_Signals::i_S4_SRR_RL_Clu_Dist_110);

	testStep("get expect variable value: ","i_S4_SRR_RL_Clu_Dist_110 :%f",@ecu_Signals::i_S4_SRR_RL_Clu_Dist_110);

	if((abs(@ecu_Signals::i_S4_SRR_RL_Clu_Dist_110)*0.9<=abs(signalvalue1))&&(abs(signalvalue1)<=abs(@ecu_Signals::i_S4_SRR_RL_Clu_Dist_110)*1.1))
	{
	testStepPass("Pass","i_S4_SRR_RL_Clu_Dist_110 :%f",signalvalue1);
	}
	else
	{
	testStepFail("Fail","i_S4_SRR_RL_Clu_Dist_110 :%f",signalvalue1);
	}
}

testcase S4_SRR_RL_Clu_Mes_15_S4_SRR_RL_Clu_Vel_110()
{
	signalvalue1 = getSignal(S4_SRR_RL_Clu_Vel_110);
	write("S4_SRR_RL_Clu_Vel_110 :%f",signalvalue1);
	write("i_S4_SRR_RL_Clu_Vel_110 :%f",@ecu_Signals::i_S4_SRR_RL_Clu_Vel_110);

	testStep("get expect variable value: ","i_S4_SRR_RL_Clu_Vel_110 :%f",@ecu_Signals::i_S4_SRR_RL_Clu_Vel_110);

	if((abs(@ecu_Signals::i_S4_SRR_RL_Clu_Vel_110)*0.9<=abs(signalvalue1))&&(abs(signalvalue1)<=abs(@ecu_Signals::i_S4_SRR_RL_Clu_Vel_110)*1.1))
	{
	testStepPass("Pass","i_S4_SRR_RL_Clu_Vel_110 :%f",signalvalue1);
	}
	else
	{
	testStepFail("Fail","i_S4_SRR_RL_Clu_Vel_110 :%f",signalvalue1);
	}
}

testcase S4_SRR_RL_Clu_Mes_15_S4_SRR_RL_Clu_SNR_110()
{
	signalvalue1 = getSignal(S4_SRR_RL_Clu_SNR_110);
	write("S4_SRR_RL_Clu_SNR_110 :%f",signalvalue1);
	write("i_S4_SRR_RL_Clu_SNR_110 :%f",@ecu_Signals::i_S4_SRR_RL_Clu_SNR_110);

	testStep("get expect variable value: ","i_S4_SRR_RL_Clu_SNR_110 :%f",@ecu_Signals::i_S4_SRR_RL_Clu_SNR_110);

	if((abs(@ecu_Signals::i_S4_SRR_RL_Clu_SNR_110)*0.9<=abs(signalvalue1))&&(abs(signalvalue1)<=abs(@ecu_Signals::i_S4_SRR_RL_Clu_SNR_110)*1.1))
	{
	testStepPass("Pass","i_S4_SRR_RL_Clu_SNR_110 :%f",signalvalue1);
	}
	else
	{
	testStepFail("Fail","i_S4_SRR_RL_Clu_SNR_110 :%f",signalvalue1);
	}
}

testcase S4_SRR_RL_Clu_Mes_15_S4_SRR_RL_Clu_DynProp_110()
{
	signalvalue1 = getSignal(S4_SRR_RL_Clu_DynProp_110);
	write("S4_SRR_RL_Clu_DynProp_110 :%f",signalvalue1);
	write("i_S4_SRR_RL_Clu_DynProp_110 :%o",@ecu_Signals::i_S4_SRR_RL_Clu_DynProp_110);

	testStep("get expect variable value: ","i_S4_SRR_RL_Clu_DynProp_110 :%o",@ecu_Signals::i_S4_SRR_RL_Clu_DynProp_110);

	if(signalvalue1==@ecu_Signals::i_S4_SRR_RL_Clu_DynProp_110)
	{
	testStepPass("Pass","i_S4_SRR_RL_Clu_DynProp_110 :%f",signalvalue1);
	}
	else
	{
	testStepFail("Fail","i_S4_SRR_RL_Clu_DynProp_110 :%f",signalvalue1);
	}
}

testcase S4_SRR_RL_Clu_Mes_15_S4_SRR_RL_Clu_Locationvalid_110()
{
	signalvalue1 = getSignal(S4_SRR_RL_Clu_Locationvalid_110);
	write("S4_SRR_RL_Clu_Locationvalid_110 :%f",signalvalue1);
	write("i_S4_SRR_RL_Clu_Locationvalid_110 :%o",@ecu_Signals::i_S4_SRR_RL_Clu_Locationvalid_110);

	testStep("get expect variable value: ","i_S4_SRR_RL_Clu_Locationvalid_110 :%o",@ecu_Signals::i_S4_SRR_RL_Clu_Locationvalid_110);

	if(signalvalue1==@ecu_Signals::i_S4_SRR_RL_Clu_Locationvalid_110)
	{
	testStepPass("Pass","i_S4_SRR_RL_Clu_Locationvalid_110 :%f",signalvalue1);
	}
	else
	{
	testStepFail("Fail","i_S4_SRR_RL_Clu_Locationvalid_110 :%f",signalvalue1);
	}
}

testcase S4_SRR_RL_Clu_Mes_15_S4_SRR_RL_Clu_Theta_111()
{
	signalvalue1 = getSignal(S4_SRR_RL_Clu_Theta_111);
	write("S4_SRR_RL_Clu_Theta_111 :%f",signalvalue1);
	write("i_S4_SRR_RL_Clu_Theta_111 :%f",@ecu_Signals::i_S4_SRR_RL_Clu_Theta_111);

	testStep("get expect variable value: ","i_S4_SRR_RL_Clu_Theta_111 :%f",@ecu_Signals::i_S4_SRR_RL_Clu_Theta_111);

	if((abs(@ecu_Signals::i_S4_SRR_RL_Clu_Theta_111)*0.9<=abs(signalvalue1))&&(abs(signalvalue1)<=abs(@ecu_Signals::i_S4_SRR_RL_Clu_Theta_111)*1.1))
	{
	testStepPass("Pass","i_S4_SRR_RL_Clu_Theta_111 :%f",signalvalue1);
	}
	else
	{
	testStepFail("Fail","i_S4_SRR_RL_Clu_Theta_111 :%f",signalvalue1);
	}
}

testcase S4_SRR_RL_Clu_Mes_15_S4_SRR_RL_Clu_Dist_111()
{
	signalvalue1 = getSignal(S4_SRR_RL_Clu_Dist_111);
	write("S4_SRR_RL_Clu_Dist_111 :%f",signalvalue1);
	write("i_S4_SRR_RL_Clu_Dist_111 :%f",@ecu_Signals::i_S4_SRR_RL_Clu_Dist_111);

	testStep("get expect variable value: ","i_S4_SRR_RL_Clu_Dist_111 :%f",@ecu_Signals::i_S4_SRR_RL_Clu_Dist_111);

	if((abs(@ecu_Signals::i_S4_SRR_RL_Clu_Dist_111)*0.9<=abs(signalvalue1))&&(abs(signalvalue1)<=abs(@ecu_Signals::i_S4_SRR_RL_Clu_Dist_111)*1.1))
	{
	testStepPass("Pass","i_S4_SRR_RL_Clu_Dist_111 :%f",signalvalue1);
	}
	else
	{
	testStepFail("Fail","i_S4_SRR_RL_Clu_Dist_111 :%f",signalvalue1);
	}
}

testcase S4_SRR_RL_Clu_Mes_15_S4_SRR_RL_Clu_Vel_111()
{
	signalvalue1 = getSignal(S4_SRR_RL_Clu_Vel_111);
	write("S4_SRR_RL_Clu_Vel_111 :%f",signalvalue1);
	write("i_S4_SRR_RL_Clu_Vel_111 :%f",@ecu_Signals::i_S4_SRR_RL_Clu_Vel_111);

	testStep("get expect variable value: ","i_S4_SRR_RL_Clu_Vel_111 :%f",@ecu_Signals::i_S4_SRR_RL_Clu_Vel_111);

	if((abs(@ecu_Signals::i_S4_SRR_RL_Clu_Vel_111)*0.9<=abs(signalvalue1))&&(abs(signalvalue1)<=abs(@ecu_Signals::i_S4_SRR_RL_Clu_Vel_111)*1.1))
	{
	testStepPass("Pass","i_S4_SRR_RL_Clu_Vel_111 :%f",signalvalue1);
	}
	else
	{
	testStepFail("Fail","i_S4_SRR_RL_Clu_Vel_111 :%f",signalvalue1);
	}
}

testcase S4_SRR_RL_Clu_Mes_15_S4_SRR_RL_Clu_SNR_111()
{
	signalvalue1 = getSignal(S4_SRR_RL_Clu_SNR_111);
	write("S4_SRR_RL_Clu_SNR_111 :%f",signalvalue1);
	write("i_S4_SRR_RL_Clu_SNR_111 :%f",@ecu_Signals::i_S4_SRR_RL_Clu_SNR_111);

	testStep("get expect variable value: ","i_S4_SRR_RL_Clu_SNR_111 :%f",@ecu_Signals::i_S4_SRR_RL_Clu_SNR_111);

	if((abs(@ecu_Signals::i_S4_SRR_RL_Clu_SNR_111)*0.9<=abs(signalvalue1))&&(abs(signalvalue1)<=abs(@ecu_Signals::i_S4_SRR_RL_Clu_SNR_111)*1.1))
	{
	testStepPass("Pass","i_S4_SRR_RL_Clu_SNR_111 :%f",signalvalue1);
	}
	else
	{
	testStepFail("Fail","i_S4_SRR_RL_Clu_SNR_111 :%f",signalvalue1);
	}
}

testcase S4_SRR_RL_Clu_Mes_15_S4_SRR_RL_Clu_DynProp_111()
{
	signalvalue1 = getSignal(S4_SRR_RL_Clu_DynProp_111);
	write("S4_SRR_RL_Clu_DynProp_111 :%f",signalvalue1);
	write("i_S4_SRR_RL_Clu_DynProp_111 :%o",@ecu_Signals::i_S4_SRR_RL_Clu_DynProp_111);

	testStep("get expect variable value: ","i_S4_SRR_RL_Clu_DynProp_111 :%o",@ecu_Signals::i_S4_SRR_RL_Clu_DynProp_111);

	if(signalvalue1==@ecu_Signals::i_S4_SRR_RL_Clu_DynProp_111)
	{
	testStepPass("Pass","i_S4_SRR_RL_Clu_DynProp_111 :%f",signalvalue1);
	}
	else
	{
	testStepFail("Fail","i_S4_SRR_RL_Clu_DynProp_111 :%f",signalvalue1);
	}
}

testcase S4_SRR_RL_Clu_Mes_15_S4_SRR_RL_Clu_Locationvalid_111()
{
	signalvalue1 = getSignal(S4_SRR_RL_Clu_Locationvalid_111);
	write("S4_SRR_RL_Clu_Locationvalid_111 :%f",signalvalue1);
	write("i_S4_SRR_RL_Clu_Locationvalid_111 :%o",@ecu_Signals::i_S4_SRR_RL_Clu_Locationvalid_111);

	testStep("get expect variable value: ","i_S4_SRR_RL_Clu_Locationvalid_111 :%o",@ecu_Signals::i_S4_SRR_RL_Clu_Locationvalid_111);

	if(signalvalue1==@ecu_Signals::i_S4_SRR_RL_Clu_Locationvalid_111)
	{
	testStepPass("Pass","i_S4_SRR_RL_Clu_Locationvalid_111 :%f",signalvalue1);
	}
	else
	{
	testStepFail("Fail","i_S4_SRR_RL_Clu_Locationvalid_111 :%f",signalvalue1);
	}
}

testcase S4_SRR_RL_Clu_Mes_16_S4_SRR_RL_Clu_Theta_112()
{
	signalvalue1 = getSignal(S4_SRR_RL_Clu_Theta_112);
	write("S4_SRR_RL_Clu_Theta_112 :%f",signalvalue1);
	write("i_S4_SRR_RL_Clu_Theta_112 :%f",@ecu_Signals::i_S4_SRR_RL_Clu_Theta_112);

	testStep("get expect variable value: ","i_S4_SRR_RL_Clu_Theta_112 :%f",@ecu_Signals::i_S4_SRR_RL_Clu_Theta_112);

	if((abs(@ecu_Signals::i_S4_SRR_RL_Clu_Theta_112)*0.9<=abs(signalvalue1))&&(abs(signalvalue1)<=abs(@ecu_Signals::i_S4_SRR_RL_Clu_Theta_112)*1.1))
	{
	testStepPass("Pass","i_S4_SRR_RL_Clu_Theta_112 :%f",signalvalue1);
	}
	else
	{
	testStepFail("Fail","i_S4_SRR_RL_Clu_Theta_112 :%f",signalvalue1);
	}
}

testcase S4_SRR_RL_Clu_Mes_16_S4_SRR_RL_Clu_Dist_112()
{
	signalvalue1 = getSignal(S4_SRR_RL_Clu_Dist_112);
	write("S4_SRR_RL_Clu_Dist_112 :%f",signalvalue1);
	write("i_S4_SRR_RL_Clu_Dist_112 :%f",@ecu_Signals::i_S4_SRR_RL_Clu_Dist_112);

	testStep("get expect variable value: ","i_S4_SRR_RL_Clu_Dist_112 :%f",@ecu_Signals::i_S4_SRR_RL_Clu_Dist_112);

	if((abs(@ecu_Signals::i_S4_SRR_RL_Clu_Dist_112)*0.9<=abs(signalvalue1))&&(abs(signalvalue1)<=abs(@ecu_Signals::i_S4_SRR_RL_Clu_Dist_112)*1.1))
	{
	testStepPass("Pass","i_S4_SRR_RL_Clu_Dist_112 :%f",signalvalue1);
	}
	else
	{
	testStepFail("Fail","i_S4_SRR_RL_Clu_Dist_112 :%f",signalvalue1);
	}
}

testcase S4_SRR_RL_Clu_Mes_16_S4_SRR_RL_Clu_Vel_112()
{
	signalvalue1 = getSignal(S4_SRR_RL_Clu_Vel_112);
	write("S4_SRR_RL_Clu_Vel_112 :%f",signalvalue1);
	write("i_S4_SRR_RL_Clu_Vel_112 :%f",@ecu_Signals::i_S4_SRR_RL_Clu_Vel_112);

	testStep("get expect variable value: ","i_S4_SRR_RL_Clu_Vel_112 :%f",@ecu_Signals::i_S4_SRR_RL_Clu_Vel_112);

	if((abs(@ecu_Signals::i_S4_SRR_RL_Clu_Vel_112)*0.9<=abs(signalvalue1))&&(abs(signalvalue1)<=abs(@ecu_Signals::i_S4_SRR_RL_Clu_Vel_112)*1.1))
	{
	testStepPass("Pass","i_S4_SRR_RL_Clu_Vel_112 :%f",signalvalue1);
	}
	else
	{
	testStepFail("Fail","i_S4_SRR_RL_Clu_Vel_112 :%f",signalvalue1);
	}
}

testcase S4_SRR_RL_Clu_Mes_16_S4_SRR_RL_Clu_SNR_112()
{
	signalvalue1 = getSignal(S4_SRR_RL_Clu_SNR_112);
	write("S4_SRR_RL_Clu_SNR_112 :%f",signalvalue1);
	write("i_S4_SRR_RL_Clu_SNR_112 :%f",@ecu_Signals::i_S4_SRR_RL_Clu_SNR_112);

	testStep("get expect variable value: ","i_S4_SRR_RL_Clu_SNR_112 :%f",@ecu_Signals::i_S4_SRR_RL_Clu_SNR_112);

	if((abs(@ecu_Signals::i_S4_SRR_RL_Clu_SNR_112)*0.9<=abs(signalvalue1))&&(abs(signalvalue1)<=abs(@ecu_Signals::i_S4_SRR_RL_Clu_SNR_112)*1.1))
	{
	testStepPass("Pass","i_S4_SRR_RL_Clu_SNR_112 :%f",signalvalue1);
	}
	else
	{
	testStepFail("Fail","i_S4_SRR_RL_Clu_SNR_112 :%f",signalvalue1);
	}
}

testcase S4_SRR_RL_Clu_Mes_16_S4_SRR_RL_Clu_DynProp_112()
{
	signalvalue1 = getSignal(S4_SRR_RL_Clu_DynProp_112);
	write("S4_SRR_RL_Clu_DynProp_112 :%f",signalvalue1);
	write("i_S4_SRR_RL_Clu_DynProp_112 :%o",@ecu_Signals::i_S4_SRR_RL_Clu_DynProp_112);

	testStep("get expect variable value: ","i_S4_SRR_RL_Clu_DynProp_112 :%o",@ecu_Signals::i_S4_SRR_RL_Clu_DynProp_112);

	if(signalvalue1==@ecu_Signals::i_S4_SRR_RL_Clu_DynProp_112)
	{
	testStepPass("Pass","i_S4_SRR_RL_Clu_DynProp_112 :%f",signalvalue1);
	}
	else
	{
	testStepFail("Fail","i_S4_SRR_RL_Clu_DynProp_112 :%f",signalvalue1);
	}
}

testcase S4_SRR_RL_Clu_Mes_16_S4_SRR_RL_Clu_Locationvalid_112()
{
	signalvalue1 = getSignal(S4_SRR_RL_Clu_Locationvalid_112);
	write("S4_SRR_RL_Clu_Locationvalid_112 :%f",signalvalue1);
	write("i_S4_SRR_RL_Clu_Locationvalid_112 :%o",@ecu_Signals::i_S4_SRR_RL_Clu_Locationvalid_112);

	testStep("get expect variable value: ","i_S4_SRR_RL_Clu_Locationvalid_112 :%o",@ecu_Signals::i_S4_SRR_RL_Clu_Locationvalid_112);

	if(signalvalue1==@ecu_Signals::i_S4_SRR_RL_Clu_Locationvalid_112)
	{
	testStepPass("Pass","i_S4_SRR_RL_Clu_Locationvalid_112 :%f",signalvalue1);
	}
	else
	{
	testStepFail("Fail","i_S4_SRR_RL_Clu_Locationvalid_112 :%f",signalvalue1);
	}
}

testcase S4_SRR_RL_Clu_Mes_16_S4_SRR_RL_Clu_Theta_113()
{
	signalvalue1 = getSignal(S4_SRR_RL_Clu_Theta_113);
	write("S4_SRR_RL_Clu_Theta_113 :%f",signalvalue1);
	write("i_S4_SRR_RL_Clu_Theta_113 :%f",@ecu_Signals::i_S4_SRR_RL_Clu_Theta_113);

	testStep("get expect variable value: ","i_S4_SRR_RL_Clu_Theta_113 :%f",@ecu_Signals::i_S4_SRR_RL_Clu_Theta_113);

	if((abs(@ecu_Signals::i_S4_SRR_RL_Clu_Theta_113)*0.9<=abs(signalvalue1))&&(abs(signalvalue1)<=abs(@ecu_Signals::i_S4_SRR_RL_Clu_Theta_113)*1.1))
	{
	testStepPass("Pass","i_S4_SRR_RL_Clu_Theta_113 :%f",signalvalue1);
	}
	else
	{
	testStepFail("Fail","i_S4_SRR_RL_Clu_Theta_113 :%f",signalvalue1);
	}
}

testcase S4_SRR_RL_Clu_Mes_16_S4_SRR_RL_Clu_Dist_113()
{
	signalvalue1 = getSignal(S4_SRR_RL_Clu_Dist_113);
	write("S4_SRR_RL_Clu_Dist_113 :%f",signalvalue1);
	write("i_S4_SRR_RL_Clu_Dist_113 :%f",@ecu_Signals::i_S4_SRR_RL_Clu_Dist_113);

	testStep("get expect variable value: ","i_S4_SRR_RL_Clu_Dist_113 :%f",@ecu_Signals::i_S4_SRR_RL_Clu_Dist_113);

	if((abs(@ecu_Signals::i_S4_SRR_RL_Clu_Dist_113)*0.9<=abs(signalvalue1))&&(abs(signalvalue1)<=abs(@ecu_Signals::i_S4_SRR_RL_Clu_Dist_113)*1.1))
	{
	testStepPass("Pass","i_S4_SRR_RL_Clu_Dist_113 :%f",signalvalue1);
	}
	else
	{
	testStepFail("Fail","i_S4_SRR_RL_Clu_Dist_113 :%f",signalvalue1);
	}
}

testcase S4_SRR_RL_Clu_Mes_16_S4_SRR_RL_Clu_Vel_113()
{
	signalvalue1 = getSignal(S4_SRR_RL_Clu_Vel_113);
	write("S4_SRR_RL_Clu_Vel_113 :%f",signalvalue1);
	write("i_S4_SRR_RL_Clu_Vel_113 :%f",@ecu_Signals::i_S4_SRR_RL_Clu_Vel_113);

	testStep("get expect variable value: ","i_S4_SRR_RL_Clu_Vel_113 :%f",@ecu_Signals::i_S4_SRR_RL_Clu_Vel_113);

	if((abs(@ecu_Signals::i_S4_SRR_RL_Clu_Vel_113)*0.9<=abs(signalvalue1))&&(abs(signalvalue1)<=abs(@ecu_Signals::i_S4_SRR_RL_Clu_Vel_113)*1.1))
	{
	testStepPass("Pass","i_S4_SRR_RL_Clu_Vel_113 :%f",signalvalue1);
	}
	else
	{
	testStepFail("Fail","i_S4_SRR_RL_Clu_Vel_113 :%f",signalvalue1);
	}
}

testcase S4_SRR_RL_Clu_Mes_16_S4_SRR_RL_Clu_SNR_113()
{
	signalvalue1 = getSignal(S4_SRR_RL_Clu_SNR_113);
	write("S4_SRR_RL_Clu_SNR_113 :%f",signalvalue1);
	write("i_S4_SRR_RL_Clu_SNR_113 :%f",@ecu_Signals::i_S4_SRR_RL_Clu_SNR_113);

	testStep("get expect variable value: ","i_S4_SRR_RL_Clu_SNR_113 :%f",@ecu_Signals::i_S4_SRR_RL_Clu_SNR_113);

	if((abs(@ecu_Signals::i_S4_SRR_RL_Clu_SNR_113)*0.9<=abs(signalvalue1))&&(abs(signalvalue1)<=abs(@ecu_Signals::i_S4_SRR_RL_Clu_SNR_113)*1.1))
	{
	testStepPass("Pass","i_S4_SRR_RL_Clu_SNR_113 :%f",signalvalue1);
	}
	else
	{
	testStepFail("Fail","i_S4_SRR_RL_Clu_SNR_113 :%f",signalvalue1);
	}
}

testcase S4_SRR_RL_Clu_Mes_16_S4_SRR_RL_Clu_DynProp_113()
{
	signalvalue1 = getSignal(S4_SRR_RL_Clu_DynProp_113);
	write("S4_SRR_RL_Clu_DynProp_113 :%f",signalvalue1);
	write("i_S4_SRR_RL_Clu_DynProp_113 :%o",@ecu_Signals::i_S4_SRR_RL_Clu_DynProp_113);

	testStep("get expect variable value: ","i_S4_SRR_RL_Clu_DynProp_113 :%o",@ecu_Signals::i_S4_SRR_RL_Clu_DynProp_113);

	if(signalvalue1==@ecu_Signals::i_S4_SRR_RL_Clu_DynProp_113)
	{
	testStepPass("Pass","i_S4_SRR_RL_Clu_DynProp_113 :%f",signalvalue1);
	}
	else
	{
	testStepFail("Fail","i_S4_SRR_RL_Clu_DynProp_113 :%f",signalvalue1);
	}
}

testcase S4_SRR_RL_Clu_Mes_16_S4_SRR_RL_Clu_Locationvalid_113()
{
	signalvalue1 = getSignal(S4_SRR_RL_Clu_Locationvalid_113);
	write("S4_SRR_RL_Clu_Locationvalid_113 :%f",signalvalue1);
	write("i_S4_SRR_RL_Clu_Locationvalid_113 :%o",@ecu_Signals::i_S4_SRR_RL_Clu_Locationvalid_113);

	testStep("get expect variable value: ","i_S4_SRR_RL_Clu_Locationvalid_113 :%o",@ecu_Signals::i_S4_SRR_RL_Clu_Locationvalid_113);

	if(signalvalue1==@ecu_Signals::i_S4_SRR_RL_Clu_Locationvalid_113)
	{
	testStepPass("Pass","i_S4_SRR_RL_Clu_Locationvalid_113 :%f",signalvalue1);
	}
	else
	{
	testStepFail("Fail","i_S4_SRR_RL_Clu_Locationvalid_113 :%f",signalvalue1);
	}
}

testcase S4_SRR_RL_Clu_Mes_16_S4_SRR_RL_Clu_Theta_114()
{
	signalvalue1 = getSignal(S4_SRR_RL_Clu_Theta_114);
	write("S4_SRR_RL_Clu_Theta_114 :%f",signalvalue1);
	write("i_S4_SRR_RL_Clu_Theta_114 :%f",@ecu_Signals::i_S4_SRR_RL_Clu_Theta_114);

	testStep("get expect variable value: ","i_S4_SRR_RL_Clu_Theta_114 :%f",@ecu_Signals::i_S4_SRR_RL_Clu_Theta_114);

	if((abs(@ecu_Signals::i_S4_SRR_RL_Clu_Theta_114)*0.9<=abs(signalvalue1))&&(abs(signalvalue1)<=abs(@ecu_Signals::i_S4_SRR_RL_Clu_Theta_114)*1.1))
	{
	testStepPass("Pass","i_S4_SRR_RL_Clu_Theta_114 :%f",signalvalue1);
	}
	else
	{
	testStepFail("Fail","i_S4_SRR_RL_Clu_Theta_114 :%f",signalvalue1);
	}
}

testcase S4_SRR_RL_Clu_Mes_16_S4_SRR_RL_Clu_Dist_114()
{
	signalvalue1 = getSignal(S4_SRR_RL_Clu_Dist_114);
	write("S4_SRR_RL_Clu_Dist_114 :%f",signalvalue1);
	write("i_S4_SRR_RL_Clu_Dist_114 :%f",@ecu_Signals::i_S4_SRR_RL_Clu_Dist_114);

	testStep("get expect variable value: ","i_S4_SRR_RL_Clu_Dist_114 :%f",@ecu_Signals::i_S4_SRR_RL_Clu_Dist_114);

	if((abs(@ecu_Signals::i_S4_SRR_RL_Clu_Dist_114)*0.9<=abs(signalvalue1))&&(abs(signalvalue1)<=abs(@ecu_Signals::i_S4_SRR_RL_Clu_Dist_114)*1.1))
	{
	testStepPass("Pass","i_S4_SRR_RL_Clu_Dist_114 :%f",signalvalue1);
	}
	else
	{
	testStepFail("Fail","i_S4_SRR_RL_Clu_Dist_114 :%f",signalvalue1);
	}
}

testcase S4_SRR_RL_Clu_Mes_16_S4_SRR_RL_Clu_Vel_114()
{
	signalvalue1 = getSignal(S4_SRR_RL_Clu_Vel_114);
	write("S4_SRR_RL_Clu_Vel_114 :%f",signalvalue1);
	write("i_S4_SRR_RL_Clu_Vel_114 :%f",@ecu_Signals::i_S4_SRR_RL_Clu_Vel_114);

	testStep("get expect variable value: ","i_S4_SRR_RL_Clu_Vel_114 :%f",@ecu_Signals::i_S4_SRR_RL_Clu_Vel_114);

	if((abs(@ecu_Signals::i_S4_SRR_RL_Clu_Vel_114)*0.9<=abs(signalvalue1))&&(abs(signalvalue1)<=abs(@ecu_Signals::i_S4_SRR_RL_Clu_Vel_114)*1.1))
	{
	testStepPass("Pass","i_S4_SRR_RL_Clu_Vel_114 :%f",signalvalue1);
	}
	else
	{
	testStepFail("Fail","i_S4_SRR_RL_Clu_Vel_114 :%f",signalvalue1);
	}
}

testcase S4_SRR_RL_Clu_Mes_16_S4_SRR_RL_Clu_SNR_114()
{
	signalvalue1 = getSignal(S4_SRR_RL_Clu_SNR_114);
	write("S4_SRR_RL_Clu_SNR_114 :%f",signalvalue1);
	write("i_S4_SRR_RL_Clu_SNR_114 :%f",@ecu_Signals::i_S4_SRR_RL_Clu_SNR_114);

	testStep("get expect variable value: ","i_S4_SRR_RL_Clu_SNR_114 :%f",@ecu_Signals::i_S4_SRR_RL_Clu_SNR_114);

	if((abs(@ecu_Signals::i_S4_SRR_RL_Clu_SNR_114)*0.9<=abs(signalvalue1))&&(abs(signalvalue1)<=abs(@ecu_Signals::i_S4_SRR_RL_Clu_SNR_114)*1.1))
	{
	testStepPass("Pass","i_S4_SRR_RL_Clu_SNR_114 :%f",signalvalue1);
	}
	else
	{
	testStepFail("Fail","i_S4_SRR_RL_Clu_SNR_114 :%f",signalvalue1);
	}
}

testcase S4_SRR_RL_Clu_Mes_16_S4_SRR_RL_Clu_DynProp_114()
{
	signalvalue1 = getSignal(S4_SRR_RL_Clu_DynProp_114);
	write("S4_SRR_RL_Clu_DynProp_114 :%f",signalvalue1);
	write("i_S4_SRR_RL_Clu_DynProp_114 :%o",@ecu_Signals::i_S4_SRR_RL_Clu_DynProp_114);

	testStep("get expect variable value: ","i_S4_SRR_RL_Clu_DynProp_114 :%o",@ecu_Signals::i_S4_SRR_RL_Clu_DynProp_114);

	if(signalvalue1==@ecu_Signals::i_S4_SRR_RL_Clu_DynProp_114)
	{
	testStepPass("Pass","i_S4_SRR_RL_Clu_DynProp_114 :%f",signalvalue1);
	}
	else
	{
	testStepFail("Fail","i_S4_SRR_RL_Clu_DynProp_114 :%f",signalvalue1);
	}
}

testcase S4_SRR_RL_Clu_Mes_16_S4_SRR_RL_Clu_Locationvalid_114()
{
	signalvalue1 = getSignal(S4_SRR_RL_Clu_Locationvalid_114);
	write("S4_SRR_RL_Clu_Locationvalid_114 :%f",signalvalue1);
	write("i_S4_SRR_RL_Clu_Locationvalid_114 :%o",@ecu_Signals::i_S4_SRR_RL_Clu_Locationvalid_114);

	testStep("get expect variable value: ","i_S4_SRR_RL_Clu_Locationvalid_114 :%o",@ecu_Signals::i_S4_SRR_RL_Clu_Locationvalid_114);

	if(signalvalue1==@ecu_Signals::i_S4_SRR_RL_Clu_Locationvalid_114)
	{
	testStepPass("Pass","i_S4_SRR_RL_Clu_Locationvalid_114 :%f",signalvalue1);
	}
	else
	{
	testStepFail("Fail","i_S4_SRR_RL_Clu_Locationvalid_114 :%f",signalvalue1);
	}
}

testcase S4_SRR_RL_Clu_Mes_16_S4_SRR_RL_Clu_Theta_115()
{
	signalvalue1 = getSignal(S4_SRR_RL_Clu_Theta_115);
	write("S4_SRR_RL_Clu_Theta_115 :%f",signalvalue1);
	write("i_S4_SRR_RL_Clu_Theta_115 :%f",@ecu_Signals::i_S4_SRR_RL_Clu_Theta_115);

	testStep("get expect variable value: ","i_S4_SRR_RL_Clu_Theta_115 :%f",@ecu_Signals::i_S4_SRR_RL_Clu_Theta_115);

	if((abs(@ecu_Signals::i_S4_SRR_RL_Clu_Theta_115)*0.9<=abs(signalvalue1))&&(abs(signalvalue1)<=abs(@ecu_Signals::i_S4_SRR_RL_Clu_Theta_115)*1.1))
	{
	testStepPass("Pass","i_S4_SRR_RL_Clu_Theta_115 :%f",signalvalue1);
	}
	else
	{
	testStepFail("Fail","i_S4_SRR_RL_Clu_Theta_115 :%f",signalvalue1);
	}
}

testcase S4_SRR_RL_Clu_Mes_16_S4_SRR_RL_Clu_Dist_115()
{
	signalvalue1 = getSignal(S4_SRR_RL_Clu_Dist_115);
	write("S4_SRR_RL_Clu_Dist_115 :%f",signalvalue1);
	write("i_S4_SRR_RL_Clu_Dist_115 :%f",@ecu_Signals::i_S4_SRR_RL_Clu_Dist_115);

	testStep("get expect variable value: ","i_S4_SRR_RL_Clu_Dist_115 :%f",@ecu_Signals::i_S4_SRR_RL_Clu_Dist_115);

	if((abs(@ecu_Signals::i_S4_SRR_RL_Clu_Dist_115)*0.9<=abs(signalvalue1))&&(abs(signalvalue1)<=abs(@ecu_Signals::i_S4_SRR_RL_Clu_Dist_115)*1.1))
	{
	testStepPass("Pass","i_S4_SRR_RL_Clu_Dist_115 :%f",signalvalue1);
	}
	else
	{
	testStepFail("Fail","i_S4_SRR_RL_Clu_Dist_115 :%f",signalvalue1);
	}
}

testcase S4_SRR_RL_Clu_Mes_16_S4_SRR_RL_Clu_Vel_115()
{
	signalvalue1 = getSignal(S4_SRR_RL_Clu_Vel_115);
	write("S4_SRR_RL_Clu_Vel_115 :%f",signalvalue1);
	write("i_S4_SRR_RL_Clu_Vel_115 :%f",@ecu_Signals::i_S4_SRR_RL_Clu_Vel_115);

	testStep("get expect variable value: ","i_S4_SRR_RL_Clu_Vel_115 :%f",@ecu_Signals::i_S4_SRR_RL_Clu_Vel_115);

	if((abs(@ecu_Signals::i_S4_SRR_RL_Clu_Vel_115)*0.9<=abs(signalvalue1))&&(abs(signalvalue1)<=abs(@ecu_Signals::i_S4_SRR_RL_Clu_Vel_115)*1.1))
	{
	testStepPass("Pass","i_S4_SRR_RL_Clu_Vel_115 :%f",signalvalue1);
	}
	else
	{
	testStepFail("Fail","i_S4_SRR_RL_Clu_Vel_115 :%f",signalvalue1);
	}
}

testcase S4_SRR_RL_Clu_Mes_16_S4_SRR_RL_Clu_SNR_115()
{
	signalvalue1 = getSignal(S4_SRR_RL_Clu_SNR_115);
	write("S4_SRR_RL_Clu_SNR_115 :%f",signalvalue1);
	write("i_S4_SRR_RL_Clu_SNR_115 :%f",@ecu_Signals::i_S4_SRR_RL_Clu_SNR_115);

	testStep("get expect variable value: ","i_S4_SRR_RL_Clu_SNR_115 :%f",@ecu_Signals::i_S4_SRR_RL_Clu_SNR_115);

	if((abs(@ecu_Signals::i_S4_SRR_RL_Clu_SNR_115)*0.9<=abs(signalvalue1))&&(abs(signalvalue1)<=abs(@ecu_Signals::i_S4_SRR_RL_Clu_SNR_115)*1.1))
	{
	testStepPass("Pass","i_S4_SRR_RL_Clu_SNR_115 :%f",signalvalue1);
	}
	else
	{
	testStepFail("Fail","i_S4_SRR_RL_Clu_SNR_115 :%f",signalvalue1);
	}
}

testcase S4_SRR_RL_Clu_Mes_16_S4_SRR_RL_Clu_DynProp_115()
{
	signalvalue1 = getSignal(S4_SRR_RL_Clu_DynProp_115);
	write("S4_SRR_RL_Clu_DynProp_115 :%f",signalvalue1);
	write("i_S4_SRR_RL_Clu_DynProp_115 :%o",@ecu_Signals::i_S4_SRR_RL_Clu_DynProp_115);

	testStep("get expect variable value: ","i_S4_SRR_RL_Clu_DynProp_115 :%o",@ecu_Signals::i_S4_SRR_RL_Clu_DynProp_115);

	if(signalvalue1==@ecu_Signals::i_S4_SRR_RL_Clu_DynProp_115)
	{
	testStepPass("Pass","i_S4_SRR_RL_Clu_DynProp_115 :%f",signalvalue1);
	}
	else
	{
	testStepFail("Fail","i_S4_SRR_RL_Clu_DynProp_115 :%f",signalvalue1);
	}
}

testcase S4_SRR_RL_Clu_Mes_16_S4_SRR_RL_Clu_Locationvalid_115()
{
	signalvalue1 = getSignal(S4_SRR_RL_Clu_Locationvalid_115);
	write("S4_SRR_RL_Clu_Locationvalid_115 :%f",signalvalue1);
	write("i_S4_SRR_RL_Clu_Locationvalid_115 :%o",@ecu_Signals::i_S4_SRR_RL_Clu_Locationvalid_115);

	testStep("get expect variable value: ","i_S4_SRR_RL_Clu_Locationvalid_115 :%o",@ecu_Signals::i_S4_SRR_RL_Clu_Locationvalid_115);

	if(signalvalue1==@ecu_Signals::i_S4_SRR_RL_Clu_Locationvalid_115)
	{
	testStepPass("Pass","i_S4_SRR_RL_Clu_Locationvalid_115 :%f",signalvalue1);
	}
	else
	{
	testStepFail("Fail","i_S4_SRR_RL_Clu_Locationvalid_115 :%f",signalvalue1);
	}
}

testcase S4_SRR_RL_Clu_Mes_16_S4_SRR_RL_Clu_Theta_116()
{
	signalvalue1 = getSignal(S4_SRR_RL_Clu_Theta_116);
	write("S4_SRR_RL_Clu_Theta_116 :%f",signalvalue1);
	write("i_S4_SRR_RL_Clu_Theta_116 :%f",@ecu_Signals::i_S4_SRR_RL_Clu_Theta_116);

	testStep("get expect variable value: ","i_S4_SRR_RL_Clu_Theta_116 :%f",@ecu_Signals::i_S4_SRR_RL_Clu_Theta_116);

	if((abs(@ecu_Signals::i_S4_SRR_RL_Clu_Theta_116)*0.9<=abs(signalvalue1))&&(abs(signalvalue1)<=abs(@ecu_Signals::i_S4_SRR_RL_Clu_Theta_116)*1.1))
	{
	testStepPass("Pass","i_S4_SRR_RL_Clu_Theta_116 :%f",signalvalue1);
	}
	else
	{
	testStepFail("Fail","i_S4_SRR_RL_Clu_Theta_116 :%f",signalvalue1);
	}
}

testcase S4_SRR_RL_Clu_Mes_16_S4_SRR_RL_Clu_Dist_116()
{
	signalvalue1 = getSignal(S4_SRR_RL_Clu_Dist_116);
	write("S4_SRR_RL_Clu_Dist_116 :%f",signalvalue1);
	write("i_S4_SRR_RL_Clu_Dist_116 :%f",@ecu_Signals::i_S4_SRR_RL_Clu_Dist_116);

	testStep("get expect variable value: ","i_S4_SRR_RL_Clu_Dist_116 :%f",@ecu_Signals::i_S4_SRR_RL_Clu_Dist_116);

	if((abs(@ecu_Signals::i_S4_SRR_RL_Clu_Dist_116)*0.9<=abs(signalvalue1))&&(abs(signalvalue1)<=abs(@ecu_Signals::i_S4_SRR_RL_Clu_Dist_116)*1.1))
	{
	testStepPass("Pass","i_S4_SRR_RL_Clu_Dist_116 :%f",signalvalue1);
	}
	else
	{
	testStepFail("Fail","i_S4_SRR_RL_Clu_Dist_116 :%f",signalvalue1);
	}
}

testcase S4_SRR_RL_Clu_Mes_16_S4_SRR_RL_Clu_Vel_116()
{
	signalvalue1 = getSignal(S4_SRR_RL_Clu_Vel_116);
	write("S4_SRR_RL_Clu_Vel_116 :%f",signalvalue1);
	write("i_S4_SRR_RL_Clu_Vel_116 :%f",@ecu_Signals::i_S4_SRR_RL_Clu_Vel_116);

	testStep("get expect variable value: ","i_S4_SRR_RL_Clu_Vel_116 :%f",@ecu_Signals::i_S4_SRR_RL_Clu_Vel_116);

	if((abs(@ecu_Signals::i_S4_SRR_RL_Clu_Vel_116)*0.9<=abs(signalvalue1))&&(abs(signalvalue1)<=abs(@ecu_Signals::i_S4_SRR_RL_Clu_Vel_116)*1.1))
	{
	testStepPass("Pass","i_S4_SRR_RL_Clu_Vel_116 :%f",signalvalue1);
	}
	else
	{
	testStepFail("Fail","i_S4_SRR_RL_Clu_Vel_116 :%f",signalvalue1);
	}
}

testcase S4_SRR_RL_Clu_Mes_16_S4_SRR_RL_Clu_SNR_116()
{
	signalvalue1 = getSignal(S4_SRR_RL_Clu_SNR_116);
	write("S4_SRR_RL_Clu_SNR_116 :%f",signalvalue1);
	write("i_S4_SRR_RL_Clu_SNR_116 :%f",@ecu_Signals::i_S4_SRR_RL_Clu_SNR_116);

	testStep("get expect variable value: ","i_S4_SRR_RL_Clu_SNR_116 :%f",@ecu_Signals::i_S4_SRR_RL_Clu_SNR_116);

	if((abs(@ecu_Signals::i_S4_SRR_RL_Clu_SNR_116)*0.9<=abs(signalvalue1))&&(abs(signalvalue1)<=abs(@ecu_Signals::i_S4_SRR_RL_Clu_SNR_116)*1.1))
	{
	testStepPass("Pass","i_S4_SRR_RL_Clu_SNR_116 :%f",signalvalue1);
	}
	else
	{
	testStepFail("Fail","i_S4_SRR_RL_Clu_SNR_116 :%f",signalvalue1);
	}
}

testcase S4_SRR_RL_Clu_Mes_16_S4_SRR_RL_Clu_DynProp_116()
{
	signalvalue1 = getSignal(S4_SRR_RL_Clu_DynProp_116);
	write("S4_SRR_RL_Clu_DynProp_116 :%f",signalvalue1);
	write("i_S4_SRR_RL_Clu_DynProp_116 :%o",@ecu_Signals::i_S4_SRR_RL_Clu_DynProp_116);

	testStep("get expect variable value: ","i_S4_SRR_RL_Clu_DynProp_116 :%o",@ecu_Signals::i_S4_SRR_RL_Clu_DynProp_116);

	if(signalvalue1==@ecu_Signals::i_S4_SRR_RL_Clu_DynProp_116)
	{
	testStepPass("Pass","i_S4_SRR_RL_Clu_DynProp_116 :%f",signalvalue1);
	}
	else
	{
	testStepFail("Fail","i_S4_SRR_RL_Clu_DynProp_116 :%f",signalvalue1);
	}
}

testcase S4_SRR_RL_Clu_Mes_16_S4_SRR_RL_Clu_Locationvalid_116()
{
	signalvalue1 = getSignal(S4_SRR_RL_Clu_Locationvalid_116);
	write("S4_SRR_RL_Clu_Locationvalid_116 :%f",signalvalue1);
	write("i_S4_SRR_RL_Clu_Locationvalid_116 :%o",@ecu_Signals::i_S4_SRR_RL_Clu_Locationvalid_116);

	testStep("get expect variable value: ","i_S4_SRR_RL_Clu_Locationvalid_116 :%o",@ecu_Signals::i_S4_SRR_RL_Clu_Locationvalid_116);

	if(signalvalue1==@ecu_Signals::i_S4_SRR_RL_Clu_Locationvalid_116)
	{
	testStepPass("Pass","i_S4_SRR_RL_Clu_Locationvalid_116 :%f",signalvalue1);
	}
	else
	{
	testStepFail("Fail","i_S4_SRR_RL_Clu_Locationvalid_116 :%f",signalvalue1);
	}
}

testcase S4_SRR_RL_Clu_Mes_16_S4_SRR_RL_Clu_Theta_117()
{
	signalvalue1 = getSignal(S4_SRR_RL_Clu_Theta_117);
	write("S4_SRR_RL_Clu_Theta_117 :%f",signalvalue1);
	write("i_S4_SRR_RL_Clu_Theta_117 :%f",@ecu_Signals::i_S4_SRR_RL_Clu_Theta_117);

	testStep("get expect variable value: ","i_S4_SRR_RL_Clu_Theta_117 :%f",@ecu_Signals::i_S4_SRR_RL_Clu_Theta_117);

	if((abs(@ecu_Signals::i_S4_SRR_RL_Clu_Theta_117)*0.9<=abs(signalvalue1))&&(abs(signalvalue1)<=abs(@ecu_Signals::i_S4_SRR_RL_Clu_Theta_117)*1.1))
	{
	testStepPass("Pass","i_S4_SRR_RL_Clu_Theta_117 :%f",signalvalue1);
	}
	else
	{
	testStepFail("Fail","i_S4_SRR_RL_Clu_Theta_117 :%f",signalvalue1);
	}
}

testcase S4_SRR_RL_Clu_Mes_16_S4_SRR_RL_Clu_Dist_117()
{
	signalvalue1 = getSignal(S4_SRR_RL_Clu_Dist_117);
	write("S4_SRR_RL_Clu_Dist_117 :%f",signalvalue1);
	write("i_S4_SRR_RL_Clu_Dist_117 :%f",@ecu_Signals::i_S4_SRR_RL_Clu_Dist_117);

	testStep("get expect variable value: ","i_S4_SRR_RL_Clu_Dist_117 :%f",@ecu_Signals::i_S4_SRR_RL_Clu_Dist_117);

	if((abs(@ecu_Signals::i_S4_SRR_RL_Clu_Dist_117)*0.9<=abs(signalvalue1))&&(abs(signalvalue1)<=abs(@ecu_Signals::i_S4_SRR_RL_Clu_Dist_117)*1.1))
	{
	testStepPass("Pass","i_S4_SRR_RL_Clu_Dist_117 :%f",signalvalue1);
	}
	else
	{
	testStepFail("Fail","i_S4_SRR_RL_Clu_Dist_117 :%f",signalvalue1);
	}
}

testcase S4_SRR_RL_Clu_Mes_16_S4_SRR_RL_Clu_Vel_117()
{
	signalvalue1 = getSignal(S4_SRR_RL_Clu_Vel_117);
	write("S4_SRR_RL_Clu_Vel_117 :%f",signalvalue1);
	write("i_S4_SRR_RL_Clu_Vel_117 :%f",@ecu_Signals::i_S4_SRR_RL_Clu_Vel_117);

	testStep("get expect variable value: ","i_S4_SRR_RL_Clu_Vel_117 :%f",@ecu_Signals::i_S4_SRR_RL_Clu_Vel_117);

	if((abs(@ecu_Signals::i_S4_SRR_RL_Clu_Vel_117)*0.9<=abs(signalvalue1))&&(abs(signalvalue1)<=abs(@ecu_Signals::i_S4_SRR_RL_Clu_Vel_117)*1.1))
	{
	testStepPass("Pass","i_S4_SRR_RL_Clu_Vel_117 :%f",signalvalue1);
	}
	else
	{
	testStepFail("Fail","i_S4_SRR_RL_Clu_Vel_117 :%f",signalvalue1);
	}
}

testcase S4_SRR_RL_Clu_Mes_16_S4_SRR_RL_Clu_SNR_117()
{
	signalvalue1 = getSignal(S4_SRR_RL_Clu_SNR_117);
	write("S4_SRR_RL_Clu_SNR_117 :%f",signalvalue1);
	write("i_S4_SRR_RL_Clu_SNR_117 :%f",@ecu_Signals::i_S4_SRR_RL_Clu_SNR_117);

	testStep("get expect variable value: ","i_S4_SRR_RL_Clu_SNR_117 :%f",@ecu_Signals::i_S4_SRR_RL_Clu_SNR_117);

	if((abs(@ecu_Signals::i_S4_SRR_RL_Clu_SNR_117)*0.9<=abs(signalvalue1))&&(abs(signalvalue1)<=abs(@ecu_Signals::i_S4_SRR_RL_Clu_SNR_117)*1.1))
	{
	testStepPass("Pass","i_S4_SRR_RL_Clu_SNR_117 :%f",signalvalue1);
	}
	else
	{
	testStepFail("Fail","i_S4_SRR_RL_Clu_SNR_117 :%f",signalvalue1);
	}
}

testcase S4_SRR_RL_Clu_Mes_16_S4_SRR_RL_Clu_DynProp_117()
{
	signalvalue1 = getSignal(S4_SRR_RL_Clu_DynProp_117);
	write("S4_SRR_RL_Clu_DynProp_117 :%f",signalvalue1);
	write("i_S4_SRR_RL_Clu_DynProp_117 :%o",@ecu_Signals::i_S4_SRR_RL_Clu_DynProp_117);

	testStep("get expect variable value: ","i_S4_SRR_RL_Clu_DynProp_117 :%o",@ecu_Signals::i_S4_SRR_RL_Clu_DynProp_117);

	if(signalvalue1==@ecu_Signals::i_S4_SRR_RL_Clu_DynProp_117)
	{
	testStepPass("Pass","i_S4_SRR_RL_Clu_DynProp_117 :%f",signalvalue1);
	}
	else
	{
	testStepFail("Fail","i_S4_SRR_RL_Clu_DynProp_117 :%f",signalvalue1);
	}
}

testcase S4_SRR_RL_Clu_Mes_16_S4_SRR_RL_Clu_Locationvalid_117()
{
	signalvalue1 = getSignal(S4_SRR_RL_Clu_Locationvalid_117);
	write("S4_SRR_RL_Clu_Locationvalid_117 :%f",signalvalue1);
	write("i_S4_SRR_RL_Clu_Locationvalid_117 :%o",@ecu_Signals::i_S4_SRR_RL_Clu_Locationvalid_117);

	testStep("get expect variable value: ","i_S4_SRR_RL_Clu_Locationvalid_117 :%o",@ecu_Signals::i_S4_SRR_RL_Clu_Locationvalid_117);

	if(signalvalue1==@ecu_Signals::i_S4_SRR_RL_Clu_Locationvalid_117)
	{
	testStepPass("Pass","i_S4_SRR_RL_Clu_Locationvalid_117 :%f",signalvalue1);
	}
	else
	{
	testStepFail("Fail","i_S4_SRR_RL_Clu_Locationvalid_117 :%f",signalvalue1);
	}
}

testcase S4_SRR_RL_Clu_Mes_16_S4_SRR_RL_Clu_Theta_118()
{
	signalvalue1 = getSignal(S4_SRR_RL_Clu_Theta_118);
	write("S4_SRR_RL_Clu_Theta_118 :%f",signalvalue1);
	write("i_S4_SRR_RL_Clu_Theta_118 :%f",@ecu_Signals::i_S4_SRR_RL_Clu_Theta_118);

	testStep("get expect variable value: ","i_S4_SRR_RL_Clu_Theta_118 :%f",@ecu_Signals::i_S4_SRR_RL_Clu_Theta_118);

	if((abs(@ecu_Signals::i_S4_SRR_RL_Clu_Theta_118)*0.9<=abs(signalvalue1))&&(abs(signalvalue1)<=abs(@ecu_Signals::i_S4_SRR_RL_Clu_Theta_118)*1.1))
	{
	testStepPass("Pass","i_S4_SRR_RL_Clu_Theta_118 :%f",signalvalue1);
	}
	else
	{
	testStepFail("Fail","i_S4_SRR_RL_Clu_Theta_118 :%f",signalvalue1);
	}
}

testcase S4_SRR_RL_Clu_Mes_16_S4_SRR_RL_Clu_Dist_118()
{
	signalvalue1 = getSignal(S4_SRR_RL_Clu_Dist_118);
	write("S4_SRR_RL_Clu_Dist_118 :%f",signalvalue1);
	write("i_S4_SRR_RL_Clu_Dist_118 :%f",@ecu_Signals::i_S4_SRR_RL_Clu_Dist_118);

	testStep("get expect variable value: ","i_S4_SRR_RL_Clu_Dist_118 :%f",@ecu_Signals::i_S4_SRR_RL_Clu_Dist_118);

	if((abs(@ecu_Signals::i_S4_SRR_RL_Clu_Dist_118)*0.9<=abs(signalvalue1))&&(abs(signalvalue1)<=abs(@ecu_Signals::i_S4_SRR_RL_Clu_Dist_118)*1.1))
	{
	testStepPass("Pass","i_S4_SRR_RL_Clu_Dist_118 :%f",signalvalue1);
	}
	else
	{
	testStepFail("Fail","i_S4_SRR_RL_Clu_Dist_118 :%f",signalvalue1);
	}
}

testcase S4_SRR_RL_Clu_Mes_16_S4_SRR_RL_Clu_Vel_118()
{
	signalvalue1 = getSignal(S4_SRR_RL_Clu_Vel_118);
	write("S4_SRR_RL_Clu_Vel_118 :%f",signalvalue1);
	write("i_S4_SRR_RL_Clu_Vel_118 :%f",@ecu_Signals::i_S4_SRR_RL_Clu_Vel_118);

	testStep("get expect variable value: ","i_S4_SRR_RL_Clu_Vel_118 :%f",@ecu_Signals::i_S4_SRR_RL_Clu_Vel_118);

	if((abs(@ecu_Signals::i_S4_SRR_RL_Clu_Vel_118)*0.9<=abs(signalvalue1))&&(abs(signalvalue1)<=abs(@ecu_Signals::i_S4_SRR_RL_Clu_Vel_118)*1.1))
	{
	testStepPass("Pass","i_S4_SRR_RL_Clu_Vel_118 :%f",signalvalue1);
	}
	else
	{
	testStepFail("Fail","i_S4_SRR_RL_Clu_Vel_118 :%f",signalvalue1);
	}
}

testcase S4_SRR_RL_Clu_Mes_16_S4_SRR_RL_Clu_SNR_118()
{
	signalvalue1 = getSignal(S4_SRR_RL_Clu_SNR_118);
	write("S4_SRR_RL_Clu_SNR_118 :%f",signalvalue1);
	write("i_S4_SRR_RL_Clu_SNR_118 :%f",@ecu_Signals::i_S4_SRR_RL_Clu_SNR_118);

	testStep("get expect variable value: ","i_S4_SRR_RL_Clu_SNR_118 :%f",@ecu_Signals::i_S4_SRR_RL_Clu_SNR_118);

	if((abs(@ecu_Signals::i_S4_SRR_RL_Clu_SNR_118)*0.9<=abs(signalvalue1))&&(abs(signalvalue1)<=abs(@ecu_Signals::i_S4_SRR_RL_Clu_SNR_118)*1.1))
	{
	testStepPass("Pass","i_S4_SRR_RL_Clu_SNR_118 :%f",signalvalue1);
	}
	else
	{
	testStepFail("Fail","i_S4_SRR_RL_Clu_SNR_118 :%f",signalvalue1);
	}
}

testcase S4_SRR_RL_Clu_Mes_16_S4_SRR_RL_Clu_DynProp_118()
{
	signalvalue1 = getSignal(S4_SRR_RL_Clu_DynProp_118);
	write("S4_SRR_RL_Clu_DynProp_118 :%f",signalvalue1);
	write("i_S4_SRR_RL_Clu_DynProp_118 :%o",@ecu_Signals::i_S4_SRR_RL_Clu_DynProp_118);

	testStep("get expect variable value: ","i_S4_SRR_RL_Clu_DynProp_118 :%o",@ecu_Signals::i_S4_SRR_RL_Clu_DynProp_118);

	if(signalvalue1==@ecu_Signals::i_S4_SRR_RL_Clu_DynProp_118)
	{
	testStepPass("Pass","i_S4_SRR_RL_Clu_DynProp_118 :%f",signalvalue1);
	}
	else
	{
	testStepFail("Fail","i_S4_SRR_RL_Clu_DynProp_118 :%f",signalvalue1);
	}
}

testcase S4_SRR_RL_Clu_Mes_16_S4_SRR_RL_Clu_Locationvalid_118()
{
	signalvalue1 = getSignal(S4_SRR_RL_Clu_Locationvalid_118);
	write("S4_SRR_RL_Clu_Locationvalid_118 :%f",signalvalue1);
	write("i_S4_SRR_RL_Clu_Locationvalid_118 :%o",@ecu_Signals::i_S4_SRR_RL_Clu_Locationvalid_118);

	testStep("get expect variable value: ","i_S4_SRR_RL_Clu_Locationvalid_118 :%o",@ecu_Signals::i_S4_SRR_RL_Clu_Locationvalid_118);

	if(signalvalue1==@ecu_Signals::i_S4_SRR_RL_Clu_Locationvalid_118)
	{
	testStepPass("Pass","i_S4_SRR_RL_Clu_Locationvalid_118 :%f",signalvalue1);
	}
	else
	{
	testStepFail("Fail","i_S4_SRR_RL_Clu_Locationvalid_118 :%f",signalvalue1);
	}
}

testcase S4_SRR_RL_Clu_Mes_17_S4_SRR_RL_Clu_Theta_119()
{
	signalvalue1 = getSignal(S4_SRR_RL_Clu_Theta_119);
	write("S4_SRR_RL_Clu_Theta_119 :%f",signalvalue1);
	write("i_S4_SRR_RL_Clu_Theta_119 :%f",@ecu_Signals::i_S4_SRR_RL_Clu_Theta_119);

	testStep("get expect variable value: ","i_S4_SRR_RL_Clu_Theta_119 :%f",@ecu_Signals::i_S4_SRR_RL_Clu_Theta_119);

	if((abs(@ecu_Signals::i_S4_SRR_RL_Clu_Theta_119)*0.9<=abs(signalvalue1))&&(abs(signalvalue1)<=abs(@ecu_Signals::i_S4_SRR_RL_Clu_Theta_119)*1.1))
	{
	testStepPass("Pass","i_S4_SRR_RL_Clu_Theta_119 :%f",signalvalue1);
	}
	else
	{
	testStepFail("Fail","i_S4_SRR_RL_Clu_Theta_119 :%f",signalvalue1);
	}
}

testcase S4_SRR_RL_Clu_Mes_17_S4_SRR_RL_Clu_Dist_119()
{
	signalvalue1 = getSignal(S4_SRR_RL_Clu_Dist_119);
	write("S4_SRR_RL_Clu_Dist_119 :%f",signalvalue1);
	write("i_S4_SRR_RL_Clu_Dist_119 :%f",@ecu_Signals::i_S4_SRR_RL_Clu_Dist_119);

	testStep("get expect variable value: ","i_S4_SRR_RL_Clu_Dist_119 :%f",@ecu_Signals::i_S4_SRR_RL_Clu_Dist_119);

	if((abs(@ecu_Signals::i_S4_SRR_RL_Clu_Dist_119)*0.9<=abs(signalvalue1))&&(abs(signalvalue1)<=abs(@ecu_Signals::i_S4_SRR_RL_Clu_Dist_119)*1.1))
	{
	testStepPass("Pass","i_S4_SRR_RL_Clu_Dist_119 :%f",signalvalue1);
	}
	else
	{
	testStepFail("Fail","i_S4_SRR_RL_Clu_Dist_119 :%f",signalvalue1);
	}
}

testcase S4_SRR_RL_Clu_Mes_17_S4_SRR_RL_Clu_Vel_119()
{
	signalvalue1 = getSignal(S4_SRR_RL_Clu_Vel_119);
	write("S4_SRR_RL_Clu_Vel_119 :%f",signalvalue1);
	write("i_S4_SRR_RL_Clu_Vel_119 :%f",@ecu_Signals::i_S4_SRR_RL_Clu_Vel_119);

	testStep("get expect variable value: ","i_S4_SRR_RL_Clu_Vel_119 :%f",@ecu_Signals::i_S4_SRR_RL_Clu_Vel_119);

	if((abs(@ecu_Signals::i_S4_SRR_RL_Clu_Vel_119)*0.9<=abs(signalvalue1))&&(abs(signalvalue1)<=abs(@ecu_Signals::i_S4_SRR_RL_Clu_Vel_119)*1.1))
	{
	testStepPass("Pass","i_S4_SRR_RL_Clu_Vel_119 :%f",signalvalue1);
	}
	else
	{
	testStepFail("Fail","i_S4_SRR_RL_Clu_Vel_119 :%f",signalvalue1);
	}
}

testcase S4_SRR_RL_Clu_Mes_17_S4_SRR_RL_Clu_SNR_119()
{
	signalvalue1 = getSignal(S4_SRR_RL_Clu_SNR_119);
	write("S4_SRR_RL_Clu_SNR_119 :%f",signalvalue1);
	write("i_S4_SRR_RL_Clu_SNR_119 :%f",@ecu_Signals::i_S4_SRR_RL_Clu_SNR_119);

	testStep("get expect variable value: ","i_S4_SRR_RL_Clu_SNR_119 :%f",@ecu_Signals::i_S4_SRR_RL_Clu_SNR_119);

	if((abs(@ecu_Signals::i_S4_SRR_RL_Clu_SNR_119)*0.9<=abs(signalvalue1))&&(abs(signalvalue1)<=abs(@ecu_Signals::i_S4_SRR_RL_Clu_SNR_119)*1.1))
	{
	testStepPass("Pass","i_S4_SRR_RL_Clu_SNR_119 :%f",signalvalue1);
	}
	else
	{
	testStepFail("Fail","i_S4_SRR_RL_Clu_SNR_119 :%f",signalvalue1);
	}
}

testcase S4_SRR_RL_Clu_Mes_17_S4_SRR_RL_Clu_DynProp_119()
{
	signalvalue1 = getSignal(S4_SRR_RL_Clu_DynProp_119);
	write("S4_SRR_RL_Clu_DynProp_119 :%f",signalvalue1);
	write("i_S4_SRR_RL_Clu_DynProp_119 :%o",@ecu_Signals::i_S4_SRR_RL_Clu_DynProp_119);

	testStep("get expect variable value: ","i_S4_SRR_RL_Clu_DynProp_119 :%o",@ecu_Signals::i_S4_SRR_RL_Clu_DynProp_119);

	if(signalvalue1==@ecu_Signals::i_S4_SRR_RL_Clu_DynProp_119)
	{
	testStepPass("Pass","i_S4_SRR_RL_Clu_DynProp_119 :%f",signalvalue1);
	}
	else
	{
	testStepFail("Fail","i_S4_SRR_RL_Clu_DynProp_119 :%f",signalvalue1);
	}
}

testcase S4_SRR_RL_Clu_Mes_17_S4_SRR_RL_Clu_Locationvalid_119()
{
	signalvalue1 = getSignal(S4_SRR_RL_Clu_Locationvalid_119);
	write("S4_SRR_RL_Clu_Locationvalid_119 :%f",signalvalue1);
	write("i_S4_SRR_RL_Clu_Locationvalid_119 :%o",@ecu_Signals::i_S4_SRR_RL_Clu_Locationvalid_119);

	testStep("get expect variable value: ","i_S4_SRR_RL_Clu_Locationvalid_119 :%o",@ecu_Signals::i_S4_SRR_RL_Clu_Locationvalid_119);

	if(signalvalue1==@ecu_Signals::i_S4_SRR_RL_Clu_Locationvalid_119)
	{
	testStepPass("Pass","i_S4_SRR_RL_Clu_Locationvalid_119 :%f",signalvalue1);
	}
	else
	{
	testStepFail("Fail","i_S4_SRR_RL_Clu_Locationvalid_119 :%f",signalvalue1);
	}
}

testcase S4_SRR_RL_Clu_Mes_17_S4_SRR_RL_Clu_Theta_120()
{
	signalvalue1 = getSignal(S4_SRR_RL_Clu_Theta_120);
	write("S4_SRR_RL_Clu_Theta_120 :%f",signalvalue1);
	write("i_S4_SRR_RL_Clu_Theta_120 :%f",@ecu_Signals::i_S4_SRR_RL_Clu_Theta_120);

	testStep("get expect variable value: ","i_S4_SRR_RL_Clu_Theta_120 :%f",@ecu_Signals::i_S4_SRR_RL_Clu_Theta_120);

	if((abs(@ecu_Signals::i_S4_SRR_RL_Clu_Theta_120)*0.9<=abs(signalvalue1))&&(abs(signalvalue1)<=abs(@ecu_Signals::i_S4_SRR_RL_Clu_Theta_120)*1.1))
	{
	testStepPass("Pass","i_S4_SRR_RL_Clu_Theta_120 :%f",signalvalue1);
	}
	else
	{
	testStepFail("Fail","i_S4_SRR_RL_Clu_Theta_120 :%f",signalvalue1);
	}
}

testcase S4_SRR_RL_Clu_Mes_17_S4_SRR_RL_Clu_Dist_120()
{
	signalvalue1 = getSignal(S4_SRR_RL_Clu_Dist_120);
	write("S4_SRR_RL_Clu_Dist_120 :%f",signalvalue1);
	write("i_S4_SRR_RL_Clu_Dist_120 :%f",@ecu_Signals::i_S4_SRR_RL_Clu_Dist_120);

	testStep("get expect variable value: ","i_S4_SRR_RL_Clu_Dist_120 :%f",@ecu_Signals::i_S4_SRR_RL_Clu_Dist_120);

	if((abs(@ecu_Signals::i_S4_SRR_RL_Clu_Dist_120)*0.9<=abs(signalvalue1))&&(abs(signalvalue1)<=abs(@ecu_Signals::i_S4_SRR_RL_Clu_Dist_120)*1.1))
	{
	testStepPass("Pass","i_S4_SRR_RL_Clu_Dist_120 :%f",signalvalue1);
	}
	else
	{
	testStepFail("Fail","i_S4_SRR_RL_Clu_Dist_120 :%f",signalvalue1);
	}
}

testcase S4_SRR_RL_Clu_Mes_17_S4_SRR_RL_Clu_Vel_120()
{
	signalvalue1 = getSignal(S4_SRR_RL_Clu_Vel_120);
	write("S4_SRR_RL_Clu_Vel_120 :%f",signalvalue1);
	write("i_S4_SRR_RL_Clu_Vel_120 :%f",@ecu_Signals::i_S4_SRR_RL_Clu_Vel_120);

	testStep("get expect variable value: ","i_S4_SRR_RL_Clu_Vel_120 :%f",@ecu_Signals::i_S4_SRR_RL_Clu_Vel_120);

	if((abs(@ecu_Signals::i_S4_SRR_RL_Clu_Vel_120)*0.9<=abs(signalvalue1))&&(abs(signalvalue1)<=abs(@ecu_Signals::i_S4_SRR_RL_Clu_Vel_120)*1.1))
	{
	testStepPass("Pass","i_S4_SRR_RL_Clu_Vel_120 :%f",signalvalue1);
	}
	else
	{
	testStepFail("Fail","i_S4_SRR_RL_Clu_Vel_120 :%f",signalvalue1);
	}
}

testcase S4_SRR_RL_Clu_Mes_17_S4_SRR_RL_Clu_SNR_120()
{
	signalvalue1 = getSignal(S4_SRR_RL_Clu_SNR_120);
	write("S4_SRR_RL_Clu_SNR_120 :%f",signalvalue1);
	write("i_S4_SRR_RL_Clu_SNR_120 :%f",@ecu_Signals::i_S4_SRR_RL_Clu_SNR_120);

	testStep("get expect variable value: ","i_S4_SRR_RL_Clu_SNR_120 :%f",@ecu_Signals::i_S4_SRR_RL_Clu_SNR_120);

	if((abs(@ecu_Signals::i_S4_SRR_RL_Clu_SNR_120)*0.9<=abs(signalvalue1))&&(abs(signalvalue1)<=abs(@ecu_Signals::i_S4_SRR_RL_Clu_SNR_120)*1.1))
	{
	testStepPass("Pass","i_S4_SRR_RL_Clu_SNR_120 :%f",signalvalue1);
	}
	else
	{
	testStepFail("Fail","i_S4_SRR_RL_Clu_SNR_120 :%f",signalvalue1);
	}
}

testcase S4_SRR_RL_Clu_Mes_17_S4_SRR_RL_Clu_DynProp_120()
{
	signalvalue1 = getSignal(S4_SRR_RL_Clu_DynProp_120);
	write("S4_SRR_RL_Clu_DynProp_120 :%f",signalvalue1);
	write("i_S4_SRR_RL_Clu_DynProp_120 :%o",@ecu_Signals::i_S4_SRR_RL_Clu_DynProp_120);

	testStep("get expect variable value: ","i_S4_SRR_RL_Clu_DynProp_120 :%o",@ecu_Signals::i_S4_SRR_RL_Clu_DynProp_120);

	if(signalvalue1==@ecu_Signals::i_S4_SRR_RL_Clu_DynProp_120)
	{
	testStepPass("Pass","i_S4_SRR_RL_Clu_DynProp_120 :%f",signalvalue1);
	}
	else
	{
	testStepFail("Fail","i_S4_SRR_RL_Clu_DynProp_120 :%f",signalvalue1);
	}
}

testcase S4_SRR_RL_Clu_Mes_17_S4_SRR_RL_Clu_Locationvalid_120()
{
	signalvalue1 = getSignal(S4_SRR_RL_Clu_Locationvalid_120);
	write("S4_SRR_RL_Clu_Locationvalid_120 :%f",signalvalue1);
	write("i_S4_SRR_RL_Clu_Locationvalid_120 :%o",@ecu_Signals::i_S4_SRR_RL_Clu_Locationvalid_120);

	testStep("get expect variable value: ","i_S4_SRR_RL_Clu_Locationvalid_120 :%o",@ecu_Signals::i_S4_SRR_RL_Clu_Locationvalid_120);

	if(signalvalue1==@ecu_Signals::i_S4_SRR_RL_Clu_Locationvalid_120)
	{
	testStepPass("Pass","i_S4_SRR_RL_Clu_Locationvalid_120 :%f",signalvalue1);
	}
	else
	{
	testStepFail("Fail","i_S4_SRR_RL_Clu_Locationvalid_120 :%f",signalvalue1);
	}
}

testcase S4_SRR_RL_Clu_Mes_17_S4_SRR_RL_Clu_Theta_121()
{
	signalvalue1 = getSignal(S4_SRR_RL_Clu_Theta_121);
	write("S4_SRR_RL_Clu_Theta_121 :%f",signalvalue1);
	write("i_S4_SRR_RL_Clu_Theta_121 :%f",@ecu_Signals::i_S4_SRR_RL_Clu_Theta_121);

	testStep("get expect variable value: ","i_S4_SRR_RL_Clu_Theta_121 :%f",@ecu_Signals::i_S4_SRR_RL_Clu_Theta_121);

	if((abs(@ecu_Signals::i_S4_SRR_RL_Clu_Theta_121)*0.9<=abs(signalvalue1))&&(abs(signalvalue1)<=abs(@ecu_Signals::i_S4_SRR_RL_Clu_Theta_121)*1.1))
	{
	testStepPass("Pass","i_S4_SRR_RL_Clu_Theta_121 :%f",signalvalue1);
	}
	else
	{
	testStepFail("Fail","i_S4_SRR_RL_Clu_Theta_121 :%f",signalvalue1);
	}
}

testcase S4_SRR_RL_Clu_Mes_17_S4_SRR_RL_Clu_Dist_121()
{
	signalvalue1 = getSignal(S4_SRR_RL_Clu_Dist_121);
	write("S4_SRR_RL_Clu_Dist_121 :%f",signalvalue1);
	write("i_S4_SRR_RL_Clu_Dist_121 :%f",@ecu_Signals::i_S4_SRR_RL_Clu_Dist_121);

	testStep("get expect variable value: ","i_S4_SRR_RL_Clu_Dist_121 :%f",@ecu_Signals::i_S4_SRR_RL_Clu_Dist_121);

	if((abs(@ecu_Signals::i_S4_SRR_RL_Clu_Dist_121)*0.9<=abs(signalvalue1))&&(abs(signalvalue1)<=abs(@ecu_Signals::i_S4_SRR_RL_Clu_Dist_121)*1.1))
	{
	testStepPass("Pass","i_S4_SRR_RL_Clu_Dist_121 :%f",signalvalue1);
	}
	else
	{
	testStepFail("Fail","i_S4_SRR_RL_Clu_Dist_121 :%f",signalvalue1);
	}
}

testcase S4_SRR_RL_Clu_Mes_17_S4_SRR_RL_Clu_Vel_121()
{
	signalvalue1 = getSignal(S4_SRR_RL_Clu_Vel_121);
	write("S4_SRR_RL_Clu_Vel_121 :%f",signalvalue1);
	write("i_S4_SRR_RL_Clu_Vel_121 :%f",@ecu_Signals::i_S4_SRR_RL_Clu_Vel_121);

	testStep("get expect variable value: ","i_S4_SRR_RL_Clu_Vel_121 :%f",@ecu_Signals::i_S4_SRR_RL_Clu_Vel_121);

	if((abs(@ecu_Signals::i_S4_SRR_RL_Clu_Vel_121)*0.9<=abs(signalvalue1))&&(abs(signalvalue1)<=abs(@ecu_Signals::i_S4_SRR_RL_Clu_Vel_121)*1.1))
	{
	testStepPass("Pass","i_S4_SRR_RL_Clu_Vel_121 :%f",signalvalue1);
	}
	else
	{
	testStepFail("Fail","i_S4_SRR_RL_Clu_Vel_121 :%f",signalvalue1);
	}
}

testcase S4_SRR_RL_Clu_Mes_17_S4_SRR_RL_Clu_SNR_121()
{
	signalvalue1 = getSignal(S4_SRR_RL_Clu_SNR_121);
	write("S4_SRR_RL_Clu_SNR_121 :%f",signalvalue1);
	write("i_S4_SRR_RL_Clu_SNR_121 :%f",@ecu_Signals::i_S4_SRR_RL_Clu_SNR_121);

	testStep("get expect variable value: ","i_S4_SRR_RL_Clu_SNR_121 :%f",@ecu_Signals::i_S4_SRR_RL_Clu_SNR_121);

	if((abs(@ecu_Signals::i_S4_SRR_RL_Clu_SNR_121)*0.9<=abs(signalvalue1))&&(abs(signalvalue1)<=abs(@ecu_Signals::i_S4_SRR_RL_Clu_SNR_121)*1.1))
	{
	testStepPass("Pass","i_S4_SRR_RL_Clu_SNR_121 :%f",signalvalue1);
	}
	else
	{
	testStepFail("Fail","i_S4_SRR_RL_Clu_SNR_121 :%f",signalvalue1);
	}
}

testcase S4_SRR_RL_Clu_Mes_17_S4_SRR_RL_Clu_DynProp_121()
{
	signalvalue1 = getSignal(S4_SRR_RL_Clu_DynProp_121);
	write("S4_SRR_RL_Clu_DynProp_121 :%f",signalvalue1);
	write("i_S4_SRR_RL_Clu_DynProp_121 :%o",@ecu_Signals::i_S4_SRR_RL_Clu_DynProp_121);

	testStep("get expect variable value: ","i_S4_SRR_RL_Clu_DynProp_121 :%o",@ecu_Signals::i_S4_SRR_RL_Clu_DynProp_121);

	if(signalvalue1==@ecu_Signals::i_S4_SRR_RL_Clu_DynProp_121)
	{
	testStepPass("Pass","i_S4_SRR_RL_Clu_DynProp_121 :%f",signalvalue1);
	}
	else
	{
	testStepFail("Fail","i_S4_SRR_RL_Clu_DynProp_121 :%f",signalvalue1);
	}
}

testcase S4_SRR_RL_Clu_Mes_17_S4_SRR_RL_Clu_Locationvalid_121()
{
	signalvalue1 = getSignal(S4_SRR_RL_Clu_Locationvalid_121);
	write("S4_SRR_RL_Clu_Locationvalid_121 :%f",signalvalue1);
	write("i_S4_SRR_RL_Clu_Locationvalid_121 :%o",@ecu_Signals::i_S4_SRR_RL_Clu_Locationvalid_121);

	testStep("get expect variable value: ","i_S4_SRR_RL_Clu_Locationvalid_121 :%o",@ecu_Signals::i_S4_SRR_RL_Clu_Locationvalid_121);

	if(signalvalue1==@ecu_Signals::i_S4_SRR_RL_Clu_Locationvalid_121)
	{
	testStepPass("Pass","i_S4_SRR_RL_Clu_Locationvalid_121 :%f",signalvalue1);
	}
	else
	{
	testStepFail("Fail","i_S4_SRR_RL_Clu_Locationvalid_121 :%f",signalvalue1);
	}
}

testcase S4_SRR_RL_Clu_Mes_17_S4_SRR_RL_Clu_Theta_122()
{
	signalvalue1 = getSignal(S4_SRR_RL_Clu_Theta_122);
	write("S4_SRR_RL_Clu_Theta_122 :%f",signalvalue1);
	write("i_S4_SRR_RL_Clu_Theta_122 :%f",@ecu_Signals::i_S4_SRR_RL_Clu_Theta_122);

	testStep("get expect variable value: ","i_S4_SRR_RL_Clu_Theta_122 :%f",@ecu_Signals::i_S4_SRR_RL_Clu_Theta_122);

	if((abs(@ecu_Signals::i_S4_SRR_RL_Clu_Theta_122)*0.9<=abs(signalvalue1))&&(abs(signalvalue1)<=abs(@ecu_Signals::i_S4_SRR_RL_Clu_Theta_122)*1.1))
	{
	testStepPass("Pass","i_S4_SRR_RL_Clu_Theta_122 :%f",signalvalue1);
	}
	else
	{
	testStepFail("Fail","i_S4_SRR_RL_Clu_Theta_122 :%f",signalvalue1);
	}
}

testcase S4_SRR_RL_Clu_Mes_17_S4_SRR_RL_Clu_Dist_122()
{
	signalvalue1 = getSignal(S4_SRR_RL_Clu_Dist_122);
	write("S4_SRR_RL_Clu_Dist_122 :%f",signalvalue1);
	write("i_S4_SRR_RL_Clu_Dist_122 :%f",@ecu_Signals::i_S4_SRR_RL_Clu_Dist_122);

	testStep("get expect variable value: ","i_S4_SRR_RL_Clu_Dist_122 :%f",@ecu_Signals::i_S4_SRR_RL_Clu_Dist_122);

	if((abs(@ecu_Signals::i_S4_SRR_RL_Clu_Dist_122)*0.9<=abs(signalvalue1))&&(abs(signalvalue1)<=abs(@ecu_Signals::i_S4_SRR_RL_Clu_Dist_122)*1.1))
	{
	testStepPass("Pass","i_S4_SRR_RL_Clu_Dist_122 :%f",signalvalue1);
	}
	else
	{
	testStepFail("Fail","i_S4_SRR_RL_Clu_Dist_122 :%f",signalvalue1);
	}
}

testcase S4_SRR_RL_Clu_Mes_17_S4_SRR_RL_Clu_Vel_122()
{
	signalvalue1 = getSignal(S4_SRR_RL_Clu_Vel_122);
	write("S4_SRR_RL_Clu_Vel_122 :%f",signalvalue1);
	write("i_S4_SRR_RL_Clu_Vel_122 :%f",@ecu_Signals::i_S4_SRR_RL_Clu_Vel_122);

	testStep("get expect variable value: ","i_S4_SRR_RL_Clu_Vel_122 :%f",@ecu_Signals::i_S4_SRR_RL_Clu_Vel_122);

	if((abs(@ecu_Signals::i_S4_SRR_RL_Clu_Vel_122)*0.9<=abs(signalvalue1))&&(abs(signalvalue1)<=abs(@ecu_Signals::i_S4_SRR_RL_Clu_Vel_122)*1.1))
	{
	testStepPass("Pass","i_S4_SRR_RL_Clu_Vel_122 :%f",signalvalue1);
	}
	else
	{
	testStepFail("Fail","i_S4_SRR_RL_Clu_Vel_122 :%f",signalvalue1);
	}
}

testcase S4_SRR_RL_Clu_Mes_17_S4_SRR_RL_Clu_SNR_122()
{
	signalvalue1 = getSignal(S4_SRR_RL_Clu_SNR_122);
	write("S4_SRR_RL_Clu_SNR_122 :%f",signalvalue1);
	write("i_S4_SRR_RL_Clu_SNR_122 :%f",@ecu_Signals::i_S4_SRR_RL_Clu_SNR_122);

	testStep("get expect variable value: ","i_S4_SRR_RL_Clu_SNR_122 :%f",@ecu_Signals::i_S4_SRR_RL_Clu_SNR_122);

	if((abs(@ecu_Signals::i_S4_SRR_RL_Clu_SNR_122)*0.9<=abs(signalvalue1))&&(abs(signalvalue1)<=abs(@ecu_Signals::i_S4_SRR_RL_Clu_SNR_122)*1.1))
	{
	testStepPass("Pass","i_S4_SRR_RL_Clu_SNR_122 :%f",signalvalue1);
	}
	else
	{
	testStepFail("Fail","i_S4_SRR_RL_Clu_SNR_122 :%f",signalvalue1);
	}
}

testcase S4_SRR_RL_Clu_Mes_17_S4_SRR_RL_Clu_DynProp_122()
{
	signalvalue1 = getSignal(S4_SRR_RL_Clu_DynProp_122);
	write("S4_SRR_RL_Clu_DynProp_122 :%f",signalvalue1);
	write("i_S4_SRR_RL_Clu_DynProp_122 :%o",@ecu_Signals::i_S4_SRR_RL_Clu_DynProp_122);

	testStep("get expect variable value: ","i_S4_SRR_RL_Clu_DynProp_122 :%o",@ecu_Signals::i_S4_SRR_RL_Clu_DynProp_122);

	if(signalvalue1==@ecu_Signals::i_S4_SRR_RL_Clu_DynProp_122)
	{
	testStepPass("Pass","i_S4_SRR_RL_Clu_DynProp_122 :%f",signalvalue1);
	}
	else
	{
	testStepFail("Fail","i_S4_SRR_RL_Clu_DynProp_122 :%f",signalvalue1);
	}
}

testcase S4_SRR_RL_Clu_Mes_17_S4_SRR_RL_Clu_Locationvalid_122()
{
	signalvalue1 = getSignal(S4_SRR_RL_Clu_Locationvalid_122);
	write("S4_SRR_RL_Clu_Locationvalid_122 :%f",signalvalue1);
	write("i_S4_SRR_RL_Clu_Locationvalid_122 :%o",@ecu_Signals::i_S4_SRR_RL_Clu_Locationvalid_122);

	testStep("get expect variable value: ","i_S4_SRR_RL_Clu_Locationvalid_122 :%o",@ecu_Signals::i_S4_SRR_RL_Clu_Locationvalid_122);

	if(signalvalue1==@ecu_Signals::i_S4_SRR_RL_Clu_Locationvalid_122)
	{
	testStepPass("Pass","i_S4_SRR_RL_Clu_Locationvalid_122 :%f",signalvalue1);
	}
	else
	{
	testStepFail("Fail","i_S4_SRR_RL_Clu_Locationvalid_122 :%f",signalvalue1);
	}
}

testcase S4_SRR_RL_Clu_Mes_17_S4_SRR_RL_Clu_Theta_123()
{
	signalvalue1 = getSignal(S4_SRR_RL_Clu_Theta_123);
	write("S4_SRR_RL_Clu_Theta_123 :%f",signalvalue1);
	write("i_S4_SRR_RL_Clu_Theta_123 :%f",@ecu_Signals::i_S4_SRR_RL_Clu_Theta_123);

	testStep("get expect variable value: ","i_S4_SRR_RL_Clu_Theta_123 :%f",@ecu_Signals::i_S4_SRR_RL_Clu_Theta_123);

	if((abs(@ecu_Signals::i_S4_SRR_RL_Clu_Theta_123)*0.9<=abs(signalvalue1))&&(abs(signalvalue1)<=abs(@ecu_Signals::i_S4_SRR_RL_Clu_Theta_123)*1.1))
	{
	testStepPass("Pass","i_S4_SRR_RL_Clu_Theta_123 :%f",signalvalue1);
	}
	else
	{
	testStepFail("Fail","i_S4_SRR_RL_Clu_Theta_123 :%f",signalvalue1);
	}
}

testcase S4_SRR_RL_Clu_Mes_17_S4_SRR_RL_Clu_Dist_123()
{
	signalvalue1 = getSignal(S4_SRR_RL_Clu_Dist_123);
	write("S4_SRR_RL_Clu_Dist_123 :%f",signalvalue1);
	write("i_S4_SRR_RL_Clu_Dist_123 :%f",@ecu_Signals::i_S4_SRR_RL_Clu_Dist_123);

	testStep("get expect variable value: ","i_S4_SRR_RL_Clu_Dist_123 :%f",@ecu_Signals::i_S4_SRR_RL_Clu_Dist_123);

	if((abs(@ecu_Signals::i_S4_SRR_RL_Clu_Dist_123)*0.9<=abs(signalvalue1))&&(abs(signalvalue1)<=abs(@ecu_Signals::i_S4_SRR_RL_Clu_Dist_123)*1.1))
	{
	testStepPass("Pass","i_S4_SRR_RL_Clu_Dist_123 :%f",signalvalue1);
	}
	else
	{
	testStepFail("Fail","i_S4_SRR_RL_Clu_Dist_123 :%f",signalvalue1);
	}
}

testcase S4_SRR_RL_Clu_Mes_17_S4_SRR_RL_Clu_Vel_123()
{
	signalvalue1 = getSignal(S4_SRR_RL_Clu_Vel_123);
	write("S4_SRR_RL_Clu_Vel_123 :%f",signalvalue1);
	write("i_S4_SRR_RL_Clu_Vel_123 :%f",@ecu_Signals::i_S4_SRR_RL_Clu_Vel_123);

	testStep("get expect variable value: ","i_S4_SRR_RL_Clu_Vel_123 :%f",@ecu_Signals::i_S4_SRR_RL_Clu_Vel_123);

	if((abs(@ecu_Signals::i_S4_SRR_RL_Clu_Vel_123)*0.9<=abs(signalvalue1))&&(abs(signalvalue1)<=abs(@ecu_Signals::i_S4_SRR_RL_Clu_Vel_123)*1.1))
	{
	testStepPass("Pass","i_S4_SRR_RL_Clu_Vel_123 :%f",signalvalue1);
	}
	else
	{
	testStepFail("Fail","i_S4_SRR_RL_Clu_Vel_123 :%f",signalvalue1);
	}
}

testcase S4_SRR_RL_Clu_Mes_17_S4_SRR_RL_Clu_SNR_123()
{
	signalvalue1 = getSignal(S4_SRR_RL_Clu_SNR_123);
	write("S4_SRR_RL_Clu_SNR_123 :%f",signalvalue1);
	write("i_S4_SRR_RL_Clu_SNR_123 :%f",@ecu_Signals::i_S4_SRR_RL_Clu_SNR_123);

	testStep("get expect variable value: ","i_S4_SRR_RL_Clu_SNR_123 :%f",@ecu_Signals::i_S4_SRR_RL_Clu_SNR_123);

	if((abs(@ecu_Signals::i_S4_SRR_RL_Clu_SNR_123)*0.9<=abs(signalvalue1))&&(abs(signalvalue1)<=abs(@ecu_Signals::i_S4_SRR_RL_Clu_SNR_123)*1.1))
	{
	testStepPass("Pass","i_S4_SRR_RL_Clu_SNR_123 :%f",signalvalue1);
	}
	else
	{
	testStepFail("Fail","i_S4_SRR_RL_Clu_SNR_123 :%f",signalvalue1);
	}
}

testcase S4_SRR_RL_Clu_Mes_17_S4_SRR_RL_Clu_DynProp_123()
{
	signalvalue1 = getSignal(S4_SRR_RL_Clu_DynProp_123);
	write("S4_SRR_RL_Clu_DynProp_123 :%f",signalvalue1);
	write("i_S4_SRR_RL_Clu_DynProp_123 :%o",@ecu_Signals::i_S4_SRR_RL_Clu_DynProp_123);

	testStep("get expect variable value: ","i_S4_SRR_RL_Clu_DynProp_123 :%o",@ecu_Signals::i_S4_SRR_RL_Clu_DynProp_123);

	if(signalvalue1==@ecu_Signals::i_S4_SRR_RL_Clu_DynProp_123)
	{
	testStepPass("Pass","i_S4_SRR_RL_Clu_DynProp_123 :%f",signalvalue1);
	}
	else
	{
	testStepFail("Fail","i_S4_SRR_RL_Clu_DynProp_123 :%f",signalvalue1);
	}
}

testcase S4_SRR_RL_Clu_Mes_17_S4_SRR_RL_Clu_Locationvalid_123()
{
	signalvalue1 = getSignal(S4_SRR_RL_Clu_Locationvalid_123);
	write("S4_SRR_RL_Clu_Locationvalid_123 :%f",signalvalue1);
	write("i_S4_SRR_RL_Clu_Locationvalid_123 :%o",@ecu_Signals::i_S4_SRR_RL_Clu_Locationvalid_123);

	testStep("get expect variable value: ","i_S4_SRR_RL_Clu_Locationvalid_123 :%o",@ecu_Signals::i_S4_SRR_RL_Clu_Locationvalid_123);

	if(signalvalue1==@ecu_Signals::i_S4_SRR_RL_Clu_Locationvalid_123)
	{
	testStepPass("Pass","i_S4_SRR_RL_Clu_Locationvalid_123 :%f",signalvalue1);
	}
	else
	{
	testStepFail("Fail","i_S4_SRR_RL_Clu_Locationvalid_123 :%f",signalvalue1);
	}
}

testcase S4_SRR_RL_Clu_Mes_17_S4_SRR_RL_Clu_Theta_124()
{
	signalvalue1 = getSignal(S4_SRR_RL_Clu_Theta_124);
	write("S4_SRR_RL_Clu_Theta_124 :%f",signalvalue1);
	write("i_S4_SRR_RL_Clu_Theta_124 :%f",@ecu_Signals::i_S4_SRR_RL_Clu_Theta_124);

	testStep("get expect variable value: ","i_S4_SRR_RL_Clu_Theta_124 :%f",@ecu_Signals::i_S4_SRR_RL_Clu_Theta_124);

	if((abs(@ecu_Signals::i_S4_SRR_RL_Clu_Theta_124)*0.9<=abs(signalvalue1))&&(abs(signalvalue1)<=abs(@ecu_Signals::i_S4_SRR_RL_Clu_Theta_124)*1.1))
	{
	testStepPass("Pass","i_S4_SRR_RL_Clu_Theta_124 :%f",signalvalue1);
	}
	else
	{
	testStepFail("Fail","i_S4_SRR_RL_Clu_Theta_124 :%f",signalvalue1);
	}
}

testcase S4_SRR_RL_Clu_Mes_17_S4_SRR_RL_Clu_Dist_124()
{
	signalvalue1 = getSignal(S4_SRR_RL_Clu_Dist_124);
	write("S4_SRR_RL_Clu_Dist_124 :%f",signalvalue1);
	write("i_S4_SRR_RL_Clu_Dist_124 :%f",@ecu_Signals::i_S4_SRR_RL_Clu_Dist_124);

	testStep("get expect variable value: ","i_S4_SRR_RL_Clu_Dist_124 :%f",@ecu_Signals::i_S4_SRR_RL_Clu_Dist_124);

	if((abs(@ecu_Signals::i_S4_SRR_RL_Clu_Dist_124)*0.9<=abs(signalvalue1))&&(abs(signalvalue1)<=abs(@ecu_Signals::i_S4_SRR_RL_Clu_Dist_124)*1.1))
	{
	testStepPass("Pass","i_S4_SRR_RL_Clu_Dist_124 :%f",signalvalue1);
	}
	else
	{
	testStepFail("Fail","i_S4_SRR_RL_Clu_Dist_124 :%f",signalvalue1);
	}
}

testcase S4_SRR_RL_Clu_Mes_17_S4_SRR_RL_Clu_Vel_124()
{
	signalvalue1 = getSignal(S4_SRR_RL_Clu_Vel_124);
	write("S4_SRR_RL_Clu_Vel_124 :%f",signalvalue1);
	write("i_S4_SRR_RL_Clu_Vel_124 :%f",@ecu_Signals::i_S4_SRR_RL_Clu_Vel_124);

	testStep("get expect variable value: ","i_S4_SRR_RL_Clu_Vel_124 :%f",@ecu_Signals::i_S4_SRR_RL_Clu_Vel_124);

	if((abs(@ecu_Signals::i_S4_SRR_RL_Clu_Vel_124)*0.9<=abs(signalvalue1))&&(abs(signalvalue1)<=abs(@ecu_Signals::i_S4_SRR_RL_Clu_Vel_124)*1.1))
	{
	testStepPass("Pass","i_S4_SRR_RL_Clu_Vel_124 :%f",signalvalue1);
	}
	else
	{
	testStepFail("Fail","i_S4_SRR_RL_Clu_Vel_124 :%f",signalvalue1);
	}
}

testcase S4_SRR_RL_Clu_Mes_17_S4_SRR_RL_Clu_SNR_124()
{
	signalvalue1 = getSignal(S4_SRR_RL_Clu_SNR_124);
	write("S4_SRR_RL_Clu_SNR_124 :%f",signalvalue1);
	write("i_S4_SRR_RL_Clu_SNR_124 :%f",@ecu_Signals::i_S4_SRR_RL_Clu_SNR_124);

	testStep("get expect variable value: ","i_S4_SRR_RL_Clu_SNR_124 :%f",@ecu_Signals::i_S4_SRR_RL_Clu_SNR_124);

	if((abs(@ecu_Signals::i_S4_SRR_RL_Clu_SNR_124)*0.9<=abs(signalvalue1))&&(abs(signalvalue1)<=abs(@ecu_Signals::i_S4_SRR_RL_Clu_SNR_124)*1.1))
	{
	testStepPass("Pass","i_S4_SRR_RL_Clu_SNR_124 :%f",signalvalue1);
	}
	else
	{
	testStepFail("Fail","i_S4_SRR_RL_Clu_SNR_124 :%f",signalvalue1);
	}
}

testcase S4_SRR_RL_Clu_Mes_17_S4_SRR_RL_Clu_DynProp_124()
{
	signalvalue1 = getSignal(S4_SRR_RL_Clu_DynProp_124);
	write("S4_SRR_RL_Clu_DynProp_124 :%f",signalvalue1);
	write("i_S4_SRR_RL_Clu_DynProp_124 :%o",@ecu_Signals::i_S4_SRR_RL_Clu_DynProp_124);

	testStep("get expect variable value: ","i_S4_SRR_RL_Clu_DynProp_124 :%o",@ecu_Signals::i_S4_SRR_RL_Clu_DynProp_124);

	if(signalvalue1==@ecu_Signals::i_S4_SRR_RL_Clu_DynProp_124)
	{
	testStepPass("Pass","i_S4_SRR_RL_Clu_DynProp_124 :%f",signalvalue1);
	}
	else
	{
	testStepFail("Fail","i_S4_SRR_RL_Clu_DynProp_124 :%f",signalvalue1);
	}
}

testcase S4_SRR_RL_Clu_Mes_17_S4_SRR_RL_Clu_Locationvalid_124()
{
	signalvalue1 = getSignal(S4_SRR_RL_Clu_Locationvalid_124);
	write("S4_SRR_RL_Clu_Locationvalid_124 :%f",signalvalue1);
	write("i_S4_SRR_RL_Clu_Locationvalid_124 :%o",@ecu_Signals::i_S4_SRR_RL_Clu_Locationvalid_124);

	testStep("get expect variable value: ","i_S4_SRR_RL_Clu_Locationvalid_124 :%o",@ecu_Signals::i_S4_SRR_RL_Clu_Locationvalid_124);

	if(signalvalue1==@ecu_Signals::i_S4_SRR_RL_Clu_Locationvalid_124)
	{
	testStepPass("Pass","i_S4_SRR_RL_Clu_Locationvalid_124 :%f",signalvalue1);
	}
	else
	{
	testStepFail("Fail","i_S4_SRR_RL_Clu_Locationvalid_124 :%f",signalvalue1);
	}
}

testcase S4_SRR_RL_Clu_Mes_17_S4_SRR_RL_Clu_Theta_125()
{
	signalvalue1 = getSignal(S4_SRR_RL_Clu_Theta_125);
	write("S4_SRR_RL_Clu_Theta_125 :%f",signalvalue1);
	write("i_S4_SRR_RL_Clu_Theta_125 :%f",@ecu_Signals::i_S4_SRR_RL_Clu_Theta_125);

	testStep("get expect variable value: ","i_S4_SRR_RL_Clu_Theta_125 :%f",@ecu_Signals::i_S4_SRR_RL_Clu_Theta_125);

	if((abs(@ecu_Signals::i_S4_SRR_RL_Clu_Theta_125)*0.9<=abs(signalvalue1))&&(abs(signalvalue1)<=abs(@ecu_Signals::i_S4_SRR_RL_Clu_Theta_125)*1.1))
	{
	testStepPass("Pass","i_S4_SRR_RL_Clu_Theta_125 :%f",signalvalue1);
	}
	else
	{
	testStepFail("Fail","i_S4_SRR_RL_Clu_Theta_125 :%f",signalvalue1);
	}
}

testcase S4_SRR_RL_Clu_Mes_17_S4_SRR_RL_Clu_Dist_125()
{
	signalvalue1 = getSignal(S4_SRR_RL_Clu_Dist_125);
	write("S4_SRR_RL_Clu_Dist_125 :%f",signalvalue1);
	write("i_S4_SRR_RL_Clu_Dist_125 :%f",@ecu_Signals::i_S4_SRR_RL_Clu_Dist_125);

	testStep("get expect variable value: ","i_S4_SRR_RL_Clu_Dist_125 :%f",@ecu_Signals::i_S4_SRR_RL_Clu_Dist_125);

	if((abs(@ecu_Signals::i_S4_SRR_RL_Clu_Dist_125)*0.9<=abs(signalvalue1))&&(abs(signalvalue1)<=abs(@ecu_Signals::i_S4_SRR_RL_Clu_Dist_125)*1.1))
	{
	testStepPass("Pass","i_S4_SRR_RL_Clu_Dist_125 :%f",signalvalue1);
	}
	else
	{
	testStepFail("Fail","i_S4_SRR_RL_Clu_Dist_125 :%f",signalvalue1);
	}
}

testcase S4_SRR_RL_Clu_Mes_17_S4_SRR_RL_Clu_Vel_125()
{
	signalvalue1 = getSignal(S4_SRR_RL_Clu_Vel_125);
	write("S4_SRR_RL_Clu_Vel_125 :%f",signalvalue1);
	write("i_S4_SRR_RL_Clu_Vel_125 :%f",@ecu_Signals::i_S4_SRR_RL_Clu_Vel_125);

	testStep("get expect variable value: ","i_S4_SRR_RL_Clu_Vel_125 :%f",@ecu_Signals::i_S4_SRR_RL_Clu_Vel_125);

	if((abs(@ecu_Signals::i_S4_SRR_RL_Clu_Vel_125)*0.9<=abs(signalvalue1))&&(abs(signalvalue1)<=abs(@ecu_Signals::i_S4_SRR_RL_Clu_Vel_125)*1.1))
	{
	testStepPass("Pass","i_S4_SRR_RL_Clu_Vel_125 :%f",signalvalue1);
	}
	else
	{
	testStepFail("Fail","i_S4_SRR_RL_Clu_Vel_125 :%f",signalvalue1);
	}
}

testcase S4_SRR_RL_Clu_Mes_17_S4_SRR_RL_Clu_SNR_125()
{
	signalvalue1 = getSignal(S4_SRR_RL_Clu_SNR_125);
	write("S4_SRR_RL_Clu_SNR_125 :%f",signalvalue1);
	write("i_S4_SRR_RL_Clu_SNR_125 :%f",@ecu_Signals::i_S4_SRR_RL_Clu_SNR_125);

	testStep("get expect variable value: ","i_S4_SRR_RL_Clu_SNR_125 :%f",@ecu_Signals::i_S4_SRR_RL_Clu_SNR_125);

	if((abs(@ecu_Signals::i_S4_SRR_RL_Clu_SNR_125)*0.9<=abs(signalvalue1))&&(abs(signalvalue1)<=abs(@ecu_Signals::i_S4_SRR_RL_Clu_SNR_125)*1.1))
	{
	testStepPass("Pass","i_S4_SRR_RL_Clu_SNR_125 :%f",signalvalue1);
	}
	else
	{
	testStepFail("Fail","i_S4_SRR_RL_Clu_SNR_125 :%f",signalvalue1);
	}
}

testcase S4_SRR_RL_Clu_Mes_17_S4_SRR_RL_Clu_DynProp_125()
{
	signalvalue1 = getSignal(S4_SRR_RL_Clu_DynProp_125);
	write("S4_SRR_RL_Clu_DynProp_125 :%f",signalvalue1);
	write("i_S4_SRR_RL_Clu_DynProp_125 :%o",@ecu_Signals::i_S4_SRR_RL_Clu_DynProp_125);

	testStep("get expect variable value: ","i_S4_SRR_RL_Clu_DynProp_125 :%o",@ecu_Signals::i_S4_SRR_RL_Clu_DynProp_125);

	if(signalvalue1==@ecu_Signals::i_S4_SRR_RL_Clu_DynProp_125)
	{
	testStepPass("Pass","i_S4_SRR_RL_Clu_DynProp_125 :%f",signalvalue1);
	}
	else
	{
	testStepFail("Fail","i_S4_SRR_RL_Clu_DynProp_125 :%f",signalvalue1);
	}
}

testcase S4_SRR_RL_Clu_Mes_17_S4_SRR_RL_Clu_Locationvalid_125()
{
	signalvalue1 = getSignal(S4_SRR_RL_Clu_Locationvalid_125);
	write("S4_SRR_RL_Clu_Locationvalid_125 :%f",signalvalue1);
	write("i_S4_SRR_RL_Clu_Locationvalid_125 :%o",@ecu_Signals::i_S4_SRR_RL_Clu_Locationvalid_125);

	testStep("get expect variable value: ","i_S4_SRR_RL_Clu_Locationvalid_125 :%o",@ecu_Signals::i_S4_SRR_RL_Clu_Locationvalid_125);

	if(signalvalue1==@ecu_Signals::i_S4_SRR_RL_Clu_Locationvalid_125)
	{
	testStepPass("Pass","i_S4_SRR_RL_Clu_Locationvalid_125 :%f",signalvalue1);
	}
	else
	{
	testStepFail("Fail","i_S4_SRR_RL_Clu_Locationvalid_125 :%f",signalvalue1);
	}
}

testcase S4_SRR_RL_Clu_Mes_18_S4_SRR_RL_Clu_Theta_126()
{
	signalvalue1 = getSignal(S4_SRR_RL_Clu_Theta_126);
	write("S4_SRR_RL_Clu_Theta_126 :%f",signalvalue1);
	write("i_S4_SRR_RL_Clu_Theta_126 :%f",@ecu_Signals::i_S4_SRR_RL_Clu_Theta_126);

	testStep("get expect variable value: ","i_S4_SRR_RL_Clu_Theta_126 :%f",@ecu_Signals::i_S4_SRR_RL_Clu_Theta_126);

	if((abs(@ecu_Signals::i_S4_SRR_RL_Clu_Theta_126)*0.9<=abs(signalvalue1))&&(abs(signalvalue1)<=abs(@ecu_Signals::i_S4_SRR_RL_Clu_Theta_126)*1.1))
	{
	testStepPass("Pass","i_S4_SRR_RL_Clu_Theta_126 :%f",signalvalue1);
	}
	else
	{
	testStepFail("Fail","i_S4_SRR_RL_Clu_Theta_126 :%f",signalvalue1);
	}
}

testcase S4_SRR_RL_Clu_Mes_18_S4_SRR_RL_Clu_Dist_126()
{
	signalvalue1 = getSignal(S4_SRR_RL_Clu_Dist_126);
	write("S4_SRR_RL_Clu_Dist_126 :%f",signalvalue1);
	write("i_S4_SRR_RL_Clu_Dist_126 :%f",@ecu_Signals::i_S4_SRR_RL_Clu_Dist_126);

	testStep("get expect variable value: ","i_S4_SRR_RL_Clu_Dist_126 :%f",@ecu_Signals::i_S4_SRR_RL_Clu_Dist_126);

	if((abs(@ecu_Signals::i_S4_SRR_RL_Clu_Dist_126)*0.9<=abs(signalvalue1))&&(abs(signalvalue1)<=abs(@ecu_Signals::i_S4_SRR_RL_Clu_Dist_126)*1.1))
	{
	testStepPass("Pass","i_S4_SRR_RL_Clu_Dist_126 :%f",signalvalue1);
	}
	else
	{
	testStepFail("Fail","i_S4_SRR_RL_Clu_Dist_126 :%f",signalvalue1);
	}
}

testcase S4_SRR_RL_Clu_Mes_18_S4_SRR_RL_Clu_Vel_126()
{
	signalvalue1 = getSignal(S4_SRR_RL_Clu_Vel_126);
	write("S4_SRR_RL_Clu_Vel_126 :%f",signalvalue1);
	write("i_S4_SRR_RL_Clu_Vel_126 :%f",@ecu_Signals::i_S4_SRR_RL_Clu_Vel_126);

	testStep("get expect variable value: ","i_S4_SRR_RL_Clu_Vel_126 :%f",@ecu_Signals::i_S4_SRR_RL_Clu_Vel_126);

	if((abs(@ecu_Signals::i_S4_SRR_RL_Clu_Vel_126)*0.9<=abs(signalvalue1))&&(abs(signalvalue1)<=abs(@ecu_Signals::i_S4_SRR_RL_Clu_Vel_126)*1.1))
	{
	testStepPass("Pass","i_S4_SRR_RL_Clu_Vel_126 :%f",signalvalue1);
	}
	else
	{
	testStepFail("Fail","i_S4_SRR_RL_Clu_Vel_126 :%f",signalvalue1);
	}
}

testcase S4_SRR_RL_Clu_Mes_18_S4_SRR_RL_Clu_SNR_126()
{
	signalvalue1 = getSignal(S4_SRR_RL_Clu_SNR_126);
	write("S4_SRR_RL_Clu_SNR_126 :%f",signalvalue1);
	write("i_S4_SRR_RL_Clu_SNR_126 :%f",@ecu_Signals::i_S4_SRR_RL_Clu_SNR_126);

	testStep("get expect variable value: ","i_S4_SRR_RL_Clu_SNR_126 :%f",@ecu_Signals::i_S4_SRR_RL_Clu_SNR_126);

	if((abs(@ecu_Signals::i_S4_SRR_RL_Clu_SNR_126)*0.9<=abs(signalvalue1))&&(abs(signalvalue1)<=abs(@ecu_Signals::i_S4_SRR_RL_Clu_SNR_126)*1.1))
	{
	testStepPass("Pass","i_S4_SRR_RL_Clu_SNR_126 :%f",signalvalue1);
	}
	else
	{
	testStepFail("Fail","i_S4_SRR_RL_Clu_SNR_126 :%f",signalvalue1);
	}
}

testcase S4_SRR_RL_Clu_Mes_18_S4_SRR_RL_Clu_DynProp_126()
{
	signalvalue1 = getSignal(S4_SRR_RL_Clu_DynProp_126);
	write("S4_SRR_RL_Clu_DynProp_126 :%f",signalvalue1);
	write("i_S4_SRR_RL_Clu_DynProp_126 :%o",@ecu_Signals::i_S4_SRR_RL_Clu_DynProp_126);

	testStep("get expect variable value: ","i_S4_SRR_RL_Clu_DynProp_126 :%o",@ecu_Signals::i_S4_SRR_RL_Clu_DynProp_126);

	if(signalvalue1==@ecu_Signals::i_S4_SRR_RL_Clu_DynProp_126)
	{
	testStepPass("Pass","i_S4_SRR_RL_Clu_DynProp_126 :%f",signalvalue1);
	}
	else
	{
	testStepFail("Fail","i_S4_SRR_RL_Clu_DynProp_126 :%f",signalvalue1);
	}
}

testcase S4_SRR_RL_Clu_Mes_18_S4_SRR_RL_Clu_Locationvalid_126()
{
	signalvalue1 = getSignal(S4_SRR_RL_Clu_Locationvalid_126);
	write("S4_SRR_RL_Clu_Locationvalid_126 :%f",signalvalue1);
	write("i_S4_SRR_RL_Clu_Locationvalid_126 :%o",@ecu_Signals::i_S4_SRR_RL_Clu_Locationvalid_126);

	testStep("get expect variable value: ","i_S4_SRR_RL_Clu_Locationvalid_126 :%o",@ecu_Signals::i_S4_SRR_RL_Clu_Locationvalid_126);

	if(signalvalue1==@ecu_Signals::i_S4_SRR_RL_Clu_Locationvalid_126)
	{
	testStepPass("Pass","i_S4_SRR_RL_Clu_Locationvalid_126 :%f",signalvalue1);
	}
	else
	{
	testStepFail("Fail","i_S4_SRR_RL_Clu_Locationvalid_126 :%f",signalvalue1);
	}
}

testcase S4_SRR_RL_Clu_Mes_18_S4_SRR_RL_Clu_Theta_127()
{
	signalvalue1 = getSignal(S4_SRR_RL_Clu_Theta_127);
	write("S4_SRR_RL_Clu_Theta_127 :%f",signalvalue1);
	write("i_S4_SRR_RL_Clu_Theta_127 :%f",@ecu_Signals::i_S4_SRR_RL_Clu_Theta_127);

	testStep("get expect variable value: ","i_S4_SRR_RL_Clu_Theta_127 :%f",@ecu_Signals::i_S4_SRR_RL_Clu_Theta_127);

	if((abs(@ecu_Signals::i_S4_SRR_RL_Clu_Theta_127)*0.9<=abs(signalvalue1))&&(abs(signalvalue1)<=abs(@ecu_Signals::i_S4_SRR_RL_Clu_Theta_127)*1.1))
	{
	testStepPass("Pass","i_S4_SRR_RL_Clu_Theta_127 :%f",signalvalue1);
	}
	else
	{
	testStepFail("Fail","i_S4_SRR_RL_Clu_Theta_127 :%f",signalvalue1);
	}
}

testcase S4_SRR_RL_Clu_Mes_18_S4_SRR_RL_Clu_Dist_127()
{
	signalvalue1 = getSignal(S4_SRR_RL_Clu_Dist_127);
	write("S4_SRR_RL_Clu_Dist_127 :%f",signalvalue1);
	write("i_S4_SRR_RL_Clu_Dist_127 :%f",@ecu_Signals::i_S4_SRR_RL_Clu_Dist_127);

	testStep("get expect variable value: ","i_S4_SRR_RL_Clu_Dist_127 :%f",@ecu_Signals::i_S4_SRR_RL_Clu_Dist_127);

	if((abs(@ecu_Signals::i_S4_SRR_RL_Clu_Dist_127)*0.9<=abs(signalvalue1))&&(abs(signalvalue1)<=abs(@ecu_Signals::i_S4_SRR_RL_Clu_Dist_127)*1.1))
	{
	testStepPass("Pass","i_S4_SRR_RL_Clu_Dist_127 :%f",signalvalue1);
	}
	else
	{
	testStepFail("Fail","i_S4_SRR_RL_Clu_Dist_127 :%f",signalvalue1);
	}
}

testcase S4_SRR_RL_Clu_Mes_18_S4_SRR_RL_Clu_Vel_127()
{
	signalvalue1 = getSignal(S4_SRR_RL_Clu_Vel_127);
	write("S4_SRR_RL_Clu_Vel_127 :%f",signalvalue1);
	write("i_S4_SRR_RL_Clu_Vel_127 :%f",@ecu_Signals::i_S4_SRR_RL_Clu_Vel_127);

	testStep("get expect variable value: ","i_S4_SRR_RL_Clu_Vel_127 :%f",@ecu_Signals::i_S4_SRR_RL_Clu_Vel_127);

	if((abs(@ecu_Signals::i_S4_SRR_RL_Clu_Vel_127)*0.9<=abs(signalvalue1))&&(abs(signalvalue1)<=abs(@ecu_Signals::i_S4_SRR_RL_Clu_Vel_127)*1.1))
	{
	testStepPass("Pass","i_S4_SRR_RL_Clu_Vel_127 :%f",signalvalue1);
	}
	else
	{
	testStepFail("Fail","i_S4_SRR_RL_Clu_Vel_127 :%f",signalvalue1);
	}
}

testcase S4_SRR_RL_Clu_Mes_18_S4_SRR_RL_Clu_SNR_127()
{
	signalvalue1 = getSignal(S4_SRR_RL_Clu_SNR_127);
	write("S4_SRR_RL_Clu_SNR_127 :%f",signalvalue1);
	write("i_S4_SRR_RL_Clu_SNR_127 :%f",@ecu_Signals::i_S4_SRR_RL_Clu_SNR_127);

	testStep("get expect variable value: ","i_S4_SRR_RL_Clu_SNR_127 :%f",@ecu_Signals::i_S4_SRR_RL_Clu_SNR_127);

	if((abs(@ecu_Signals::i_S4_SRR_RL_Clu_SNR_127)*0.9<=abs(signalvalue1))&&(abs(signalvalue1)<=abs(@ecu_Signals::i_S4_SRR_RL_Clu_SNR_127)*1.1))
	{
	testStepPass("Pass","i_S4_SRR_RL_Clu_SNR_127 :%f",signalvalue1);
	}
	else
	{
	testStepFail("Fail","i_S4_SRR_RL_Clu_SNR_127 :%f",signalvalue1);
	}
}

testcase S4_SRR_RL_Clu_Mes_18_S4_SRR_RL_Clu_DynProp_127()
{
	signalvalue1 = getSignal(S4_SRR_RL_Clu_DynProp_127);
	write("S4_SRR_RL_Clu_DynProp_127 :%f",signalvalue1);
	write("i_S4_SRR_RL_Clu_DynProp_127 :%o",@ecu_Signals::i_S4_SRR_RL_Clu_DynProp_127);

	testStep("get expect variable value: ","i_S4_SRR_RL_Clu_DynProp_127 :%o",@ecu_Signals::i_S4_SRR_RL_Clu_DynProp_127);

	if(signalvalue1==@ecu_Signals::i_S4_SRR_RL_Clu_DynProp_127)
	{
	testStepPass("Pass","i_S4_SRR_RL_Clu_DynProp_127 :%f",signalvalue1);
	}
	else
	{
	testStepFail("Fail","i_S4_SRR_RL_Clu_DynProp_127 :%f",signalvalue1);
	}
}

testcase S4_SRR_RL_Clu_Mes_18_S4_SRR_RL_Clu_Locationvalid_127()
{
	signalvalue1 = getSignal(S4_SRR_RL_Clu_Locationvalid_127);
	write("S4_SRR_RL_Clu_Locationvalid_127 :%f",signalvalue1);
	write("i_S4_SRR_RL_Clu_Locationvalid_127 :%o",@ecu_Signals::i_S4_SRR_RL_Clu_Locationvalid_127);

	testStep("get expect variable value: ","i_S4_SRR_RL_Clu_Locationvalid_127 :%o",@ecu_Signals::i_S4_SRR_RL_Clu_Locationvalid_127);

	if(signalvalue1==@ecu_Signals::i_S4_SRR_RL_Clu_Locationvalid_127)
	{
	testStepPass("Pass","i_S4_SRR_RL_Clu_Locationvalid_127 :%f",signalvalue1);
	}
	else
	{
	testStepFail("Fail","i_S4_SRR_RL_Clu_Locationvalid_127 :%f",signalvalue1);
	}
}

testcase S4_SRR_RL_Clu_Mes_18_S4_SRR_RL_Clu_Theta_128()
{
	signalvalue1 = getSignal(S4_SRR_RL_Clu_Theta_128);
	write("S4_SRR_RL_Clu_Theta_128 :%f",signalvalue1);
	write("i_S4_SRR_RL_Clu_Theta_128 :%f",@ecu_Signals::i_S4_SRR_RL_Clu_Theta_128);

	testStep("get expect variable value: ","i_S4_SRR_RL_Clu_Theta_128 :%f",@ecu_Signals::i_S4_SRR_RL_Clu_Theta_128);

	if((abs(@ecu_Signals::i_S4_SRR_RL_Clu_Theta_128)*0.9<=abs(signalvalue1))&&(abs(signalvalue1)<=abs(@ecu_Signals::i_S4_SRR_RL_Clu_Theta_128)*1.1))
	{
	testStepPass("Pass","i_S4_SRR_RL_Clu_Theta_128 :%f",signalvalue1);
	}
	else
	{
	testStepFail("Fail","i_S4_SRR_RL_Clu_Theta_128 :%f",signalvalue1);
	}
}

testcase S4_SRR_RL_Clu_Mes_18_S4_SRR_RL_Clu_Dist_128()
{
	signalvalue1 = getSignal(S4_SRR_RL_Clu_Dist_128);
	write("S4_SRR_RL_Clu_Dist_128 :%f",signalvalue1);
	write("i_S4_SRR_RL_Clu_Dist_128 :%f",@ecu_Signals::i_S4_SRR_RL_Clu_Dist_128);

	testStep("get expect variable value: ","i_S4_SRR_RL_Clu_Dist_128 :%f",@ecu_Signals::i_S4_SRR_RL_Clu_Dist_128);

	if((abs(@ecu_Signals::i_S4_SRR_RL_Clu_Dist_128)*0.9<=abs(signalvalue1))&&(abs(signalvalue1)<=abs(@ecu_Signals::i_S4_SRR_RL_Clu_Dist_128)*1.1))
	{
	testStepPass("Pass","i_S4_SRR_RL_Clu_Dist_128 :%f",signalvalue1);
	}
	else
	{
	testStepFail("Fail","i_S4_SRR_RL_Clu_Dist_128 :%f",signalvalue1);
	}
}

testcase S4_SRR_RL_Clu_Mes_18_S4_SRR_RL_Clu_Vel_128()
{
	signalvalue1 = getSignal(S4_SRR_RL_Clu_Vel_128);
	write("S4_SRR_RL_Clu_Vel_128 :%f",signalvalue1);
	write("i_S4_SRR_RL_Clu_Vel_128 :%f",@ecu_Signals::i_S4_SRR_RL_Clu_Vel_128);

	testStep("get expect variable value: ","i_S4_SRR_RL_Clu_Vel_128 :%f",@ecu_Signals::i_S4_SRR_RL_Clu_Vel_128);

	if((abs(@ecu_Signals::i_S4_SRR_RL_Clu_Vel_128)*0.9<=abs(signalvalue1))&&(abs(signalvalue1)<=abs(@ecu_Signals::i_S4_SRR_RL_Clu_Vel_128)*1.1))
	{
	testStepPass("Pass","i_S4_SRR_RL_Clu_Vel_128 :%f",signalvalue1);
	}
	else
	{
	testStepFail("Fail","i_S4_SRR_RL_Clu_Vel_128 :%f",signalvalue1);
	}
}

testcase S4_SRR_RL_Clu_Mes_18_S4_SRR_RL_Clu_SNR_128()
{
	signalvalue1 = getSignal(S4_SRR_RL_Clu_SNR_128);
	write("S4_SRR_RL_Clu_SNR_128 :%f",signalvalue1);
	write("i_S4_SRR_RL_Clu_SNR_128 :%f",@ecu_Signals::i_S4_SRR_RL_Clu_SNR_128);

	testStep("get expect variable value: ","i_S4_SRR_RL_Clu_SNR_128 :%f",@ecu_Signals::i_S4_SRR_RL_Clu_SNR_128);

	if((abs(@ecu_Signals::i_S4_SRR_RL_Clu_SNR_128)*0.9<=abs(signalvalue1))&&(abs(signalvalue1)<=abs(@ecu_Signals::i_S4_SRR_RL_Clu_SNR_128)*1.1))
	{
	testStepPass("Pass","i_S4_SRR_RL_Clu_SNR_128 :%f",signalvalue1);
	}
	else
	{
	testStepFail("Fail","i_S4_SRR_RL_Clu_SNR_128 :%f",signalvalue1);
	}
}

testcase S4_SRR_RL_Clu_Mes_18_S4_SRR_RL_Clu_DynProp_128()
{
	signalvalue1 = getSignal(S4_SRR_RL_Clu_DynProp_128);
	write("S4_SRR_RL_Clu_DynProp_128 :%f",signalvalue1);
	write("i_S4_SRR_RL_Clu_DynProp_128 :%o",@ecu_Signals::i_S4_SRR_RL_Clu_DynProp_128);

	testStep("get expect variable value: ","i_S4_SRR_RL_Clu_DynProp_128 :%o",@ecu_Signals::i_S4_SRR_RL_Clu_DynProp_128);

	if(signalvalue1==@ecu_Signals::i_S4_SRR_RL_Clu_DynProp_128)
	{
	testStepPass("Pass","i_S4_SRR_RL_Clu_DynProp_128 :%f",signalvalue1);
	}
	else
	{
	testStepFail("Fail","i_S4_SRR_RL_Clu_DynProp_128 :%f",signalvalue1);
	}
}

testcase S4_SRR_RL_Clu_Mes_18_S4_SRR_RL_Clu_Locationvalid_128()
{
	signalvalue1 = getSignal(S4_SRR_RL_Clu_Locationvalid_128);
	write("S4_SRR_RL_Clu_Locationvalid_128 :%f",signalvalue1);
	write("i_S4_SRR_RL_Clu_Locationvalid_128 :%o",@ecu_Signals::i_S4_SRR_RL_Clu_Locationvalid_128);

	testStep("get expect variable value: ","i_S4_SRR_RL_Clu_Locationvalid_128 :%o",@ecu_Signals::i_S4_SRR_RL_Clu_Locationvalid_128);

	if(signalvalue1==@ecu_Signals::i_S4_SRR_RL_Clu_Locationvalid_128)
	{
	testStepPass("Pass","i_S4_SRR_RL_Clu_Locationvalid_128 :%f",signalvalue1);
	}
	else
	{
	testStepFail("Fail","i_S4_SRR_RL_Clu_Locationvalid_128 :%f",signalvalue1);
	}
}

testcase S4_SRR_RL_Clu_Mes_18_S4_SRR_RL_Clu_Theta_129()
{
	signalvalue1 = getSignal(S4_SRR_RL_Clu_Theta_129);
	write("S4_SRR_RL_Clu_Theta_129 :%f",signalvalue1);
	write("i_S4_SRR_RL_Clu_Theta_129 :%f",@ecu_Signals::i_S4_SRR_RL_Clu_Theta_129);

	testStep("get expect variable value: ","i_S4_SRR_RL_Clu_Theta_129 :%f",@ecu_Signals::i_S4_SRR_RL_Clu_Theta_129);

	if((abs(@ecu_Signals::i_S4_SRR_RL_Clu_Theta_129)*0.9<=abs(signalvalue1))&&(abs(signalvalue1)<=abs(@ecu_Signals::i_S4_SRR_RL_Clu_Theta_129)*1.1))
	{
	testStepPass("Pass","i_S4_SRR_RL_Clu_Theta_129 :%f",signalvalue1);
	}
	else
	{
	testStepFail("Fail","i_S4_SRR_RL_Clu_Theta_129 :%f",signalvalue1);
	}
}

testcase S4_SRR_RL_Clu_Mes_18_S4_SRR_RL_Clu_Dist_129()
{
	signalvalue1 = getSignal(S4_SRR_RL_Clu_Dist_129);
	write("S4_SRR_RL_Clu_Dist_129 :%f",signalvalue1);
	write("i_S4_SRR_RL_Clu_Dist_129 :%f",@ecu_Signals::i_S4_SRR_RL_Clu_Dist_129);

	testStep("get expect variable value: ","i_S4_SRR_RL_Clu_Dist_129 :%f",@ecu_Signals::i_S4_SRR_RL_Clu_Dist_129);

	if((abs(@ecu_Signals::i_S4_SRR_RL_Clu_Dist_129)*0.9<=abs(signalvalue1))&&(abs(signalvalue1)<=abs(@ecu_Signals::i_S4_SRR_RL_Clu_Dist_129)*1.1))
	{
	testStepPass("Pass","i_S4_SRR_RL_Clu_Dist_129 :%f",signalvalue1);
	}
	else
	{
	testStepFail("Fail","i_S4_SRR_RL_Clu_Dist_129 :%f",signalvalue1);
	}
}

testcase S4_SRR_RL_Clu_Mes_18_S4_SRR_RL_Clu_Vel_129()
{
	signalvalue1 = getSignal(S4_SRR_RL_Clu_Vel_129);
	write("S4_SRR_RL_Clu_Vel_129 :%f",signalvalue1);
	write("i_S4_SRR_RL_Clu_Vel_129 :%f",@ecu_Signals::i_S4_SRR_RL_Clu_Vel_129);

	testStep("get expect variable value: ","i_S4_SRR_RL_Clu_Vel_129 :%f",@ecu_Signals::i_S4_SRR_RL_Clu_Vel_129);

	if((abs(@ecu_Signals::i_S4_SRR_RL_Clu_Vel_129)*0.9<=abs(signalvalue1))&&(abs(signalvalue1)<=abs(@ecu_Signals::i_S4_SRR_RL_Clu_Vel_129)*1.1))
	{
	testStepPass("Pass","i_S4_SRR_RL_Clu_Vel_129 :%f",signalvalue1);
	}
	else
	{
	testStepFail("Fail","i_S4_SRR_RL_Clu_Vel_129 :%f",signalvalue1);
	}
}

testcase S4_SRR_RL_Clu_Mes_18_S4_SRR_RL_Clu_SNR_129()
{
	signalvalue1 = getSignal(S4_SRR_RL_Clu_SNR_129);
	write("S4_SRR_RL_Clu_SNR_129 :%f",signalvalue1);
	write("i_S4_SRR_RL_Clu_SNR_129 :%f",@ecu_Signals::i_S4_SRR_RL_Clu_SNR_129);

	testStep("get expect variable value: ","i_S4_SRR_RL_Clu_SNR_129 :%f",@ecu_Signals::i_S4_SRR_RL_Clu_SNR_129);

	if((abs(@ecu_Signals::i_S4_SRR_RL_Clu_SNR_129)*0.9<=abs(signalvalue1))&&(abs(signalvalue1)<=abs(@ecu_Signals::i_S4_SRR_RL_Clu_SNR_129)*1.1))
	{
	testStepPass("Pass","i_S4_SRR_RL_Clu_SNR_129 :%f",signalvalue1);
	}
	else
	{
	testStepFail("Fail","i_S4_SRR_RL_Clu_SNR_129 :%f",signalvalue1);
	}
}

testcase S4_SRR_RL_Clu_Mes_18_S4_SRR_RL_Clu_DynProp_129()
{
	signalvalue1 = getSignal(S4_SRR_RL_Clu_DynProp_129);
	write("S4_SRR_RL_Clu_DynProp_129 :%f",signalvalue1);
	write("i_S4_SRR_RL_Clu_DynProp_129 :%o",@ecu_Signals::i_S4_SRR_RL_Clu_DynProp_129);

	testStep("get expect variable value: ","i_S4_SRR_RL_Clu_DynProp_129 :%o",@ecu_Signals::i_S4_SRR_RL_Clu_DynProp_129);

	if(signalvalue1==@ecu_Signals::i_S4_SRR_RL_Clu_DynProp_129)
	{
	testStepPass("Pass","i_S4_SRR_RL_Clu_DynProp_129 :%f",signalvalue1);
	}
	else
	{
	testStepFail("Fail","i_S4_SRR_RL_Clu_DynProp_129 :%f",signalvalue1);
	}
}

testcase S4_SRR_RL_Clu_Mes_18_S4_SRR_RL_Clu_Locationvalid_129()
{
	signalvalue1 = getSignal(S4_SRR_RL_Clu_Locationvalid_129);
	write("S4_SRR_RL_Clu_Locationvalid_129 :%f",signalvalue1);
	write("i_S4_SRR_RL_Clu_Locationvalid_129 :%o",@ecu_Signals::i_S4_SRR_RL_Clu_Locationvalid_129);

	testStep("get expect variable value: ","i_S4_SRR_RL_Clu_Locationvalid_129 :%o",@ecu_Signals::i_S4_SRR_RL_Clu_Locationvalid_129);

	if(signalvalue1==@ecu_Signals::i_S4_SRR_RL_Clu_Locationvalid_129)
	{
	testStepPass("Pass","i_S4_SRR_RL_Clu_Locationvalid_129 :%f",signalvalue1);
	}
	else
	{
	testStepFail("Fail","i_S4_SRR_RL_Clu_Locationvalid_129 :%f",signalvalue1);
	}
}

testcase S4_SRR_RL_Clu_Mes_18_S4_SRR_RL_Clu_Theta_130()
{
	signalvalue1 = getSignal(S4_SRR_RL_Clu_Theta_130);
	write("S4_SRR_RL_Clu_Theta_130 :%f",signalvalue1);
	write("i_S4_SRR_RL_Clu_Theta_130 :%f",@ecu_Signals::i_S4_SRR_RL_Clu_Theta_130);

	testStep("get expect variable value: ","i_S4_SRR_RL_Clu_Theta_130 :%f",@ecu_Signals::i_S4_SRR_RL_Clu_Theta_130);

	if((abs(@ecu_Signals::i_S4_SRR_RL_Clu_Theta_130)*0.9<=abs(signalvalue1))&&(abs(signalvalue1)<=abs(@ecu_Signals::i_S4_SRR_RL_Clu_Theta_130)*1.1))
	{
	testStepPass("Pass","i_S4_SRR_RL_Clu_Theta_130 :%f",signalvalue1);
	}
	else
	{
	testStepFail("Fail","i_S4_SRR_RL_Clu_Theta_130 :%f",signalvalue1);
	}
}

testcase S4_SRR_RL_Clu_Mes_18_S4_SRR_RL_Clu_Dist_130()
{
	signalvalue1 = getSignal(S4_SRR_RL_Clu_Dist_130);
	write("S4_SRR_RL_Clu_Dist_130 :%f",signalvalue1);
	write("i_S4_SRR_RL_Clu_Dist_130 :%f",@ecu_Signals::i_S4_SRR_RL_Clu_Dist_130);

	testStep("get expect variable value: ","i_S4_SRR_RL_Clu_Dist_130 :%f",@ecu_Signals::i_S4_SRR_RL_Clu_Dist_130);

	if((abs(@ecu_Signals::i_S4_SRR_RL_Clu_Dist_130)*0.9<=abs(signalvalue1))&&(abs(signalvalue1)<=abs(@ecu_Signals::i_S4_SRR_RL_Clu_Dist_130)*1.1))
	{
	testStepPass("Pass","i_S4_SRR_RL_Clu_Dist_130 :%f",signalvalue1);
	}
	else
	{
	testStepFail("Fail","i_S4_SRR_RL_Clu_Dist_130 :%f",signalvalue1);
	}
}

testcase S4_SRR_RL_Clu_Mes_18_S4_SRR_RL_Clu_Vel_130()
{
	signalvalue1 = getSignal(S4_SRR_RL_Clu_Vel_130);
	write("S4_SRR_RL_Clu_Vel_130 :%f",signalvalue1);
	write("i_S4_SRR_RL_Clu_Vel_130 :%f",@ecu_Signals::i_S4_SRR_RL_Clu_Vel_130);

	testStep("get expect variable value: ","i_S4_SRR_RL_Clu_Vel_130 :%f",@ecu_Signals::i_S4_SRR_RL_Clu_Vel_130);

	if((abs(@ecu_Signals::i_S4_SRR_RL_Clu_Vel_130)*0.9<=abs(signalvalue1))&&(abs(signalvalue1)<=abs(@ecu_Signals::i_S4_SRR_RL_Clu_Vel_130)*1.1))
	{
	testStepPass("Pass","i_S4_SRR_RL_Clu_Vel_130 :%f",signalvalue1);
	}
	else
	{
	testStepFail("Fail","i_S4_SRR_RL_Clu_Vel_130 :%f",signalvalue1);
	}
}

testcase S4_SRR_RL_Clu_Mes_18_S4_SRR_RL_Clu_SNR_130()
{
	signalvalue1 = getSignal(S4_SRR_RL_Clu_SNR_130);
	write("S4_SRR_RL_Clu_SNR_130 :%f",signalvalue1);
	write("i_S4_SRR_RL_Clu_SNR_130 :%f",@ecu_Signals::i_S4_SRR_RL_Clu_SNR_130);

	testStep("get expect variable value: ","i_S4_SRR_RL_Clu_SNR_130 :%f",@ecu_Signals::i_S4_SRR_RL_Clu_SNR_130);

	if((abs(@ecu_Signals::i_S4_SRR_RL_Clu_SNR_130)*0.9<=abs(signalvalue1))&&(abs(signalvalue1)<=abs(@ecu_Signals::i_S4_SRR_RL_Clu_SNR_130)*1.1))
	{
	testStepPass("Pass","i_S4_SRR_RL_Clu_SNR_130 :%f",signalvalue1);
	}
	else
	{
	testStepFail("Fail","i_S4_SRR_RL_Clu_SNR_130 :%f",signalvalue1);
	}
}

testcase S4_SRR_RL_Clu_Mes_18_S4_SRR_RL_Clu_DynProp_130()
{
	signalvalue1 = getSignal(S4_SRR_RL_Clu_DynProp_130);
	write("S4_SRR_RL_Clu_DynProp_130 :%f",signalvalue1);
	write("i_S4_SRR_RL_Clu_DynProp_130 :%o",@ecu_Signals::i_S4_SRR_RL_Clu_DynProp_130);

	testStep("get expect variable value: ","i_S4_SRR_RL_Clu_DynProp_130 :%o",@ecu_Signals::i_S4_SRR_RL_Clu_DynProp_130);

	if(signalvalue1==@ecu_Signals::i_S4_SRR_RL_Clu_DynProp_130)
	{
	testStepPass("Pass","i_S4_SRR_RL_Clu_DynProp_130 :%f",signalvalue1);
	}
	else
	{
	testStepFail("Fail","i_S4_SRR_RL_Clu_DynProp_130 :%f",signalvalue1);
	}
}

testcase S4_SRR_RL_Clu_Mes_18_S4_SRR_RL_Clu_Locationvalid_130()
{
	signalvalue1 = getSignal(S4_SRR_RL_Clu_Locationvalid_130);
	write("S4_SRR_RL_Clu_Locationvalid_130 :%f",signalvalue1);
	write("i_S4_SRR_RL_Clu_Locationvalid_130 :%o",@ecu_Signals::i_S4_SRR_RL_Clu_Locationvalid_130);

	testStep("get expect variable value: ","i_S4_SRR_RL_Clu_Locationvalid_130 :%o",@ecu_Signals::i_S4_SRR_RL_Clu_Locationvalid_130);

	if(signalvalue1==@ecu_Signals::i_S4_SRR_RL_Clu_Locationvalid_130)
	{
	testStepPass("Pass","i_S4_SRR_RL_Clu_Locationvalid_130 :%f",signalvalue1);
	}
	else
	{
	testStepFail("Fail","i_S4_SRR_RL_Clu_Locationvalid_130 :%f",signalvalue1);
	}
}

testcase S4_SRR_RL_Clu_Mes_18_S4_SRR_RL_Clu_Theta_131()
{
	signalvalue1 = getSignal(S4_SRR_RL_Clu_Theta_131);
	write("S4_SRR_RL_Clu_Theta_131 :%f",signalvalue1);
	write("i_S4_SRR_RL_Clu_Theta_131 :%f",@ecu_Signals::i_S4_SRR_RL_Clu_Theta_131);

	testStep("get expect variable value: ","i_S4_SRR_RL_Clu_Theta_131 :%f",@ecu_Signals::i_S4_SRR_RL_Clu_Theta_131);

	if((abs(@ecu_Signals::i_S4_SRR_RL_Clu_Theta_131)*0.9<=abs(signalvalue1))&&(abs(signalvalue1)<=abs(@ecu_Signals::i_S4_SRR_RL_Clu_Theta_131)*1.1))
	{
	testStepPass("Pass","i_S4_SRR_RL_Clu_Theta_131 :%f",signalvalue1);
	}
	else
	{
	testStepFail("Fail","i_S4_SRR_RL_Clu_Theta_131 :%f",signalvalue1);
	}
}

testcase S4_SRR_RL_Clu_Mes_18_S4_SRR_RL_Clu_Dist_131()
{
	signalvalue1 = getSignal(S4_SRR_RL_Clu_Dist_131);
	write("S4_SRR_RL_Clu_Dist_131 :%f",signalvalue1);
	write("i_S4_SRR_RL_Clu_Dist_131 :%f",@ecu_Signals::i_S4_SRR_RL_Clu_Dist_131);

	testStep("get expect variable value: ","i_S4_SRR_RL_Clu_Dist_131 :%f",@ecu_Signals::i_S4_SRR_RL_Clu_Dist_131);

	if((abs(@ecu_Signals::i_S4_SRR_RL_Clu_Dist_131)*0.9<=abs(signalvalue1))&&(abs(signalvalue1)<=abs(@ecu_Signals::i_S4_SRR_RL_Clu_Dist_131)*1.1))
	{
	testStepPass("Pass","i_S4_SRR_RL_Clu_Dist_131 :%f",signalvalue1);
	}
	else
	{
	testStepFail("Fail","i_S4_SRR_RL_Clu_Dist_131 :%f",signalvalue1);
	}
}

testcase S4_SRR_RL_Clu_Mes_18_S4_SRR_RL_Clu_Vel_131()
{
	signalvalue1 = getSignal(S4_SRR_RL_Clu_Vel_131);
	write("S4_SRR_RL_Clu_Vel_131 :%f",signalvalue1);
	write("i_S4_SRR_RL_Clu_Vel_131 :%f",@ecu_Signals::i_S4_SRR_RL_Clu_Vel_131);

	testStep("get expect variable value: ","i_S4_SRR_RL_Clu_Vel_131 :%f",@ecu_Signals::i_S4_SRR_RL_Clu_Vel_131);

	if((abs(@ecu_Signals::i_S4_SRR_RL_Clu_Vel_131)*0.9<=abs(signalvalue1))&&(abs(signalvalue1)<=abs(@ecu_Signals::i_S4_SRR_RL_Clu_Vel_131)*1.1))
	{
	testStepPass("Pass","i_S4_SRR_RL_Clu_Vel_131 :%f",signalvalue1);
	}
	else
	{
	testStepFail("Fail","i_S4_SRR_RL_Clu_Vel_131 :%f",signalvalue1);
	}
}

testcase S4_SRR_RL_Clu_Mes_18_S4_SRR_RL_Clu_SNR_131()
{
	signalvalue1 = getSignal(S4_SRR_RL_Clu_SNR_131);
	write("S4_SRR_RL_Clu_SNR_131 :%f",signalvalue1);
	write("i_S4_SRR_RL_Clu_SNR_131 :%f",@ecu_Signals::i_S4_SRR_RL_Clu_SNR_131);

	testStep("get expect variable value: ","i_S4_SRR_RL_Clu_SNR_131 :%f",@ecu_Signals::i_S4_SRR_RL_Clu_SNR_131);

	if((abs(@ecu_Signals::i_S4_SRR_RL_Clu_SNR_131)*0.9<=abs(signalvalue1))&&(abs(signalvalue1)<=abs(@ecu_Signals::i_S4_SRR_RL_Clu_SNR_131)*1.1))
	{
	testStepPass("Pass","i_S4_SRR_RL_Clu_SNR_131 :%f",signalvalue1);
	}
	else
	{
	testStepFail("Fail","i_S4_SRR_RL_Clu_SNR_131 :%f",signalvalue1);
	}
}

testcase S4_SRR_RL_Clu_Mes_18_S4_SRR_RL_Clu_DynProp_131()
{
	signalvalue1 = getSignal(S4_SRR_RL_Clu_DynProp_131);
	write("S4_SRR_RL_Clu_DynProp_131 :%f",signalvalue1);
	write("i_S4_SRR_RL_Clu_DynProp_131 :%o",@ecu_Signals::i_S4_SRR_RL_Clu_DynProp_131);

	testStep("get expect variable value: ","i_S4_SRR_RL_Clu_DynProp_131 :%o",@ecu_Signals::i_S4_SRR_RL_Clu_DynProp_131);

	if(signalvalue1==@ecu_Signals::i_S4_SRR_RL_Clu_DynProp_131)
	{
	testStepPass("Pass","i_S4_SRR_RL_Clu_DynProp_131 :%f",signalvalue1);
	}
	else
	{
	testStepFail("Fail","i_S4_SRR_RL_Clu_DynProp_131 :%f",signalvalue1);
	}
}

testcase S4_SRR_RL_Clu_Mes_18_S4_SRR_RL_Clu_Locationvalid_131()
{
	signalvalue1 = getSignal(S4_SRR_RL_Clu_Locationvalid_131);
	write("S4_SRR_RL_Clu_Locationvalid_131 :%f",signalvalue1);
	write("i_S4_SRR_RL_Clu_Locationvalid_131 :%o",@ecu_Signals::i_S4_SRR_RL_Clu_Locationvalid_131);

	testStep("get expect variable value: ","i_S4_SRR_RL_Clu_Locationvalid_131 :%o",@ecu_Signals::i_S4_SRR_RL_Clu_Locationvalid_131);

	if(signalvalue1==@ecu_Signals::i_S4_SRR_RL_Clu_Locationvalid_131)
	{
	testStepPass("Pass","i_S4_SRR_RL_Clu_Locationvalid_131 :%f",signalvalue1);
	}
	else
	{
	testStepFail("Fail","i_S4_SRR_RL_Clu_Locationvalid_131 :%f",signalvalue1);
	}
}

testcase S4_SRR_RL_Clu_Mes_18_S4_SRR_RL_Clu_Theta_132()
{
	signalvalue1 = getSignal(S4_SRR_RL_Clu_Theta_132);
	write("S4_SRR_RL_Clu_Theta_132 :%f",signalvalue1);
	write("i_S4_SRR_RL_Clu_Theta_132 :%f",@ecu_Signals::i_S4_SRR_RL_Clu_Theta_132);

	testStep("get expect variable value: ","i_S4_SRR_RL_Clu_Theta_132 :%f",@ecu_Signals::i_S4_SRR_RL_Clu_Theta_132);

	if((abs(@ecu_Signals::i_S4_SRR_RL_Clu_Theta_132)*0.9<=abs(signalvalue1))&&(abs(signalvalue1)<=abs(@ecu_Signals::i_S4_SRR_RL_Clu_Theta_132)*1.1))
	{
	testStepPass("Pass","i_S4_SRR_RL_Clu_Theta_132 :%f",signalvalue1);
	}
	else
	{
	testStepFail("Fail","i_S4_SRR_RL_Clu_Theta_132 :%f",signalvalue1);
	}
}

testcase S4_SRR_RL_Clu_Mes_18_S4_SRR_RL_Clu_Dist_132()
{
	signalvalue1 = getSignal(S4_SRR_RL_Clu_Dist_132);
	write("S4_SRR_RL_Clu_Dist_132 :%f",signalvalue1);
	write("i_S4_SRR_RL_Clu_Dist_132 :%f",@ecu_Signals::i_S4_SRR_RL_Clu_Dist_132);

	testStep("get expect variable value: ","i_S4_SRR_RL_Clu_Dist_132 :%f",@ecu_Signals::i_S4_SRR_RL_Clu_Dist_132);

	if((abs(@ecu_Signals::i_S4_SRR_RL_Clu_Dist_132)*0.9<=abs(signalvalue1))&&(abs(signalvalue1)<=abs(@ecu_Signals::i_S4_SRR_RL_Clu_Dist_132)*1.1))
	{
	testStepPass("Pass","i_S4_SRR_RL_Clu_Dist_132 :%f",signalvalue1);
	}
	else
	{
	testStepFail("Fail","i_S4_SRR_RL_Clu_Dist_132 :%f",signalvalue1);
	}
}

testcase S4_SRR_RL_Clu_Mes_18_S4_SRR_RL_Clu_Vel_132()
{
	signalvalue1 = getSignal(S4_SRR_RL_Clu_Vel_132);
	write("S4_SRR_RL_Clu_Vel_132 :%f",signalvalue1);
	write("i_S4_SRR_RL_Clu_Vel_132 :%f",@ecu_Signals::i_S4_SRR_RL_Clu_Vel_132);

	testStep("get expect variable value: ","i_S4_SRR_RL_Clu_Vel_132 :%f",@ecu_Signals::i_S4_SRR_RL_Clu_Vel_132);

	if((abs(@ecu_Signals::i_S4_SRR_RL_Clu_Vel_132)*0.9<=abs(signalvalue1))&&(abs(signalvalue1)<=abs(@ecu_Signals::i_S4_SRR_RL_Clu_Vel_132)*1.1))
	{
	testStepPass("Pass","i_S4_SRR_RL_Clu_Vel_132 :%f",signalvalue1);
	}
	else
	{
	testStepFail("Fail","i_S4_SRR_RL_Clu_Vel_132 :%f",signalvalue1);
	}
}

testcase S4_SRR_RL_Clu_Mes_18_S4_SRR_RL_Clu_SNR_132()
{
	signalvalue1 = getSignal(S4_SRR_RL_Clu_SNR_132);
	write("S4_SRR_RL_Clu_SNR_132 :%f",signalvalue1);
	write("i_S4_SRR_RL_Clu_SNR_132 :%f",@ecu_Signals::i_S4_SRR_RL_Clu_SNR_132);

	testStep("get expect variable value: ","i_S4_SRR_RL_Clu_SNR_132 :%f",@ecu_Signals::i_S4_SRR_RL_Clu_SNR_132);

	if((abs(@ecu_Signals::i_S4_SRR_RL_Clu_SNR_132)*0.9<=abs(signalvalue1))&&(abs(signalvalue1)<=abs(@ecu_Signals::i_S4_SRR_RL_Clu_SNR_132)*1.1))
	{
	testStepPass("Pass","i_S4_SRR_RL_Clu_SNR_132 :%f",signalvalue1);
	}
	else
	{
	testStepFail("Fail","i_S4_SRR_RL_Clu_SNR_132 :%f",signalvalue1);
	}
}

testcase S4_SRR_RL_Clu_Mes_18_S4_SRR_RL_Clu_DynProp_132()
{
	signalvalue1 = getSignal(S4_SRR_RL_Clu_DynProp_132);
	write("S4_SRR_RL_Clu_DynProp_132 :%f",signalvalue1);
	write("i_S4_SRR_RL_Clu_DynProp_132 :%o",@ecu_Signals::i_S4_SRR_RL_Clu_DynProp_132);

	testStep("get expect variable value: ","i_S4_SRR_RL_Clu_DynProp_132 :%o",@ecu_Signals::i_S4_SRR_RL_Clu_DynProp_132);

	if(signalvalue1==@ecu_Signals::i_S4_SRR_RL_Clu_DynProp_132)
	{
	testStepPass("Pass","i_S4_SRR_RL_Clu_DynProp_132 :%f",signalvalue1);
	}
	else
	{
	testStepFail("Fail","i_S4_SRR_RL_Clu_DynProp_132 :%f",signalvalue1);
	}
}

testcase S4_SRR_RL_Clu_Mes_18_S4_SRR_RL_Clu_Locationvalid_132()
{
	signalvalue1 = getSignal(S4_SRR_RL_Clu_Locationvalid_132);
	write("S4_SRR_RL_Clu_Locationvalid_132 :%f",signalvalue1);
	write("i_S4_SRR_RL_Clu_Locationvalid_132 :%o",@ecu_Signals::i_S4_SRR_RL_Clu_Locationvalid_132);

	testStep("get expect variable value: ","i_S4_SRR_RL_Clu_Locationvalid_132 :%o",@ecu_Signals::i_S4_SRR_RL_Clu_Locationvalid_132);

	if(signalvalue1==@ecu_Signals::i_S4_SRR_RL_Clu_Locationvalid_132)
	{
	testStepPass("Pass","i_S4_SRR_RL_Clu_Locationvalid_132 :%f",signalvalue1);
	}
	else
	{
	testStepFail("Fail","i_S4_SRR_RL_Clu_Locationvalid_132 :%f",signalvalue1);
	}
}

testcase S4_SRR_RL_Clu_Mes_19_S4_SRR_RL_Clu_Theta_133()
{
	signalvalue1 = getSignal(S4_SRR_RL_Clu_Theta_133);
	write("S4_SRR_RL_Clu_Theta_133 :%f",signalvalue1);
	write("i_S4_SRR_RL_Clu_Theta_133 :%f",@ecu_Signals::i_S4_SRR_RL_Clu_Theta_133);

	testStep("get expect variable value: ","i_S4_SRR_RL_Clu_Theta_133 :%f",@ecu_Signals::i_S4_SRR_RL_Clu_Theta_133);

	if((abs(@ecu_Signals::i_S4_SRR_RL_Clu_Theta_133)*0.9<=abs(signalvalue1))&&(abs(signalvalue1)<=abs(@ecu_Signals::i_S4_SRR_RL_Clu_Theta_133)*1.1))
	{
	testStepPass("Pass","i_S4_SRR_RL_Clu_Theta_133 :%f",signalvalue1);
	}
	else
	{
	testStepFail("Fail","i_S4_SRR_RL_Clu_Theta_133 :%f",signalvalue1);
	}
}

testcase S4_SRR_RL_Clu_Mes_19_S4_SRR_RL_Clu_Dist_133()
{
	signalvalue1 = getSignal(S4_SRR_RL_Clu_Dist_133);
	write("S4_SRR_RL_Clu_Dist_133 :%f",signalvalue1);
	write("i_S4_SRR_RL_Clu_Dist_133 :%f",@ecu_Signals::i_S4_SRR_RL_Clu_Dist_133);

	testStep("get expect variable value: ","i_S4_SRR_RL_Clu_Dist_133 :%f",@ecu_Signals::i_S4_SRR_RL_Clu_Dist_133);

	if((abs(@ecu_Signals::i_S4_SRR_RL_Clu_Dist_133)*0.9<=abs(signalvalue1))&&(abs(signalvalue1)<=abs(@ecu_Signals::i_S4_SRR_RL_Clu_Dist_133)*1.1))
	{
	testStepPass("Pass","i_S4_SRR_RL_Clu_Dist_133 :%f",signalvalue1);
	}
	else
	{
	testStepFail("Fail","i_S4_SRR_RL_Clu_Dist_133 :%f",signalvalue1);
	}
}

testcase S4_SRR_RL_Clu_Mes_19_S4_SRR_RL_Clu_Vel_133()
{
	signalvalue1 = getSignal(S4_SRR_RL_Clu_Vel_133);
	write("S4_SRR_RL_Clu_Vel_133 :%f",signalvalue1);
	write("i_S4_SRR_RL_Clu_Vel_133 :%f",@ecu_Signals::i_S4_SRR_RL_Clu_Vel_133);

	testStep("get expect variable value: ","i_S4_SRR_RL_Clu_Vel_133 :%f",@ecu_Signals::i_S4_SRR_RL_Clu_Vel_133);

	if((abs(@ecu_Signals::i_S4_SRR_RL_Clu_Vel_133)*0.9<=abs(signalvalue1))&&(abs(signalvalue1)<=abs(@ecu_Signals::i_S4_SRR_RL_Clu_Vel_133)*1.1))
	{
	testStepPass("Pass","i_S4_SRR_RL_Clu_Vel_133 :%f",signalvalue1);
	}
	else
	{
	testStepFail("Fail","i_S4_SRR_RL_Clu_Vel_133 :%f",signalvalue1);
	}
}

testcase S4_SRR_RL_Clu_Mes_19_S4_SRR_RL_Clu_SNR_133()
{
	signalvalue1 = getSignal(S4_SRR_RL_Clu_SNR_133);
	write("S4_SRR_RL_Clu_SNR_133 :%f",signalvalue1);
	write("i_S4_SRR_RL_Clu_SNR_133 :%f",@ecu_Signals::i_S4_SRR_RL_Clu_SNR_133);

	testStep("get expect variable value: ","i_S4_SRR_RL_Clu_SNR_133 :%f",@ecu_Signals::i_S4_SRR_RL_Clu_SNR_133);

	if((abs(@ecu_Signals::i_S4_SRR_RL_Clu_SNR_133)*0.9<=abs(signalvalue1))&&(abs(signalvalue1)<=abs(@ecu_Signals::i_S4_SRR_RL_Clu_SNR_133)*1.1))
	{
	testStepPass("Pass","i_S4_SRR_RL_Clu_SNR_133 :%f",signalvalue1);
	}
	else
	{
	testStepFail("Fail","i_S4_SRR_RL_Clu_SNR_133 :%f",signalvalue1);
	}
}

testcase S4_SRR_RL_Clu_Mes_19_S4_SRR_RL_Clu_DynProp_133()
{
	signalvalue1 = getSignal(S4_SRR_RL_Clu_DynProp_133);
	write("S4_SRR_RL_Clu_DynProp_133 :%f",signalvalue1);
	write("i_S4_SRR_RL_Clu_DynProp_133 :%o",@ecu_Signals::i_S4_SRR_RL_Clu_DynProp_133);

	testStep("get expect variable value: ","i_S4_SRR_RL_Clu_DynProp_133 :%o",@ecu_Signals::i_S4_SRR_RL_Clu_DynProp_133);

	if(signalvalue1==@ecu_Signals::i_S4_SRR_RL_Clu_DynProp_133)
	{
	testStepPass("Pass","i_S4_SRR_RL_Clu_DynProp_133 :%f",signalvalue1);
	}
	else
	{
	testStepFail("Fail","i_S4_SRR_RL_Clu_DynProp_133 :%f",signalvalue1);
	}
}

testcase S4_SRR_RL_Clu_Mes_19_S4_SRR_RL_Clu_Locationvalid_133()
{
	signalvalue1 = getSignal(S4_SRR_RL_Clu_Locationvalid_133);
	write("S4_SRR_RL_Clu_Locationvalid_133 :%f",signalvalue1);
	write("i_S4_SRR_RL_Clu_Locationvalid_133 :%o",@ecu_Signals::i_S4_SRR_RL_Clu_Locationvalid_133);

	testStep("get expect variable value: ","i_S4_SRR_RL_Clu_Locationvalid_133 :%o",@ecu_Signals::i_S4_SRR_RL_Clu_Locationvalid_133);

	if(signalvalue1==@ecu_Signals::i_S4_SRR_RL_Clu_Locationvalid_133)
	{
	testStepPass("Pass","i_S4_SRR_RL_Clu_Locationvalid_133 :%f",signalvalue1);
	}
	else
	{
	testStepFail("Fail","i_S4_SRR_RL_Clu_Locationvalid_133 :%f",signalvalue1);
	}
}

testcase S4_SRR_RL_Clu_Mes_19_S4_SRR_RL_Clu_Theta_134()
{
	signalvalue1 = getSignal(S4_SRR_RL_Clu_Theta_134);
	write("S4_SRR_RL_Clu_Theta_134 :%f",signalvalue1);
	write("i_S4_SRR_RL_Clu_Theta_134 :%f",@ecu_Signals::i_S4_SRR_RL_Clu_Theta_134);

	testStep("get expect variable value: ","i_S4_SRR_RL_Clu_Theta_134 :%f",@ecu_Signals::i_S4_SRR_RL_Clu_Theta_134);

	if((abs(@ecu_Signals::i_S4_SRR_RL_Clu_Theta_134)*0.9<=abs(signalvalue1))&&(abs(signalvalue1)<=abs(@ecu_Signals::i_S4_SRR_RL_Clu_Theta_134)*1.1))
	{
	testStepPass("Pass","i_S4_SRR_RL_Clu_Theta_134 :%f",signalvalue1);
	}
	else
	{
	testStepFail("Fail","i_S4_SRR_RL_Clu_Theta_134 :%f",signalvalue1);
	}
}

testcase S4_SRR_RL_Clu_Mes_19_S4_SRR_RL_Clu_Dist_134()
{
	signalvalue1 = getSignal(S4_SRR_RL_Clu_Dist_134);
	write("S4_SRR_RL_Clu_Dist_134 :%f",signalvalue1);
	write("i_S4_SRR_RL_Clu_Dist_134 :%f",@ecu_Signals::i_S4_SRR_RL_Clu_Dist_134);

	testStep("get expect variable value: ","i_S4_SRR_RL_Clu_Dist_134 :%f",@ecu_Signals::i_S4_SRR_RL_Clu_Dist_134);

	if((abs(@ecu_Signals::i_S4_SRR_RL_Clu_Dist_134)*0.9<=abs(signalvalue1))&&(abs(signalvalue1)<=abs(@ecu_Signals::i_S4_SRR_RL_Clu_Dist_134)*1.1))
	{
	testStepPass("Pass","i_S4_SRR_RL_Clu_Dist_134 :%f",signalvalue1);
	}
	else
	{
	testStepFail("Fail","i_S4_SRR_RL_Clu_Dist_134 :%f",signalvalue1);
	}
}

testcase S4_SRR_RL_Clu_Mes_19_S4_SRR_RL_Clu_Vel_134()
{
	signalvalue1 = getSignal(S4_SRR_RL_Clu_Vel_134);
	write("S4_SRR_RL_Clu_Vel_134 :%f",signalvalue1);
	write("i_S4_SRR_RL_Clu_Vel_134 :%f",@ecu_Signals::i_S4_SRR_RL_Clu_Vel_134);

	testStep("get expect variable value: ","i_S4_SRR_RL_Clu_Vel_134 :%f",@ecu_Signals::i_S4_SRR_RL_Clu_Vel_134);

	if((abs(@ecu_Signals::i_S4_SRR_RL_Clu_Vel_134)*0.9<=abs(signalvalue1))&&(abs(signalvalue1)<=abs(@ecu_Signals::i_S4_SRR_RL_Clu_Vel_134)*1.1))
	{
	testStepPass("Pass","i_S4_SRR_RL_Clu_Vel_134 :%f",signalvalue1);
	}
	else
	{
	testStepFail("Fail","i_S4_SRR_RL_Clu_Vel_134 :%f",signalvalue1);
	}
}

testcase S4_SRR_RL_Clu_Mes_19_S4_SRR_RL_Clu_SNR_134()
{
	signalvalue1 = getSignal(S4_SRR_RL_Clu_SNR_134);
	write("S4_SRR_RL_Clu_SNR_134 :%f",signalvalue1);
	write("i_S4_SRR_RL_Clu_SNR_134 :%f",@ecu_Signals::i_S4_SRR_RL_Clu_SNR_134);

	testStep("get expect variable value: ","i_S4_SRR_RL_Clu_SNR_134 :%f",@ecu_Signals::i_S4_SRR_RL_Clu_SNR_134);

	if((abs(@ecu_Signals::i_S4_SRR_RL_Clu_SNR_134)*0.9<=abs(signalvalue1))&&(abs(signalvalue1)<=abs(@ecu_Signals::i_S4_SRR_RL_Clu_SNR_134)*1.1))
	{
	testStepPass("Pass","i_S4_SRR_RL_Clu_SNR_134 :%f",signalvalue1);
	}
	else
	{
	testStepFail("Fail","i_S4_SRR_RL_Clu_SNR_134 :%f",signalvalue1);
	}
}

testcase S4_SRR_RL_Clu_Mes_19_S4_SRR_RL_Clu_DynProp_134()
{
	signalvalue1 = getSignal(S4_SRR_RL_Clu_DynProp_134);
	write("S4_SRR_RL_Clu_DynProp_134 :%f",signalvalue1);
	write("i_S4_SRR_RL_Clu_DynProp_134 :%o",@ecu_Signals::i_S4_SRR_RL_Clu_DynProp_134);

	testStep("get expect variable value: ","i_S4_SRR_RL_Clu_DynProp_134 :%o",@ecu_Signals::i_S4_SRR_RL_Clu_DynProp_134);

	if(signalvalue1==@ecu_Signals::i_S4_SRR_RL_Clu_DynProp_134)
	{
	testStepPass("Pass","i_S4_SRR_RL_Clu_DynProp_134 :%f",signalvalue1);
	}
	else
	{
	testStepFail("Fail","i_S4_SRR_RL_Clu_DynProp_134 :%f",signalvalue1);
	}
}

testcase S4_SRR_RL_Clu_Mes_19_S4_SRR_RL_Clu_Locationvalid_134()
{
	signalvalue1 = getSignal(S4_SRR_RL_Clu_Locationvalid_134);
	write("S4_SRR_RL_Clu_Locationvalid_134 :%f",signalvalue1);
	write("i_S4_SRR_RL_Clu_Locationvalid_134 :%o",@ecu_Signals::i_S4_SRR_RL_Clu_Locationvalid_134);

	testStep("get expect variable value: ","i_S4_SRR_RL_Clu_Locationvalid_134 :%o",@ecu_Signals::i_S4_SRR_RL_Clu_Locationvalid_134);

	if(signalvalue1==@ecu_Signals::i_S4_SRR_RL_Clu_Locationvalid_134)
	{
	testStepPass("Pass","i_S4_SRR_RL_Clu_Locationvalid_134 :%f",signalvalue1);
	}
	else
	{
	testStepFail("Fail","i_S4_SRR_RL_Clu_Locationvalid_134 :%f",signalvalue1);
	}
}

testcase S4_SRR_RL_Clu_Mes_19_S4_SRR_RL_Clu_Theta_135()
{
	signalvalue1 = getSignal(S4_SRR_RL_Clu_Theta_135);
	write("S4_SRR_RL_Clu_Theta_135 :%f",signalvalue1);
	write("i_S4_SRR_RL_Clu_Theta_135 :%f",@ecu_Signals::i_S4_SRR_RL_Clu_Theta_135);

	testStep("get expect variable value: ","i_S4_SRR_RL_Clu_Theta_135 :%f",@ecu_Signals::i_S4_SRR_RL_Clu_Theta_135);

	if((abs(@ecu_Signals::i_S4_SRR_RL_Clu_Theta_135)*0.9<=abs(signalvalue1))&&(abs(signalvalue1)<=abs(@ecu_Signals::i_S4_SRR_RL_Clu_Theta_135)*1.1))
	{
	testStepPass("Pass","i_S4_SRR_RL_Clu_Theta_135 :%f",signalvalue1);
	}
	else
	{
	testStepFail("Fail","i_S4_SRR_RL_Clu_Theta_135 :%f",signalvalue1);
	}
}

testcase S4_SRR_RL_Clu_Mes_19_S4_SRR_RL_Clu_Dist_135()
{
	signalvalue1 = getSignal(S4_SRR_RL_Clu_Dist_135);
	write("S4_SRR_RL_Clu_Dist_135 :%f",signalvalue1);
	write("i_S4_SRR_RL_Clu_Dist_135 :%f",@ecu_Signals::i_S4_SRR_RL_Clu_Dist_135);

	testStep("get expect variable value: ","i_S4_SRR_RL_Clu_Dist_135 :%f",@ecu_Signals::i_S4_SRR_RL_Clu_Dist_135);

	if((abs(@ecu_Signals::i_S4_SRR_RL_Clu_Dist_135)*0.9<=abs(signalvalue1))&&(abs(signalvalue1)<=abs(@ecu_Signals::i_S4_SRR_RL_Clu_Dist_135)*1.1))
	{
	testStepPass("Pass","i_S4_SRR_RL_Clu_Dist_135 :%f",signalvalue1);
	}
	else
	{
	testStepFail("Fail","i_S4_SRR_RL_Clu_Dist_135 :%f",signalvalue1);
	}
}

testcase S4_SRR_RL_Clu_Mes_19_S4_SRR_RL_Clu_Vel_135()
{
	signalvalue1 = getSignal(S4_SRR_RL_Clu_Vel_135);
	write("S4_SRR_RL_Clu_Vel_135 :%f",signalvalue1);
	write("i_S4_SRR_RL_Clu_Vel_135 :%f",@ecu_Signals::i_S4_SRR_RL_Clu_Vel_135);

	testStep("get expect variable value: ","i_S4_SRR_RL_Clu_Vel_135 :%f",@ecu_Signals::i_S4_SRR_RL_Clu_Vel_135);

	if((abs(@ecu_Signals::i_S4_SRR_RL_Clu_Vel_135)*0.9<=abs(signalvalue1))&&(abs(signalvalue1)<=abs(@ecu_Signals::i_S4_SRR_RL_Clu_Vel_135)*1.1))
	{
	testStepPass("Pass","i_S4_SRR_RL_Clu_Vel_135 :%f",signalvalue1);
	}
	else
	{
	testStepFail("Fail","i_S4_SRR_RL_Clu_Vel_135 :%f",signalvalue1);
	}
}

testcase S4_SRR_RL_Clu_Mes_19_S4_SRR_RL_Clu_SNR_135()
{
	signalvalue1 = getSignal(S4_SRR_RL_Clu_SNR_135);
	write("S4_SRR_RL_Clu_SNR_135 :%f",signalvalue1);
	write("i_S4_SRR_RL_Clu_SNR_135 :%f",@ecu_Signals::i_S4_SRR_RL_Clu_SNR_135);

	testStep("get expect variable value: ","i_S4_SRR_RL_Clu_SNR_135 :%f",@ecu_Signals::i_S4_SRR_RL_Clu_SNR_135);

	if((abs(@ecu_Signals::i_S4_SRR_RL_Clu_SNR_135)*0.9<=abs(signalvalue1))&&(abs(signalvalue1)<=abs(@ecu_Signals::i_S4_SRR_RL_Clu_SNR_135)*1.1))
	{
	testStepPass("Pass","i_S4_SRR_RL_Clu_SNR_135 :%f",signalvalue1);
	}
	else
	{
	testStepFail("Fail","i_S4_SRR_RL_Clu_SNR_135 :%f",signalvalue1);
	}
}

testcase S4_SRR_RL_Clu_Mes_19_S4_SRR_RL_Clu_DynProp_135()
{
	signalvalue1 = getSignal(S4_SRR_RL_Clu_DynProp_135);
	write("S4_SRR_RL_Clu_DynProp_135 :%f",signalvalue1);
	write("i_S4_SRR_RL_Clu_DynProp_135 :%o",@ecu_Signals::i_S4_SRR_RL_Clu_DynProp_135);

	testStep("get expect variable value: ","i_S4_SRR_RL_Clu_DynProp_135 :%o",@ecu_Signals::i_S4_SRR_RL_Clu_DynProp_135);

	if(signalvalue1==@ecu_Signals::i_S4_SRR_RL_Clu_DynProp_135)
	{
	testStepPass("Pass","i_S4_SRR_RL_Clu_DynProp_135 :%f",signalvalue1);
	}
	else
	{
	testStepFail("Fail","i_S4_SRR_RL_Clu_DynProp_135 :%f",signalvalue1);
	}
}

testcase S4_SRR_RL_Clu_Mes_19_S4_SRR_RL_Clu_Locationvalid_135()
{
	signalvalue1 = getSignal(S4_SRR_RL_Clu_Locationvalid_135);
	write("S4_SRR_RL_Clu_Locationvalid_135 :%f",signalvalue1);
	write("i_S4_SRR_RL_Clu_Locationvalid_135 :%o",@ecu_Signals::i_S4_SRR_RL_Clu_Locationvalid_135);

	testStep("get expect variable value: ","i_S4_SRR_RL_Clu_Locationvalid_135 :%o",@ecu_Signals::i_S4_SRR_RL_Clu_Locationvalid_135);

	if(signalvalue1==@ecu_Signals::i_S4_SRR_RL_Clu_Locationvalid_135)
	{
	testStepPass("Pass","i_S4_SRR_RL_Clu_Locationvalid_135 :%f",signalvalue1);
	}
	else
	{
	testStepFail("Fail","i_S4_SRR_RL_Clu_Locationvalid_135 :%f",signalvalue1);
	}
}

testcase S4_SRR_RL_Clu_Mes_19_S4_SRR_RL_Clu_Theta_136()
{
	signalvalue1 = getSignal(S4_SRR_RL_Clu_Theta_136);
	write("S4_SRR_RL_Clu_Theta_136 :%f",signalvalue1);
	write("i_S4_SRR_RL_Clu_Theta_136 :%f",@ecu_Signals::i_S4_SRR_RL_Clu_Theta_136);

	testStep("get expect variable value: ","i_S4_SRR_RL_Clu_Theta_136 :%f",@ecu_Signals::i_S4_SRR_RL_Clu_Theta_136);

	if((abs(@ecu_Signals::i_S4_SRR_RL_Clu_Theta_136)*0.9<=abs(signalvalue1))&&(abs(signalvalue1)<=abs(@ecu_Signals::i_S4_SRR_RL_Clu_Theta_136)*1.1))
	{
	testStepPass("Pass","i_S4_SRR_RL_Clu_Theta_136 :%f",signalvalue1);
	}
	else
	{
	testStepFail("Fail","i_S4_SRR_RL_Clu_Theta_136 :%f",signalvalue1);
	}
}

testcase S4_SRR_RL_Clu_Mes_19_S4_SRR_RL_Clu_Dist_136()
{
	signalvalue1 = getSignal(S4_SRR_RL_Clu_Dist_136);
	write("S4_SRR_RL_Clu_Dist_136 :%f",signalvalue1);
	write("i_S4_SRR_RL_Clu_Dist_136 :%f",@ecu_Signals::i_S4_SRR_RL_Clu_Dist_136);

	testStep("get expect variable value: ","i_S4_SRR_RL_Clu_Dist_136 :%f",@ecu_Signals::i_S4_SRR_RL_Clu_Dist_136);

	if((abs(@ecu_Signals::i_S4_SRR_RL_Clu_Dist_136)*0.9<=abs(signalvalue1))&&(abs(signalvalue1)<=abs(@ecu_Signals::i_S4_SRR_RL_Clu_Dist_136)*1.1))
	{
	testStepPass("Pass","i_S4_SRR_RL_Clu_Dist_136 :%f",signalvalue1);
	}
	else
	{
	testStepFail("Fail","i_S4_SRR_RL_Clu_Dist_136 :%f",signalvalue1);
	}
}

testcase S4_SRR_RL_Clu_Mes_19_S4_SRR_RL_Clu_Vel_136()
{
	signalvalue1 = getSignal(S4_SRR_RL_Clu_Vel_136);
	write("S4_SRR_RL_Clu_Vel_136 :%f",signalvalue1);
	write("i_S4_SRR_RL_Clu_Vel_136 :%f",@ecu_Signals::i_S4_SRR_RL_Clu_Vel_136);

	testStep("get expect variable value: ","i_S4_SRR_RL_Clu_Vel_136 :%f",@ecu_Signals::i_S4_SRR_RL_Clu_Vel_136);

	if((abs(@ecu_Signals::i_S4_SRR_RL_Clu_Vel_136)*0.9<=abs(signalvalue1))&&(abs(signalvalue1)<=abs(@ecu_Signals::i_S4_SRR_RL_Clu_Vel_136)*1.1))
	{
	testStepPass("Pass","i_S4_SRR_RL_Clu_Vel_136 :%f",signalvalue1);
	}
	else
	{
	testStepFail("Fail","i_S4_SRR_RL_Clu_Vel_136 :%f",signalvalue1);
	}
}

testcase S4_SRR_RL_Clu_Mes_19_S4_SRR_RL_Clu_SNR_136()
{
	signalvalue1 = getSignal(S4_SRR_RL_Clu_SNR_136);
	write("S4_SRR_RL_Clu_SNR_136 :%f",signalvalue1);
	write("i_S4_SRR_RL_Clu_SNR_136 :%f",@ecu_Signals::i_S4_SRR_RL_Clu_SNR_136);

	testStep("get expect variable value: ","i_S4_SRR_RL_Clu_SNR_136 :%f",@ecu_Signals::i_S4_SRR_RL_Clu_SNR_136);

	if((abs(@ecu_Signals::i_S4_SRR_RL_Clu_SNR_136)*0.9<=abs(signalvalue1))&&(abs(signalvalue1)<=abs(@ecu_Signals::i_S4_SRR_RL_Clu_SNR_136)*1.1))
	{
	testStepPass("Pass","i_S4_SRR_RL_Clu_SNR_136 :%f",signalvalue1);
	}
	else
	{
	testStepFail("Fail","i_S4_SRR_RL_Clu_SNR_136 :%f",signalvalue1);
	}
}

testcase S4_SRR_RL_Clu_Mes_19_S4_SRR_RL_Clu_DynProp_136()
{
	signalvalue1 = getSignal(S4_SRR_RL_Clu_DynProp_136);
	write("S4_SRR_RL_Clu_DynProp_136 :%f",signalvalue1);
	write("i_S4_SRR_RL_Clu_DynProp_136 :%o",@ecu_Signals::i_S4_SRR_RL_Clu_DynProp_136);

	testStep("get expect variable value: ","i_S4_SRR_RL_Clu_DynProp_136 :%o",@ecu_Signals::i_S4_SRR_RL_Clu_DynProp_136);

	if(signalvalue1==@ecu_Signals::i_S4_SRR_RL_Clu_DynProp_136)
	{
	testStepPass("Pass","i_S4_SRR_RL_Clu_DynProp_136 :%f",signalvalue1);
	}
	else
	{
	testStepFail("Fail","i_S4_SRR_RL_Clu_DynProp_136 :%f",signalvalue1);
	}
}

testcase S4_SRR_RL_Clu_Mes_19_S4_SRR_RL_Clu_Locationvalid_136()
{
	signalvalue1 = getSignal(S4_SRR_RL_Clu_Locationvalid_136);
	write("S4_SRR_RL_Clu_Locationvalid_136 :%f",signalvalue1);
	write("i_S4_SRR_RL_Clu_Locationvalid_136 :%o",@ecu_Signals::i_S4_SRR_RL_Clu_Locationvalid_136);

	testStep("get expect variable value: ","i_S4_SRR_RL_Clu_Locationvalid_136 :%o",@ecu_Signals::i_S4_SRR_RL_Clu_Locationvalid_136);

	if(signalvalue1==@ecu_Signals::i_S4_SRR_RL_Clu_Locationvalid_136)
	{
	testStepPass("Pass","i_S4_SRR_RL_Clu_Locationvalid_136 :%f",signalvalue1);
	}
	else
	{
	testStepFail("Fail","i_S4_SRR_RL_Clu_Locationvalid_136 :%f",signalvalue1);
	}
}

testcase S4_SRR_RL_Clu_Mes_19_S4_SRR_RL_Clu_Theta_137()
{
	signalvalue1 = getSignal(S4_SRR_RL_Clu_Theta_137);
	write("S4_SRR_RL_Clu_Theta_137 :%f",signalvalue1);
	write("i_S4_SRR_RL_Clu_Theta_137 :%f",@ecu_Signals::i_S4_SRR_RL_Clu_Theta_137);

	testStep("get expect variable value: ","i_S4_SRR_RL_Clu_Theta_137 :%f",@ecu_Signals::i_S4_SRR_RL_Clu_Theta_137);

	if((abs(@ecu_Signals::i_S4_SRR_RL_Clu_Theta_137)*0.9<=abs(signalvalue1))&&(abs(signalvalue1)<=abs(@ecu_Signals::i_S4_SRR_RL_Clu_Theta_137)*1.1))
	{
	testStepPass("Pass","i_S4_SRR_RL_Clu_Theta_137 :%f",signalvalue1);
	}
	else
	{
	testStepFail("Fail","i_S4_SRR_RL_Clu_Theta_137 :%f",signalvalue1);
	}
}

testcase S4_SRR_RL_Clu_Mes_19_S4_SRR_RL_Clu_Dist_137()
{
	signalvalue1 = getSignal(S4_SRR_RL_Clu_Dist_137);
	write("S4_SRR_RL_Clu_Dist_137 :%f",signalvalue1);
	write("i_S4_SRR_RL_Clu_Dist_137 :%f",@ecu_Signals::i_S4_SRR_RL_Clu_Dist_137);

	testStep("get expect variable value: ","i_S4_SRR_RL_Clu_Dist_137 :%f",@ecu_Signals::i_S4_SRR_RL_Clu_Dist_137);

	if((abs(@ecu_Signals::i_S4_SRR_RL_Clu_Dist_137)*0.9<=abs(signalvalue1))&&(abs(signalvalue1)<=abs(@ecu_Signals::i_S4_SRR_RL_Clu_Dist_137)*1.1))
	{
	testStepPass("Pass","i_S4_SRR_RL_Clu_Dist_137 :%f",signalvalue1);
	}
	else
	{
	testStepFail("Fail","i_S4_SRR_RL_Clu_Dist_137 :%f",signalvalue1);
	}
}

testcase S4_SRR_RL_Clu_Mes_19_S4_SRR_RL_Clu_Vel_137()
{
	signalvalue1 = getSignal(S4_SRR_RL_Clu_Vel_137);
	write("S4_SRR_RL_Clu_Vel_137 :%f",signalvalue1);
	write("i_S4_SRR_RL_Clu_Vel_137 :%f",@ecu_Signals::i_S4_SRR_RL_Clu_Vel_137);

	testStep("get expect variable value: ","i_S4_SRR_RL_Clu_Vel_137 :%f",@ecu_Signals::i_S4_SRR_RL_Clu_Vel_137);

	if((abs(@ecu_Signals::i_S4_SRR_RL_Clu_Vel_137)*0.9<=abs(signalvalue1))&&(abs(signalvalue1)<=abs(@ecu_Signals::i_S4_SRR_RL_Clu_Vel_137)*1.1))
	{
	testStepPass("Pass","i_S4_SRR_RL_Clu_Vel_137 :%f",signalvalue1);
	}
	else
	{
	testStepFail("Fail","i_S4_SRR_RL_Clu_Vel_137 :%f",signalvalue1);
	}
}

testcase S4_SRR_RL_Clu_Mes_19_S4_SRR_RL_Clu_SNR_137()
{
	signalvalue1 = getSignal(S4_SRR_RL_Clu_SNR_137);
	write("S4_SRR_RL_Clu_SNR_137 :%f",signalvalue1);
	write("i_S4_SRR_RL_Clu_SNR_137 :%f",@ecu_Signals::i_S4_SRR_RL_Clu_SNR_137);

	testStep("get expect variable value: ","i_S4_SRR_RL_Clu_SNR_137 :%f",@ecu_Signals::i_S4_SRR_RL_Clu_SNR_137);

	if((abs(@ecu_Signals::i_S4_SRR_RL_Clu_SNR_137)*0.9<=abs(signalvalue1))&&(abs(signalvalue1)<=abs(@ecu_Signals::i_S4_SRR_RL_Clu_SNR_137)*1.1))
	{
	testStepPass("Pass","i_S4_SRR_RL_Clu_SNR_137 :%f",signalvalue1);
	}
	else
	{
	testStepFail("Fail","i_S4_SRR_RL_Clu_SNR_137 :%f",signalvalue1);
	}
}

testcase S4_SRR_RL_Clu_Mes_19_S4_SRR_RL_Clu_DynProp_137()
{
	signalvalue1 = getSignal(S4_SRR_RL_Clu_DynProp_137);
	write("S4_SRR_RL_Clu_DynProp_137 :%f",signalvalue1);
	write("i_S4_SRR_RL_Clu_DynProp_137 :%o",@ecu_Signals::i_S4_SRR_RL_Clu_DynProp_137);

	testStep("get expect variable value: ","i_S4_SRR_RL_Clu_DynProp_137 :%o",@ecu_Signals::i_S4_SRR_RL_Clu_DynProp_137);

	if(signalvalue1==@ecu_Signals::i_S4_SRR_RL_Clu_DynProp_137)
	{
	testStepPass("Pass","i_S4_SRR_RL_Clu_DynProp_137 :%f",signalvalue1);
	}
	else
	{
	testStepFail("Fail","i_S4_SRR_RL_Clu_DynProp_137 :%f",signalvalue1);
	}
}

testcase S4_SRR_RL_Clu_Mes_19_S4_SRR_RL_Clu_Locationvalid_137()
{
	signalvalue1 = getSignal(S4_SRR_RL_Clu_Locationvalid_137);
	write("S4_SRR_RL_Clu_Locationvalid_137 :%f",signalvalue1);
	write("i_S4_SRR_RL_Clu_Locationvalid_137 :%o",@ecu_Signals::i_S4_SRR_RL_Clu_Locationvalid_137);

	testStep("get expect variable value: ","i_S4_SRR_RL_Clu_Locationvalid_137 :%o",@ecu_Signals::i_S4_SRR_RL_Clu_Locationvalid_137);

	if(signalvalue1==@ecu_Signals::i_S4_SRR_RL_Clu_Locationvalid_137)
	{
	testStepPass("Pass","i_S4_SRR_RL_Clu_Locationvalid_137 :%f",signalvalue1);
	}
	else
	{
	testStepFail("Fail","i_S4_SRR_RL_Clu_Locationvalid_137 :%f",signalvalue1);
	}
}

testcase S4_SRR_RL_Clu_Mes_19_S4_SRR_RL_Clu_Theta_138()
{
	signalvalue1 = getSignal(S4_SRR_RL_Clu_Theta_138);
	write("S4_SRR_RL_Clu_Theta_138 :%f",signalvalue1);
	write("i_S4_SRR_RL_Clu_Theta_138 :%f",@ecu_Signals::i_S4_SRR_RL_Clu_Theta_138);

	testStep("get expect variable value: ","i_S4_SRR_RL_Clu_Theta_138 :%f",@ecu_Signals::i_S4_SRR_RL_Clu_Theta_138);

	if((abs(@ecu_Signals::i_S4_SRR_RL_Clu_Theta_138)*0.9<=abs(signalvalue1))&&(abs(signalvalue1)<=abs(@ecu_Signals::i_S4_SRR_RL_Clu_Theta_138)*1.1))
	{
	testStepPass("Pass","i_S4_SRR_RL_Clu_Theta_138 :%f",signalvalue1);
	}
	else
	{
	testStepFail("Fail","i_S4_SRR_RL_Clu_Theta_138 :%f",signalvalue1);
	}
}

testcase S4_SRR_RL_Clu_Mes_19_S4_SRR_RL_Clu_Dist_138()
{
	signalvalue1 = getSignal(S4_SRR_RL_Clu_Dist_138);
	write("S4_SRR_RL_Clu_Dist_138 :%f",signalvalue1);
	write("i_S4_SRR_RL_Clu_Dist_138 :%f",@ecu_Signals::i_S4_SRR_RL_Clu_Dist_138);

	testStep("get expect variable value: ","i_S4_SRR_RL_Clu_Dist_138 :%f",@ecu_Signals::i_S4_SRR_RL_Clu_Dist_138);

	if((abs(@ecu_Signals::i_S4_SRR_RL_Clu_Dist_138)*0.9<=abs(signalvalue1))&&(abs(signalvalue1)<=abs(@ecu_Signals::i_S4_SRR_RL_Clu_Dist_138)*1.1))
	{
	testStepPass("Pass","i_S4_SRR_RL_Clu_Dist_138 :%f",signalvalue1);
	}
	else
	{
	testStepFail("Fail","i_S4_SRR_RL_Clu_Dist_138 :%f",signalvalue1);
	}
}

testcase S4_SRR_RL_Clu_Mes_19_S4_SRR_RL_Clu_Vel_138()
{
	signalvalue1 = getSignal(S4_SRR_RL_Clu_Vel_138);
	write("S4_SRR_RL_Clu_Vel_138 :%f",signalvalue1);
	write("i_S4_SRR_RL_Clu_Vel_138 :%f",@ecu_Signals::i_S4_SRR_RL_Clu_Vel_138);

	testStep("get expect variable value: ","i_S4_SRR_RL_Clu_Vel_138 :%f",@ecu_Signals::i_S4_SRR_RL_Clu_Vel_138);

	if((abs(@ecu_Signals::i_S4_SRR_RL_Clu_Vel_138)*0.9<=abs(signalvalue1))&&(abs(signalvalue1)<=abs(@ecu_Signals::i_S4_SRR_RL_Clu_Vel_138)*1.1))
	{
	testStepPass("Pass","i_S4_SRR_RL_Clu_Vel_138 :%f",signalvalue1);
	}
	else
	{
	testStepFail("Fail","i_S4_SRR_RL_Clu_Vel_138 :%f",signalvalue1);
	}
}

testcase S4_SRR_RL_Clu_Mes_19_S4_SRR_RL_Clu_SNR_138()
{
	signalvalue1 = getSignal(S4_SRR_RL_Clu_SNR_138);
	write("S4_SRR_RL_Clu_SNR_138 :%f",signalvalue1);
	write("i_S4_SRR_RL_Clu_SNR_138 :%f",@ecu_Signals::i_S4_SRR_RL_Clu_SNR_138);

	testStep("get expect variable value: ","i_S4_SRR_RL_Clu_SNR_138 :%f",@ecu_Signals::i_S4_SRR_RL_Clu_SNR_138);

	if((abs(@ecu_Signals::i_S4_SRR_RL_Clu_SNR_138)*0.9<=abs(signalvalue1))&&(abs(signalvalue1)<=abs(@ecu_Signals::i_S4_SRR_RL_Clu_SNR_138)*1.1))
	{
	testStepPass("Pass","i_S4_SRR_RL_Clu_SNR_138 :%f",signalvalue1);
	}
	else
	{
	testStepFail("Fail","i_S4_SRR_RL_Clu_SNR_138 :%f",signalvalue1);
	}
}

testcase S4_SRR_RL_Clu_Mes_19_S4_SRR_RL_Clu_DynProp_138()
{
	signalvalue1 = getSignal(S4_SRR_RL_Clu_DynProp_138);
	write("S4_SRR_RL_Clu_DynProp_138 :%f",signalvalue1);
	write("i_S4_SRR_RL_Clu_DynProp_138 :%o",@ecu_Signals::i_S4_SRR_RL_Clu_DynProp_138);

	testStep("get expect variable value: ","i_S4_SRR_RL_Clu_DynProp_138 :%o",@ecu_Signals::i_S4_SRR_RL_Clu_DynProp_138);

	if(signalvalue1==@ecu_Signals::i_S4_SRR_RL_Clu_DynProp_138)
	{
	testStepPass("Pass","i_S4_SRR_RL_Clu_DynProp_138 :%f",signalvalue1);
	}
	else
	{
	testStepFail("Fail","i_S4_SRR_RL_Clu_DynProp_138 :%f",signalvalue1);
	}
}

testcase S4_SRR_RL_Clu_Mes_19_S4_SRR_RL_Clu_Locationvalid_138()
{
	signalvalue1 = getSignal(S4_SRR_RL_Clu_Locationvalid_138);
	write("S4_SRR_RL_Clu_Locationvalid_138 :%f",signalvalue1);
	write("i_S4_SRR_RL_Clu_Locationvalid_138 :%o",@ecu_Signals::i_S4_SRR_RL_Clu_Locationvalid_138);

	testStep("get expect variable value: ","i_S4_SRR_RL_Clu_Locationvalid_138 :%o",@ecu_Signals::i_S4_SRR_RL_Clu_Locationvalid_138);

	if(signalvalue1==@ecu_Signals::i_S4_SRR_RL_Clu_Locationvalid_138)
	{
	testStepPass("Pass","i_S4_SRR_RL_Clu_Locationvalid_138 :%f",signalvalue1);
	}
	else
	{
	testStepFail("Fail","i_S4_SRR_RL_Clu_Locationvalid_138 :%f",signalvalue1);
	}
}

testcase S4_SRR_RL_Clu_Mes_19_S4_SRR_RL_Clu_Theta_139()
{
	signalvalue1 = getSignal(S4_SRR_RL_Clu_Theta_139);
	write("S4_SRR_RL_Clu_Theta_139 :%f",signalvalue1);
	write("i_S4_SRR_RL_Clu_Theta_139 :%f",@ecu_Signals::i_S4_SRR_RL_Clu_Theta_139);

	testStep("get expect variable value: ","i_S4_SRR_RL_Clu_Theta_139 :%f",@ecu_Signals::i_S4_SRR_RL_Clu_Theta_139);

	if((abs(@ecu_Signals::i_S4_SRR_RL_Clu_Theta_139)*0.9<=abs(signalvalue1))&&(abs(signalvalue1)<=abs(@ecu_Signals::i_S4_SRR_RL_Clu_Theta_139)*1.1))
	{
	testStepPass("Pass","i_S4_SRR_RL_Clu_Theta_139 :%f",signalvalue1);
	}
	else
	{
	testStepFail("Fail","i_S4_SRR_RL_Clu_Theta_139 :%f",signalvalue1);
	}
}

testcase S4_SRR_RL_Clu_Mes_19_S4_SRR_RL_Clu_Dist_139()
{
	signalvalue1 = getSignal(S4_SRR_RL_Clu_Dist_139);
	write("S4_SRR_RL_Clu_Dist_139 :%f",signalvalue1);
	write("i_S4_SRR_RL_Clu_Dist_139 :%f",@ecu_Signals::i_S4_SRR_RL_Clu_Dist_139);

	testStep("get expect variable value: ","i_S4_SRR_RL_Clu_Dist_139 :%f",@ecu_Signals::i_S4_SRR_RL_Clu_Dist_139);

	if((abs(@ecu_Signals::i_S4_SRR_RL_Clu_Dist_139)*0.9<=abs(signalvalue1))&&(abs(signalvalue1)<=abs(@ecu_Signals::i_S4_SRR_RL_Clu_Dist_139)*1.1))
	{
	testStepPass("Pass","i_S4_SRR_RL_Clu_Dist_139 :%f",signalvalue1);
	}
	else
	{
	testStepFail("Fail","i_S4_SRR_RL_Clu_Dist_139 :%f",signalvalue1);
	}
}

testcase S4_SRR_RL_Clu_Mes_19_S4_SRR_RL_Clu_Vel_139()
{
	signalvalue1 = getSignal(S4_SRR_RL_Clu_Vel_139);
	write("S4_SRR_RL_Clu_Vel_139 :%f",signalvalue1);
	write("i_S4_SRR_RL_Clu_Vel_139 :%f",@ecu_Signals::i_S4_SRR_RL_Clu_Vel_139);

	testStep("get expect variable value: ","i_S4_SRR_RL_Clu_Vel_139 :%f",@ecu_Signals::i_S4_SRR_RL_Clu_Vel_139);

	if((abs(@ecu_Signals::i_S4_SRR_RL_Clu_Vel_139)*0.9<=abs(signalvalue1))&&(abs(signalvalue1)<=abs(@ecu_Signals::i_S4_SRR_RL_Clu_Vel_139)*1.1))
	{
	testStepPass("Pass","i_S4_SRR_RL_Clu_Vel_139 :%f",signalvalue1);
	}
	else
	{
	testStepFail("Fail","i_S4_SRR_RL_Clu_Vel_139 :%f",signalvalue1);
	}
}

testcase S4_SRR_RL_Clu_Mes_19_S4_SRR_RL_Clu_SNR_139()
{
	signalvalue1 = getSignal(S4_SRR_RL_Clu_SNR_139);
	write("S4_SRR_RL_Clu_SNR_139 :%f",signalvalue1);
	write("i_S4_SRR_RL_Clu_SNR_139 :%f",@ecu_Signals::i_S4_SRR_RL_Clu_SNR_139);

	testStep("get expect variable value: ","i_S4_SRR_RL_Clu_SNR_139 :%f",@ecu_Signals::i_S4_SRR_RL_Clu_SNR_139);

	if((abs(@ecu_Signals::i_S4_SRR_RL_Clu_SNR_139)*0.9<=abs(signalvalue1))&&(abs(signalvalue1)<=abs(@ecu_Signals::i_S4_SRR_RL_Clu_SNR_139)*1.1))
	{
	testStepPass("Pass","i_S4_SRR_RL_Clu_SNR_139 :%f",signalvalue1);
	}
	else
	{
	testStepFail("Fail","i_S4_SRR_RL_Clu_SNR_139 :%f",signalvalue1);
	}
}

testcase S4_SRR_RL_Clu_Mes_19_S4_SRR_RL_Clu_DynProp_139()
{
	signalvalue1 = getSignal(S4_SRR_RL_Clu_DynProp_139);
	write("S4_SRR_RL_Clu_DynProp_139 :%f",signalvalue1);
	write("i_S4_SRR_RL_Clu_DynProp_139 :%o",@ecu_Signals::i_S4_SRR_RL_Clu_DynProp_139);

	testStep("get expect variable value: ","i_S4_SRR_RL_Clu_DynProp_139 :%o",@ecu_Signals::i_S4_SRR_RL_Clu_DynProp_139);

	if(signalvalue1==@ecu_Signals::i_S4_SRR_RL_Clu_DynProp_139)
	{
	testStepPass("Pass","i_S4_SRR_RL_Clu_DynProp_139 :%f",signalvalue1);
	}
	else
	{
	testStepFail("Fail","i_S4_SRR_RL_Clu_DynProp_139 :%f",signalvalue1);
	}
}

testcase S4_SRR_RL_Clu_Mes_19_S4_SRR_RL_Clu_Locationvalid_139()
{
	signalvalue1 = getSignal(S4_SRR_RL_Clu_Locationvalid_139);
	write("S4_SRR_RL_Clu_Locationvalid_139 :%f",signalvalue1);
	write("i_S4_SRR_RL_Clu_Locationvalid_139 :%o",@ecu_Signals::i_S4_SRR_RL_Clu_Locationvalid_139);

	testStep("get expect variable value: ","i_S4_SRR_RL_Clu_Locationvalid_139 :%o",@ecu_Signals::i_S4_SRR_RL_Clu_Locationvalid_139);

	if(signalvalue1==@ecu_Signals::i_S4_SRR_RL_Clu_Locationvalid_139)
	{
	testStepPass("Pass","i_S4_SRR_RL_Clu_Locationvalid_139 :%f",signalvalue1);
	}
	else
	{
	testStepFail("Fail","i_S4_SRR_RL_Clu_Locationvalid_139 :%f",signalvalue1);
	}
}

testcase S4_SRR_RL_Clu_Mes_20_S4_SRR_RL_Clu_Theta_140()
{
	signalvalue1 = getSignal(S4_SRR_RL_Clu_Theta_140);
	write("S4_SRR_RL_Clu_Theta_140 :%f",signalvalue1);
	write("i_S4_SRR_RL_Clu_Theta_140 :%f",@ecu_Signals::i_S4_SRR_RL_Clu_Theta_140);

	testStep("get expect variable value: ","i_S4_SRR_RL_Clu_Theta_140 :%f",@ecu_Signals::i_S4_SRR_RL_Clu_Theta_140);

	if((abs(@ecu_Signals::i_S4_SRR_RL_Clu_Theta_140)*0.9<=abs(signalvalue1))&&(abs(signalvalue1)<=abs(@ecu_Signals::i_S4_SRR_RL_Clu_Theta_140)*1.1))
	{
	testStepPass("Pass","i_S4_SRR_RL_Clu_Theta_140 :%f",signalvalue1);
	}
	else
	{
	testStepFail("Fail","i_S4_SRR_RL_Clu_Theta_140 :%f",signalvalue1);
	}
}

testcase S4_SRR_RL_Clu_Mes_20_S4_SRR_RL_Clu_Dist_140()
{
	signalvalue1 = getSignal(S4_SRR_RL_Clu_Dist_140);
	write("S4_SRR_RL_Clu_Dist_140 :%f",signalvalue1);
	write("i_S4_SRR_RL_Clu_Dist_140 :%f",@ecu_Signals::i_S4_SRR_RL_Clu_Dist_140);

	testStep("get expect variable value: ","i_S4_SRR_RL_Clu_Dist_140 :%f",@ecu_Signals::i_S4_SRR_RL_Clu_Dist_140);

	if((abs(@ecu_Signals::i_S4_SRR_RL_Clu_Dist_140)*0.9<=abs(signalvalue1))&&(abs(signalvalue1)<=abs(@ecu_Signals::i_S4_SRR_RL_Clu_Dist_140)*1.1))
	{
	testStepPass("Pass","i_S4_SRR_RL_Clu_Dist_140 :%f",signalvalue1);
	}
	else
	{
	testStepFail("Fail","i_S4_SRR_RL_Clu_Dist_140 :%f",signalvalue1);
	}
}

testcase S4_SRR_RL_Clu_Mes_20_S4_SRR_RL_Clu_Vel_140()
{
	signalvalue1 = getSignal(S4_SRR_RL_Clu_Vel_140);
	write("S4_SRR_RL_Clu_Vel_140 :%f",signalvalue1);
	write("i_S4_SRR_RL_Clu_Vel_140 :%f",@ecu_Signals::i_S4_SRR_RL_Clu_Vel_140);

	testStep("get expect variable value: ","i_S4_SRR_RL_Clu_Vel_140 :%f",@ecu_Signals::i_S4_SRR_RL_Clu_Vel_140);

	if((abs(@ecu_Signals::i_S4_SRR_RL_Clu_Vel_140)*0.9<=abs(signalvalue1))&&(abs(signalvalue1)<=abs(@ecu_Signals::i_S4_SRR_RL_Clu_Vel_140)*1.1))
	{
	testStepPass("Pass","i_S4_SRR_RL_Clu_Vel_140 :%f",signalvalue1);
	}
	else
	{
	testStepFail("Fail","i_S4_SRR_RL_Clu_Vel_140 :%f",signalvalue1);
	}
}

testcase S4_SRR_RL_Clu_Mes_20_S4_SRR_RL_Clu_SNR_140()
{
	signalvalue1 = getSignal(S4_SRR_RL_Clu_SNR_140);
	write("S4_SRR_RL_Clu_SNR_140 :%f",signalvalue1);
	write("i_S4_SRR_RL_Clu_SNR_140 :%f",@ecu_Signals::i_S4_SRR_RL_Clu_SNR_140);

	testStep("get expect variable value: ","i_S4_SRR_RL_Clu_SNR_140 :%f",@ecu_Signals::i_S4_SRR_RL_Clu_SNR_140);

	if((abs(@ecu_Signals::i_S4_SRR_RL_Clu_SNR_140)*0.9<=abs(signalvalue1))&&(abs(signalvalue1)<=abs(@ecu_Signals::i_S4_SRR_RL_Clu_SNR_140)*1.1))
	{
	testStepPass("Pass","i_S4_SRR_RL_Clu_SNR_140 :%f",signalvalue1);
	}
	else
	{
	testStepFail("Fail","i_S4_SRR_RL_Clu_SNR_140 :%f",signalvalue1);
	}
}

testcase S4_SRR_RL_Clu_Mes_20_S4_SRR_RL_Clu_DynProp_140()
{
	signalvalue1 = getSignal(S4_SRR_RL_Clu_DynProp_140);
	write("S4_SRR_RL_Clu_DynProp_140 :%f",signalvalue1);
	write("i_S4_SRR_RL_Clu_DynProp_140 :%o",@ecu_Signals::i_S4_SRR_RL_Clu_DynProp_140);

	testStep("get expect variable value: ","i_S4_SRR_RL_Clu_DynProp_140 :%o",@ecu_Signals::i_S4_SRR_RL_Clu_DynProp_140);

	if(signalvalue1==@ecu_Signals::i_S4_SRR_RL_Clu_DynProp_140)
	{
	testStepPass("Pass","i_S4_SRR_RL_Clu_DynProp_140 :%f",signalvalue1);
	}
	else
	{
	testStepFail("Fail","i_S4_SRR_RL_Clu_DynProp_140 :%f",signalvalue1);
	}
}

testcase S4_SRR_RL_Clu_Mes_20_S4_SRR_RL_Clu_Locationvalid_140()
{
	signalvalue1 = getSignal(S4_SRR_RL_Clu_Locationvalid_140);
	write("S4_SRR_RL_Clu_Locationvalid_140 :%f",signalvalue1);
	write("i_S4_SRR_RL_Clu_Locationvalid_140 :%o",@ecu_Signals::i_S4_SRR_RL_Clu_Locationvalid_140);

	testStep("get expect variable value: ","i_S4_SRR_RL_Clu_Locationvalid_140 :%o",@ecu_Signals::i_S4_SRR_RL_Clu_Locationvalid_140);

	if(signalvalue1==@ecu_Signals::i_S4_SRR_RL_Clu_Locationvalid_140)
	{
	testStepPass("Pass","i_S4_SRR_RL_Clu_Locationvalid_140 :%f",signalvalue1);
	}
	else
	{
	testStepFail("Fail","i_S4_SRR_RL_Clu_Locationvalid_140 :%f",signalvalue1);
	}
}

testcase S4_SRR_RL_Clu_Mes_20_S4_SRR_RL_Clu_Theta_141()
{
	signalvalue1 = getSignal(S4_SRR_RL_Clu_Theta_141);
	write("S4_SRR_RL_Clu_Theta_141 :%f",signalvalue1);
	write("i_S4_SRR_RL_Clu_Theta_141 :%f",@ecu_Signals::i_S4_SRR_RL_Clu_Theta_141);

	testStep("get expect variable value: ","i_S4_SRR_RL_Clu_Theta_141 :%f",@ecu_Signals::i_S4_SRR_RL_Clu_Theta_141);

	if((abs(@ecu_Signals::i_S4_SRR_RL_Clu_Theta_141)*0.9<=abs(signalvalue1))&&(abs(signalvalue1)<=abs(@ecu_Signals::i_S4_SRR_RL_Clu_Theta_141)*1.1))
	{
	testStepPass("Pass","i_S4_SRR_RL_Clu_Theta_141 :%f",signalvalue1);
	}
	else
	{
	testStepFail("Fail","i_S4_SRR_RL_Clu_Theta_141 :%f",signalvalue1);
	}
}

testcase S4_SRR_RL_Clu_Mes_20_S4_SRR_RL_Clu_Dist_141()
{
	signalvalue1 = getSignal(S4_SRR_RL_Clu_Dist_141);
	write("S4_SRR_RL_Clu_Dist_141 :%f",signalvalue1);
	write("i_S4_SRR_RL_Clu_Dist_141 :%f",@ecu_Signals::i_S4_SRR_RL_Clu_Dist_141);

	testStep("get expect variable value: ","i_S4_SRR_RL_Clu_Dist_141 :%f",@ecu_Signals::i_S4_SRR_RL_Clu_Dist_141);

	if((abs(@ecu_Signals::i_S4_SRR_RL_Clu_Dist_141)*0.9<=abs(signalvalue1))&&(abs(signalvalue1)<=abs(@ecu_Signals::i_S4_SRR_RL_Clu_Dist_141)*1.1))
	{
	testStepPass("Pass","i_S4_SRR_RL_Clu_Dist_141 :%f",signalvalue1);
	}
	else
	{
	testStepFail("Fail","i_S4_SRR_RL_Clu_Dist_141 :%f",signalvalue1);
	}
}

testcase S4_SRR_RL_Clu_Mes_20_S4_SRR_RL_Clu_Vel_141()
{
	signalvalue1 = getSignal(S4_SRR_RL_Clu_Vel_141);
	write("S4_SRR_RL_Clu_Vel_141 :%f",signalvalue1);
	write("i_S4_SRR_RL_Clu_Vel_141 :%f",@ecu_Signals::i_S4_SRR_RL_Clu_Vel_141);

	testStep("get expect variable value: ","i_S4_SRR_RL_Clu_Vel_141 :%f",@ecu_Signals::i_S4_SRR_RL_Clu_Vel_141);

	if((abs(@ecu_Signals::i_S4_SRR_RL_Clu_Vel_141)*0.9<=abs(signalvalue1))&&(abs(signalvalue1)<=abs(@ecu_Signals::i_S4_SRR_RL_Clu_Vel_141)*1.1))
	{
	testStepPass("Pass","i_S4_SRR_RL_Clu_Vel_141 :%f",signalvalue1);
	}
	else
	{
	testStepFail("Fail","i_S4_SRR_RL_Clu_Vel_141 :%f",signalvalue1);
	}
}

testcase S4_SRR_RL_Clu_Mes_20_S4_SRR_RL_Clu_SNR_141()
{
	signalvalue1 = getSignal(S4_SRR_RL_Clu_SNR_141);
	write("S4_SRR_RL_Clu_SNR_141 :%f",signalvalue1);
	write("i_S4_SRR_RL_Clu_SNR_141 :%f",@ecu_Signals::i_S4_SRR_RL_Clu_SNR_141);

	testStep("get expect variable value: ","i_S4_SRR_RL_Clu_SNR_141 :%f",@ecu_Signals::i_S4_SRR_RL_Clu_SNR_141);

	if((abs(@ecu_Signals::i_S4_SRR_RL_Clu_SNR_141)*0.9<=abs(signalvalue1))&&(abs(signalvalue1)<=abs(@ecu_Signals::i_S4_SRR_RL_Clu_SNR_141)*1.1))
	{
	testStepPass("Pass","i_S4_SRR_RL_Clu_SNR_141 :%f",signalvalue1);
	}
	else
	{
	testStepFail("Fail","i_S4_SRR_RL_Clu_SNR_141 :%f",signalvalue1);
	}
}

testcase S4_SRR_RL_Clu_Mes_20_S4_SRR_RL_Clu_DynProp_141()
{
	signalvalue1 = getSignal(S4_SRR_RL_Clu_DynProp_141);
	write("S4_SRR_RL_Clu_DynProp_141 :%f",signalvalue1);
	write("i_S4_SRR_RL_Clu_DynProp_141 :%o",@ecu_Signals::i_S4_SRR_RL_Clu_DynProp_141);

	testStep("get expect variable value: ","i_S4_SRR_RL_Clu_DynProp_141 :%o",@ecu_Signals::i_S4_SRR_RL_Clu_DynProp_141);

	if(signalvalue1==@ecu_Signals::i_S4_SRR_RL_Clu_DynProp_141)
	{
	testStepPass("Pass","i_S4_SRR_RL_Clu_DynProp_141 :%f",signalvalue1);
	}
	else
	{
	testStepFail("Fail","i_S4_SRR_RL_Clu_DynProp_141 :%f",signalvalue1);
	}
}

testcase S4_SRR_RL_Clu_Mes_20_S4_SRR_RL_Clu_Locationvalid_141()
{
	signalvalue1 = getSignal(S4_SRR_RL_Clu_Locationvalid_141);
	write("S4_SRR_RL_Clu_Locationvalid_141 :%f",signalvalue1);
	write("i_S4_SRR_RL_Clu_Locationvalid_141 :%o",@ecu_Signals::i_S4_SRR_RL_Clu_Locationvalid_141);

	testStep("get expect variable value: ","i_S4_SRR_RL_Clu_Locationvalid_141 :%o",@ecu_Signals::i_S4_SRR_RL_Clu_Locationvalid_141);

	if(signalvalue1==@ecu_Signals::i_S4_SRR_RL_Clu_Locationvalid_141)
	{
	testStepPass("Pass","i_S4_SRR_RL_Clu_Locationvalid_141 :%f",signalvalue1);
	}
	else
	{
	testStepFail("Fail","i_S4_SRR_RL_Clu_Locationvalid_141 :%f",signalvalue1);
	}
}

testcase S4_SRR_RL_Clu_Mes_20_S4_SRR_RL_Clu_Theta_142()
{
	signalvalue1 = getSignal(S4_SRR_RL_Clu_Theta_142);
	write("S4_SRR_RL_Clu_Theta_142 :%f",signalvalue1);
	write("i_S4_SRR_RL_Clu_Theta_142 :%f",@ecu_Signals::i_S4_SRR_RL_Clu_Theta_142);

	testStep("get expect variable value: ","i_S4_SRR_RL_Clu_Theta_142 :%f",@ecu_Signals::i_S4_SRR_RL_Clu_Theta_142);

	if((abs(@ecu_Signals::i_S4_SRR_RL_Clu_Theta_142)*0.9<=abs(signalvalue1))&&(abs(signalvalue1)<=abs(@ecu_Signals::i_S4_SRR_RL_Clu_Theta_142)*1.1))
	{
	testStepPass("Pass","i_S4_SRR_RL_Clu_Theta_142 :%f",signalvalue1);
	}
	else
	{
	testStepFail("Fail","i_S4_SRR_RL_Clu_Theta_142 :%f",signalvalue1);
	}
}

testcase S4_SRR_RL_Clu_Mes_20_S4_SRR_RL_Clu_Dist_142()
{
	signalvalue1 = getSignal(S4_SRR_RL_Clu_Dist_142);
	write("S4_SRR_RL_Clu_Dist_142 :%f",signalvalue1);
	write("i_S4_SRR_RL_Clu_Dist_142 :%f",@ecu_Signals::i_S4_SRR_RL_Clu_Dist_142);

	testStep("get expect variable value: ","i_S4_SRR_RL_Clu_Dist_142 :%f",@ecu_Signals::i_S4_SRR_RL_Clu_Dist_142);

	if((abs(@ecu_Signals::i_S4_SRR_RL_Clu_Dist_142)*0.9<=abs(signalvalue1))&&(abs(signalvalue1)<=abs(@ecu_Signals::i_S4_SRR_RL_Clu_Dist_142)*1.1))
	{
	testStepPass("Pass","i_S4_SRR_RL_Clu_Dist_142 :%f",signalvalue1);
	}
	else
	{
	testStepFail("Fail","i_S4_SRR_RL_Clu_Dist_142 :%f",signalvalue1);
	}
}

testcase S4_SRR_RL_Clu_Mes_20_S4_SRR_RL_Clu_Vel_142()
{
	signalvalue1 = getSignal(S4_SRR_RL_Clu_Vel_142);
	write("S4_SRR_RL_Clu_Vel_142 :%f",signalvalue1);
	write("i_S4_SRR_RL_Clu_Vel_142 :%f",@ecu_Signals::i_S4_SRR_RL_Clu_Vel_142);

	testStep("get expect variable value: ","i_S4_SRR_RL_Clu_Vel_142 :%f",@ecu_Signals::i_S4_SRR_RL_Clu_Vel_142);

	if((abs(@ecu_Signals::i_S4_SRR_RL_Clu_Vel_142)*0.9<=abs(signalvalue1))&&(abs(signalvalue1)<=abs(@ecu_Signals::i_S4_SRR_RL_Clu_Vel_142)*1.1))
	{
	testStepPass("Pass","i_S4_SRR_RL_Clu_Vel_142 :%f",signalvalue1);
	}
	else
	{
	testStepFail("Fail","i_S4_SRR_RL_Clu_Vel_142 :%f",signalvalue1);
	}
}

testcase S4_SRR_RL_Clu_Mes_20_S4_SRR_RL_Clu_SNR_142()
{
	signalvalue1 = getSignal(S4_SRR_RL_Clu_SNR_142);
	write("S4_SRR_RL_Clu_SNR_142 :%f",signalvalue1);
	write("i_S4_SRR_RL_Clu_SNR_142 :%f",@ecu_Signals::i_S4_SRR_RL_Clu_SNR_142);

	testStep("get expect variable value: ","i_S4_SRR_RL_Clu_SNR_142 :%f",@ecu_Signals::i_S4_SRR_RL_Clu_SNR_142);

	if((abs(@ecu_Signals::i_S4_SRR_RL_Clu_SNR_142)*0.9<=abs(signalvalue1))&&(abs(signalvalue1)<=abs(@ecu_Signals::i_S4_SRR_RL_Clu_SNR_142)*1.1))
	{
	testStepPass("Pass","i_S4_SRR_RL_Clu_SNR_142 :%f",signalvalue1);
	}
	else
	{
	testStepFail("Fail","i_S4_SRR_RL_Clu_SNR_142 :%f",signalvalue1);
	}
}

testcase S4_SRR_RL_Clu_Mes_20_S4_SRR_RL_Clu_DynProp_142()
{
	signalvalue1 = getSignal(S4_SRR_RL_Clu_DynProp_142);
	write("S4_SRR_RL_Clu_DynProp_142 :%f",signalvalue1);
	write("i_S4_SRR_RL_Clu_DynProp_142 :%o",@ecu_Signals::i_S4_SRR_RL_Clu_DynProp_142);

	testStep("get expect variable value: ","i_S4_SRR_RL_Clu_DynProp_142 :%o",@ecu_Signals::i_S4_SRR_RL_Clu_DynProp_142);

	if(signalvalue1==@ecu_Signals::i_S4_SRR_RL_Clu_DynProp_142)
	{
	testStepPass("Pass","i_S4_SRR_RL_Clu_DynProp_142 :%f",signalvalue1);
	}
	else
	{
	testStepFail("Fail","i_S4_SRR_RL_Clu_DynProp_142 :%f",signalvalue1);
	}
}

testcase S4_SRR_RL_Clu_Mes_20_S4_SRR_RL_Clu_Locationvalid_142()
{
	signalvalue1 = getSignal(S4_SRR_RL_Clu_Locationvalid_142);
	write("S4_SRR_RL_Clu_Locationvalid_142 :%f",signalvalue1);
	write("i_S4_SRR_RL_Clu_Locationvalid_142 :%o",@ecu_Signals::i_S4_SRR_RL_Clu_Locationvalid_142);

	testStep("get expect variable value: ","i_S4_SRR_RL_Clu_Locationvalid_142 :%o",@ecu_Signals::i_S4_SRR_RL_Clu_Locationvalid_142);

	if(signalvalue1==@ecu_Signals::i_S4_SRR_RL_Clu_Locationvalid_142)
	{
	testStepPass("Pass","i_S4_SRR_RL_Clu_Locationvalid_142 :%f",signalvalue1);
	}
	else
	{
	testStepFail("Fail","i_S4_SRR_RL_Clu_Locationvalid_142 :%f",signalvalue1);
	}
}

testcase S4_SRR_RL_Clu_Mes_20_S4_SRR_RL_Clu_Theta_143()
{
	signalvalue1 = getSignal(S4_SRR_RL_Clu_Theta_143);
	write("S4_SRR_RL_Clu_Theta_143 :%f",signalvalue1);
	write("i_S4_SRR_RL_Clu_Theta_143 :%f",@ecu_Signals::i_S4_SRR_RL_Clu_Theta_143);

	testStep("get expect variable value: ","i_S4_SRR_RL_Clu_Theta_143 :%f",@ecu_Signals::i_S4_SRR_RL_Clu_Theta_143);

	if((abs(@ecu_Signals::i_S4_SRR_RL_Clu_Theta_143)*0.9<=abs(signalvalue1))&&(abs(signalvalue1)<=abs(@ecu_Signals::i_S4_SRR_RL_Clu_Theta_143)*1.1))
	{
	testStepPass("Pass","i_S4_SRR_RL_Clu_Theta_143 :%f",signalvalue1);
	}
	else
	{
	testStepFail("Fail","i_S4_SRR_RL_Clu_Theta_143 :%f",signalvalue1);
	}
}

testcase S4_SRR_RL_Clu_Mes_20_S4_SRR_RL_Clu_Dist_143()
{
	signalvalue1 = getSignal(S4_SRR_RL_Clu_Dist_143);
	write("S4_SRR_RL_Clu_Dist_143 :%f",signalvalue1);
	write("i_S4_SRR_RL_Clu_Dist_143 :%f",@ecu_Signals::i_S4_SRR_RL_Clu_Dist_143);

	testStep("get expect variable value: ","i_S4_SRR_RL_Clu_Dist_143 :%f",@ecu_Signals::i_S4_SRR_RL_Clu_Dist_143);

	if((abs(@ecu_Signals::i_S4_SRR_RL_Clu_Dist_143)*0.9<=abs(signalvalue1))&&(abs(signalvalue1)<=abs(@ecu_Signals::i_S4_SRR_RL_Clu_Dist_143)*1.1))
	{
	testStepPass("Pass","i_S4_SRR_RL_Clu_Dist_143 :%f",signalvalue1);
	}
	else
	{
	testStepFail("Fail","i_S4_SRR_RL_Clu_Dist_143 :%f",signalvalue1);
	}
}

testcase S4_SRR_RL_Clu_Mes_20_S4_SRR_RL_Clu_Vel_143()
{
	signalvalue1 = getSignal(S4_SRR_RL_Clu_Vel_143);
	write("S4_SRR_RL_Clu_Vel_143 :%f",signalvalue1);
	write("i_S4_SRR_RL_Clu_Vel_143 :%f",@ecu_Signals::i_S4_SRR_RL_Clu_Vel_143);

	testStep("get expect variable value: ","i_S4_SRR_RL_Clu_Vel_143 :%f",@ecu_Signals::i_S4_SRR_RL_Clu_Vel_143);

	if((abs(@ecu_Signals::i_S4_SRR_RL_Clu_Vel_143)*0.9<=abs(signalvalue1))&&(abs(signalvalue1)<=abs(@ecu_Signals::i_S4_SRR_RL_Clu_Vel_143)*1.1))
	{
	testStepPass("Pass","i_S4_SRR_RL_Clu_Vel_143 :%f",signalvalue1);
	}
	else
	{
	testStepFail("Fail","i_S4_SRR_RL_Clu_Vel_143 :%f",signalvalue1);
	}
}

testcase S4_SRR_RL_Clu_Mes_20_S4_SRR_RL_Clu_SNR_143()
{
	signalvalue1 = getSignal(S4_SRR_RL_Clu_SNR_143);
	write("S4_SRR_RL_Clu_SNR_143 :%f",signalvalue1);
	write("i_S4_SRR_RL_Clu_SNR_143 :%f",@ecu_Signals::i_S4_SRR_RL_Clu_SNR_143);

	testStep("get expect variable value: ","i_S4_SRR_RL_Clu_SNR_143 :%f",@ecu_Signals::i_S4_SRR_RL_Clu_SNR_143);

	if((abs(@ecu_Signals::i_S4_SRR_RL_Clu_SNR_143)*0.9<=abs(signalvalue1))&&(abs(signalvalue1)<=abs(@ecu_Signals::i_S4_SRR_RL_Clu_SNR_143)*1.1))
	{
	testStepPass("Pass","i_S4_SRR_RL_Clu_SNR_143 :%f",signalvalue1);
	}
	else
	{
	testStepFail("Fail","i_S4_SRR_RL_Clu_SNR_143 :%f",signalvalue1);
	}
}

testcase S4_SRR_RL_Clu_Mes_20_S4_SRR_RL_Clu_DynProp_143()
{
	signalvalue1 = getSignal(S4_SRR_RL_Clu_DynProp_143);
	write("S4_SRR_RL_Clu_DynProp_143 :%f",signalvalue1);
	write("i_S4_SRR_RL_Clu_DynProp_143 :%o",@ecu_Signals::i_S4_SRR_RL_Clu_DynProp_143);

	testStep("get expect variable value: ","i_S4_SRR_RL_Clu_DynProp_143 :%o",@ecu_Signals::i_S4_SRR_RL_Clu_DynProp_143);

	if(signalvalue1==@ecu_Signals::i_S4_SRR_RL_Clu_DynProp_143)
	{
	testStepPass("Pass","i_S4_SRR_RL_Clu_DynProp_143 :%f",signalvalue1);
	}
	else
	{
	testStepFail("Fail","i_S4_SRR_RL_Clu_DynProp_143 :%f",signalvalue1);
	}
}

testcase S4_SRR_RL_Clu_Mes_20_S4_SRR_RL_Clu_Locationvalid_143()
{
	signalvalue1 = getSignal(S4_SRR_RL_Clu_Locationvalid_143);
	write("S4_SRR_RL_Clu_Locationvalid_143 :%f",signalvalue1);
	write("i_S4_SRR_RL_Clu_Locationvalid_143 :%o",@ecu_Signals::i_S4_SRR_RL_Clu_Locationvalid_143);

	testStep("get expect variable value: ","i_S4_SRR_RL_Clu_Locationvalid_143 :%o",@ecu_Signals::i_S4_SRR_RL_Clu_Locationvalid_143);

	if(signalvalue1==@ecu_Signals::i_S4_SRR_RL_Clu_Locationvalid_143)
	{
	testStepPass("Pass","i_S4_SRR_RL_Clu_Locationvalid_143 :%f",signalvalue1);
	}
	else
	{
	testStepFail("Fail","i_S4_SRR_RL_Clu_Locationvalid_143 :%f",signalvalue1);
	}
}

testcase S4_SRR_RL_Clu_Mes_20_S4_SRR_RL_Clu_Theta_144()
{
	signalvalue1 = getSignal(S4_SRR_RL_Clu_Theta_144);
	write("S4_SRR_RL_Clu_Theta_144 :%f",signalvalue1);
	write("i_S4_SRR_RL_Clu_Theta_144 :%f",@ecu_Signals::i_S4_SRR_RL_Clu_Theta_144);

	testStep("get expect variable value: ","i_S4_SRR_RL_Clu_Theta_144 :%f",@ecu_Signals::i_S4_SRR_RL_Clu_Theta_144);

	if((abs(@ecu_Signals::i_S4_SRR_RL_Clu_Theta_144)*0.9<=abs(signalvalue1))&&(abs(signalvalue1)<=abs(@ecu_Signals::i_S4_SRR_RL_Clu_Theta_144)*1.1))
	{
	testStepPass("Pass","i_S4_SRR_RL_Clu_Theta_144 :%f",signalvalue1);
	}
	else
	{
	testStepFail("Fail","i_S4_SRR_RL_Clu_Theta_144 :%f",signalvalue1);
	}
}

testcase S4_SRR_RL_Clu_Mes_20_S4_SRR_RL_Clu_Dist_144()
{
	signalvalue1 = getSignal(S4_SRR_RL_Clu_Dist_144);
	write("S4_SRR_RL_Clu_Dist_144 :%f",signalvalue1);
	write("i_S4_SRR_RL_Clu_Dist_144 :%f",@ecu_Signals::i_S4_SRR_RL_Clu_Dist_144);

	testStep("get expect variable value: ","i_S4_SRR_RL_Clu_Dist_144 :%f",@ecu_Signals::i_S4_SRR_RL_Clu_Dist_144);

	if((abs(@ecu_Signals::i_S4_SRR_RL_Clu_Dist_144)*0.9<=abs(signalvalue1))&&(abs(signalvalue1)<=abs(@ecu_Signals::i_S4_SRR_RL_Clu_Dist_144)*1.1))
	{
	testStepPass("Pass","i_S4_SRR_RL_Clu_Dist_144 :%f",signalvalue1);
	}
	else
	{
	testStepFail("Fail","i_S4_SRR_RL_Clu_Dist_144 :%f",signalvalue1);
	}
}

testcase S4_SRR_RL_Clu_Mes_20_S4_SRR_RL_Clu_Vel_144()
{
	signalvalue1 = getSignal(S4_SRR_RL_Clu_Vel_144);
	write("S4_SRR_RL_Clu_Vel_144 :%f",signalvalue1);
	write("i_S4_SRR_RL_Clu_Vel_144 :%f",@ecu_Signals::i_S4_SRR_RL_Clu_Vel_144);

	testStep("get expect variable value: ","i_S4_SRR_RL_Clu_Vel_144 :%f",@ecu_Signals::i_S4_SRR_RL_Clu_Vel_144);

	if((abs(@ecu_Signals::i_S4_SRR_RL_Clu_Vel_144)*0.9<=abs(signalvalue1))&&(abs(signalvalue1)<=abs(@ecu_Signals::i_S4_SRR_RL_Clu_Vel_144)*1.1))
	{
	testStepPass("Pass","i_S4_SRR_RL_Clu_Vel_144 :%f",signalvalue1);
	}
	else
	{
	testStepFail("Fail","i_S4_SRR_RL_Clu_Vel_144 :%f",signalvalue1);
	}
}

testcase S4_SRR_RL_Clu_Mes_20_S4_SRR_RL_Clu_SNR_144()
{
	signalvalue1 = getSignal(S4_SRR_RL_Clu_SNR_144);
	write("S4_SRR_RL_Clu_SNR_144 :%f",signalvalue1);
	write("i_S4_SRR_RL_Clu_SNR_144 :%f",@ecu_Signals::i_S4_SRR_RL_Clu_SNR_144);

	testStep("get expect variable value: ","i_S4_SRR_RL_Clu_SNR_144 :%f",@ecu_Signals::i_S4_SRR_RL_Clu_SNR_144);

	if((abs(@ecu_Signals::i_S4_SRR_RL_Clu_SNR_144)*0.9<=abs(signalvalue1))&&(abs(signalvalue1)<=abs(@ecu_Signals::i_S4_SRR_RL_Clu_SNR_144)*1.1))
	{
	testStepPass("Pass","i_S4_SRR_RL_Clu_SNR_144 :%f",signalvalue1);
	}
	else
	{
	testStepFail("Fail","i_S4_SRR_RL_Clu_SNR_144 :%f",signalvalue1);
	}
}

testcase S4_SRR_RL_Clu_Mes_20_S4_SRR_RL_Clu_DynProp_144()
{
	signalvalue1 = getSignal(S4_SRR_RL_Clu_DynProp_144);
	write("S4_SRR_RL_Clu_DynProp_144 :%f",signalvalue1);
	write("i_S4_SRR_RL_Clu_DynProp_144 :%o",@ecu_Signals::i_S4_SRR_RL_Clu_DynProp_144);

	testStep("get expect variable value: ","i_S4_SRR_RL_Clu_DynProp_144 :%o",@ecu_Signals::i_S4_SRR_RL_Clu_DynProp_144);

	if(signalvalue1==@ecu_Signals::i_S4_SRR_RL_Clu_DynProp_144)
	{
	testStepPass("Pass","i_S4_SRR_RL_Clu_DynProp_144 :%f",signalvalue1);
	}
	else
	{
	testStepFail("Fail","i_S4_SRR_RL_Clu_DynProp_144 :%f",signalvalue1);
	}
}

testcase S4_SRR_RL_Clu_Mes_20_S4_SRR_RL_Clu_Locationvalid_144()
{
	signalvalue1 = getSignal(S4_SRR_RL_Clu_Locationvalid_144);
	write("S4_SRR_RL_Clu_Locationvalid_144 :%f",signalvalue1);
	write("i_S4_SRR_RL_Clu_Locationvalid_144 :%o",@ecu_Signals::i_S4_SRR_RL_Clu_Locationvalid_144);

	testStep("get expect variable value: ","i_S4_SRR_RL_Clu_Locationvalid_144 :%o",@ecu_Signals::i_S4_SRR_RL_Clu_Locationvalid_144);

	if(signalvalue1==@ecu_Signals::i_S4_SRR_RL_Clu_Locationvalid_144)
	{
	testStepPass("Pass","i_S4_SRR_RL_Clu_Locationvalid_144 :%f",signalvalue1);
	}
	else
	{
	testStepFail("Fail","i_S4_SRR_RL_Clu_Locationvalid_144 :%f",signalvalue1);
	}
}

testcase S4_SRR_RL_Clu_Mes_20_S4_SRR_RL_Clu_Theta_145()
{
	signalvalue1 = getSignal(S4_SRR_RL_Clu_Theta_145);
	write("S4_SRR_RL_Clu_Theta_145 :%f",signalvalue1);
	write("i_S4_SRR_RL_Clu_Theta_145 :%f",@ecu_Signals::i_S4_SRR_RL_Clu_Theta_145);

	testStep("get expect variable value: ","i_S4_SRR_RL_Clu_Theta_145 :%f",@ecu_Signals::i_S4_SRR_RL_Clu_Theta_145);

	if((abs(@ecu_Signals::i_S4_SRR_RL_Clu_Theta_145)*0.9<=abs(signalvalue1))&&(abs(signalvalue1)<=abs(@ecu_Signals::i_S4_SRR_RL_Clu_Theta_145)*1.1))
	{
	testStepPass("Pass","i_S4_SRR_RL_Clu_Theta_145 :%f",signalvalue1);
	}
	else
	{
	testStepFail("Fail","i_S4_SRR_RL_Clu_Theta_145 :%f",signalvalue1);
	}
}

testcase S4_SRR_RL_Clu_Mes_20_S4_SRR_RL_Clu_Dist_145()
{
	signalvalue1 = getSignal(S4_SRR_RL_Clu_Dist_145);
	write("S4_SRR_RL_Clu_Dist_145 :%f",signalvalue1);
	write("i_S4_SRR_RL_Clu_Dist_145 :%f",@ecu_Signals::i_S4_SRR_RL_Clu_Dist_145);

	testStep("get expect variable value: ","i_S4_SRR_RL_Clu_Dist_145 :%f",@ecu_Signals::i_S4_SRR_RL_Clu_Dist_145);

	if((abs(@ecu_Signals::i_S4_SRR_RL_Clu_Dist_145)*0.9<=abs(signalvalue1))&&(abs(signalvalue1)<=abs(@ecu_Signals::i_S4_SRR_RL_Clu_Dist_145)*1.1))
	{
	testStepPass("Pass","i_S4_SRR_RL_Clu_Dist_145 :%f",signalvalue1);
	}
	else
	{
	testStepFail("Fail","i_S4_SRR_RL_Clu_Dist_145 :%f",signalvalue1);
	}
}

testcase S4_SRR_RL_Clu_Mes_20_S4_SRR_RL_Clu_Vel_145()
{
	signalvalue1 = getSignal(S4_SRR_RL_Clu_Vel_145);
	write("S4_SRR_RL_Clu_Vel_145 :%f",signalvalue1);
	write("i_S4_SRR_RL_Clu_Vel_145 :%f",@ecu_Signals::i_S4_SRR_RL_Clu_Vel_145);

	testStep("get expect variable value: ","i_S4_SRR_RL_Clu_Vel_145 :%f",@ecu_Signals::i_S4_SRR_RL_Clu_Vel_145);

	if((abs(@ecu_Signals::i_S4_SRR_RL_Clu_Vel_145)*0.9<=abs(signalvalue1))&&(abs(signalvalue1)<=abs(@ecu_Signals::i_S4_SRR_RL_Clu_Vel_145)*1.1))
	{
	testStepPass("Pass","i_S4_SRR_RL_Clu_Vel_145 :%f",signalvalue1);
	}
	else
	{
	testStepFail("Fail","i_S4_SRR_RL_Clu_Vel_145 :%f",signalvalue1);
	}
}

testcase S4_SRR_RL_Clu_Mes_20_S4_SRR_RL_Clu_SNR_145()
{
	signalvalue1 = getSignal(S4_SRR_RL_Clu_SNR_145);
	write("S4_SRR_RL_Clu_SNR_145 :%f",signalvalue1);
	write("i_S4_SRR_RL_Clu_SNR_145 :%f",@ecu_Signals::i_S4_SRR_RL_Clu_SNR_145);

	testStep("get expect variable value: ","i_S4_SRR_RL_Clu_SNR_145 :%f",@ecu_Signals::i_S4_SRR_RL_Clu_SNR_145);

	if((abs(@ecu_Signals::i_S4_SRR_RL_Clu_SNR_145)*0.9<=abs(signalvalue1))&&(abs(signalvalue1)<=abs(@ecu_Signals::i_S4_SRR_RL_Clu_SNR_145)*1.1))
	{
	testStepPass("Pass","i_S4_SRR_RL_Clu_SNR_145 :%f",signalvalue1);
	}
	else
	{
	testStepFail("Fail","i_S4_SRR_RL_Clu_SNR_145 :%f",signalvalue1);
	}
}

testcase S4_SRR_RL_Clu_Mes_20_S4_SRR_RL_Clu_DynProp_145()
{
	signalvalue1 = getSignal(S4_SRR_RL_Clu_DynProp_145);
	write("S4_SRR_RL_Clu_DynProp_145 :%f",signalvalue1);
	write("i_S4_SRR_RL_Clu_DynProp_145 :%o",@ecu_Signals::i_S4_SRR_RL_Clu_DynProp_145);

	testStep("get expect variable value: ","i_S4_SRR_RL_Clu_DynProp_145 :%o",@ecu_Signals::i_S4_SRR_RL_Clu_DynProp_145);

	if(signalvalue1==@ecu_Signals::i_S4_SRR_RL_Clu_DynProp_145)
	{
	testStepPass("Pass","i_S4_SRR_RL_Clu_DynProp_145 :%f",signalvalue1);
	}
	else
	{
	testStepFail("Fail","i_S4_SRR_RL_Clu_DynProp_145 :%f",signalvalue1);
	}
}

testcase S4_SRR_RL_Clu_Mes_20_S4_SRR_RL_Clu_Locationvalid_145()
{
	signalvalue1 = getSignal(S4_SRR_RL_Clu_Locationvalid_145);
	write("S4_SRR_RL_Clu_Locationvalid_145 :%f",signalvalue1);
	write("i_S4_SRR_RL_Clu_Locationvalid_145 :%o",@ecu_Signals::i_S4_SRR_RL_Clu_Locationvalid_145);

	testStep("get expect variable value: ","i_S4_SRR_RL_Clu_Locationvalid_145 :%o",@ecu_Signals::i_S4_SRR_RL_Clu_Locationvalid_145);

	if(signalvalue1==@ecu_Signals::i_S4_SRR_RL_Clu_Locationvalid_145)
	{
	testStepPass("Pass","i_S4_SRR_RL_Clu_Locationvalid_145 :%f",signalvalue1);
	}
	else
	{
	testStepFail("Fail","i_S4_SRR_RL_Clu_Locationvalid_145 :%f",signalvalue1);
	}
}

testcase S4_SRR_RL_Clu_Mes_20_S4_SRR_RL_Clu_Theta_146()
{
	signalvalue1 = getSignal(S4_SRR_RL_Clu_Theta_146);
	write("S4_SRR_RL_Clu_Theta_146 :%f",signalvalue1);
	write("i_S4_SRR_RL_Clu_Theta_146 :%f",@ecu_Signals::i_S4_SRR_RL_Clu_Theta_146);

	testStep("get expect variable value: ","i_S4_SRR_RL_Clu_Theta_146 :%f",@ecu_Signals::i_S4_SRR_RL_Clu_Theta_146);

	if((abs(@ecu_Signals::i_S4_SRR_RL_Clu_Theta_146)*0.9<=abs(signalvalue1))&&(abs(signalvalue1)<=abs(@ecu_Signals::i_S4_SRR_RL_Clu_Theta_146)*1.1))
	{
	testStepPass("Pass","i_S4_SRR_RL_Clu_Theta_146 :%f",signalvalue1);
	}
	else
	{
	testStepFail("Fail","i_S4_SRR_RL_Clu_Theta_146 :%f",signalvalue1);
	}
}

testcase S4_SRR_RL_Clu_Mes_20_S4_SRR_RL_Clu_Dist_146()
{
	signalvalue1 = getSignal(S4_SRR_RL_Clu_Dist_146);
	write("S4_SRR_RL_Clu_Dist_146 :%f",signalvalue1);
	write("i_S4_SRR_RL_Clu_Dist_146 :%f",@ecu_Signals::i_S4_SRR_RL_Clu_Dist_146);

	testStep("get expect variable value: ","i_S4_SRR_RL_Clu_Dist_146 :%f",@ecu_Signals::i_S4_SRR_RL_Clu_Dist_146);

	if((abs(@ecu_Signals::i_S4_SRR_RL_Clu_Dist_146)*0.9<=abs(signalvalue1))&&(abs(signalvalue1)<=abs(@ecu_Signals::i_S4_SRR_RL_Clu_Dist_146)*1.1))
	{
	testStepPass("Pass","i_S4_SRR_RL_Clu_Dist_146 :%f",signalvalue1);
	}
	else
	{
	testStepFail("Fail","i_S4_SRR_RL_Clu_Dist_146 :%f",signalvalue1);
	}
}

testcase S4_SRR_RL_Clu_Mes_20_S4_SRR_RL_Clu_Vel_146()
{
	signalvalue1 = getSignal(S4_SRR_RL_Clu_Vel_146);
	write("S4_SRR_RL_Clu_Vel_146 :%f",signalvalue1);
	write("i_S4_SRR_RL_Clu_Vel_146 :%f",@ecu_Signals::i_S4_SRR_RL_Clu_Vel_146);

	testStep("get expect variable value: ","i_S4_SRR_RL_Clu_Vel_146 :%f",@ecu_Signals::i_S4_SRR_RL_Clu_Vel_146);

	if((abs(@ecu_Signals::i_S4_SRR_RL_Clu_Vel_146)*0.9<=abs(signalvalue1))&&(abs(signalvalue1)<=abs(@ecu_Signals::i_S4_SRR_RL_Clu_Vel_146)*1.1))
	{
	testStepPass("Pass","i_S4_SRR_RL_Clu_Vel_146 :%f",signalvalue1);
	}
	else
	{
	testStepFail("Fail","i_S4_SRR_RL_Clu_Vel_146 :%f",signalvalue1);
	}
}

testcase S4_SRR_RL_Clu_Mes_20_S4_SRR_RL_Clu_SNR_146()
{
	signalvalue1 = getSignal(S4_SRR_RL_Clu_SNR_146);
	write("S4_SRR_RL_Clu_SNR_146 :%f",signalvalue1);
	write("i_S4_SRR_RL_Clu_SNR_146 :%f",@ecu_Signals::i_S4_SRR_RL_Clu_SNR_146);

	testStep("get expect variable value: ","i_S4_SRR_RL_Clu_SNR_146 :%f",@ecu_Signals::i_S4_SRR_RL_Clu_SNR_146);

	if((abs(@ecu_Signals::i_S4_SRR_RL_Clu_SNR_146)*0.9<=abs(signalvalue1))&&(abs(signalvalue1)<=abs(@ecu_Signals::i_S4_SRR_RL_Clu_SNR_146)*1.1))
	{
	testStepPass("Pass","i_S4_SRR_RL_Clu_SNR_146 :%f",signalvalue1);
	}
	else
	{
	testStepFail("Fail","i_S4_SRR_RL_Clu_SNR_146 :%f",signalvalue1);
	}
}

testcase S4_SRR_RL_Clu_Mes_20_S4_SRR_RL_Clu_DynProp_146()
{
	signalvalue1 = getSignal(S4_SRR_RL_Clu_DynProp_146);
	write("S4_SRR_RL_Clu_DynProp_146 :%f",signalvalue1);
	write("i_S4_SRR_RL_Clu_DynProp_146 :%o",@ecu_Signals::i_S4_SRR_RL_Clu_DynProp_146);

	testStep("get expect variable value: ","i_S4_SRR_RL_Clu_DynProp_146 :%o",@ecu_Signals::i_S4_SRR_RL_Clu_DynProp_146);

	if(signalvalue1==@ecu_Signals::i_S4_SRR_RL_Clu_DynProp_146)
	{
	testStepPass("Pass","i_S4_SRR_RL_Clu_DynProp_146 :%f",signalvalue1);
	}
	else
	{
	testStepFail("Fail","i_S4_SRR_RL_Clu_DynProp_146 :%f",signalvalue1);
	}
}

testcase S4_SRR_RL_Clu_Mes_20_S4_SRR_RL_Clu_Locationvalid_146()
{
	signalvalue1 = getSignal(S4_SRR_RL_Clu_Locationvalid_146);
	write("S4_SRR_RL_Clu_Locationvalid_146 :%f",signalvalue1);
	write("i_S4_SRR_RL_Clu_Locationvalid_146 :%o",@ecu_Signals::i_S4_SRR_RL_Clu_Locationvalid_146);

	testStep("get expect variable value: ","i_S4_SRR_RL_Clu_Locationvalid_146 :%o",@ecu_Signals::i_S4_SRR_RL_Clu_Locationvalid_146);

	if(signalvalue1==@ecu_Signals::i_S4_SRR_RL_Clu_Locationvalid_146)
	{
	testStepPass("Pass","i_S4_SRR_RL_Clu_Locationvalid_146 :%f",signalvalue1);
	}
	else
	{
	testStepFail("Fail","i_S4_SRR_RL_Clu_Locationvalid_146 :%f",signalvalue1);
	}
}

testcase S4_SRR_RL_Clu_Mes_21_S4_SRR_RL_Clu_Theta_147()
{
	signalvalue1 = getSignal(S4_SRR_RL_Clu_Theta_147);
	write("S4_SRR_RL_Clu_Theta_147 :%f",signalvalue1);
	write("i_S4_SRR_RL_Clu_Theta_147 :%f",@ecu_Signals::i_S4_SRR_RL_Clu_Theta_147);

	testStep("get expect variable value: ","i_S4_SRR_RL_Clu_Theta_147 :%f",@ecu_Signals::i_S4_SRR_RL_Clu_Theta_147);

	if((abs(@ecu_Signals::i_S4_SRR_RL_Clu_Theta_147)*0.9<=abs(signalvalue1))&&(abs(signalvalue1)<=abs(@ecu_Signals::i_S4_SRR_RL_Clu_Theta_147)*1.1))
	{
	testStepPass("Pass","i_S4_SRR_RL_Clu_Theta_147 :%f",signalvalue1);
	}
	else
	{
	testStepFail("Fail","i_S4_SRR_RL_Clu_Theta_147 :%f",signalvalue1);
	}
}

testcase S4_SRR_RL_Clu_Mes_21_S4_SRR_RL_Clu_Dist_147()
{
	signalvalue1 = getSignal(S4_SRR_RL_Clu_Dist_147);
	write("S4_SRR_RL_Clu_Dist_147 :%f",signalvalue1);
	write("i_S4_SRR_RL_Clu_Dist_147 :%f",@ecu_Signals::i_S4_SRR_RL_Clu_Dist_147);

	testStep("get expect variable value: ","i_S4_SRR_RL_Clu_Dist_147 :%f",@ecu_Signals::i_S4_SRR_RL_Clu_Dist_147);

	if((abs(@ecu_Signals::i_S4_SRR_RL_Clu_Dist_147)*0.9<=abs(signalvalue1))&&(abs(signalvalue1)<=abs(@ecu_Signals::i_S4_SRR_RL_Clu_Dist_147)*1.1))
	{
	testStepPass("Pass","i_S4_SRR_RL_Clu_Dist_147 :%f",signalvalue1);
	}
	else
	{
	testStepFail("Fail","i_S4_SRR_RL_Clu_Dist_147 :%f",signalvalue1);
	}
}

testcase S4_SRR_RL_Clu_Mes_21_S4_SRR_RL_Clu_Vel_147()
{
	signalvalue1 = getSignal(S4_SRR_RL_Clu_Vel_147);
	write("S4_SRR_RL_Clu_Vel_147 :%f",signalvalue1);
	write("i_S4_SRR_RL_Clu_Vel_147 :%f",@ecu_Signals::i_S4_SRR_RL_Clu_Vel_147);

	testStep("get expect variable value: ","i_S4_SRR_RL_Clu_Vel_147 :%f",@ecu_Signals::i_S4_SRR_RL_Clu_Vel_147);

	if((abs(@ecu_Signals::i_S4_SRR_RL_Clu_Vel_147)*0.9<=abs(signalvalue1))&&(abs(signalvalue1)<=abs(@ecu_Signals::i_S4_SRR_RL_Clu_Vel_147)*1.1))
	{
	testStepPass("Pass","i_S4_SRR_RL_Clu_Vel_147 :%f",signalvalue1);
	}
	else
	{
	testStepFail("Fail","i_S4_SRR_RL_Clu_Vel_147 :%f",signalvalue1);
	}
}

testcase S4_SRR_RL_Clu_Mes_21_S4_SRR_RL_Clu_SNR_147()
{
	signalvalue1 = getSignal(S4_SRR_RL_Clu_SNR_147);
	write("S4_SRR_RL_Clu_SNR_147 :%f",signalvalue1);
	write("i_S4_SRR_RL_Clu_SNR_147 :%f",@ecu_Signals::i_S4_SRR_RL_Clu_SNR_147);

	testStep("get expect variable value: ","i_S4_SRR_RL_Clu_SNR_147 :%f",@ecu_Signals::i_S4_SRR_RL_Clu_SNR_147);

	if((abs(@ecu_Signals::i_S4_SRR_RL_Clu_SNR_147)*0.9<=abs(signalvalue1))&&(abs(signalvalue1)<=abs(@ecu_Signals::i_S4_SRR_RL_Clu_SNR_147)*1.1))
	{
	testStepPass("Pass","i_S4_SRR_RL_Clu_SNR_147 :%f",signalvalue1);
	}
	else
	{
	testStepFail("Fail","i_S4_SRR_RL_Clu_SNR_147 :%f",signalvalue1);
	}
}

testcase S4_SRR_RL_Clu_Mes_21_S4_SRR_RL_Clu_DynProp_147()
{
	signalvalue1 = getSignal(S4_SRR_RL_Clu_DynProp_147);
	write("S4_SRR_RL_Clu_DynProp_147 :%f",signalvalue1);
	write("i_S4_SRR_RL_Clu_DynProp_147 :%o",@ecu_Signals::i_S4_SRR_RL_Clu_DynProp_147);

	testStep("get expect variable value: ","i_S4_SRR_RL_Clu_DynProp_147 :%o",@ecu_Signals::i_S4_SRR_RL_Clu_DynProp_147);

	if(signalvalue1==@ecu_Signals::i_S4_SRR_RL_Clu_DynProp_147)
	{
	testStepPass("Pass","i_S4_SRR_RL_Clu_DynProp_147 :%f",signalvalue1);
	}
	else
	{
	testStepFail("Fail","i_S4_SRR_RL_Clu_DynProp_147 :%f",signalvalue1);
	}
}

testcase S4_SRR_RL_Clu_Mes_21_S4_SRR_RL_Clu_Locationvalid_147()
{
	signalvalue1 = getSignal(S4_SRR_RL_Clu_Locationvalid_147);
	write("S4_SRR_RL_Clu_Locationvalid_147 :%f",signalvalue1);
	write("i_S4_SRR_RL_Clu_Locationvalid_147 :%o",@ecu_Signals::i_S4_SRR_RL_Clu_Locationvalid_147);

	testStep("get expect variable value: ","i_S4_SRR_RL_Clu_Locationvalid_147 :%o",@ecu_Signals::i_S4_SRR_RL_Clu_Locationvalid_147);

	if(signalvalue1==@ecu_Signals::i_S4_SRR_RL_Clu_Locationvalid_147)
	{
	testStepPass("Pass","i_S4_SRR_RL_Clu_Locationvalid_147 :%f",signalvalue1);
	}
	else
	{
	testStepFail("Fail","i_S4_SRR_RL_Clu_Locationvalid_147 :%f",signalvalue1);
	}
}

testcase S4_SRR_RL_Clu_Mes_21_S4_SRR_RL_Clu_Theta_148()
{
	signalvalue1 = getSignal(S4_SRR_RL_Clu_Theta_148);
	write("S4_SRR_RL_Clu_Theta_148 :%f",signalvalue1);
	write("i_S4_SRR_RL_Clu_Theta_148 :%f",@ecu_Signals::i_S4_SRR_RL_Clu_Theta_148);

	testStep("get expect variable value: ","i_S4_SRR_RL_Clu_Theta_148 :%f",@ecu_Signals::i_S4_SRR_RL_Clu_Theta_148);

	if((abs(@ecu_Signals::i_S4_SRR_RL_Clu_Theta_148)*0.9<=abs(signalvalue1))&&(abs(signalvalue1)<=abs(@ecu_Signals::i_S4_SRR_RL_Clu_Theta_148)*1.1))
	{
	testStepPass("Pass","i_S4_SRR_RL_Clu_Theta_148 :%f",signalvalue1);
	}
	else
	{
	testStepFail("Fail","i_S4_SRR_RL_Clu_Theta_148 :%f",signalvalue1);
	}
}

testcase S4_SRR_RL_Clu_Mes_21_S4_SRR_RL_Clu_Dist_148()
{
	signalvalue1 = getSignal(S4_SRR_RL_Clu_Dist_148);
	write("S4_SRR_RL_Clu_Dist_148 :%f",signalvalue1);
	write("i_S4_SRR_RL_Clu_Dist_148 :%f",@ecu_Signals::i_S4_SRR_RL_Clu_Dist_148);

	testStep("get expect variable value: ","i_S4_SRR_RL_Clu_Dist_148 :%f",@ecu_Signals::i_S4_SRR_RL_Clu_Dist_148);

	if((abs(@ecu_Signals::i_S4_SRR_RL_Clu_Dist_148)*0.9<=abs(signalvalue1))&&(abs(signalvalue1)<=abs(@ecu_Signals::i_S4_SRR_RL_Clu_Dist_148)*1.1))
	{
	testStepPass("Pass","i_S4_SRR_RL_Clu_Dist_148 :%f",signalvalue1);
	}
	else
	{
	testStepFail("Fail","i_S4_SRR_RL_Clu_Dist_148 :%f",signalvalue1);
	}
}

testcase S4_SRR_RL_Clu_Mes_21_S4_SRR_RL_Clu_Vel_148()
{
	signalvalue1 = getSignal(S4_SRR_RL_Clu_Vel_148);
	write("S4_SRR_RL_Clu_Vel_148 :%f",signalvalue1);
	write("i_S4_SRR_RL_Clu_Vel_148 :%f",@ecu_Signals::i_S4_SRR_RL_Clu_Vel_148);

	testStep("get expect variable value: ","i_S4_SRR_RL_Clu_Vel_148 :%f",@ecu_Signals::i_S4_SRR_RL_Clu_Vel_148);

	if((abs(@ecu_Signals::i_S4_SRR_RL_Clu_Vel_148)*0.9<=abs(signalvalue1))&&(abs(signalvalue1)<=abs(@ecu_Signals::i_S4_SRR_RL_Clu_Vel_148)*1.1))
	{
	testStepPass("Pass","i_S4_SRR_RL_Clu_Vel_148 :%f",signalvalue1);
	}
	else
	{
	testStepFail("Fail","i_S4_SRR_RL_Clu_Vel_148 :%f",signalvalue1);
	}
}

testcase S4_SRR_RL_Clu_Mes_21_S4_SRR_RL_Clu_SNR_148()
{
	signalvalue1 = getSignal(S4_SRR_RL_Clu_SNR_148);
	write("S4_SRR_RL_Clu_SNR_148 :%f",signalvalue1);
	write("i_S4_SRR_RL_Clu_SNR_148 :%f",@ecu_Signals::i_S4_SRR_RL_Clu_SNR_148);

	testStep("get expect variable value: ","i_S4_SRR_RL_Clu_SNR_148 :%f",@ecu_Signals::i_S4_SRR_RL_Clu_SNR_148);

	if((abs(@ecu_Signals::i_S4_SRR_RL_Clu_SNR_148)*0.9<=abs(signalvalue1))&&(abs(signalvalue1)<=abs(@ecu_Signals::i_S4_SRR_RL_Clu_SNR_148)*1.1))
	{
	testStepPass("Pass","i_S4_SRR_RL_Clu_SNR_148 :%f",signalvalue1);
	}
	else
	{
	testStepFail("Fail","i_S4_SRR_RL_Clu_SNR_148 :%f",signalvalue1);
	}
}

testcase S4_SRR_RL_Clu_Mes_21_S4_SRR_RL_Clu_DynProp_148()
{
	signalvalue1 = getSignal(S4_SRR_RL_Clu_DynProp_148);
	write("S4_SRR_RL_Clu_DynProp_148 :%f",signalvalue1);
	write("i_S4_SRR_RL_Clu_DynProp_148 :%o",@ecu_Signals::i_S4_SRR_RL_Clu_DynProp_148);

	testStep("get expect variable value: ","i_S4_SRR_RL_Clu_DynProp_148 :%o",@ecu_Signals::i_S4_SRR_RL_Clu_DynProp_148);

	if(signalvalue1==@ecu_Signals::i_S4_SRR_RL_Clu_DynProp_148)
	{
	testStepPass("Pass","i_S4_SRR_RL_Clu_DynProp_148 :%f",signalvalue1);
	}
	else
	{
	testStepFail("Fail","i_S4_SRR_RL_Clu_DynProp_148 :%f",signalvalue1);
	}
}

testcase S4_SRR_RL_Clu_Mes_21_S4_SRR_RL_Clu_Locationvalid_148()
{
	signalvalue1 = getSignal(S4_SRR_RL_Clu_Locationvalid_148);
	write("S4_SRR_RL_Clu_Locationvalid_148 :%f",signalvalue1);
	write("i_S4_SRR_RL_Clu_Locationvalid_148 :%o",@ecu_Signals::i_S4_SRR_RL_Clu_Locationvalid_148);

	testStep("get expect variable value: ","i_S4_SRR_RL_Clu_Locationvalid_148 :%o",@ecu_Signals::i_S4_SRR_RL_Clu_Locationvalid_148);

	if(signalvalue1==@ecu_Signals::i_S4_SRR_RL_Clu_Locationvalid_148)
	{
	testStepPass("Pass","i_S4_SRR_RL_Clu_Locationvalid_148 :%f",signalvalue1);
	}
	else
	{
	testStepFail("Fail","i_S4_SRR_RL_Clu_Locationvalid_148 :%f",signalvalue1);
	}
}

testcase S4_SRR_RL_Clu_Mes_21_S4_SRR_RL_Clu_Theta_149()
{
	signalvalue1 = getSignal(S4_SRR_RL_Clu_Theta_149);
	write("S4_SRR_RL_Clu_Theta_149 :%f",signalvalue1);
	write("i_S4_SRR_RL_Clu_Theta_149 :%f",@ecu_Signals::i_S4_SRR_RL_Clu_Theta_149);

	testStep("get expect variable value: ","i_S4_SRR_RL_Clu_Theta_149 :%f",@ecu_Signals::i_S4_SRR_RL_Clu_Theta_149);

	if((abs(@ecu_Signals::i_S4_SRR_RL_Clu_Theta_149)*0.9<=abs(signalvalue1))&&(abs(signalvalue1)<=abs(@ecu_Signals::i_S4_SRR_RL_Clu_Theta_149)*1.1))
	{
	testStepPass("Pass","i_S4_SRR_RL_Clu_Theta_149 :%f",signalvalue1);
	}
	else
	{
	testStepFail("Fail","i_S4_SRR_RL_Clu_Theta_149 :%f",signalvalue1);
	}
}

testcase S4_SRR_RL_Clu_Mes_21_S4_SRR_RL_Clu_Dist_149()
{
	signalvalue1 = getSignal(S4_SRR_RL_Clu_Dist_149);
	write("S4_SRR_RL_Clu_Dist_149 :%f",signalvalue1);
	write("i_S4_SRR_RL_Clu_Dist_149 :%f",@ecu_Signals::i_S4_SRR_RL_Clu_Dist_149);

	testStep("get expect variable value: ","i_S4_SRR_RL_Clu_Dist_149 :%f",@ecu_Signals::i_S4_SRR_RL_Clu_Dist_149);

	if((abs(@ecu_Signals::i_S4_SRR_RL_Clu_Dist_149)*0.9<=abs(signalvalue1))&&(abs(signalvalue1)<=abs(@ecu_Signals::i_S4_SRR_RL_Clu_Dist_149)*1.1))
	{
	testStepPass("Pass","i_S4_SRR_RL_Clu_Dist_149 :%f",signalvalue1);
	}
	else
	{
	testStepFail("Fail","i_S4_SRR_RL_Clu_Dist_149 :%f",signalvalue1);
	}
}

testcase S4_SRR_RL_Clu_Mes_21_S4_SRR_RL_Clu_Vel_149()
{
	signalvalue1 = getSignal(S4_SRR_RL_Clu_Vel_149);
	write("S4_SRR_RL_Clu_Vel_149 :%f",signalvalue1);
	write("i_S4_SRR_RL_Clu_Vel_149 :%f",@ecu_Signals::i_S4_SRR_RL_Clu_Vel_149);

	testStep("get expect variable value: ","i_S4_SRR_RL_Clu_Vel_149 :%f",@ecu_Signals::i_S4_SRR_RL_Clu_Vel_149);

	if((abs(@ecu_Signals::i_S4_SRR_RL_Clu_Vel_149)*0.9<=abs(signalvalue1))&&(abs(signalvalue1)<=abs(@ecu_Signals::i_S4_SRR_RL_Clu_Vel_149)*1.1))
	{
	testStepPass("Pass","i_S4_SRR_RL_Clu_Vel_149 :%f",signalvalue1);
	}
	else
	{
	testStepFail("Fail","i_S4_SRR_RL_Clu_Vel_149 :%f",signalvalue1);
	}
}

testcase S4_SRR_RL_Clu_Mes_21_S4_SRR_RL_Clu_SNR_149()
{
	signalvalue1 = getSignal(S4_SRR_RL_Clu_SNR_149);
	write("S4_SRR_RL_Clu_SNR_149 :%f",signalvalue1);
	write("i_S4_SRR_RL_Clu_SNR_149 :%f",@ecu_Signals::i_S4_SRR_RL_Clu_SNR_149);

	testStep("get expect variable value: ","i_S4_SRR_RL_Clu_SNR_149 :%f",@ecu_Signals::i_S4_SRR_RL_Clu_SNR_149);

	if((abs(@ecu_Signals::i_S4_SRR_RL_Clu_SNR_149)*0.9<=abs(signalvalue1))&&(abs(signalvalue1)<=abs(@ecu_Signals::i_S4_SRR_RL_Clu_SNR_149)*1.1))
	{
	testStepPass("Pass","i_S4_SRR_RL_Clu_SNR_149 :%f",signalvalue1);
	}
	else
	{
	testStepFail("Fail","i_S4_SRR_RL_Clu_SNR_149 :%f",signalvalue1);
	}
}

testcase S4_SRR_RL_Clu_Mes_21_S4_SRR_RL_Clu_DynProp_149()
{
	signalvalue1 = getSignal(S4_SRR_RL_Clu_DynProp_149);
	write("S4_SRR_RL_Clu_DynProp_149 :%f",signalvalue1);
	write("i_S4_SRR_RL_Clu_DynProp_149 :%o",@ecu_Signals::i_S4_SRR_RL_Clu_DynProp_149);

	testStep("get expect variable value: ","i_S4_SRR_RL_Clu_DynProp_149 :%o",@ecu_Signals::i_S4_SRR_RL_Clu_DynProp_149);

	if(signalvalue1==@ecu_Signals::i_S4_SRR_RL_Clu_DynProp_149)
	{
	testStepPass("Pass","i_S4_SRR_RL_Clu_DynProp_149 :%f",signalvalue1);
	}
	else
	{
	testStepFail("Fail","i_S4_SRR_RL_Clu_DynProp_149 :%f",signalvalue1);
	}
}

testcase S4_SRR_RL_Clu_Mes_21_S4_SRR_RL_Clu_Locationvalid_149()
{
	signalvalue1 = getSignal(S4_SRR_RL_Clu_Locationvalid_149);
	write("S4_SRR_RL_Clu_Locationvalid_149 :%f",signalvalue1);
	write("i_S4_SRR_RL_Clu_Locationvalid_149 :%o",@ecu_Signals::i_S4_SRR_RL_Clu_Locationvalid_149);

	testStep("get expect variable value: ","i_S4_SRR_RL_Clu_Locationvalid_149 :%o",@ecu_Signals::i_S4_SRR_RL_Clu_Locationvalid_149);

	if(signalvalue1==@ecu_Signals::i_S4_SRR_RL_Clu_Locationvalid_149)
	{
	testStepPass("Pass","i_S4_SRR_RL_Clu_Locationvalid_149 :%f",signalvalue1);
	}
	else
	{
	testStepFail("Fail","i_S4_SRR_RL_Clu_Locationvalid_149 :%f",signalvalue1);
	}
}

testcase S4_SRR_RL_Clu_Mes_21_S4_SRR_RL_Clu_Theta_150()
{
	signalvalue1 = getSignal(S4_SRR_RL_Clu_Theta_150);
	write("S4_SRR_RL_Clu_Theta_150 :%f",signalvalue1);
	write("i_S4_SRR_RL_Clu_Theta_150 :%f",@ecu_Signals::i_S4_SRR_RL_Clu_Theta_150);

	testStep("get expect variable value: ","i_S4_SRR_RL_Clu_Theta_150 :%f",@ecu_Signals::i_S4_SRR_RL_Clu_Theta_150);

	if((abs(@ecu_Signals::i_S4_SRR_RL_Clu_Theta_150)*0.9<=abs(signalvalue1))&&(abs(signalvalue1)<=abs(@ecu_Signals::i_S4_SRR_RL_Clu_Theta_150)*1.1))
	{
	testStepPass("Pass","i_S4_SRR_RL_Clu_Theta_150 :%f",signalvalue1);
	}
	else
	{
	testStepFail("Fail","i_S4_SRR_RL_Clu_Theta_150 :%f",signalvalue1);
	}
}

testcase S4_SRR_RL_Clu_Mes_21_S4_SRR_RL_Clu_Dist_150()
{
	signalvalue1 = getSignal(S4_SRR_RL_Clu_Dist_150);
	write("S4_SRR_RL_Clu_Dist_150 :%f",signalvalue1);
	write("i_S4_SRR_RL_Clu_Dist_150 :%f",@ecu_Signals::i_S4_SRR_RL_Clu_Dist_150);

	testStep("get expect variable value: ","i_S4_SRR_RL_Clu_Dist_150 :%f",@ecu_Signals::i_S4_SRR_RL_Clu_Dist_150);

	if((abs(@ecu_Signals::i_S4_SRR_RL_Clu_Dist_150)*0.9<=abs(signalvalue1))&&(abs(signalvalue1)<=abs(@ecu_Signals::i_S4_SRR_RL_Clu_Dist_150)*1.1))
	{
	testStepPass("Pass","i_S4_SRR_RL_Clu_Dist_150 :%f",signalvalue1);
	}
	else
	{
	testStepFail("Fail","i_S4_SRR_RL_Clu_Dist_150 :%f",signalvalue1);
	}
}

testcase S4_SRR_RL_Clu_Mes_21_S4_SRR_RL_Clu_Vel_150()
{
	signalvalue1 = getSignal(S4_SRR_RL_Clu_Vel_150);
	write("S4_SRR_RL_Clu_Vel_150 :%f",signalvalue1);
	write("i_S4_SRR_RL_Clu_Vel_150 :%f",@ecu_Signals::i_S4_SRR_RL_Clu_Vel_150);

	testStep("get expect variable value: ","i_S4_SRR_RL_Clu_Vel_150 :%f",@ecu_Signals::i_S4_SRR_RL_Clu_Vel_150);

	if((abs(@ecu_Signals::i_S4_SRR_RL_Clu_Vel_150)*0.9<=abs(signalvalue1))&&(abs(signalvalue1)<=abs(@ecu_Signals::i_S4_SRR_RL_Clu_Vel_150)*1.1))
	{
	testStepPass("Pass","i_S4_SRR_RL_Clu_Vel_150 :%f",signalvalue1);
	}
	else
	{
	testStepFail("Fail","i_S4_SRR_RL_Clu_Vel_150 :%f",signalvalue1);
	}
}

testcase S4_SRR_RL_Clu_Mes_21_S4_SRR_RL_Clu_SNR_150()
{
	signalvalue1 = getSignal(S4_SRR_RL_Clu_SNR_150);
	write("S4_SRR_RL_Clu_SNR_150 :%f",signalvalue1);
	write("i_S4_SRR_RL_Clu_SNR_150 :%f",@ecu_Signals::i_S4_SRR_RL_Clu_SNR_150);

	testStep("get expect variable value: ","i_S4_SRR_RL_Clu_SNR_150 :%f",@ecu_Signals::i_S4_SRR_RL_Clu_SNR_150);

	if((abs(@ecu_Signals::i_S4_SRR_RL_Clu_SNR_150)*0.9<=abs(signalvalue1))&&(abs(signalvalue1)<=abs(@ecu_Signals::i_S4_SRR_RL_Clu_SNR_150)*1.1))
	{
	testStepPass("Pass","i_S4_SRR_RL_Clu_SNR_150 :%f",signalvalue1);
	}
	else
	{
	testStepFail("Fail","i_S4_SRR_RL_Clu_SNR_150 :%f",signalvalue1);
	}
}

testcase S4_SRR_RL_Clu_Mes_21_S4_SRR_RL_Clu_DynProp_150()
{
	signalvalue1 = getSignal(S4_SRR_RL_Clu_DynProp_150);
	write("S4_SRR_RL_Clu_DynProp_150 :%f",signalvalue1);
	write("i_S4_SRR_RL_Clu_DynProp_150 :%o",@ecu_Signals::i_S4_SRR_RL_Clu_DynProp_150);

	testStep("get expect variable value: ","i_S4_SRR_RL_Clu_DynProp_150 :%o",@ecu_Signals::i_S4_SRR_RL_Clu_DynProp_150);

	if(signalvalue1==@ecu_Signals::i_S4_SRR_RL_Clu_DynProp_150)
	{
	testStepPass("Pass","i_S4_SRR_RL_Clu_DynProp_150 :%f",signalvalue1);
	}
	else
	{
	testStepFail("Fail","i_S4_SRR_RL_Clu_DynProp_150 :%f",signalvalue1);
	}
}

testcase S4_SRR_RL_Clu_Mes_21_S4_SRR_RL_Clu_Locationvalid_150()
{
	signalvalue1 = getSignal(S4_SRR_RL_Clu_Locationvalid_150);
	write("S4_SRR_RL_Clu_Locationvalid_150 :%f",signalvalue1);
	write("i_S4_SRR_RL_Clu_Locationvalid_150 :%o",@ecu_Signals::i_S4_SRR_RL_Clu_Locationvalid_150);

	testStep("get expect variable value: ","i_S4_SRR_RL_Clu_Locationvalid_150 :%o",@ecu_Signals::i_S4_SRR_RL_Clu_Locationvalid_150);

	if(signalvalue1==@ecu_Signals::i_S4_SRR_RL_Clu_Locationvalid_150)
	{
	testStepPass("Pass","i_S4_SRR_RL_Clu_Locationvalid_150 :%f",signalvalue1);
	}
	else
	{
	testStepFail("Fail","i_S4_SRR_RL_Clu_Locationvalid_150 :%f",signalvalue1);
	}
}

testcase S4_SRR_RL_Clu_Mes_21_S4_SRR_RL_Clu_Theta_151()
{
	signalvalue1 = getSignal(S4_SRR_RL_Clu_Theta_151);
	write("S4_SRR_RL_Clu_Theta_151 :%f",signalvalue1);
	write("i_S4_SRR_RL_Clu_Theta_151 :%f",@ecu_Signals::i_S4_SRR_RL_Clu_Theta_151);

	testStep("get expect variable value: ","i_S4_SRR_RL_Clu_Theta_151 :%f",@ecu_Signals::i_S4_SRR_RL_Clu_Theta_151);

	if((abs(@ecu_Signals::i_S4_SRR_RL_Clu_Theta_151)*0.9<=abs(signalvalue1))&&(abs(signalvalue1)<=abs(@ecu_Signals::i_S4_SRR_RL_Clu_Theta_151)*1.1))
	{
	testStepPass("Pass","i_S4_SRR_RL_Clu_Theta_151 :%f",signalvalue1);
	}
	else
	{
	testStepFail("Fail","i_S4_SRR_RL_Clu_Theta_151 :%f",signalvalue1);
	}
}

testcase S4_SRR_RL_Clu_Mes_21_S4_SRR_RL_Clu_Dist_151()
{
	signalvalue1 = getSignal(S4_SRR_RL_Clu_Dist_151);
	write("S4_SRR_RL_Clu_Dist_151 :%f",signalvalue1);
	write("i_S4_SRR_RL_Clu_Dist_151 :%f",@ecu_Signals::i_S4_SRR_RL_Clu_Dist_151);

	testStep("get expect variable value: ","i_S4_SRR_RL_Clu_Dist_151 :%f",@ecu_Signals::i_S4_SRR_RL_Clu_Dist_151);

	if((abs(@ecu_Signals::i_S4_SRR_RL_Clu_Dist_151)*0.9<=abs(signalvalue1))&&(abs(signalvalue1)<=abs(@ecu_Signals::i_S4_SRR_RL_Clu_Dist_151)*1.1))
	{
	testStepPass("Pass","i_S4_SRR_RL_Clu_Dist_151 :%f",signalvalue1);
	}
	else
	{
	testStepFail("Fail","i_S4_SRR_RL_Clu_Dist_151 :%f",signalvalue1);
	}
}

testcase S4_SRR_RL_Clu_Mes_21_S4_SRR_RL_Clu_Vel_151()
{
	signalvalue1 = getSignal(S4_SRR_RL_Clu_Vel_151);
	write("S4_SRR_RL_Clu_Vel_151 :%f",signalvalue1);
	write("i_S4_SRR_RL_Clu_Vel_151 :%f",@ecu_Signals::i_S4_SRR_RL_Clu_Vel_151);

	testStep("get expect variable value: ","i_S4_SRR_RL_Clu_Vel_151 :%f",@ecu_Signals::i_S4_SRR_RL_Clu_Vel_151);

	if((abs(@ecu_Signals::i_S4_SRR_RL_Clu_Vel_151)*0.9<=abs(signalvalue1))&&(abs(signalvalue1)<=abs(@ecu_Signals::i_S4_SRR_RL_Clu_Vel_151)*1.1))
	{
	testStepPass("Pass","i_S4_SRR_RL_Clu_Vel_151 :%f",signalvalue1);
	}
	else
	{
	testStepFail("Fail","i_S4_SRR_RL_Clu_Vel_151 :%f",signalvalue1);
	}
}

testcase S4_SRR_RL_Clu_Mes_21_S4_SRR_RL_Clu_SNR_151()
{
	signalvalue1 = getSignal(S4_SRR_RL_Clu_SNR_151);
	write("S4_SRR_RL_Clu_SNR_151 :%f",signalvalue1);
	write("i_S4_SRR_RL_Clu_SNR_151 :%f",@ecu_Signals::i_S4_SRR_RL_Clu_SNR_151);

	testStep("get expect variable value: ","i_S4_SRR_RL_Clu_SNR_151 :%f",@ecu_Signals::i_S4_SRR_RL_Clu_SNR_151);

	if((abs(@ecu_Signals::i_S4_SRR_RL_Clu_SNR_151)*0.9<=abs(signalvalue1))&&(abs(signalvalue1)<=abs(@ecu_Signals::i_S4_SRR_RL_Clu_SNR_151)*1.1))
	{
	testStepPass("Pass","i_S4_SRR_RL_Clu_SNR_151 :%f",signalvalue1);
	}
	else
	{
	testStepFail("Fail","i_S4_SRR_RL_Clu_SNR_151 :%f",signalvalue1);
	}
}

testcase S4_SRR_RL_Clu_Mes_21_S4_SRR_RL_Clu_DynProp_151()
{
	signalvalue1 = getSignal(S4_SRR_RL_Clu_DynProp_151);
	write("S4_SRR_RL_Clu_DynProp_151 :%f",signalvalue1);
	write("i_S4_SRR_RL_Clu_DynProp_151 :%o",@ecu_Signals::i_S4_SRR_RL_Clu_DynProp_151);

	testStep("get expect variable value: ","i_S4_SRR_RL_Clu_DynProp_151 :%o",@ecu_Signals::i_S4_SRR_RL_Clu_DynProp_151);

	if(signalvalue1==@ecu_Signals::i_S4_SRR_RL_Clu_DynProp_151)
	{
	testStepPass("Pass","i_S4_SRR_RL_Clu_DynProp_151 :%f",signalvalue1);
	}
	else
	{
	testStepFail("Fail","i_S4_SRR_RL_Clu_DynProp_151 :%f",signalvalue1);
	}
}

testcase S4_SRR_RL_Clu_Mes_21_S4_SRR_RL_Clu_Locationvalid_151()
{
	signalvalue1 = getSignal(S4_SRR_RL_Clu_Locationvalid_151);
	write("S4_SRR_RL_Clu_Locationvalid_151 :%f",signalvalue1);
	write("i_S4_SRR_RL_Clu_Locationvalid_151 :%o",@ecu_Signals::i_S4_SRR_RL_Clu_Locationvalid_151);

	testStep("get expect variable value: ","i_S4_SRR_RL_Clu_Locationvalid_151 :%o",@ecu_Signals::i_S4_SRR_RL_Clu_Locationvalid_151);

	if(signalvalue1==@ecu_Signals::i_S4_SRR_RL_Clu_Locationvalid_151)
	{
	testStepPass("Pass","i_S4_SRR_RL_Clu_Locationvalid_151 :%f",signalvalue1);
	}
	else
	{
	testStepFail("Fail","i_S4_SRR_RL_Clu_Locationvalid_151 :%f",signalvalue1);
	}
}

testcase S4_SRR_RL_Clu_Mes_21_S4_SRR_RL_Clu_Theta_152()
{
	signalvalue1 = getSignal(S4_SRR_RL_Clu_Theta_152);
	write("S4_SRR_RL_Clu_Theta_152 :%f",signalvalue1);
	write("i_S4_SRR_RL_Clu_Theta_152 :%f",@ecu_Signals::i_S4_SRR_RL_Clu_Theta_152);

	testStep("get expect variable value: ","i_S4_SRR_RL_Clu_Theta_152 :%f",@ecu_Signals::i_S4_SRR_RL_Clu_Theta_152);

	if((abs(@ecu_Signals::i_S4_SRR_RL_Clu_Theta_152)*0.9<=abs(signalvalue1))&&(abs(signalvalue1)<=abs(@ecu_Signals::i_S4_SRR_RL_Clu_Theta_152)*1.1))
	{
	testStepPass("Pass","i_S4_SRR_RL_Clu_Theta_152 :%f",signalvalue1);
	}
	else
	{
	testStepFail("Fail","i_S4_SRR_RL_Clu_Theta_152 :%f",signalvalue1);
	}
}

testcase S4_SRR_RL_Clu_Mes_21_S4_SRR_RL_Clu_Dist_152()
{
	signalvalue1 = getSignal(S4_SRR_RL_Clu_Dist_152);
	write("S4_SRR_RL_Clu_Dist_152 :%f",signalvalue1);
	write("i_S4_SRR_RL_Clu_Dist_152 :%f",@ecu_Signals::i_S4_SRR_RL_Clu_Dist_152);

	testStep("get expect variable value: ","i_S4_SRR_RL_Clu_Dist_152 :%f",@ecu_Signals::i_S4_SRR_RL_Clu_Dist_152);

	if((abs(@ecu_Signals::i_S4_SRR_RL_Clu_Dist_152)*0.9<=abs(signalvalue1))&&(abs(signalvalue1)<=abs(@ecu_Signals::i_S4_SRR_RL_Clu_Dist_152)*1.1))
	{
	testStepPass("Pass","i_S4_SRR_RL_Clu_Dist_152 :%f",signalvalue1);
	}
	else
	{
	testStepFail("Fail","i_S4_SRR_RL_Clu_Dist_152 :%f",signalvalue1);
	}
}

testcase S4_SRR_RL_Clu_Mes_21_S4_SRR_RL_Clu_Vel_152()
{
	signalvalue1 = getSignal(S4_SRR_RL_Clu_Vel_152);
	write("S4_SRR_RL_Clu_Vel_152 :%f",signalvalue1);
	write("i_S4_SRR_RL_Clu_Vel_152 :%f",@ecu_Signals::i_S4_SRR_RL_Clu_Vel_152);

	testStep("get expect variable value: ","i_S4_SRR_RL_Clu_Vel_152 :%f",@ecu_Signals::i_S4_SRR_RL_Clu_Vel_152);

	if((abs(@ecu_Signals::i_S4_SRR_RL_Clu_Vel_152)*0.9<=abs(signalvalue1))&&(abs(signalvalue1)<=abs(@ecu_Signals::i_S4_SRR_RL_Clu_Vel_152)*1.1))
	{
	testStepPass("Pass","i_S4_SRR_RL_Clu_Vel_152 :%f",signalvalue1);
	}
	else
	{
	testStepFail("Fail","i_S4_SRR_RL_Clu_Vel_152 :%f",signalvalue1);
	}
}

testcase S4_SRR_RL_Clu_Mes_21_S4_SRR_RL_Clu_SNR_152()
{
	signalvalue1 = getSignal(S4_SRR_RL_Clu_SNR_152);
	write("S4_SRR_RL_Clu_SNR_152 :%f",signalvalue1);
	write("i_S4_SRR_RL_Clu_SNR_152 :%f",@ecu_Signals::i_S4_SRR_RL_Clu_SNR_152);

	testStep("get expect variable value: ","i_S4_SRR_RL_Clu_SNR_152 :%f",@ecu_Signals::i_S4_SRR_RL_Clu_SNR_152);

	if((abs(@ecu_Signals::i_S4_SRR_RL_Clu_SNR_152)*0.9<=abs(signalvalue1))&&(abs(signalvalue1)<=abs(@ecu_Signals::i_S4_SRR_RL_Clu_SNR_152)*1.1))
	{
	testStepPass("Pass","i_S4_SRR_RL_Clu_SNR_152 :%f",signalvalue1);
	}
	else
	{
	testStepFail("Fail","i_S4_SRR_RL_Clu_SNR_152 :%f",signalvalue1);
	}
}

testcase S4_SRR_RL_Clu_Mes_21_S4_SRR_RL_Clu_DynProp_152()
{
	signalvalue1 = getSignal(S4_SRR_RL_Clu_DynProp_152);
	write("S4_SRR_RL_Clu_DynProp_152 :%f",signalvalue1);
	write("i_S4_SRR_RL_Clu_DynProp_152 :%o",@ecu_Signals::i_S4_SRR_RL_Clu_DynProp_152);

	testStep("get expect variable value: ","i_S4_SRR_RL_Clu_DynProp_152 :%o",@ecu_Signals::i_S4_SRR_RL_Clu_DynProp_152);

	if(signalvalue1==@ecu_Signals::i_S4_SRR_RL_Clu_DynProp_152)
	{
	testStepPass("Pass","i_S4_SRR_RL_Clu_DynProp_152 :%f",signalvalue1);
	}
	else
	{
	testStepFail("Fail","i_S4_SRR_RL_Clu_DynProp_152 :%f",signalvalue1);
	}
}

testcase S4_SRR_RL_Clu_Mes_21_S4_SRR_RL_Clu_Locationvalid_152()
{
	signalvalue1 = getSignal(S4_SRR_RL_Clu_Locationvalid_152);
	write("S4_SRR_RL_Clu_Locationvalid_152 :%f",signalvalue1);
	write("i_S4_SRR_RL_Clu_Locationvalid_152 :%o",@ecu_Signals::i_S4_SRR_RL_Clu_Locationvalid_152);

	testStep("get expect variable value: ","i_S4_SRR_RL_Clu_Locationvalid_152 :%o",@ecu_Signals::i_S4_SRR_RL_Clu_Locationvalid_152);

	if(signalvalue1==@ecu_Signals::i_S4_SRR_RL_Clu_Locationvalid_152)
	{
	testStepPass("Pass","i_S4_SRR_RL_Clu_Locationvalid_152 :%f",signalvalue1);
	}
	else
	{
	testStepFail("Fail","i_S4_SRR_RL_Clu_Locationvalid_152 :%f",signalvalue1);
	}
}

testcase S4_SRR_RL_Clu_Mes_21_S4_SRR_RL_Clu_Theta_153()
{
	signalvalue1 = getSignal(S4_SRR_RL_Clu_Theta_153);
	write("S4_SRR_RL_Clu_Theta_153 :%f",signalvalue1);
	write("i_S4_SRR_RL_Clu_Theta_153 :%f",@ecu_Signals::i_S4_SRR_RL_Clu_Theta_153);

	testStep("get expect variable value: ","i_S4_SRR_RL_Clu_Theta_153 :%f",@ecu_Signals::i_S4_SRR_RL_Clu_Theta_153);

	if((abs(@ecu_Signals::i_S4_SRR_RL_Clu_Theta_153)*0.9<=abs(signalvalue1))&&(abs(signalvalue1)<=abs(@ecu_Signals::i_S4_SRR_RL_Clu_Theta_153)*1.1))
	{
	testStepPass("Pass","i_S4_SRR_RL_Clu_Theta_153 :%f",signalvalue1);
	}
	else
	{
	testStepFail("Fail","i_S4_SRR_RL_Clu_Theta_153 :%f",signalvalue1);
	}
}

testcase S4_SRR_RL_Clu_Mes_21_S4_SRR_RL_Clu_Dist_153()
{
	signalvalue1 = getSignal(S4_SRR_RL_Clu_Dist_153);
	write("S4_SRR_RL_Clu_Dist_153 :%f",signalvalue1);
	write("i_S4_SRR_RL_Clu_Dist_153 :%f",@ecu_Signals::i_S4_SRR_RL_Clu_Dist_153);

	testStep("get expect variable value: ","i_S4_SRR_RL_Clu_Dist_153 :%f",@ecu_Signals::i_S4_SRR_RL_Clu_Dist_153);

	if((abs(@ecu_Signals::i_S4_SRR_RL_Clu_Dist_153)*0.9<=abs(signalvalue1))&&(abs(signalvalue1)<=abs(@ecu_Signals::i_S4_SRR_RL_Clu_Dist_153)*1.1))
	{
	testStepPass("Pass","i_S4_SRR_RL_Clu_Dist_153 :%f",signalvalue1);
	}
	else
	{
	testStepFail("Fail","i_S4_SRR_RL_Clu_Dist_153 :%f",signalvalue1);
	}
}

testcase S4_SRR_RL_Clu_Mes_21_S4_SRR_RL_Clu_Vel_153()
{
	signalvalue1 = getSignal(S4_SRR_RL_Clu_Vel_153);
	write("S4_SRR_RL_Clu_Vel_153 :%f",signalvalue1);
	write("i_S4_SRR_RL_Clu_Vel_153 :%f",@ecu_Signals::i_S4_SRR_RL_Clu_Vel_153);

	testStep("get expect variable value: ","i_S4_SRR_RL_Clu_Vel_153 :%f",@ecu_Signals::i_S4_SRR_RL_Clu_Vel_153);

	if((abs(@ecu_Signals::i_S4_SRR_RL_Clu_Vel_153)*0.9<=abs(signalvalue1))&&(abs(signalvalue1)<=abs(@ecu_Signals::i_S4_SRR_RL_Clu_Vel_153)*1.1))
	{
	testStepPass("Pass","i_S4_SRR_RL_Clu_Vel_153 :%f",signalvalue1);
	}
	else
	{
	testStepFail("Fail","i_S4_SRR_RL_Clu_Vel_153 :%f",signalvalue1);
	}
}

testcase S4_SRR_RL_Clu_Mes_21_S4_SRR_RL_Clu_SNR_153()
{
	signalvalue1 = getSignal(S4_SRR_RL_Clu_SNR_153);
	write("S4_SRR_RL_Clu_SNR_153 :%f",signalvalue1);
	write("i_S4_SRR_RL_Clu_SNR_153 :%f",@ecu_Signals::i_S4_SRR_RL_Clu_SNR_153);

	testStep("get expect variable value: ","i_S4_SRR_RL_Clu_SNR_153 :%f",@ecu_Signals::i_S4_SRR_RL_Clu_SNR_153);

	if((abs(@ecu_Signals::i_S4_SRR_RL_Clu_SNR_153)*0.9<=abs(signalvalue1))&&(abs(signalvalue1)<=abs(@ecu_Signals::i_S4_SRR_RL_Clu_SNR_153)*1.1))
	{
	testStepPass("Pass","i_S4_SRR_RL_Clu_SNR_153 :%f",signalvalue1);
	}
	else
	{
	testStepFail("Fail","i_S4_SRR_RL_Clu_SNR_153 :%f",signalvalue1);
	}
}

testcase S4_SRR_RL_Clu_Mes_21_S4_SRR_RL_Clu_DynProp_153()
{
	signalvalue1 = getSignal(S4_SRR_RL_Clu_DynProp_153);
	write("S4_SRR_RL_Clu_DynProp_153 :%f",signalvalue1);
	write("i_S4_SRR_RL_Clu_DynProp_153 :%o",@ecu_Signals::i_S4_SRR_RL_Clu_DynProp_153);

	testStep("get expect variable value: ","i_S4_SRR_RL_Clu_DynProp_153 :%o",@ecu_Signals::i_S4_SRR_RL_Clu_DynProp_153);

	if(signalvalue1==@ecu_Signals::i_S4_SRR_RL_Clu_DynProp_153)
	{
	testStepPass("Pass","i_S4_SRR_RL_Clu_DynProp_153 :%f",signalvalue1);
	}
	else
	{
	testStepFail("Fail","i_S4_SRR_RL_Clu_DynProp_153 :%f",signalvalue1);
	}
}

testcase S4_SRR_RL_Clu_Mes_21_S4_SRR_RL_Clu_Locationvalid_153()
{
	signalvalue1 = getSignal(S4_SRR_RL_Clu_Locationvalid_153);
	write("S4_SRR_RL_Clu_Locationvalid_153 :%f",signalvalue1);
	write("i_S4_SRR_RL_Clu_Locationvalid_153 :%o",@ecu_Signals::i_S4_SRR_RL_Clu_Locationvalid_153);

	testStep("get expect variable value: ","i_S4_SRR_RL_Clu_Locationvalid_153 :%o",@ecu_Signals::i_S4_SRR_RL_Clu_Locationvalid_153);

	if(signalvalue1==@ecu_Signals::i_S4_SRR_RL_Clu_Locationvalid_153)
	{
	testStepPass("Pass","i_S4_SRR_RL_Clu_Locationvalid_153 :%f",signalvalue1);
	}
	else
	{
	testStepFail("Fail","i_S4_SRR_RL_Clu_Locationvalid_153 :%f",signalvalue1);
	}
}

testcase S4_SRR_RL_Clu_Mes_22_S4_SRR_RL_Clu_Theta_154()
{
	signalvalue1 = getSignal(S4_SRR_RL_Clu_Theta_154);
	write("S4_SRR_RL_Clu_Theta_154 :%f",signalvalue1);
	write("i_S4_SRR_RL_Clu_Theta_154 :%f",@ecu_Signals::i_S4_SRR_RL_Clu_Theta_154);

	testStep("get expect variable value: ","i_S4_SRR_RL_Clu_Theta_154 :%f",@ecu_Signals::i_S4_SRR_RL_Clu_Theta_154);

	if((abs(@ecu_Signals::i_S4_SRR_RL_Clu_Theta_154)*0.9<=abs(signalvalue1))&&(abs(signalvalue1)<=abs(@ecu_Signals::i_S4_SRR_RL_Clu_Theta_154)*1.1))
	{
	testStepPass("Pass","i_S4_SRR_RL_Clu_Theta_154 :%f",signalvalue1);
	}
	else
	{
	testStepFail("Fail","i_S4_SRR_RL_Clu_Theta_154 :%f",signalvalue1);
	}
}

testcase S4_SRR_RL_Clu_Mes_22_S4_SRR_RL_Clu_Dist_154()
{
	signalvalue1 = getSignal(S4_SRR_RL_Clu_Dist_154);
	write("S4_SRR_RL_Clu_Dist_154 :%f",signalvalue1);
	write("i_S4_SRR_RL_Clu_Dist_154 :%f",@ecu_Signals::i_S4_SRR_RL_Clu_Dist_154);

	testStep("get expect variable value: ","i_S4_SRR_RL_Clu_Dist_154 :%f",@ecu_Signals::i_S4_SRR_RL_Clu_Dist_154);

	if((abs(@ecu_Signals::i_S4_SRR_RL_Clu_Dist_154)*0.9<=abs(signalvalue1))&&(abs(signalvalue1)<=abs(@ecu_Signals::i_S4_SRR_RL_Clu_Dist_154)*1.1))
	{
	testStepPass("Pass","i_S4_SRR_RL_Clu_Dist_154 :%f",signalvalue1);
	}
	else
	{
	testStepFail("Fail","i_S4_SRR_RL_Clu_Dist_154 :%f",signalvalue1);
	}
}

testcase S4_SRR_RL_Clu_Mes_22_S4_SRR_RL_Clu_Vel_154()
{
	signalvalue1 = getSignal(S4_SRR_RL_Clu_Vel_154);
	write("S4_SRR_RL_Clu_Vel_154 :%f",signalvalue1);
	write("i_S4_SRR_RL_Clu_Vel_154 :%f",@ecu_Signals::i_S4_SRR_RL_Clu_Vel_154);

	testStep("get expect variable value: ","i_S4_SRR_RL_Clu_Vel_154 :%f",@ecu_Signals::i_S4_SRR_RL_Clu_Vel_154);

	if((abs(@ecu_Signals::i_S4_SRR_RL_Clu_Vel_154)*0.9<=abs(signalvalue1))&&(abs(signalvalue1)<=abs(@ecu_Signals::i_S4_SRR_RL_Clu_Vel_154)*1.1))
	{
	testStepPass("Pass","i_S4_SRR_RL_Clu_Vel_154 :%f",signalvalue1);
	}
	else
	{
	testStepFail("Fail","i_S4_SRR_RL_Clu_Vel_154 :%f",signalvalue1);
	}
}

testcase S4_SRR_RL_Clu_Mes_22_S4_SRR_RL_Clu_SNR_154()
{
	signalvalue1 = getSignal(S4_SRR_RL_Clu_SNR_154);
	write("S4_SRR_RL_Clu_SNR_154 :%f",signalvalue1);
	write("i_S4_SRR_RL_Clu_SNR_154 :%f",@ecu_Signals::i_S4_SRR_RL_Clu_SNR_154);

	testStep("get expect variable value: ","i_S4_SRR_RL_Clu_SNR_154 :%f",@ecu_Signals::i_S4_SRR_RL_Clu_SNR_154);

	if((abs(@ecu_Signals::i_S4_SRR_RL_Clu_SNR_154)*0.9<=abs(signalvalue1))&&(abs(signalvalue1)<=abs(@ecu_Signals::i_S4_SRR_RL_Clu_SNR_154)*1.1))
	{
	testStepPass("Pass","i_S4_SRR_RL_Clu_SNR_154 :%f",signalvalue1);
	}
	else
	{
	testStepFail("Fail","i_S4_SRR_RL_Clu_SNR_154 :%f",signalvalue1);
	}
}

testcase S4_SRR_RL_Clu_Mes_22_S4_SRR_RL_Clu_DynProp_154()
{
	signalvalue1 = getSignal(S4_SRR_RL_Clu_DynProp_154);
	write("S4_SRR_RL_Clu_DynProp_154 :%f",signalvalue1);
	write("i_S4_SRR_RL_Clu_DynProp_154 :%o",@ecu_Signals::i_S4_SRR_RL_Clu_DynProp_154);

	testStep("get expect variable value: ","i_S4_SRR_RL_Clu_DynProp_154 :%o",@ecu_Signals::i_S4_SRR_RL_Clu_DynProp_154);

	if(signalvalue1==@ecu_Signals::i_S4_SRR_RL_Clu_DynProp_154)
	{
	testStepPass("Pass","i_S4_SRR_RL_Clu_DynProp_154 :%f",signalvalue1);
	}
	else
	{
	testStepFail("Fail","i_S4_SRR_RL_Clu_DynProp_154 :%f",signalvalue1);
	}
}

testcase S4_SRR_RL_Clu_Mes_22_S4_SRR_RL_Clu_Locationvalid_154()
{
	signalvalue1 = getSignal(S4_SRR_RL_Clu_Locationvalid_154);
	write("S4_SRR_RL_Clu_Locationvalid_154 :%f",signalvalue1);
	write("i_S4_SRR_RL_Clu_Locationvalid_154 :%o",@ecu_Signals::i_S4_SRR_RL_Clu_Locationvalid_154);

	testStep("get expect variable value: ","i_S4_SRR_RL_Clu_Locationvalid_154 :%o",@ecu_Signals::i_S4_SRR_RL_Clu_Locationvalid_154);

	if(signalvalue1==@ecu_Signals::i_S4_SRR_RL_Clu_Locationvalid_154)
	{
	testStepPass("Pass","i_S4_SRR_RL_Clu_Locationvalid_154 :%f",signalvalue1);
	}
	else
	{
	testStepFail("Fail","i_S4_SRR_RL_Clu_Locationvalid_154 :%f",signalvalue1);
	}
}

testcase S4_SRR_RL_Clu_Mes_22_S4_SRR_RL_Clu_Theta_155()
{
	signalvalue1 = getSignal(S4_SRR_RL_Clu_Theta_155);
	write("S4_SRR_RL_Clu_Theta_155 :%f",signalvalue1);
	write("i_S4_SRR_RL_Clu_Theta_155 :%f",@ecu_Signals::i_S4_SRR_RL_Clu_Theta_155);

	testStep("get expect variable value: ","i_S4_SRR_RL_Clu_Theta_155 :%f",@ecu_Signals::i_S4_SRR_RL_Clu_Theta_155);

	if((abs(@ecu_Signals::i_S4_SRR_RL_Clu_Theta_155)*0.9<=abs(signalvalue1))&&(abs(signalvalue1)<=abs(@ecu_Signals::i_S4_SRR_RL_Clu_Theta_155)*1.1))
	{
	testStepPass("Pass","i_S4_SRR_RL_Clu_Theta_155 :%f",signalvalue1);
	}
	else
	{
	testStepFail("Fail","i_S4_SRR_RL_Clu_Theta_155 :%f",signalvalue1);
	}
}

testcase S4_SRR_RL_Clu_Mes_22_S4_SRR_RL_Clu_Dist_155()
{
	signalvalue1 = getSignal(S4_SRR_RL_Clu_Dist_155);
	write("S4_SRR_RL_Clu_Dist_155 :%f",signalvalue1);
	write("i_S4_SRR_RL_Clu_Dist_155 :%f",@ecu_Signals::i_S4_SRR_RL_Clu_Dist_155);

	testStep("get expect variable value: ","i_S4_SRR_RL_Clu_Dist_155 :%f",@ecu_Signals::i_S4_SRR_RL_Clu_Dist_155);

	if((abs(@ecu_Signals::i_S4_SRR_RL_Clu_Dist_155)*0.9<=abs(signalvalue1))&&(abs(signalvalue1)<=abs(@ecu_Signals::i_S4_SRR_RL_Clu_Dist_155)*1.1))
	{
	testStepPass("Pass","i_S4_SRR_RL_Clu_Dist_155 :%f",signalvalue1);
	}
	else
	{
	testStepFail("Fail","i_S4_SRR_RL_Clu_Dist_155 :%f",signalvalue1);
	}
}

testcase S4_SRR_RL_Clu_Mes_22_S4_SRR_RL_Clu_Vel_155()
{
	signalvalue1 = getSignal(S4_SRR_RL_Clu_Vel_155);
	write("S4_SRR_RL_Clu_Vel_155 :%f",signalvalue1);
	write("i_S4_SRR_RL_Clu_Vel_155 :%f",@ecu_Signals::i_S4_SRR_RL_Clu_Vel_155);

	testStep("get expect variable value: ","i_S4_SRR_RL_Clu_Vel_155 :%f",@ecu_Signals::i_S4_SRR_RL_Clu_Vel_155);

	if((abs(@ecu_Signals::i_S4_SRR_RL_Clu_Vel_155)*0.9<=abs(signalvalue1))&&(abs(signalvalue1)<=abs(@ecu_Signals::i_S4_SRR_RL_Clu_Vel_155)*1.1))
	{
	testStepPass("Pass","i_S4_SRR_RL_Clu_Vel_155 :%f",signalvalue1);
	}
	else
	{
	testStepFail("Fail","i_S4_SRR_RL_Clu_Vel_155 :%f",signalvalue1);
	}
}

testcase S4_SRR_RL_Clu_Mes_22_S4_SRR_RL_Clu_SNR_155()
{
	signalvalue1 = getSignal(S4_SRR_RL_Clu_SNR_155);
	write("S4_SRR_RL_Clu_SNR_155 :%f",signalvalue1);
	write("i_S4_SRR_RL_Clu_SNR_155 :%f",@ecu_Signals::i_S4_SRR_RL_Clu_SNR_155);

	testStep("get expect variable value: ","i_S4_SRR_RL_Clu_SNR_155 :%f",@ecu_Signals::i_S4_SRR_RL_Clu_SNR_155);

	if((abs(@ecu_Signals::i_S4_SRR_RL_Clu_SNR_155)*0.9<=abs(signalvalue1))&&(abs(signalvalue1)<=abs(@ecu_Signals::i_S4_SRR_RL_Clu_SNR_155)*1.1))
	{
	testStepPass("Pass","i_S4_SRR_RL_Clu_SNR_155 :%f",signalvalue1);
	}
	else
	{
	testStepFail("Fail","i_S4_SRR_RL_Clu_SNR_155 :%f",signalvalue1);
	}
}

testcase S4_SRR_RL_Clu_Mes_22_S4_SRR_RL_Clu_DynProp_155()
{
	signalvalue1 = getSignal(S4_SRR_RL_Clu_DynProp_155);
	write("S4_SRR_RL_Clu_DynProp_155 :%f",signalvalue1);
	write("i_S4_SRR_RL_Clu_DynProp_155 :%o",@ecu_Signals::i_S4_SRR_RL_Clu_DynProp_155);

	testStep("get expect variable value: ","i_S4_SRR_RL_Clu_DynProp_155 :%o",@ecu_Signals::i_S4_SRR_RL_Clu_DynProp_155);

	if(signalvalue1==@ecu_Signals::i_S4_SRR_RL_Clu_DynProp_155)
	{
	testStepPass("Pass","i_S4_SRR_RL_Clu_DynProp_155 :%f",signalvalue1);
	}
	else
	{
	testStepFail("Fail","i_S4_SRR_RL_Clu_DynProp_155 :%f",signalvalue1);
	}
}

testcase S4_SRR_RL_Clu_Mes_22_S4_SRR_RL_Clu_Locationvalid_155()
{
	signalvalue1 = getSignal(S4_SRR_RL_Clu_Locationvalid_155);
	write("S4_SRR_RL_Clu_Locationvalid_155 :%f",signalvalue1);
	write("i_S4_SRR_RL_Clu_Locationvalid_155 :%o",@ecu_Signals::i_S4_SRR_RL_Clu_Locationvalid_155);

	testStep("get expect variable value: ","i_S4_SRR_RL_Clu_Locationvalid_155 :%o",@ecu_Signals::i_S4_SRR_RL_Clu_Locationvalid_155);

	if(signalvalue1==@ecu_Signals::i_S4_SRR_RL_Clu_Locationvalid_155)
	{
	testStepPass("Pass","i_S4_SRR_RL_Clu_Locationvalid_155 :%f",signalvalue1);
	}
	else
	{
	testStepFail("Fail","i_S4_SRR_RL_Clu_Locationvalid_155 :%f",signalvalue1);
	}
}

testcase S4_SRR_RL_Clu_Mes_22_S4_SRR_RL_Clu_Theta_156()
{
	signalvalue1 = getSignal(S4_SRR_RL_Clu_Theta_156);
	write("S4_SRR_RL_Clu_Theta_156 :%f",signalvalue1);
	write("i_S4_SRR_RL_Clu_Theta_156 :%f",@ecu_Signals::i_S4_SRR_RL_Clu_Theta_156);

	testStep("get expect variable value: ","i_S4_SRR_RL_Clu_Theta_156 :%f",@ecu_Signals::i_S4_SRR_RL_Clu_Theta_156);

	if((abs(@ecu_Signals::i_S4_SRR_RL_Clu_Theta_156)*0.9<=abs(signalvalue1))&&(abs(signalvalue1)<=abs(@ecu_Signals::i_S4_SRR_RL_Clu_Theta_156)*1.1))
	{
	testStepPass("Pass","i_S4_SRR_RL_Clu_Theta_156 :%f",signalvalue1);
	}
	else
	{
	testStepFail("Fail","i_S4_SRR_RL_Clu_Theta_156 :%f",signalvalue1);
	}
}

testcase S4_SRR_RL_Clu_Mes_22_S4_SRR_RL_Clu_Dist_156()
{
	signalvalue1 = getSignal(S4_SRR_RL_Clu_Dist_156);
	write("S4_SRR_RL_Clu_Dist_156 :%f",signalvalue1);
	write("i_S4_SRR_RL_Clu_Dist_156 :%f",@ecu_Signals::i_S4_SRR_RL_Clu_Dist_156);

	testStep("get expect variable value: ","i_S4_SRR_RL_Clu_Dist_156 :%f",@ecu_Signals::i_S4_SRR_RL_Clu_Dist_156);

	if((abs(@ecu_Signals::i_S4_SRR_RL_Clu_Dist_156)*0.9<=abs(signalvalue1))&&(abs(signalvalue1)<=abs(@ecu_Signals::i_S4_SRR_RL_Clu_Dist_156)*1.1))
	{
	testStepPass("Pass","i_S4_SRR_RL_Clu_Dist_156 :%f",signalvalue1);
	}
	else
	{
	testStepFail("Fail","i_S4_SRR_RL_Clu_Dist_156 :%f",signalvalue1);
	}
}

testcase S4_SRR_RL_Clu_Mes_22_S4_SRR_RL_Clu_Vel_156()
{
	signalvalue1 = getSignal(S4_SRR_RL_Clu_Vel_156);
	write("S4_SRR_RL_Clu_Vel_156 :%f",signalvalue1);
	write("i_S4_SRR_RL_Clu_Vel_156 :%f",@ecu_Signals::i_S4_SRR_RL_Clu_Vel_156);

	testStep("get expect variable value: ","i_S4_SRR_RL_Clu_Vel_156 :%f",@ecu_Signals::i_S4_SRR_RL_Clu_Vel_156);

	if((abs(@ecu_Signals::i_S4_SRR_RL_Clu_Vel_156)*0.9<=abs(signalvalue1))&&(abs(signalvalue1)<=abs(@ecu_Signals::i_S4_SRR_RL_Clu_Vel_156)*1.1))
	{
	testStepPass("Pass","i_S4_SRR_RL_Clu_Vel_156 :%f",signalvalue1);
	}
	else
	{
	testStepFail("Fail","i_S4_SRR_RL_Clu_Vel_156 :%f",signalvalue1);
	}
}

testcase S4_SRR_RL_Clu_Mes_22_S4_SRR_RL_Clu_SNR_156()
{
	signalvalue1 = getSignal(S4_SRR_RL_Clu_SNR_156);
	write("S4_SRR_RL_Clu_SNR_156 :%f",signalvalue1);
	write("i_S4_SRR_RL_Clu_SNR_156 :%f",@ecu_Signals::i_S4_SRR_RL_Clu_SNR_156);

	testStep("get expect variable value: ","i_S4_SRR_RL_Clu_SNR_156 :%f",@ecu_Signals::i_S4_SRR_RL_Clu_SNR_156);

	if((abs(@ecu_Signals::i_S4_SRR_RL_Clu_SNR_156)*0.9<=abs(signalvalue1))&&(abs(signalvalue1)<=abs(@ecu_Signals::i_S4_SRR_RL_Clu_SNR_156)*1.1))
	{
	testStepPass("Pass","i_S4_SRR_RL_Clu_SNR_156 :%f",signalvalue1);
	}
	else
	{
	testStepFail("Fail","i_S4_SRR_RL_Clu_SNR_156 :%f",signalvalue1);
	}
}

testcase S4_SRR_RL_Clu_Mes_22_S4_SRR_RL_Clu_DynProp_156()
{
	signalvalue1 = getSignal(S4_SRR_RL_Clu_DynProp_156);
	write("S4_SRR_RL_Clu_DynProp_156 :%f",signalvalue1);
	write("i_S4_SRR_RL_Clu_DynProp_156 :%o",@ecu_Signals::i_S4_SRR_RL_Clu_DynProp_156);

	testStep("get expect variable value: ","i_S4_SRR_RL_Clu_DynProp_156 :%o",@ecu_Signals::i_S4_SRR_RL_Clu_DynProp_156);

	if(signalvalue1==@ecu_Signals::i_S4_SRR_RL_Clu_DynProp_156)
	{
	testStepPass("Pass","i_S4_SRR_RL_Clu_DynProp_156 :%f",signalvalue1);
	}
	else
	{
	testStepFail("Fail","i_S4_SRR_RL_Clu_DynProp_156 :%f",signalvalue1);
	}
}

testcase S4_SRR_RL_Clu_Mes_22_S4_SRR_RL_Clu_Locationvalid_156()
{
	signalvalue1 = getSignal(S4_SRR_RL_Clu_Locationvalid_156);
	write("S4_SRR_RL_Clu_Locationvalid_156 :%f",signalvalue1);
	write("i_S4_SRR_RL_Clu_Locationvalid_156 :%o",@ecu_Signals::i_S4_SRR_RL_Clu_Locationvalid_156);

	testStep("get expect variable value: ","i_S4_SRR_RL_Clu_Locationvalid_156 :%o",@ecu_Signals::i_S4_SRR_RL_Clu_Locationvalid_156);

	if(signalvalue1==@ecu_Signals::i_S4_SRR_RL_Clu_Locationvalid_156)
	{
	testStepPass("Pass","i_S4_SRR_RL_Clu_Locationvalid_156 :%f",signalvalue1);
	}
	else
	{
	testStepFail("Fail","i_S4_SRR_RL_Clu_Locationvalid_156 :%f",signalvalue1);
	}
}

testcase S4_SRR_RL_Clu_Mes_22_S4_SRR_RL_Clu_Theta_157()
{
	signalvalue1 = getSignal(S4_SRR_RL_Clu_Theta_157);
	write("S4_SRR_RL_Clu_Theta_157 :%f",signalvalue1);
	write("i_S4_SRR_RL_Clu_Theta_157 :%f",@ecu_Signals::i_S4_SRR_RL_Clu_Theta_157);

	testStep("get expect variable value: ","i_S4_SRR_RL_Clu_Theta_157 :%f",@ecu_Signals::i_S4_SRR_RL_Clu_Theta_157);

	if((abs(@ecu_Signals::i_S4_SRR_RL_Clu_Theta_157)*0.9<=abs(signalvalue1))&&(abs(signalvalue1)<=abs(@ecu_Signals::i_S4_SRR_RL_Clu_Theta_157)*1.1))
	{
	testStepPass("Pass","i_S4_SRR_RL_Clu_Theta_157 :%f",signalvalue1);
	}
	else
	{
	testStepFail("Fail","i_S4_SRR_RL_Clu_Theta_157 :%f",signalvalue1);
	}
}

testcase S4_SRR_RL_Clu_Mes_22_S4_SRR_RL_Clu_Dist_157()
{
	signalvalue1 = getSignal(S4_SRR_RL_Clu_Dist_157);
	write("S4_SRR_RL_Clu_Dist_157 :%f",signalvalue1);
	write("i_S4_SRR_RL_Clu_Dist_157 :%f",@ecu_Signals::i_S4_SRR_RL_Clu_Dist_157);

	testStep("get expect variable value: ","i_S4_SRR_RL_Clu_Dist_157 :%f",@ecu_Signals::i_S4_SRR_RL_Clu_Dist_157);

	if((abs(@ecu_Signals::i_S4_SRR_RL_Clu_Dist_157)*0.9<=abs(signalvalue1))&&(abs(signalvalue1)<=abs(@ecu_Signals::i_S4_SRR_RL_Clu_Dist_157)*1.1))
	{
	testStepPass("Pass","i_S4_SRR_RL_Clu_Dist_157 :%f",signalvalue1);
	}
	else
	{
	testStepFail("Fail","i_S4_SRR_RL_Clu_Dist_157 :%f",signalvalue1);
	}
}

testcase S4_SRR_RL_Clu_Mes_22_S4_SRR_RL_Clu_Vel_157()
{
	signalvalue1 = getSignal(S4_SRR_RL_Clu_Vel_157);
	write("S4_SRR_RL_Clu_Vel_157 :%f",signalvalue1);
	write("i_S4_SRR_RL_Clu_Vel_157 :%f",@ecu_Signals::i_S4_SRR_RL_Clu_Vel_157);

	testStep("get expect variable value: ","i_S4_SRR_RL_Clu_Vel_157 :%f",@ecu_Signals::i_S4_SRR_RL_Clu_Vel_157);

	if((abs(@ecu_Signals::i_S4_SRR_RL_Clu_Vel_157)*0.9<=abs(signalvalue1))&&(abs(signalvalue1)<=abs(@ecu_Signals::i_S4_SRR_RL_Clu_Vel_157)*1.1))
	{
	testStepPass("Pass","i_S4_SRR_RL_Clu_Vel_157 :%f",signalvalue1);
	}
	else
	{
	testStepFail("Fail","i_S4_SRR_RL_Clu_Vel_157 :%f",signalvalue1);
	}
}

testcase S4_SRR_RL_Clu_Mes_22_S4_SRR_RL_Clu_SNR_157()
{
	signalvalue1 = getSignal(S4_SRR_RL_Clu_SNR_157);
	write("S4_SRR_RL_Clu_SNR_157 :%f",signalvalue1);
	write("i_S4_SRR_RL_Clu_SNR_157 :%f",@ecu_Signals::i_S4_SRR_RL_Clu_SNR_157);

	testStep("get expect variable value: ","i_S4_SRR_RL_Clu_SNR_157 :%f",@ecu_Signals::i_S4_SRR_RL_Clu_SNR_157);

	if((abs(@ecu_Signals::i_S4_SRR_RL_Clu_SNR_157)*0.9<=abs(signalvalue1))&&(abs(signalvalue1)<=abs(@ecu_Signals::i_S4_SRR_RL_Clu_SNR_157)*1.1))
	{
	testStepPass("Pass","i_S4_SRR_RL_Clu_SNR_157 :%f",signalvalue1);
	}
	else
	{
	testStepFail("Fail","i_S4_SRR_RL_Clu_SNR_157 :%f",signalvalue1);
	}
}

testcase S4_SRR_RL_Clu_Mes_22_S4_SRR_RL_Clu_DynProp_157()
{
	signalvalue1 = getSignal(S4_SRR_RL_Clu_DynProp_157);
	write("S4_SRR_RL_Clu_DynProp_157 :%f",signalvalue1);
	write("i_S4_SRR_RL_Clu_DynProp_157 :%o",@ecu_Signals::i_S4_SRR_RL_Clu_DynProp_157);

	testStep("get expect variable value: ","i_S4_SRR_RL_Clu_DynProp_157 :%o",@ecu_Signals::i_S4_SRR_RL_Clu_DynProp_157);

	if(signalvalue1==@ecu_Signals::i_S4_SRR_RL_Clu_DynProp_157)
	{
	testStepPass("Pass","i_S4_SRR_RL_Clu_DynProp_157 :%f",signalvalue1);
	}
	else
	{
	testStepFail("Fail","i_S4_SRR_RL_Clu_DynProp_157 :%f",signalvalue1);
	}
}

testcase S4_SRR_RL_Clu_Mes_22_S4_SRR_RL_Clu_Locationvalid_157()
{
	signalvalue1 = getSignal(S4_SRR_RL_Clu_Locationvalid_157);
	write("S4_SRR_RL_Clu_Locationvalid_157 :%f",signalvalue1);
	write("i_S4_SRR_RL_Clu_Locationvalid_157 :%o",@ecu_Signals::i_S4_SRR_RL_Clu_Locationvalid_157);

	testStep("get expect variable value: ","i_S4_SRR_RL_Clu_Locationvalid_157 :%o",@ecu_Signals::i_S4_SRR_RL_Clu_Locationvalid_157);

	if(signalvalue1==@ecu_Signals::i_S4_SRR_RL_Clu_Locationvalid_157)
	{
	testStepPass("Pass","i_S4_SRR_RL_Clu_Locationvalid_157 :%f",signalvalue1);
	}
	else
	{
	testStepFail("Fail","i_S4_SRR_RL_Clu_Locationvalid_157 :%f",signalvalue1);
	}
}

testcase S4_SRR_RL_Clu_Mes_22_S4_SRR_RL_Clu_Theta_158()
{
	signalvalue1 = getSignal(S4_SRR_RL_Clu_Theta_158);
	write("S4_SRR_RL_Clu_Theta_158 :%f",signalvalue1);
	write("i_S4_SRR_RL_Clu_Theta_158 :%f",@ecu_Signals::i_S4_SRR_RL_Clu_Theta_158);

	testStep("get expect variable value: ","i_S4_SRR_RL_Clu_Theta_158 :%f",@ecu_Signals::i_S4_SRR_RL_Clu_Theta_158);

	if((abs(@ecu_Signals::i_S4_SRR_RL_Clu_Theta_158)*0.9<=abs(signalvalue1))&&(abs(signalvalue1)<=abs(@ecu_Signals::i_S4_SRR_RL_Clu_Theta_158)*1.1))
	{
	testStepPass("Pass","i_S4_SRR_RL_Clu_Theta_158 :%f",signalvalue1);
	}
	else
	{
	testStepFail("Fail","i_S4_SRR_RL_Clu_Theta_158 :%f",signalvalue1);
	}
}

testcase S4_SRR_RL_Clu_Mes_22_S4_SRR_RL_Clu_Dist_158()
{
	signalvalue1 = getSignal(S4_SRR_RL_Clu_Dist_158);
	write("S4_SRR_RL_Clu_Dist_158 :%f",signalvalue1);
	write("i_S4_SRR_RL_Clu_Dist_158 :%f",@ecu_Signals::i_S4_SRR_RL_Clu_Dist_158);

	testStep("get expect variable value: ","i_S4_SRR_RL_Clu_Dist_158 :%f",@ecu_Signals::i_S4_SRR_RL_Clu_Dist_158);

	if((abs(@ecu_Signals::i_S4_SRR_RL_Clu_Dist_158)*0.9<=abs(signalvalue1))&&(abs(signalvalue1)<=abs(@ecu_Signals::i_S4_SRR_RL_Clu_Dist_158)*1.1))
	{
	testStepPass("Pass","i_S4_SRR_RL_Clu_Dist_158 :%f",signalvalue1);
	}
	else
	{
	testStepFail("Fail","i_S4_SRR_RL_Clu_Dist_158 :%f",signalvalue1);
	}
}

testcase S4_SRR_RL_Clu_Mes_22_S4_SRR_RL_Clu_Vel_158()
{
	signalvalue1 = getSignal(S4_SRR_RL_Clu_Vel_158);
	write("S4_SRR_RL_Clu_Vel_158 :%f",signalvalue1);
	write("i_S4_SRR_RL_Clu_Vel_158 :%f",@ecu_Signals::i_S4_SRR_RL_Clu_Vel_158);

	testStep("get expect variable value: ","i_S4_SRR_RL_Clu_Vel_158 :%f",@ecu_Signals::i_S4_SRR_RL_Clu_Vel_158);

	if((abs(@ecu_Signals::i_S4_SRR_RL_Clu_Vel_158)*0.9<=abs(signalvalue1))&&(abs(signalvalue1)<=abs(@ecu_Signals::i_S4_SRR_RL_Clu_Vel_158)*1.1))
	{
	testStepPass("Pass","i_S4_SRR_RL_Clu_Vel_158 :%f",signalvalue1);
	}
	else
	{
	testStepFail("Fail","i_S4_SRR_RL_Clu_Vel_158 :%f",signalvalue1);
	}
}

testcase S4_SRR_RL_Clu_Mes_22_S4_SRR_RL_Clu_SNR_158()
{
	signalvalue1 = getSignal(S4_SRR_RL_Clu_SNR_158);
	write("S4_SRR_RL_Clu_SNR_158 :%f",signalvalue1);
	write("i_S4_SRR_RL_Clu_SNR_158 :%f",@ecu_Signals::i_S4_SRR_RL_Clu_SNR_158);

	testStep("get expect variable value: ","i_S4_SRR_RL_Clu_SNR_158 :%f",@ecu_Signals::i_S4_SRR_RL_Clu_SNR_158);

	if((abs(@ecu_Signals::i_S4_SRR_RL_Clu_SNR_158)*0.9<=abs(signalvalue1))&&(abs(signalvalue1)<=abs(@ecu_Signals::i_S4_SRR_RL_Clu_SNR_158)*1.1))
	{
	testStepPass("Pass","i_S4_SRR_RL_Clu_SNR_158 :%f",signalvalue1);
	}
	else
	{
	testStepFail("Fail","i_S4_SRR_RL_Clu_SNR_158 :%f",signalvalue1);
	}
}

testcase S4_SRR_RL_Clu_Mes_22_S4_SRR_RL_Clu_DynProp_158()
{
	signalvalue1 = getSignal(S4_SRR_RL_Clu_DynProp_158);
	write("S4_SRR_RL_Clu_DynProp_158 :%f",signalvalue1);
	write("i_S4_SRR_RL_Clu_DynProp_158 :%o",@ecu_Signals::i_S4_SRR_RL_Clu_DynProp_158);

	testStep("get expect variable value: ","i_S4_SRR_RL_Clu_DynProp_158 :%o",@ecu_Signals::i_S4_SRR_RL_Clu_DynProp_158);

	if(signalvalue1==@ecu_Signals::i_S4_SRR_RL_Clu_DynProp_158)
	{
	testStepPass("Pass","i_S4_SRR_RL_Clu_DynProp_158 :%f",signalvalue1);
	}
	else
	{
	testStepFail("Fail","i_S4_SRR_RL_Clu_DynProp_158 :%f",signalvalue1);
	}
}

testcase S4_SRR_RL_Clu_Mes_22_S4_SRR_RL_Clu_Locationvalid_158()
{
	signalvalue1 = getSignal(S4_SRR_RL_Clu_Locationvalid_158);
	write("S4_SRR_RL_Clu_Locationvalid_158 :%f",signalvalue1);
	write("i_S4_SRR_RL_Clu_Locationvalid_158 :%o",@ecu_Signals::i_S4_SRR_RL_Clu_Locationvalid_158);

	testStep("get expect variable value: ","i_S4_SRR_RL_Clu_Locationvalid_158 :%o",@ecu_Signals::i_S4_SRR_RL_Clu_Locationvalid_158);

	if(signalvalue1==@ecu_Signals::i_S4_SRR_RL_Clu_Locationvalid_158)
	{
	testStepPass("Pass","i_S4_SRR_RL_Clu_Locationvalid_158 :%f",signalvalue1);
	}
	else
	{
	testStepFail("Fail","i_S4_SRR_RL_Clu_Locationvalid_158 :%f",signalvalue1);
	}
}

testcase S4_SRR_RL_Clu_Mes_22_S4_SRR_RL_Clu_Theta_159()
{
	signalvalue1 = getSignal(S4_SRR_RL_Clu_Theta_159);
	write("S4_SRR_RL_Clu_Theta_159 :%f",signalvalue1);
	write("i_S4_SRR_RL_Clu_Theta_159 :%f",@ecu_Signals::i_S4_SRR_RL_Clu_Theta_159);

	testStep("get expect variable value: ","i_S4_SRR_RL_Clu_Theta_159 :%f",@ecu_Signals::i_S4_SRR_RL_Clu_Theta_159);

	if((abs(@ecu_Signals::i_S4_SRR_RL_Clu_Theta_159)*0.9<=abs(signalvalue1))&&(abs(signalvalue1)<=abs(@ecu_Signals::i_S4_SRR_RL_Clu_Theta_159)*1.1))
	{
	testStepPass("Pass","i_S4_SRR_RL_Clu_Theta_159 :%f",signalvalue1);
	}
	else
	{
	testStepFail("Fail","i_S4_SRR_RL_Clu_Theta_159 :%f",signalvalue1);
	}
}

testcase S4_SRR_RL_Clu_Mes_22_S4_SRR_RL_Clu_Dist_159()
{
	signalvalue1 = getSignal(S4_SRR_RL_Clu_Dist_159);
	write("S4_SRR_RL_Clu_Dist_159 :%f",signalvalue1);
	write("i_S4_SRR_RL_Clu_Dist_159 :%f",@ecu_Signals::i_S4_SRR_RL_Clu_Dist_159);

	testStep("get expect variable value: ","i_S4_SRR_RL_Clu_Dist_159 :%f",@ecu_Signals::i_S4_SRR_RL_Clu_Dist_159);

	if((abs(@ecu_Signals::i_S4_SRR_RL_Clu_Dist_159)*0.9<=abs(signalvalue1))&&(abs(signalvalue1)<=abs(@ecu_Signals::i_S4_SRR_RL_Clu_Dist_159)*1.1))
	{
	testStepPass("Pass","i_S4_SRR_RL_Clu_Dist_159 :%f",signalvalue1);
	}
	else
	{
	testStepFail("Fail","i_S4_SRR_RL_Clu_Dist_159 :%f",signalvalue1);
	}
}

testcase S4_SRR_RL_Clu_Mes_22_S4_SRR_RL_Clu_Vel_159()
{
	signalvalue1 = getSignal(S4_SRR_RL_Clu_Vel_159);
	write("S4_SRR_RL_Clu_Vel_159 :%f",signalvalue1);
	write("i_S4_SRR_RL_Clu_Vel_159 :%f",@ecu_Signals::i_S4_SRR_RL_Clu_Vel_159);

	testStep("get expect variable value: ","i_S4_SRR_RL_Clu_Vel_159 :%f",@ecu_Signals::i_S4_SRR_RL_Clu_Vel_159);

	if((abs(@ecu_Signals::i_S4_SRR_RL_Clu_Vel_159)*0.9<=abs(signalvalue1))&&(abs(signalvalue1)<=abs(@ecu_Signals::i_S4_SRR_RL_Clu_Vel_159)*1.1))
	{
	testStepPass("Pass","i_S4_SRR_RL_Clu_Vel_159 :%f",signalvalue1);
	}
	else
	{
	testStepFail("Fail","i_S4_SRR_RL_Clu_Vel_159 :%f",signalvalue1);
	}
}

testcase S4_SRR_RL_Clu_Mes_22_S4_SRR_RL_Clu_SNR_159()
{
	signalvalue1 = getSignal(S4_SRR_RL_Clu_SNR_159);
	write("S4_SRR_RL_Clu_SNR_159 :%f",signalvalue1);
	write("i_S4_SRR_RL_Clu_SNR_159 :%f",@ecu_Signals::i_S4_SRR_RL_Clu_SNR_159);

	testStep("get expect variable value: ","i_S4_SRR_RL_Clu_SNR_159 :%f",@ecu_Signals::i_S4_SRR_RL_Clu_SNR_159);

	if((abs(@ecu_Signals::i_S4_SRR_RL_Clu_SNR_159)*0.9<=abs(signalvalue1))&&(abs(signalvalue1)<=abs(@ecu_Signals::i_S4_SRR_RL_Clu_SNR_159)*1.1))
	{
	testStepPass("Pass","i_S4_SRR_RL_Clu_SNR_159 :%f",signalvalue1);
	}
	else
	{
	testStepFail("Fail","i_S4_SRR_RL_Clu_SNR_159 :%f",signalvalue1);
	}
}

testcase S4_SRR_RL_Clu_Mes_22_S4_SRR_RL_Clu_DynProp_159()
{
	signalvalue1 = getSignal(S4_SRR_RL_Clu_DynProp_159);
	write("S4_SRR_RL_Clu_DynProp_159 :%f",signalvalue1);
	write("i_S4_SRR_RL_Clu_DynProp_159 :%o",@ecu_Signals::i_S4_SRR_RL_Clu_DynProp_159);

	testStep("get expect variable value: ","i_S4_SRR_RL_Clu_DynProp_159 :%o",@ecu_Signals::i_S4_SRR_RL_Clu_DynProp_159);

	if(signalvalue1==@ecu_Signals::i_S4_SRR_RL_Clu_DynProp_159)
	{
	testStepPass("Pass","i_S4_SRR_RL_Clu_DynProp_159 :%f",signalvalue1);
	}
	else
	{
	testStepFail("Fail","i_S4_SRR_RL_Clu_DynProp_159 :%f",signalvalue1);
	}
}

testcase S4_SRR_RL_Clu_Mes_22_S4_SRR_RL_Clu_Locationvalid_159()
{
	signalvalue1 = getSignal(S4_SRR_RL_Clu_Locationvalid_159);
	write("S4_SRR_RL_Clu_Locationvalid_159 :%f",signalvalue1);
	write("i_S4_SRR_RL_Clu_Locationvalid_159 :%o",@ecu_Signals::i_S4_SRR_RL_Clu_Locationvalid_159);

	testStep("get expect variable value: ","i_S4_SRR_RL_Clu_Locationvalid_159 :%o",@ecu_Signals::i_S4_SRR_RL_Clu_Locationvalid_159);

	if(signalvalue1==@ecu_Signals::i_S4_SRR_RL_Clu_Locationvalid_159)
	{
	testStepPass("Pass","i_S4_SRR_RL_Clu_Locationvalid_159 :%f",signalvalue1);
	}
	else
	{
	testStepFail("Fail","i_S4_SRR_RL_Clu_Locationvalid_159 :%f",signalvalue1);
	}
}

testcase S4_SRR_RL_Clu_Mes_22_S4_SRR_RL_Clu_Theta_160()
{
	signalvalue1 = getSignal(S4_SRR_RL_Clu_Theta_160);
	write("S4_SRR_RL_Clu_Theta_160 :%f",signalvalue1);
	write("i_S4_SRR_RL_Clu_Theta_160 :%f",@ecu_Signals::i_S4_SRR_RL_Clu_Theta_160);

	testStep("get expect variable value: ","i_S4_SRR_RL_Clu_Theta_160 :%f",@ecu_Signals::i_S4_SRR_RL_Clu_Theta_160);

	if((abs(@ecu_Signals::i_S4_SRR_RL_Clu_Theta_160)*0.9<=abs(signalvalue1))&&(abs(signalvalue1)<=abs(@ecu_Signals::i_S4_SRR_RL_Clu_Theta_160)*1.1))
	{
	testStepPass("Pass","i_S4_SRR_RL_Clu_Theta_160 :%f",signalvalue1);
	}
	else
	{
	testStepFail("Fail","i_S4_SRR_RL_Clu_Theta_160 :%f",signalvalue1);
	}
}

testcase S4_SRR_RL_Clu_Mes_22_S4_SRR_RL_Clu_Dist_160()
{
	signalvalue1 = getSignal(S4_SRR_RL_Clu_Dist_160);
	write("S4_SRR_RL_Clu_Dist_160 :%f",signalvalue1);
	write("i_S4_SRR_RL_Clu_Dist_160 :%f",@ecu_Signals::i_S4_SRR_RL_Clu_Dist_160);

	testStep("get expect variable value: ","i_S4_SRR_RL_Clu_Dist_160 :%f",@ecu_Signals::i_S4_SRR_RL_Clu_Dist_160);

	if((abs(@ecu_Signals::i_S4_SRR_RL_Clu_Dist_160)*0.9<=abs(signalvalue1))&&(abs(signalvalue1)<=abs(@ecu_Signals::i_S4_SRR_RL_Clu_Dist_160)*1.1))
	{
	testStepPass("Pass","i_S4_SRR_RL_Clu_Dist_160 :%f",signalvalue1);
	}
	else
	{
	testStepFail("Fail","i_S4_SRR_RL_Clu_Dist_160 :%f",signalvalue1);
	}
}

testcase S4_SRR_RL_Clu_Mes_22_S4_SRR_RL_Clu_Vel_160()
{
	signalvalue1 = getSignal(S4_SRR_RL_Clu_Vel_160);
	write("S4_SRR_RL_Clu_Vel_160 :%f",signalvalue1);
	write("i_S4_SRR_RL_Clu_Vel_160 :%f",@ecu_Signals::i_S4_SRR_RL_Clu_Vel_160);

	testStep("get expect variable value: ","i_S4_SRR_RL_Clu_Vel_160 :%f",@ecu_Signals::i_S4_SRR_RL_Clu_Vel_160);

	if((abs(@ecu_Signals::i_S4_SRR_RL_Clu_Vel_160)*0.9<=abs(signalvalue1))&&(abs(signalvalue1)<=abs(@ecu_Signals::i_S4_SRR_RL_Clu_Vel_160)*1.1))
	{
	testStepPass("Pass","i_S4_SRR_RL_Clu_Vel_160 :%f",signalvalue1);
	}
	else
	{
	testStepFail("Fail","i_S4_SRR_RL_Clu_Vel_160 :%f",signalvalue1);
	}
}

testcase S4_SRR_RL_Clu_Mes_22_S4_SRR_RL_Clu_SNR_160()
{
	signalvalue1 = getSignal(S4_SRR_RL_Clu_SNR_160);
	write("S4_SRR_RL_Clu_SNR_160 :%f",signalvalue1);
	write("i_S4_SRR_RL_Clu_SNR_160 :%f",@ecu_Signals::i_S4_SRR_RL_Clu_SNR_160);

	testStep("get expect variable value: ","i_S4_SRR_RL_Clu_SNR_160 :%f",@ecu_Signals::i_S4_SRR_RL_Clu_SNR_160);

	if((abs(@ecu_Signals::i_S4_SRR_RL_Clu_SNR_160)*0.9<=abs(signalvalue1))&&(abs(signalvalue1)<=abs(@ecu_Signals::i_S4_SRR_RL_Clu_SNR_160)*1.1))
	{
	testStepPass("Pass","i_S4_SRR_RL_Clu_SNR_160 :%f",signalvalue1);
	}
	else
	{
	testStepFail("Fail","i_S4_SRR_RL_Clu_SNR_160 :%f",signalvalue1);
	}
}

testcase S4_SRR_RL_Clu_Mes_22_S4_SRR_RL_Clu_DynProp_160()
{
	signalvalue1 = getSignal(S4_SRR_RL_Clu_DynProp_160);
	write("S4_SRR_RL_Clu_DynProp_160 :%f",signalvalue1);
	write("i_S4_SRR_RL_Clu_DynProp_160 :%o",@ecu_Signals::i_S4_SRR_RL_Clu_DynProp_160);

	testStep("get expect variable value: ","i_S4_SRR_RL_Clu_DynProp_160 :%o",@ecu_Signals::i_S4_SRR_RL_Clu_DynProp_160);

	if(signalvalue1==@ecu_Signals::i_S4_SRR_RL_Clu_DynProp_160)
	{
	testStepPass("Pass","i_S4_SRR_RL_Clu_DynProp_160 :%f",signalvalue1);
	}
	else
	{
	testStepFail("Fail","i_S4_SRR_RL_Clu_DynProp_160 :%f",signalvalue1);
	}
}

testcase S4_SRR_RL_Clu_Mes_22_S4_SRR_RL_Clu_Locationvalid_160()
{
	signalvalue1 = getSignal(S4_SRR_RL_Clu_Locationvalid_160);
	write("S4_SRR_RL_Clu_Locationvalid_160 :%f",signalvalue1);
	write("i_S4_SRR_RL_Clu_Locationvalid_160 :%o",@ecu_Signals::i_S4_SRR_RL_Clu_Locationvalid_160);

	testStep("get expect variable value: ","i_S4_SRR_RL_Clu_Locationvalid_160 :%o",@ecu_Signals::i_S4_SRR_RL_Clu_Locationvalid_160);

	if(signalvalue1==@ecu_Signals::i_S4_SRR_RL_Clu_Locationvalid_160)
	{
	testStepPass("Pass","i_S4_SRR_RL_Clu_Locationvalid_160 :%f",signalvalue1);
	}
	else
	{
	testStepFail("Fail","i_S4_SRR_RL_Clu_Locationvalid_160 :%f",signalvalue1);
	}
}

testcase S4_SRR_RL_Clu_Mes_23_S4_SRR_RL_Clu_Theta_161()
{
	signalvalue1 = getSignal(S4_SRR_RL_Clu_Theta_161);
	write("S4_SRR_RL_Clu_Theta_161 :%f",signalvalue1);
	write("i_S4_SRR_RL_Clu_Theta_161 :%f",@ecu_Signals::i_S4_SRR_RL_Clu_Theta_161);

	testStep("get expect variable value: ","i_S4_SRR_RL_Clu_Theta_161 :%f",@ecu_Signals::i_S4_SRR_RL_Clu_Theta_161);

	if((abs(@ecu_Signals::i_S4_SRR_RL_Clu_Theta_161)*0.9<=abs(signalvalue1))&&(abs(signalvalue1)<=abs(@ecu_Signals::i_S4_SRR_RL_Clu_Theta_161)*1.1))
	{
	testStepPass("Pass","i_S4_SRR_RL_Clu_Theta_161 :%f",signalvalue1);
	}
	else
	{
	testStepFail("Fail","i_S4_SRR_RL_Clu_Theta_161 :%f",signalvalue1);
	}
}

testcase S4_SRR_RL_Clu_Mes_23_S4_SRR_RL_Clu_Dist_161()
{
	signalvalue1 = getSignal(S4_SRR_RL_Clu_Dist_161);
	write("S4_SRR_RL_Clu_Dist_161 :%f",signalvalue1);
	write("i_S4_SRR_RL_Clu_Dist_161 :%f",@ecu_Signals::i_S4_SRR_RL_Clu_Dist_161);

	testStep("get expect variable value: ","i_S4_SRR_RL_Clu_Dist_161 :%f",@ecu_Signals::i_S4_SRR_RL_Clu_Dist_161);

	if((abs(@ecu_Signals::i_S4_SRR_RL_Clu_Dist_161)*0.9<=abs(signalvalue1))&&(abs(signalvalue1)<=abs(@ecu_Signals::i_S4_SRR_RL_Clu_Dist_161)*1.1))
	{
	testStepPass("Pass","i_S4_SRR_RL_Clu_Dist_161 :%f",signalvalue1);
	}
	else
	{
	testStepFail("Fail","i_S4_SRR_RL_Clu_Dist_161 :%f",signalvalue1);
	}
}

testcase S4_SRR_RL_Clu_Mes_23_S4_SRR_RL_Clu_Vel_161()
{
	signalvalue1 = getSignal(S4_SRR_RL_Clu_Vel_161);
	write("S4_SRR_RL_Clu_Vel_161 :%f",signalvalue1);
	write("i_S4_SRR_RL_Clu_Vel_161 :%f",@ecu_Signals::i_S4_SRR_RL_Clu_Vel_161);

	testStep("get expect variable value: ","i_S4_SRR_RL_Clu_Vel_161 :%f",@ecu_Signals::i_S4_SRR_RL_Clu_Vel_161);

	if((abs(@ecu_Signals::i_S4_SRR_RL_Clu_Vel_161)*0.9<=abs(signalvalue1))&&(abs(signalvalue1)<=abs(@ecu_Signals::i_S4_SRR_RL_Clu_Vel_161)*1.1))
	{
	testStepPass("Pass","i_S4_SRR_RL_Clu_Vel_161 :%f",signalvalue1);
	}
	else
	{
	testStepFail("Fail","i_S4_SRR_RL_Clu_Vel_161 :%f",signalvalue1);
	}
}

testcase S4_SRR_RL_Clu_Mes_23_S4_SRR_RL_Clu_SNR_161()
{
	signalvalue1 = getSignal(S4_SRR_RL_Clu_SNR_161);
	write("S4_SRR_RL_Clu_SNR_161 :%f",signalvalue1);
	write("i_S4_SRR_RL_Clu_SNR_161 :%f",@ecu_Signals::i_S4_SRR_RL_Clu_SNR_161);

	testStep("get expect variable value: ","i_S4_SRR_RL_Clu_SNR_161 :%f",@ecu_Signals::i_S4_SRR_RL_Clu_SNR_161);

	if((abs(@ecu_Signals::i_S4_SRR_RL_Clu_SNR_161)*0.9<=abs(signalvalue1))&&(abs(signalvalue1)<=abs(@ecu_Signals::i_S4_SRR_RL_Clu_SNR_161)*1.1))
	{
	testStepPass("Pass","i_S4_SRR_RL_Clu_SNR_161 :%f",signalvalue1);
	}
	else
	{
	testStepFail("Fail","i_S4_SRR_RL_Clu_SNR_161 :%f",signalvalue1);
	}
}

testcase S4_SRR_RL_Clu_Mes_23_S4_SRR_RL_Clu_DynProp_161()
{
	signalvalue1 = getSignal(S4_SRR_RL_Clu_DynProp_161);
	write("S4_SRR_RL_Clu_DynProp_161 :%f",signalvalue1);
	write("i_S4_SRR_RL_Clu_DynProp_161 :%o",@ecu_Signals::i_S4_SRR_RL_Clu_DynProp_161);

	testStep("get expect variable value: ","i_S4_SRR_RL_Clu_DynProp_161 :%o",@ecu_Signals::i_S4_SRR_RL_Clu_DynProp_161);

	if(signalvalue1==@ecu_Signals::i_S4_SRR_RL_Clu_DynProp_161)
	{
	testStepPass("Pass","i_S4_SRR_RL_Clu_DynProp_161 :%f",signalvalue1);
	}
	else
	{
	testStepFail("Fail","i_S4_SRR_RL_Clu_DynProp_161 :%f",signalvalue1);
	}
}

testcase S4_SRR_RL_Clu_Mes_23_S4_SRR_RL_Clu_Locationvalid_161()
{
	signalvalue1 = getSignal(S4_SRR_RL_Clu_Locationvalid_161);
	write("S4_SRR_RL_Clu_Locationvalid_161 :%f",signalvalue1);
	write("i_S4_SRR_RL_Clu_Locationvalid_161 :%o",@ecu_Signals::i_S4_SRR_RL_Clu_Locationvalid_161);

	testStep("get expect variable value: ","i_S4_SRR_RL_Clu_Locationvalid_161 :%o",@ecu_Signals::i_S4_SRR_RL_Clu_Locationvalid_161);

	if(signalvalue1==@ecu_Signals::i_S4_SRR_RL_Clu_Locationvalid_161)
	{
	testStepPass("Pass","i_S4_SRR_RL_Clu_Locationvalid_161 :%f",signalvalue1);
	}
	else
	{
	testStepFail("Fail","i_S4_SRR_RL_Clu_Locationvalid_161 :%f",signalvalue1);
	}
}

testcase S4_SRR_RL_Clu_Mes_23_S4_SRR_RL_Clu_Theta_162()
{
	signalvalue1 = getSignal(S4_SRR_RL_Clu_Theta_162);
	write("S4_SRR_RL_Clu_Theta_162 :%f",signalvalue1);
	write("i_S4_SRR_RL_Clu_Theta_162 :%f",@ecu_Signals::i_S4_SRR_RL_Clu_Theta_162);

	testStep("get expect variable value: ","i_S4_SRR_RL_Clu_Theta_162 :%f",@ecu_Signals::i_S4_SRR_RL_Clu_Theta_162);

	if((abs(@ecu_Signals::i_S4_SRR_RL_Clu_Theta_162)*0.9<=abs(signalvalue1))&&(abs(signalvalue1)<=abs(@ecu_Signals::i_S4_SRR_RL_Clu_Theta_162)*1.1))
	{
	testStepPass("Pass","i_S4_SRR_RL_Clu_Theta_162 :%f",signalvalue1);
	}
	else
	{
	testStepFail("Fail","i_S4_SRR_RL_Clu_Theta_162 :%f",signalvalue1);
	}
}

testcase S4_SRR_RL_Clu_Mes_23_S4_SRR_RL_Clu_Dist_162()
{
	signalvalue1 = getSignal(S4_SRR_RL_Clu_Dist_162);
	write("S4_SRR_RL_Clu_Dist_162 :%f",signalvalue1);
	write("i_S4_SRR_RL_Clu_Dist_162 :%f",@ecu_Signals::i_S4_SRR_RL_Clu_Dist_162);

	testStep("get expect variable value: ","i_S4_SRR_RL_Clu_Dist_162 :%f",@ecu_Signals::i_S4_SRR_RL_Clu_Dist_162);

	if((abs(@ecu_Signals::i_S4_SRR_RL_Clu_Dist_162)*0.9<=abs(signalvalue1))&&(abs(signalvalue1)<=abs(@ecu_Signals::i_S4_SRR_RL_Clu_Dist_162)*1.1))
	{
	testStepPass("Pass","i_S4_SRR_RL_Clu_Dist_162 :%f",signalvalue1);
	}
	else
	{
	testStepFail("Fail","i_S4_SRR_RL_Clu_Dist_162 :%f",signalvalue1);
	}
}

testcase S4_SRR_RL_Clu_Mes_23_S4_SRR_RL_Clu_Vel_162()
{
	signalvalue1 = getSignal(S4_SRR_RL_Clu_Vel_162);
	write("S4_SRR_RL_Clu_Vel_162 :%f",signalvalue1);
	write("i_S4_SRR_RL_Clu_Vel_162 :%f",@ecu_Signals::i_S4_SRR_RL_Clu_Vel_162);

	testStep("get expect variable value: ","i_S4_SRR_RL_Clu_Vel_162 :%f",@ecu_Signals::i_S4_SRR_RL_Clu_Vel_162);

	if((abs(@ecu_Signals::i_S4_SRR_RL_Clu_Vel_162)*0.9<=abs(signalvalue1))&&(abs(signalvalue1)<=abs(@ecu_Signals::i_S4_SRR_RL_Clu_Vel_162)*1.1))
	{
	testStepPass("Pass","i_S4_SRR_RL_Clu_Vel_162 :%f",signalvalue1);
	}
	else
	{
	testStepFail("Fail","i_S4_SRR_RL_Clu_Vel_162 :%f",signalvalue1);
	}
}

testcase S4_SRR_RL_Clu_Mes_23_S4_SRR_RL_Clu_SNR_162()
{
	signalvalue1 = getSignal(S4_SRR_RL_Clu_SNR_162);
	write("S4_SRR_RL_Clu_SNR_162 :%f",signalvalue1);
	write("i_S4_SRR_RL_Clu_SNR_162 :%f",@ecu_Signals::i_S4_SRR_RL_Clu_SNR_162);

	testStep("get expect variable value: ","i_S4_SRR_RL_Clu_SNR_162 :%f",@ecu_Signals::i_S4_SRR_RL_Clu_SNR_162);

	if((abs(@ecu_Signals::i_S4_SRR_RL_Clu_SNR_162)*0.9<=abs(signalvalue1))&&(abs(signalvalue1)<=abs(@ecu_Signals::i_S4_SRR_RL_Clu_SNR_162)*1.1))
	{
	testStepPass("Pass","i_S4_SRR_RL_Clu_SNR_162 :%f",signalvalue1);
	}
	else
	{
	testStepFail("Fail","i_S4_SRR_RL_Clu_SNR_162 :%f",signalvalue1);
	}
}

testcase S4_SRR_RL_Clu_Mes_23_S4_SRR_RL_Clu_DynProp_162()
{
	signalvalue1 = getSignal(S4_SRR_RL_Clu_DynProp_162);
	write("S4_SRR_RL_Clu_DynProp_162 :%f",signalvalue1);
	write("i_S4_SRR_RL_Clu_DynProp_162 :%o",@ecu_Signals::i_S4_SRR_RL_Clu_DynProp_162);

	testStep("get expect variable value: ","i_S4_SRR_RL_Clu_DynProp_162 :%o",@ecu_Signals::i_S4_SRR_RL_Clu_DynProp_162);

	if(signalvalue1==@ecu_Signals::i_S4_SRR_RL_Clu_DynProp_162)
	{
	testStepPass("Pass","i_S4_SRR_RL_Clu_DynProp_162 :%f",signalvalue1);
	}
	else
	{
	testStepFail("Fail","i_S4_SRR_RL_Clu_DynProp_162 :%f",signalvalue1);
	}
}

testcase S4_SRR_RL_Clu_Mes_23_S4_SRR_RL_Clu_Locationvalid_162()
{
	signalvalue1 = getSignal(S4_SRR_RL_Clu_Locationvalid_162);
	write("S4_SRR_RL_Clu_Locationvalid_162 :%f",signalvalue1);
	write("i_S4_SRR_RL_Clu_Locationvalid_162 :%o",@ecu_Signals::i_S4_SRR_RL_Clu_Locationvalid_162);

	testStep("get expect variable value: ","i_S4_SRR_RL_Clu_Locationvalid_162 :%o",@ecu_Signals::i_S4_SRR_RL_Clu_Locationvalid_162);

	if(signalvalue1==@ecu_Signals::i_S4_SRR_RL_Clu_Locationvalid_162)
	{
	testStepPass("Pass","i_S4_SRR_RL_Clu_Locationvalid_162 :%f",signalvalue1);
	}
	else
	{
	testStepFail("Fail","i_S4_SRR_RL_Clu_Locationvalid_162 :%f",signalvalue1);
	}
}

testcase S4_SRR_RL_Clu_Mes_23_S4_SRR_RL_Clu_Theta_163()
{
	signalvalue1 = getSignal(S4_SRR_RL_Clu_Theta_163);
	write("S4_SRR_RL_Clu_Theta_163 :%f",signalvalue1);
	write("i_S4_SRR_RL_Clu_Theta_163 :%f",@ecu_Signals::i_S4_SRR_RL_Clu_Theta_163);

	testStep("get expect variable value: ","i_S4_SRR_RL_Clu_Theta_163 :%f",@ecu_Signals::i_S4_SRR_RL_Clu_Theta_163);

	if((abs(@ecu_Signals::i_S4_SRR_RL_Clu_Theta_163)*0.9<=abs(signalvalue1))&&(abs(signalvalue1)<=abs(@ecu_Signals::i_S4_SRR_RL_Clu_Theta_163)*1.1))
	{
	testStepPass("Pass","i_S4_SRR_RL_Clu_Theta_163 :%f",signalvalue1);
	}
	else
	{
	testStepFail("Fail","i_S4_SRR_RL_Clu_Theta_163 :%f",signalvalue1);
	}
}

testcase S4_SRR_RL_Clu_Mes_23_S4_SRR_RL_Clu_Dist_163()
{
	signalvalue1 = getSignal(S4_SRR_RL_Clu_Dist_163);
	write("S4_SRR_RL_Clu_Dist_163 :%f",signalvalue1);
	write("i_S4_SRR_RL_Clu_Dist_163 :%f",@ecu_Signals::i_S4_SRR_RL_Clu_Dist_163);

	testStep("get expect variable value: ","i_S4_SRR_RL_Clu_Dist_163 :%f",@ecu_Signals::i_S4_SRR_RL_Clu_Dist_163);

	if((abs(@ecu_Signals::i_S4_SRR_RL_Clu_Dist_163)*0.9<=abs(signalvalue1))&&(abs(signalvalue1)<=abs(@ecu_Signals::i_S4_SRR_RL_Clu_Dist_163)*1.1))
	{
	testStepPass("Pass","i_S4_SRR_RL_Clu_Dist_163 :%f",signalvalue1);
	}
	else
	{
	testStepFail("Fail","i_S4_SRR_RL_Clu_Dist_163 :%f",signalvalue1);
	}
}

testcase S4_SRR_RL_Clu_Mes_23_S4_SRR_RL_Clu_Vel_163()
{
	signalvalue1 = getSignal(S4_SRR_RL_Clu_Vel_163);
	write("S4_SRR_RL_Clu_Vel_163 :%f",signalvalue1);
	write("i_S4_SRR_RL_Clu_Vel_163 :%f",@ecu_Signals::i_S4_SRR_RL_Clu_Vel_163);

	testStep("get expect variable value: ","i_S4_SRR_RL_Clu_Vel_163 :%f",@ecu_Signals::i_S4_SRR_RL_Clu_Vel_163);

	if((abs(@ecu_Signals::i_S4_SRR_RL_Clu_Vel_163)*0.9<=abs(signalvalue1))&&(abs(signalvalue1)<=abs(@ecu_Signals::i_S4_SRR_RL_Clu_Vel_163)*1.1))
	{
	testStepPass("Pass","i_S4_SRR_RL_Clu_Vel_163 :%f",signalvalue1);
	}
	else
	{
	testStepFail("Fail","i_S4_SRR_RL_Clu_Vel_163 :%f",signalvalue1);
	}
}

testcase S4_SRR_RL_Clu_Mes_23_S4_SRR_RL_Clu_SNR_163()
{
	signalvalue1 = getSignal(S4_SRR_RL_Clu_SNR_163);
	write("S4_SRR_RL_Clu_SNR_163 :%f",signalvalue1);
	write("i_S4_SRR_RL_Clu_SNR_163 :%f",@ecu_Signals::i_S4_SRR_RL_Clu_SNR_163);

	testStep("get expect variable value: ","i_S4_SRR_RL_Clu_SNR_163 :%f",@ecu_Signals::i_S4_SRR_RL_Clu_SNR_163);

	if((abs(@ecu_Signals::i_S4_SRR_RL_Clu_SNR_163)*0.9<=abs(signalvalue1))&&(abs(signalvalue1)<=abs(@ecu_Signals::i_S4_SRR_RL_Clu_SNR_163)*1.1))
	{
	testStepPass("Pass","i_S4_SRR_RL_Clu_SNR_163 :%f",signalvalue1);
	}
	else
	{
	testStepFail("Fail","i_S4_SRR_RL_Clu_SNR_163 :%f",signalvalue1);
	}
}

testcase S4_SRR_RL_Clu_Mes_23_S4_SRR_RL_Clu_DynProp_163()
{
	signalvalue1 = getSignal(S4_SRR_RL_Clu_DynProp_163);
	write("S4_SRR_RL_Clu_DynProp_163 :%f",signalvalue1);
	write("i_S4_SRR_RL_Clu_DynProp_163 :%o",@ecu_Signals::i_S4_SRR_RL_Clu_DynProp_163);

	testStep("get expect variable value: ","i_S4_SRR_RL_Clu_DynProp_163 :%o",@ecu_Signals::i_S4_SRR_RL_Clu_DynProp_163);

	if(signalvalue1==@ecu_Signals::i_S4_SRR_RL_Clu_DynProp_163)
	{
	testStepPass("Pass","i_S4_SRR_RL_Clu_DynProp_163 :%f",signalvalue1);
	}
	else
	{
	testStepFail("Fail","i_S4_SRR_RL_Clu_DynProp_163 :%f",signalvalue1);
	}
}

testcase S4_SRR_RL_Clu_Mes_23_S4_SRR_RL_Clu_Locationvalid_163()
{
	signalvalue1 = getSignal(S4_SRR_RL_Clu_Locationvalid_163);
	write("S4_SRR_RL_Clu_Locationvalid_163 :%f",signalvalue1);
	write("i_S4_SRR_RL_Clu_Locationvalid_163 :%o",@ecu_Signals::i_S4_SRR_RL_Clu_Locationvalid_163);

	testStep("get expect variable value: ","i_S4_SRR_RL_Clu_Locationvalid_163 :%o",@ecu_Signals::i_S4_SRR_RL_Clu_Locationvalid_163);

	if(signalvalue1==@ecu_Signals::i_S4_SRR_RL_Clu_Locationvalid_163)
	{
	testStepPass("Pass","i_S4_SRR_RL_Clu_Locationvalid_163 :%f",signalvalue1);
	}
	else
	{
	testStepFail("Fail","i_S4_SRR_RL_Clu_Locationvalid_163 :%f",signalvalue1);
	}
}

testcase S4_SRR_RL_Clu_Mes_23_S4_SRR_RL_Clu_Theta_164()
{
	signalvalue1 = getSignal(S4_SRR_RL_Clu_Theta_164);
	write("S4_SRR_RL_Clu_Theta_164 :%f",signalvalue1);
	write("i_S4_SRR_RL_Clu_Theta_164 :%f",@ecu_Signals::i_S4_SRR_RL_Clu_Theta_164);

	testStep("get expect variable value: ","i_S4_SRR_RL_Clu_Theta_164 :%f",@ecu_Signals::i_S4_SRR_RL_Clu_Theta_164);

	if((abs(@ecu_Signals::i_S4_SRR_RL_Clu_Theta_164)*0.9<=abs(signalvalue1))&&(abs(signalvalue1)<=abs(@ecu_Signals::i_S4_SRR_RL_Clu_Theta_164)*1.1))
	{
	testStepPass("Pass","i_S4_SRR_RL_Clu_Theta_164 :%f",signalvalue1);
	}
	else
	{
	testStepFail("Fail","i_S4_SRR_RL_Clu_Theta_164 :%f",signalvalue1);
	}
}

testcase S4_SRR_RL_Clu_Mes_23_S4_SRR_RL_Clu_Dist_164()
{
	signalvalue1 = getSignal(S4_SRR_RL_Clu_Dist_164);
	write("S4_SRR_RL_Clu_Dist_164 :%f",signalvalue1);
	write("i_S4_SRR_RL_Clu_Dist_164 :%f",@ecu_Signals::i_S4_SRR_RL_Clu_Dist_164);

	testStep("get expect variable value: ","i_S4_SRR_RL_Clu_Dist_164 :%f",@ecu_Signals::i_S4_SRR_RL_Clu_Dist_164);

	if((abs(@ecu_Signals::i_S4_SRR_RL_Clu_Dist_164)*0.9<=abs(signalvalue1))&&(abs(signalvalue1)<=abs(@ecu_Signals::i_S4_SRR_RL_Clu_Dist_164)*1.1))
	{
	testStepPass("Pass","i_S4_SRR_RL_Clu_Dist_164 :%f",signalvalue1);
	}
	else
	{
	testStepFail("Fail","i_S4_SRR_RL_Clu_Dist_164 :%f",signalvalue1);
	}
}

testcase S4_SRR_RL_Clu_Mes_23_S4_SRR_RL_Clu_Vel_164()
{
	signalvalue1 = getSignal(S4_SRR_RL_Clu_Vel_164);
	write("S4_SRR_RL_Clu_Vel_164 :%f",signalvalue1);
	write("i_S4_SRR_RL_Clu_Vel_164 :%f",@ecu_Signals::i_S4_SRR_RL_Clu_Vel_164);

	testStep("get expect variable value: ","i_S4_SRR_RL_Clu_Vel_164 :%f",@ecu_Signals::i_S4_SRR_RL_Clu_Vel_164);

	if((abs(@ecu_Signals::i_S4_SRR_RL_Clu_Vel_164)*0.9<=abs(signalvalue1))&&(abs(signalvalue1)<=abs(@ecu_Signals::i_S4_SRR_RL_Clu_Vel_164)*1.1))
	{
	testStepPass("Pass","i_S4_SRR_RL_Clu_Vel_164 :%f",signalvalue1);
	}
	else
	{
	testStepFail("Fail","i_S4_SRR_RL_Clu_Vel_164 :%f",signalvalue1);
	}
}

testcase S4_SRR_RL_Clu_Mes_23_S4_SRR_RL_Clu_SNR_164()
{
	signalvalue1 = getSignal(S4_SRR_RL_Clu_SNR_164);
	write("S4_SRR_RL_Clu_SNR_164 :%f",signalvalue1);
	write("i_S4_SRR_RL_Clu_SNR_164 :%f",@ecu_Signals::i_S4_SRR_RL_Clu_SNR_164);

	testStep("get expect variable value: ","i_S4_SRR_RL_Clu_SNR_164 :%f",@ecu_Signals::i_S4_SRR_RL_Clu_SNR_164);

	if((abs(@ecu_Signals::i_S4_SRR_RL_Clu_SNR_164)*0.9<=abs(signalvalue1))&&(abs(signalvalue1)<=abs(@ecu_Signals::i_S4_SRR_RL_Clu_SNR_164)*1.1))
	{
	testStepPass("Pass","i_S4_SRR_RL_Clu_SNR_164 :%f",signalvalue1);
	}
	else
	{
	testStepFail("Fail","i_S4_SRR_RL_Clu_SNR_164 :%f",signalvalue1);
	}
}

testcase S4_SRR_RL_Clu_Mes_23_S4_SRR_RL_Clu_DynProp_164()
{
	signalvalue1 = getSignal(S4_SRR_RL_Clu_DynProp_164);
	write("S4_SRR_RL_Clu_DynProp_164 :%f",signalvalue1);
	write("i_S4_SRR_RL_Clu_DynProp_164 :%o",@ecu_Signals::i_S4_SRR_RL_Clu_DynProp_164);

	testStep("get expect variable value: ","i_S4_SRR_RL_Clu_DynProp_164 :%o",@ecu_Signals::i_S4_SRR_RL_Clu_DynProp_164);

	if(signalvalue1==@ecu_Signals::i_S4_SRR_RL_Clu_DynProp_164)
	{
	testStepPass("Pass","i_S4_SRR_RL_Clu_DynProp_164 :%f",signalvalue1);
	}
	else
	{
	testStepFail("Fail","i_S4_SRR_RL_Clu_DynProp_164 :%f",signalvalue1);
	}
}

testcase S4_SRR_RL_Clu_Mes_23_S4_SRR_RL_Clu_Locationvalid_164()
{
	signalvalue1 = getSignal(S4_SRR_RL_Clu_Locationvalid_164);
	write("S4_SRR_RL_Clu_Locationvalid_164 :%f",signalvalue1);
	write("i_S4_SRR_RL_Clu_Locationvalid_164 :%o",@ecu_Signals::i_S4_SRR_RL_Clu_Locationvalid_164);

	testStep("get expect variable value: ","i_S4_SRR_RL_Clu_Locationvalid_164 :%o",@ecu_Signals::i_S4_SRR_RL_Clu_Locationvalid_164);

	if(signalvalue1==@ecu_Signals::i_S4_SRR_RL_Clu_Locationvalid_164)
	{
	testStepPass("Pass","i_S4_SRR_RL_Clu_Locationvalid_164 :%f",signalvalue1);
	}
	else
	{
	testStepFail("Fail","i_S4_SRR_RL_Clu_Locationvalid_164 :%f",signalvalue1);
	}
}

testcase S4_SRR_RL_Clu_Mes_23_S4_SRR_RL_Clu_Theta_165()
{
	signalvalue1 = getSignal(S4_SRR_RL_Clu_Theta_165);
	write("S4_SRR_RL_Clu_Theta_165 :%f",signalvalue1);
	write("i_S4_SRR_RL_Clu_Theta_165 :%f",@ecu_Signals::i_S4_SRR_RL_Clu_Theta_165);

	testStep("get expect variable value: ","i_S4_SRR_RL_Clu_Theta_165 :%f",@ecu_Signals::i_S4_SRR_RL_Clu_Theta_165);

	if((abs(@ecu_Signals::i_S4_SRR_RL_Clu_Theta_165)*0.9<=abs(signalvalue1))&&(abs(signalvalue1)<=abs(@ecu_Signals::i_S4_SRR_RL_Clu_Theta_165)*1.1))
	{
	testStepPass("Pass","i_S4_SRR_RL_Clu_Theta_165 :%f",signalvalue1);
	}
	else
	{
	testStepFail("Fail","i_S4_SRR_RL_Clu_Theta_165 :%f",signalvalue1);
	}
}

testcase S4_SRR_RL_Clu_Mes_23_S4_SRR_RL_Clu_Dist_165()
{
	signalvalue1 = getSignal(S4_SRR_RL_Clu_Dist_165);
	write("S4_SRR_RL_Clu_Dist_165 :%f",signalvalue1);
	write("i_S4_SRR_RL_Clu_Dist_165 :%f",@ecu_Signals::i_S4_SRR_RL_Clu_Dist_165);

	testStep("get expect variable value: ","i_S4_SRR_RL_Clu_Dist_165 :%f",@ecu_Signals::i_S4_SRR_RL_Clu_Dist_165);

	if((abs(@ecu_Signals::i_S4_SRR_RL_Clu_Dist_165)*0.9<=abs(signalvalue1))&&(abs(signalvalue1)<=abs(@ecu_Signals::i_S4_SRR_RL_Clu_Dist_165)*1.1))
	{
	testStepPass("Pass","i_S4_SRR_RL_Clu_Dist_165 :%f",signalvalue1);
	}
	else
	{
	testStepFail("Fail","i_S4_SRR_RL_Clu_Dist_165 :%f",signalvalue1);
	}
}

testcase S4_SRR_RL_Clu_Mes_23_S4_SRR_RL_Clu_Vel_165()
{
	signalvalue1 = getSignal(S4_SRR_RL_Clu_Vel_165);
	write("S4_SRR_RL_Clu_Vel_165 :%f",signalvalue1);
	write("i_S4_SRR_RL_Clu_Vel_165 :%f",@ecu_Signals::i_S4_SRR_RL_Clu_Vel_165);

	testStep("get expect variable value: ","i_S4_SRR_RL_Clu_Vel_165 :%f",@ecu_Signals::i_S4_SRR_RL_Clu_Vel_165);

	if((abs(@ecu_Signals::i_S4_SRR_RL_Clu_Vel_165)*0.9<=abs(signalvalue1))&&(abs(signalvalue1)<=abs(@ecu_Signals::i_S4_SRR_RL_Clu_Vel_165)*1.1))
	{
	testStepPass("Pass","i_S4_SRR_RL_Clu_Vel_165 :%f",signalvalue1);
	}
	else
	{
	testStepFail("Fail","i_S4_SRR_RL_Clu_Vel_165 :%f",signalvalue1);
	}
}

testcase S4_SRR_RL_Clu_Mes_23_S4_SRR_RL_Clu_SNR_165()
{
	signalvalue1 = getSignal(S4_SRR_RL_Clu_SNR_165);
	write("S4_SRR_RL_Clu_SNR_165 :%f",signalvalue1);
	write("i_S4_SRR_RL_Clu_SNR_165 :%f",@ecu_Signals::i_S4_SRR_RL_Clu_SNR_165);

	testStep("get expect variable value: ","i_S4_SRR_RL_Clu_SNR_165 :%f",@ecu_Signals::i_S4_SRR_RL_Clu_SNR_165);

	if((abs(@ecu_Signals::i_S4_SRR_RL_Clu_SNR_165)*0.9<=abs(signalvalue1))&&(abs(signalvalue1)<=abs(@ecu_Signals::i_S4_SRR_RL_Clu_SNR_165)*1.1))
	{
	testStepPass("Pass","i_S4_SRR_RL_Clu_SNR_165 :%f",signalvalue1);
	}
	else
	{
	testStepFail("Fail","i_S4_SRR_RL_Clu_SNR_165 :%f",signalvalue1);
	}
}

testcase S4_SRR_RL_Clu_Mes_23_S4_SRR_RL_Clu_DynProp_165()
{
	signalvalue1 = getSignal(S4_SRR_RL_Clu_DynProp_165);
	write("S4_SRR_RL_Clu_DynProp_165 :%f",signalvalue1);
	write("i_S4_SRR_RL_Clu_DynProp_165 :%o",@ecu_Signals::i_S4_SRR_RL_Clu_DynProp_165);

	testStep("get expect variable value: ","i_S4_SRR_RL_Clu_DynProp_165 :%o",@ecu_Signals::i_S4_SRR_RL_Clu_DynProp_165);

	if(signalvalue1==@ecu_Signals::i_S4_SRR_RL_Clu_DynProp_165)
	{
	testStepPass("Pass","i_S4_SRR_RL_Clu_DynProp_165 :%f",signalvalue1);
	}
	else
	{
	testStepFail("Fail","i_S4_SRR_RL_Clu_DynProp_165 :%f",signalvalue1);
	}
}

testcase S4_SRR_RL_Clu_Mes_23_S4_SRR_RL_Clu_Locationvalid_165()
{
	signalvalue1 = getSignal(S4_SRR_RL_Clu_Locationvalid_165);
	write("S4_SRR_RL_Clu_Locationvalid_165 :%f",signalvalue1);
	write("i_S4_SRR_RL_Clu_Locationvalid_165 :%o",@ecu_Signals::i_S4_SRR_RL_Clu_Locationvalid_165);

	testStep("get expect variable value: ","i_S4_SRR_RL_Clu_Locationvalid_165 :%o",@ecu_Signals::i_S4_SRR_RL_Clu_Locationvalid_165);

	if(signalvalue1==@ecu_Signals::i_S4_SRR_RL_Clu_Locationvalid_165)
	{
	testStepPass("Pass","i_S4_SRR_RL_Clu_Locationvalid_165 :%f",signalvalue1);
	}
	else
	{
	testStepFail("Fail","i_S4_SRR_RL_Clu_Locationvalid_165 :%f",signalvalue1);
	}
}

testcase S4_SRR_RL_Clu_Mes_23_S4_SRR_RL_Clu_Theta_166()
{
	signalvalue1 = getSignal(S4_SRR_RL_Clu_Theta_166);
	write("S4_SRR_RL_Clu_Theta_166 :%f",signalvalue1);
	write("i_S4_SRR_RL_Clu_Theta_166 :%f",@ecu_Signals::i_S4_SRR_RL_Clu_Theta_166);

	testStep("get expect variable value: ","i_S4_SRR_RL_Clu_Theta_166 :%f",@ecu_Signals::i_S4_SRR_RL_Clu_Theta_166);

	if((abs(@ecu_Signals::i_S4_SRR_RL_Clu_Theta_166)*0.9<=abs(signalvalue1))&&(abs(signalvalue1)<=abs(@ecu_Signals::i_S4_SRR_RL_Clu_Theta_166)*1.1))
	{
	testStepPass("Pass","i_S4_SRR_RL_Clu_Theta_166 :%f",signalvalue1);
	}
	else
	{
	testStepFail("Fail","i_S4_SRR_RL_Clu_Theta_166 :%f",signalvalue1);
	}
}

testcase S4_SRR_RL_Clu_Mes_23_S4_SRR_RL_Clu_Dist_166()
{
	signalvalue1 = getSignal(S4_SRR_RL_Clu_Dist_166);
	write("S4_SRR_RL_Clu_Dist_166 :%f",signalvalue1);
	write("i_S4_SRR_RL_Clu_Dist_166 :%f",@ecu_Signals::i_S4_SRR_RL_Clu_Dist_166);

	testStep("get expect variable value: ","i_S4_SRR_RL_Clu_Dist_166 :%f",@ecu_Signals::i_S4_SRR_RL_Clu_Dist_166);

	if((abs(@ecu_Signals::i_S4_SRR_RL_Clu_Dist_166)*0.9<=abs(signalvalue1))&&(abs(signalvalue1)<=abs(@ecu_Signals::i_S4_SRR_RL_Clu_Dist_166)*1.1))
	{
	testStepPass("Pass","i_S4_SRR_RL_Clu_Dist_166 :%f",signalvalue1);
	}
	else
	{
	testStepFail("Fail","i_S4_SRR_RL_Clu_Dist_166 :%f",signalvalue1);
	}
}

testcase S4_SRR_RL_Clu_Mes_23_S4_SRR_RL_Clu_Vel_166()
{
	signalvalue1 = getSignal(S4_SRR_RL_Clu_Vel_166);
	write("S4_SRR_RL_Clu_Vel_166 :%f",signalvalue1);
	write("i_S4_SRR_RL_Clu_Vel_166 :%f",@ecu_Signals::i_S4_SRR_RL_Clu_Vel_166);

	testStep("get expect variable value: ","i_S4_SRR_RL_Clu_Vel_166 :%f",@ecu_Signals::i_S4_SRR_RL_Clu_Vel_166);

	if((abs(@ecu_Signals::i_S4_SRR_RL_Clu_Vel_166)*0.9<=abs(signalvalue1))&&(abs(signalvalue1)<=abs(@ecu_Signals::i_S4_SRR_RL_Clu_Vel_166)*1.1))
	{
	testStepPass("Pass","i_S4_SRR_RL_Clu_Vel_166 :%f",signalvalue1);
	}
	else
	{
	testStepFail("Fail","i_S4_SRR_RL_Clu_Vel_166 :%f",signalvalue1);
	}
}

testcase S4_SRR_RL_Clu_Mes_23_S4_SRR_RL_Clu_SNR_166()
{
	signalvalue1 = getSignal(S4_SRR_RL_Clu_SNR_166);
	write("S4_SRR_RL_Clu_SNR_166 :%f",signalvalue1);
	write("i_S4_SRR_RL_Clu_SNR_166 :%f",@ecu_Signals::i_S4_SRR_RL_Clu_SNR_166);

	testStep("get expect variable value: ","i_S4_SRR_RL_Clu_SNR_166 :%f",@ecu_Signals::i_S4_SRR_RL_Clu_SNR_166);

	if((abs(@ecu_Signals::i_S4_SRR_RL_Clu_SNR_166)*0.9<=abs(signalvalue1))&&(abs(signalvalue1)<=abs(@ecu_Signals::i_S4_SRR_RL_Clu_SNR_166)*1.1))
	{
	testStepPass("Pass","i_S4_SRR_RL_Clu_SNR_166 :%f",signalvalue1);
	}
	else
	{
	testStepFail("Fail","i_S4_SRR_RL_Clu_SNR_166 :%f",signalvalue1);
	}
}

testcase S4_SRR_RL_Clu_Mes_23_S4_SRR_RL_Clu_DynProp_166()
{
	signalvalue1 = getSignal(S4_SRR_RL_Clu_DynProp_166);
	write("S4_SRR_RL_Clu_DynProp_166 :%f",signalvalue1);
	write("i_S4_SRR_RL_Clu_DynProp_166 :%o",@ecu_Signals::i_S4_SRR_RL_Clu_DynProp_166);

	testStep("get expect variable value: ","i_S4_SRR_RL_Clu_DynProp_166 :%o",@ecu_Signals::i_S4_SRR_RL_Clu_DynProp_166);

	if(signalvalue1==@ecu_Signals::i_S4_SRR_RL_Clu_DynProp_166)
	{
	testStepPass("Pass","i_S4_SRR_RL_Clu_DynProp_166 :%f",signalvalue1);
	}
	else
	{
	testStepFail("Fail","i_S4_SRR_RL_Clu_DynProp_166 :%f",signalvalue1);
	}
}

testcase S4_SRR_RL_Clu_Mes_23_S4_SRR_RL_Clu_Locationvalid_166()
{
	signalvalue1 = getSignal(S4_SRR_RL_Clu_Locationvalid_166);
	write("S4_SRR_RL_Clu_Locationvalid_166 :%f",signalvalue1);
	write("i_S4_SRR_RL_Clu_Locationvalid_166 :%o",@ecu_Signals::i_S4_SRR_RL_Clu_Locationvalid_166);

	testStep("get expect variable value: ","i_S4_SRR_RL_Clu_Locationvalid_166 :%o",@ecu_Signals::i_S4_SRR_RL_Clu_Locationvalid_166);

	if(signalvalue1==@ecu_Signals::i_S4_SRR_RL_Clu_Locationvalid_166)
	{
	testStepPass("Pass","i_S4_SRR_RL_Clu_Locationvalid_166 :%f",signalvalue1);
	}
	else
	{
	testStepFail("Fail","i_S4_SRR_RL_Clu_Locationvalid_166 :%f",signalvalue1);
	}
}

testcase S4_SRR_RL_Clu_Mes_23_S4_SRR_RL_Clu_Theta_167()
{
	signalvalue1 = getSignal(S4_SRR_RL_Clu_Theta_167);
	write("S4_SRR_RL_Clu_Theta_167 :%f",signalvalue1);
	write("i_S4_SRR_RL_Clu_Theta_167 :%f",@ecu_Signals::i_S4_SRR_RL_Clu_Theta_167);

	testStep("get expect variable value: ","i_S4_SRR_RL_Clu_Theta_167 :%f",@ecu_Signals::i_S4_SRR_RL_Clu_Theta_167);

	if((abs(@ecu_Signals::i_S4_SRR_RL_Clu_Theta_167)*0.9<=abs(signalvalue1))&&(abs(signalvalue1)<=abs(@ecu_Signals::i_S4_SRR_RL_Clu_Theta_167)*1.1))
	{
	testStepPass("Pass","i_S4_SRR_RL_Clu_Theta_167 :%f",signalvalue1);
	}
	else
	{
	testStepFail("Fail","i_S4_SRR_RL_Clu_Theta_167 :%f",signalvalue1);
	}
}

testcase S4_SRR_RL_Clu_Mes_23_S4_SRR_RL_Clu_Dist_167()
{
	signalvalue1 = getSignal(S4_SRR_RL_Clu_Dist_167);
	write("S4_SRR_RL_Clu_Dist_167 :%f",signalvalue1);
	write("i_S4_SRR_RL_Clu_Dist_167 :%f",@ecu_Signals::i_S4_SRR_RL_Clu_Dist_167);

	testStep("get expect variable value: ","i_S4_SRR_RL_Clu_Dist_167 :%f",@ecu_Signals::i_S4_SRR_RL_Clu_Dist_167);

	if((abs(@ecu_Signals::i_S4_SRR_RL_Clu_Dist_167)*0.9<=abs(signalvalue1))&&(abs(signalvalue1)<=abs(@ecu_Signals::i_S4_SRR_RL_Clu_Dist_167)*1.1))
	{
	testStepPass("Pass","i_S4_SRR_RL_Clu_Dist_167 :%f",signalvalue1);
	}
	else
	{
	testStepFail("Fail","i_S4_SRR_RL_Clu_Dist_167 :%f",signalvalue1);
	}
}

testcase S4_SRR_RL_Clu_Mes_23_S4_SRR_RL_Clu_Vel_167()
{
	signalvalue1 = getSignal(S4_SRR_RL_Clu_Vel_167);
	write("S4_SRR_RL_Clu_Vel_167 :%f",signalvalue1);
	write("i_S4_SRR_RL_Clu_Vel_167 :%f",@ecu_Signals::i_S4_SRR_RL_Clu_Vel_167);

	testStep("get expect variable value: ","i_S4_SRR_RL_Clu_Vel_167 :%f",@ecu_Signals::i_S4_SRR_RL_Clu_Vel_167);

	if((abs(@ecu_Signals::i_S4_SRR_RL_Clu_Vel_167)*0.9<=abs(signalvalue1))&&(abs(signalvalue1)<=abs(@ecu_Signals::i_S4_SRR_RL_Clu_Vel_167)*1.1))
	{
	testStepPass("Pass","i_S4_SRR_RL_Clu_Vel_167 :%f",signalvalue1);
	}
	else
	{
	testStepFail("Fail","i_S4_SRR_RL_Clu_Vel_167 :%f",signalvalue1);
	}
}

testcase S4_SRR_RL_Clu_Mes_23_S4_SRR_RL_Clu_SNR_167()
{
	signalvalue1 = getSignal(S4_SRR_RL_Clu_SNR_167);
	write("S4_SRR_RL_Clu_SNR_167 :%f",signalvalue1);
	write("i_S4_SRR_RL_Clu_SNR_167 :%f",@ecu_Signals::i_S4_SRR_RL_Clu_SNR_167);

	testStep("get expect variable value: ","i_S4_SRR_RL_Clu_SNR_167 :%f",@ecu_Signals::i_S4_SRR_RL_Clu_SNR_167);

	if((abs(@ecu_Signals::i_S4_SRR_RL_Clu_SNR_167)*0.9<=abs(signalvalue1))&&(abs(signalvalue1)<=abs(@ecu_Signals::i_S4_SRR_RL_Clu_SNR_167)*1.1))
	{
	testStepPass("Pass","i_S4_SRR_RL_Clu_SNR_167 :%f",signalvalue1);
	}
	else
	{
	testStepFail("Fail","i_S4_SRR_RL_Clu_SNR_167 :%f",signalvalue1);
	}
}

testcase S4_SRR_RL_Clu_Mes_23_S4_SRR_RL_Clu_DynProp_167()
{
	signalvalue1 = getSignal(S4_SRR_RL_Clu_DynProp_167);
	write("S4_SRR_RL_Clu_DynProp_167 :%f",signalvalue1);
	write("i_S4_SRR_RL_Clu_DynProp_167 :%o",@ecu_Signals::i_S4_SRR_RL_Clu_DynProp_167);

	testStep("get expect variable value: ","i_S4_SRR_RL_Clu_DynProp_167 :%o",@ecu_Signals::i_S4_SRR_RL_Clu_DynProp_167);

	if(signalvalue1==@ecu_Signals::i_S4_SRR_RL_Clu_DynProp_167)
	{
	testStepPass("Pass","i_S4_SRR_RL_Clu_DynProp_167 :%f",signalvalue1);
	}
	else
	{
	testStepFail("Fail","i_S4_SRR_RL_Clu_DynProp_167 :%f",signalvalue1);
	}
}

testcase S4_SRR_RL_Clu_Mes_23_S4_SRR_RL_Clu_Locationvalid_167()
{
	signalvalue1 = getSignal(S4_SRR_RL_Clu_Locationvalid_167);
	write("S4_SRR_RL_Clu_Locationvalid_167 :%f",signalvalue1);
	write("i_S4_SRR_RL_Clu_Locationvalid_167 :%o",@ecu_Signals::i_S4_SRR_RL_Clu_Locationvalid_167);

	testStep("get expect variable value: ","i_S4_SRR_RL_Clu_Locationvalid_167 :%o",@ecu_Signals::i_S4_SRR_RL_Clu_Locationvalid_167);

	if(signalvalue1==@ecu_Signals::i_S4_SRR_RL_Clu_Locationvalid_167)
	{
	testStepPass("Pass","i_S4_SRR_RL_Clu_Locationvalid_167 :%f",signalvalue1);
	}
	else
	{
	testStepFail("Fail","i_S4_SRR_RL_Clu_Locationvalid_167 :%f",signalvalue1);
	}
}

testcase S4_SRR_RL_Clu_Mes_24_S4_SRR_RL_Clu_Theta_168()
{
	signalvalue1 = getSignal(S4_SRR_RL_Clu_Theta_168);
	write("S4_SRR_RL_Clu_Theta_168 :%f",signalvalue1);
	write("i_S4_SRR_RL_Clu_Theta_168 :%f",@ecu_Signals::i_S4_SRR_RL_Clu_Theta_168);

	testStep("get expect variable value: ","i_S4_SRR_RL_Clu_Theta_168 :%f",@ecu_Signals::i_S4_SRR_RL_Clu_Theta_168);

	if((abs(@ecu_Signals::i_S4_SRR_RL_Clu_Theta_168)*0.9<=abs(signalvalue1))&&(abs(signalvalue1)<=abs(@ecu_Signals::i_S4_SRR_RL_Clu_Theta_168)*1.1))
	{
	testStepPass("Pass","i_S4_SRR_RL_Clu_Theta_168 :%f",signalvalue1);
	}
	else
	{
	testStepFail("Fail","i_S4_SRR_RL_Clu_Theta_168 :%f",signalvalue1);
	}
}

testcase S4_SRR_RL_Clu_Mes_24_S4_SRR_RL_Clu_Dist_168()
{
	signalvalue1 = getSignal(S4_SRR_RL_Clu_Dist_168);
	write("S4_SRR_RL_Clu_Dist_168 :%f",signalvalue1);
	write("i_S4_SRR_RL_Clu_Dist_168 :%f",@ecu_Signals::i_S4_SRR_RL_Clu_Dist_168);

	testStep("get expect variable value: ","i_S4_SRR_RL_Clu_Dist_168 :%f",@ecu_Signals::i_S4_SRR_RL_Clu_Dist_168);

	if((abs(@ecu_Signals::i_S4_SRR_RL_Clu_Dist_168)*0.9<=abs(signalvalue1))&&(abs(signalvalue1)<=abs(@ecu_Signals::i_S4_SRR_RL_Clu_Dist_168)*1.1))
	{
	testStepPass("Pass","i_S4_SRR_RL_Clu_Dist_168 :%f",signalvalue1);
	}
	else
	{
	testStepFail("Fail","i_S4_SRR_RL_Clu_Dist_168 :%f",signalvalue1);
	}
}

testcase S4_SRR_RL_Clu_Mes_24_S4_SRR_RL_Clu_Vel_168()
{
	signalvalue1 = getSignal(S4_SRR_RL_Clu_Vel_168);
	write("S4_SRR_RL_Clu_Vel_168 :%f",signalvalue1);
	write("i_S4_SRR_RL_Clu_Vel_168 :%f",@ecu_Signals::i_S4_SRR_RL_Clu_Vel_168);

	testStep("get expect variable value: ","i_S4_SRR_RL_Clu_Vel_168 :%f",@ecu_Signals::i_S4_SRR_RL_Clu_Vel_168);

	if((abs(@ecu_Signals::i_S4_SRR_RL_Clu_Vel_168)*0.9<=abs(signalvalue1))&&(abs(signalvalue1)<=abs(@ecu_Signals::i_S4_SRR_RL_Clu_Vel_168)*1.1))
	{
	testStepPass("Pass","i_S4_SRR_RL_Clu_Vel_168 :%f",signalvalue1);
	}
	else
	{
	testStepFail("Fail","i_S4_SRR_RL_Clu_Vel_168 :%f",signalvalue1);
	}
}

testcase S4_SRR_RL_Clu_Mes_24_S4_SRR_RL_Clu_SNR_168()
{
	signalvalue1 = getSignal(S4_SRR_RL_Clu_SNR_168);
	write("S4_SRR_RL_Clu_SNR_168 :%f",signalvalue1);
	write("i_S4_SRR_RL_Clu_SNR_168 :%f",@ecu_Signals::i_S4_SRR_RL_Clu_SNR_168);

	testStep("get expect variable value: ","i_S4_SRR_RL_Clu_SNR_168 :%f",@ecu_Signals::i_S4_SRR_RL_Clu_SNR_168);

	if((abs(@ecu_Signals::i_S4_SRR_RL_Clu_SNR_168)*0.9<=abs(signalvalue1))&&(abs(signalvalue1)<=abs(@ecu_Signals::i_S4_SRR_RL_Clu_SNR_168)*1.1))
	{
	testStepPass("Pass","i_S4_SRR_RL_Clu_SNR_168 :%f",signalvalue1);
	}
	else
	{
	testStepFail("Fail","i_S4_SRR_RL_Clu_SNR_168 :%f",signalvalue1);
	}
}

testcase S4_SRR_RL_Clu_Mes_24_S4_SRR_RL_Clu_DynProp_168()
{
	signalvalue1 = getSignal(S4_SRR_RL_Clu_DynProp_168);
	write("S4_SRR_RL_Clu_DynProp_168 :%f",signalvalue1);
	write("i_S4_SRR_RL_Clu_DynProp_168 :%o",@ecu_Signals::i_S4_SRR_RL_Clu_DynProp_168);

	testStep("get expect variable value: ","i_S4_SRR_RL_Clu_DynProp_168 :%o",@ecu_Signals::i_S4_SRR_RL_Clu_DynProp_168);

	if(signalvalue1==@ecu_Signals::i_S4_SRR_RL_Clu_DynProp_168)
	{
	testStepPass("Pass","i_S4_SRR_RL_Clu_DynProp_168 :%f",signalvalue1);
	}
	else
	{
	testStepFail("Fail","i_S4_SRR_RL_Clu_DynProp_168 :%f",signalvalue1);
	}
}

testcase S4_SRR_RL_Clu_Mes_24_S4_SRR_RL_Clu_Locationvalid_168()
{
	signalvalue1 = getSignal(S4_SRR_RL_Clu_Locationvalid_168);
	write("S4_SRR_RL_Clu_Locationvalid_168 :%f",signalvalue1);
	write("i_S4_SRR_RL_Clu_Locationvalid_168 :%o",@ecu_Signals::i_S4_SRR_RL_Clu_Locationvalid_168);

	testStep("get expect variable value: ","i_S4_SRR_RL_Clu_Locationvalid_168 :%o",@ecu_Signals::i_S4_SRR_RL_Clu_Locationvalid_168);

	if(signalvalue1==@ecu_Signals::i_S4_SRR_RL_Clu_Locationvalid_168)
	{
	testStepPass("Pass","i_S4_SRR_RL_Clu_Locationvalid_168 :%f",signalvalue1);
	}
	else
	{
	testStepFail("Fail","i_S4_SRR_RL_Clu_Locationvalid_168 :%f",signalvalue1);
	}
}

testcase S4_SRR_RL_Clu_Mes_24_S4_SRR_RL_Clu_Theta_169()
{
	signalvalue1 = getSignal(S4_SRR_RL_Clu_Theta_169);
	write("S4_SRR_RL_Clu_Theta_169 :%f",signalvalue1);
	write("i_S4_SRR_RL_Clu_Theta_169 :%f",@ecu_Signals::i_S4_SRR_RL_Clu_Theta_169);

	testStep("get expect variable value: ","i_S4_SRR_RL_Clu_Theta_169 :%f",@ecu_Signals::i_S4_SRR_RL_Clu_Theta_169);

	if((abs(@ecu_Signals::i_S4_SRR_RL_Clu_Theta_169)*0.9<=abs(signalvalue1))&&(abs(signalvalue1)<=abs(@ecu_Signals::i_S4_SRR_RL_Clu_Theta_169)*1.1))
	{
	testStepPass("Pass","i_S4_SRR_RL_Clu_Theta_169 :%f",signalvalue1);
	}
	else
	{
	testStepFail("Fail","i_S4_SRR_RL_Clu_Theta_169 :%f",signalvalue1);
	}
}

testcase S4_SRR_RL_Clu_Mes_24_S4_SRR_RL_Clu_Dist_169()
{
	signalvalue1 = getSignal(S4_SRR_RL_Clu_Dist_169);
	write("S4_SRR_RL_Clu_Dist_169 :%f",signalvalue1);
	write("i_S4_SRR_RL_Clu_Dist_169 :%f",@ecu_Signals::i_S4_SRR_RL_Clu_Dist_169);

	testStep("get expect variable value: ","i_S4_SRR_RL_Clu_Dist_169 :%f",@ecu_Signals::i_S4_SRR_RL_Clu_Dist_169);

	if((abs(@ecu_Signals::i_S4_SRR_RL_Clu_Dist_169)*0.9<=abs(signalvalue1))&&(abs(signalvalue1)<=abs(@ecu_Signals::i_S4_SRR_RL_Clu_Dist_169)*1.1))
	{
	testStepPass("Pass","i_S4_SRR_RL_Clu_Dist_169 :%f",signalvalue1);
	}
	else
	{
	testStepFail("Fail","i_S4_SRR_RL_Clu_Dist_169 :%f",signalvalue1);
	}
}

testcase S4_SRR_RL_Clu_Mes_24_S4_SRR_RL_Clu_Vel_169()
{
	signalvalue1 = getSignal(S4_SRR_RL_Clu_Vel_169);
	write("S4_SRR_RL_Clu_Vel_169 :%f",signalvalue1);
	write("i_S4_SRR_RL_Clu_Vel_169 :%f",@ecu_Signals::i_S4_SRR_RL_Clu_Vel_169);

	testStep("get expect variable value: ","i_S4_SRR_RL_Clu_Vel_169 :%f",@ecu_Signals::i_S4_SRR_RL_Clu_Vel_169);

	if((abs(@ecu_Signals::i_S4_SRR_RL_Clu_Vel_169)*0.9<=abs(signalvalue1))&&(abs(signalvalue1)<=abs(@ecu_Signals::i_S4_SRR_RL_Clu_Vel_169)*1.1))
	{
	testStepPass("Pass","i_S4_SRR_RL_Clu_Vel_169 :%f",signalvalue1);
	}
	else
	{
	testStepFail("Fail","i_S4_SRR_RL_Clu_Vel_169 :%f",signalvalue1);
	}
}

testcase S4_SRR_RL_Clu_Mes_24_S4_SRR_RL_Clu_SNR_169()
{
	signalvalue1 = getSignal(S4_SRR_RL_Clu_SNR_169);
	write("S4_SRR_RL_Clu_SNR_169 :%f",signalvalue1);
	write("i_S4_SRR_RL_Clu_SNR_169 :%f",@ecu_Signals::i_S4_SRR_RL_Clu_SNR_169);

	testStep("get expect variable value: ","i_S4_SRR_RL_Clu_SNR_169 :%f",@ecu_Signals::i_S4_SRR_RL_Clu_SNR_169);

	if((abs(@ecu_Signals::i_S4_SRR_RL_Clu_SNR_169)*0.9<=abs(signalvalue1))&&(abs(signalvalue1)<=abs(@ecu_Signals::i_S4_SRR_RL_Clu_SNR_169)*1.1))
	{
	testStepPass("Pass","i_S4_SRR_RL_Clu_SNR_169 :%f",signalvalue1);
	}
	else
	{
	testStepFail("Fail","i_S4_SRR_RL_Clu_SNR_169 :%f",signalvalue1);
	}
}

testcase S4_SRR_RL_Clu_Mes_24_S4_SRR_RL_Clu_DynProp_169()
{
	signalvalue1 = getSignal(S4_SRR_RL_Clu_DynProp_169);
	write("S4_SRR_RL_Clu_DynProp_169 :%f",signalvalue1);
	write("i_S4_SRR_RL_Clu_DynProp_169 :%o",@ecu_Signals::i_S4_SRR_RL_Clu_DynProp_169);

	testStep("get expect variable value: ","i_S4_SRR_RL_Clu_DynProp_169 :%o",@ecu_Signals::i_S4_SRR_RL_Clu_DynProp_169);

	if(signalvalue1==@ecu_Signals::i_S4_SRR_RL_Clu_DynProp_169)
	{
	testStepPass("Pass","i_S4_SRR_RL_Clu_DynProp_169 :%f",signalvalue1);
	}
	else
	{
	testStepFail("Fail","i_S4_SRR_RL_Clu_DynProp_169 :%f",signalvalue1);
	}
}

testcase S4_SRR_RL_Clu_Mes_24_S4_SRR_RL_Clu_Locationvalid_169()
{
	signalvalue1 = getSignal(S4_SRR_RL_Clu_Locationvalid_169);
	write("S4_SRR_RL_Clu_Locationvalid_169 :%f",signalvalue1);
	write("i_S4_SRR_RL_Clu_Locationvalid_169 :%o",@ecu_Signals::i_S4_SRR_RL_Clu_Locationvalid_169);

	testStep("get expect variable value: ","i_S4_SRR_RL_Clu_Locationvalid_169 :%o",@ecu_Signals::i_S4_SRR_RL_Clu_Locationvalid_169);

	if(signalvalue1==@ecu_Signals::i_S4_SRR_RL_Clu_Locationvalid_169)
	{
	testStepPass("Pass","i_S4_SRR_RL_Clu_Locationvalid_169 :%f",signalvalue1);
	}
	else
	{
	testStepFail("Fail","i_S4_SRR_RL_Clu_Locationvalid_169 :%f",signalvalue1);
	}
}

testcase S4_SRR_RL_Clu_Mes_24_S4_SRR_RL_Clu_Theta_170()
{
	signalvalue1 = getSignal(S4_SRR_RL_Clu_Theta_170);
	write("S4_SRR_RL_Clu_Theta_170 :%f",signalvalue1);
	write("i_S4_SRR_RL_Clu_Theta_170 :%f",@ecu_Signals::i_S4_SRR_RL_Clu_Theta_170);

	testStep("get expect variable value: ","i_S4_SRR_RL_Clu_Theta_170 :%f",@ecu_Signals::i_S4_SRR_RL_Clu_Theta_170);

	if((abs(@ecu_Signals::i_S4_SRR_RL_Clu_Theta_170)*0.9<=abs(signalvalue1))&&(abs(signalvalue1)<=abs(@ecu_Signals::i_S4_SRR_RL_Clu_Theta_170)*1.1))
	{
	testStepPass("Pass","i_S4_SRR_RL_Clu_Theta_170 :%f",signalvalue1);
	}
	else
	{
	testStepFail("Fail","i_S4_SRR_RL_Clu_Theta_170 :%f",signalvalue1);
	}
}

testcase S4_SRR_RL_Clu_Mes_24_S4_SRR_RL_Clu_Dist_170()
{
	signalvalue1 = getSignal(S4_SRR_RL_Clu_Dist_170);
	write("S4_SRR_RL_Clu_Dist_170 :%f",signalvalue1);
	write("i_S4_SRR_RL_Clu_Dist_170 :%f",@ecu_Signals::i_S4_SRR_RL_Clu_Dist_170);

	testStep("get expect variable value: ","i_S4_SRR_RL_Clu_Dist_170 :%f",@ecu_Signals::i_S4_SRR_RL_Clu_Dist_170);

	if((abs(@ecu_Signals::i_S4_SRR_RL_Clu_Dist_170)*0.9<=abs(signalvalue1))&&(abs(signalvalue1)<=abs(@ecu_Signals::i_S4_SRR_RL_Clu_Dist_170)*1.1))
	{
	testStepPass("Pass","i_S4_SRR_RL_Clu_Dist_170 :%f",signalvalue1);
	}
	else
	{
	testStepFail("Fail","i_S4_SRR_RL_Clu_Dist_170 :%f",signalvalue1);
	}
}

testcase S4_SRR_RL_Clu_Mes_24_S4_SRR_RL_Clu_Vel_170()
{
	signalvalue1 = getSignal(S4_SRR_RL_Clu_Vel_170);
	write("S4_SRR_RL_Clu_Vel_170 :%f",signalvalue1);
	write("i_S4_SRR_RL_Clu_Vel_170 :%f",@ecu_Signals::i_S4_SRR_RL_Clu_Vel_170);

	testStep("get expect variable value: ","i_S4_SRR_RL_Clu_Vel_170 :%f",@ecu_Signals::i_S4_SRR_RL_Clu_Vel_170);

	if((abs(@ecu_Signals::i_S4_SRR_RL_Clu_Vel_170)*0.9<=abs(signalvalue1))&&(abs(signalvalue1)<=abs(@ecu_Signals::i_S4_SRR_RL_Clu_Vel_170)*1.1))
	{
	testStepPass("Pass","i_S4_SRR_RL_Clu_Vel_170 :%f",signalvalue1);
	}
	else
	{
	testStepFail("Fail","i_S4_SRR_RL_Clu_Vel_170 :%f",signalvalue1);
	}
}

testcase S4_SRR_RL_Clu_Mes_24_S4_SRR_RL_Clu_SNR_170()
{
	signalvalue1 = getSignal(S4_SRR_RL_Clu_SNR_170);
	write("S4_SRR_RL_Clu_SNR_170 :%f",signalvalue1);
	write("i_S4_SRR_RL_Clu_SNR_170 :%f",@ecu_Signals::i_S4_SRR_RL_Clu_SNR_170);

	testStep("get expect variable value: ","i_S4_SRR_RL_Clu_SNR_170 :%f",@ecu_Signals::i_S4_SRR_RL_Clu_SNR_170);

	if((abs(@ecu_Signals::i_S4_SRR_RL_Clu_SNR_170)*0.9<=abs(signalvalue1))&&(abs(signalvalue1)<=abs(@ecu_Signals::i_S4_SRR_RL_Clu_SNR_170)*1.1))
	{
	testStepPass("Pass","i_S4_SRR_RL_Clu_SNR_170 :%f",signalvalue1);
	}
	else
	{
	testStepFail("Fail","i_S4_SRR_RL_Clu_SNR_170 :%f",signalvalue1);
	}
}

testcase S4_SRR_RL_Clu_Mes_24_S4_SRR_RL_Clu_DynProp_170()
{
	signalvalue1 = getSignal(S4_SRR_RL_Clu_DynProp_170);
	write("S4_SRR_RL_Clu_DynProp_170 :%f",signalvalue1);
	write("i_S4_SRR_RL_Clu_DynProp_170 :%o",@ecu_Signals::i_S4_SRR_RL_Clu_DynProp_170);

	testStep("get expect variable value: ","i_S4_SRR_RL_Clu_DynProp_170 :%o",@ecu_Signals::i_S4_SRR_RL_Clu_DynProp_170);

	if(signalvalue1==@ecu_Signals::i_S4_SRR_RL_Clu_DynProp_170)
	{
	testStepPass("Pass","i_S4_SRR_RL_Clu_DynProp_170 :%f",signalvalue1);
	}
	else
	{
	testStepFail("Fail","i_S4_SRR_RL_Clu_DynProp_170 :%f",signalvalue1);
	}
}

testcase S4_SRR_RL_Clu_Mes_24_S4_SRR_RL_Clu_Locationvalid_170()
{
	signalvalue1 = getSignal(S4_SRR_RL_Clu_Locationvalid_170);
	write("S4_SRR_RL_Clu_Locationvalid_170 :%f",signalvalue1);
	write("i_S4_SRR_RL_Clu_Locationvalid_170 :%o",@ecu_Signals::i_S4_SRR_RL_Clu_Locationvalid_170);

	testStep("get expect variable value: ","i_S4_SRR_RL_Clu_Locationvalid_170 :%o",@ecu_Signals::i_S4_SRR_RL_Clu_Locationvalid_170);

	if(signalvalue1==@ecu_Signals::i_S4_SRR_RL_Clu_Locationvalid_170)
	{
	testStepPass("Pass","i_S4_SRR_RL_Clu_Locationvalid_170 :%f",signalvalue1);
	}
	else
	{
	testStepFail("Fail","i_S4_SRR_RL_Clu_Locationvalid_170 :%f",signalvalue1);
	}
}

testcase S4_SRR_RL_Clu_Mes_24_S4_SRR_RL_Clu_Theta_171()
{
	signalvalue1 = getSignal(S4_SRR_RL_Clu_Theta_171);
	write("S4_SRR_RL_Clu_Theta_171 :%f",signalvalue1);
	write("i_S4_SRR_RL_Clu_Theta_171 :%f",@ecu_Signals::i_S4_SRR_RL_Clu_Theta_171);

	testStep("get expect variable value: ","i_S4_SRR_RL_Clu_Theta_171 :%f",@ecu_Signals::i_S4_SRR_RL_Clu_Theta_171);

	if((abs(@ecu_Signals::i_S4_SRR_RL_Clu_Theta_171)*0.9<=abs(signalvalue1))&&(abs(signalvalue1)<=abs(@ecu_Signals::i_S4_SRR_RL_Clu_Theta_171)*1.1))
	{
	testStepPass("Pass","i_S4_SRR_RL_Clu_Theta_171 :%f",signalvalue1);
	}
	else
	{
	testStepFail("Fail","i_S4_SRR_RL_Clu_Theta_171 :%f",signalvalue1);
	}
}

testcase S4_SRR_RL_Clu_Mes_24_S4_SRR_RL_Clu_Dist_171()
{
	signalvalue1 = getSignal(S4_SRR_RL_Clu_Dist_171);
	write("S4_SRR_RL_Clu_Dist_171 :%f",signalvalue1);
	write("i_S4_SRR_RL_Clu_Dist_171 :%f",@ecu_Signals::i_S4_SRR_RL_Clu_Dist_171);

	testStep("get expect variable value: ","i_S4_SRR_RL_Clu_Dist_171 :%f",@ecu_Signals::i_S4_SRR_RL_Clu_Dist_171);

	if((abs(@ecu_Signals::i_S4_SRR_RL_Clu_Dist_171)*0.9<=abs(signalvalue1))&&(abs(signalvalue1)<=abs(@ecu_Signals::i_S4_SRR_RL_Clu_Dist_171)*1.1))
	{
	testStepPass("Pass","i_S4_SRR_RL_Clu_Dist_171 :%f",signalvalue1);
	}
	else
	{
	testStepFail("Fail","i_S4_SRR_RL_Clu_Dist_171 :%f",signalvalue1);
	}
}

testcase S4_SRR_RL_Clu_Mes_24_S4_SRR_RL_Clu_Vel_171()
{
	signalvalue1 = getSignal(S4_SRR_RL_Clu_Vel_171);
	write("S4_SRR_RL_Clu_Vel_171 :%f",signalvalue1);
	write("i_S4_SRR_RL_Clu_Vel_171 :%f",@ecu_Signals::i_S4_SRR_RL_Clu_Vel_171);

	testStep("get expect variable value: ","i_S4_SRR_RL_Clu_Vel_171 :%f",@ecu_Signals::i_S4_SRR_RL_Clu_Vel_171);

	if((abs(@ecu_Signals::i_S4_SRR_RL_Clu_Vel_171)*0.9<=abs(signalvalue1))&&(abs(signalvalue1)<=abs(@ecu_Signals::i_S4_SRR_RL_Clu_Vel_171)*1.1))
	{
	testStepPass("Pass","i_S4_SRR_RL_Clu_Vel_171 :%f",signalvalue1);
	}
	else
	{
	testStepFail("Fail","i_S4_SRR_RL_Clu_Vel_171 :%f",signalvalue1);
	}
}

testcase S4_SRR_RL_Clu_Mes_24_S4_SRR_RL_Clu_SNR_171()
{
	signalvalue1 = getSignal(S4_SRR_RL_Clu_SNR_171);
	write("S4_SRR_RL_Clu_SNR_171 :%f",signalvalue1);
	write("i_S4_SRR_RL_Clu_SNR_171 :%f",@ecu_Signals::i_S4_SRR_RL_Clu_SNR_171);

	testStep("get expect variable value: ","i_S4_SRR_RL_Clu_SNR_171 :%f",@ecu_Signals::i_S4_SRR_RL_Clu_SNR_171);

	if((abs(@ecu_Signals::i_S4_SRR_RL_Clu_SNR_171)*0.9<=abs(signalvalue1))&&(abs(signalvalue1)<=abs(@ecu_Signals::i_S4_SRR_RL_Clu_SNR_171)*1.1))
	{
	testStepPass("Pass","i_S4_SRR_RL_Clu_SNR_171 :%f",signalvalue1);
	}
	else
	{
	testStepFail("Fail","i_S4_SRR_RL_Clu_SNR_171 :%f",signalvalue1);
	}
}

testcase S4_SRR_RL_Clu_Mes_24_S4_SRR_RL_Clu_DynProp_171()
{
	signalvalue1 = getSignal(S4_SRR_RL_Clu_DynProp_171);
	write("S4_SRR_RL_Clu_DynProp_171 :%f",signalvalue1);
	write("i_S4_SRR_RL_Clu_DynProp_171 :%o",@ecu_Signals::i_S4_SRR_RL_Clu_DynProp_171);

	testStep("get expect variable value: ","i_S4_SRR_RL_Clu_DynProp_171 :%o",@ecu_Signals::i_S4_SRR_RL_Clu_DynProp_171);

	if(signalvalue1==@ecu_Signals::i_S4_SRR_RL_Clu_DynProp_171)
	{
	testStepPass("Pass","i_S4_SRR_RL_Clu_DynProp_171 :%f",signalvalue1);
	}
	else
	{
	testStepFail("Fail","i_S4_SRR_RL_Clu_DynProp_171 :%f",signalvalue1);
	}
}

testcase S4_SRR_RL_Clu_Mes_24_S4_SRR_RL_Clu_Locationvalid_171()
{
	signalvalue1 = getSignal(S4_SRR_RL_Clu_Locationvalid_171);
	write("S4_SRR_RL_Clu_Locationvalid_171 :%f",signalvalue1);
	write("i_S4_SRR_RL_Clu_Locationvalid_171 :%o",@ecu_Signals::i_S4_SRR_RL_Clu_Locationvalid_171);

	testStep("get expect variable value: ","i_S4_SRR_RL_Clu_Locationvalid_171 :%o",@ecu_Signals::i_S4_SRR_RL_Clu_Locationvalid_171);

	if(signalvalue1==@ecu_Signals::i_S4_SRR_RL_Clu_Locationvalid_171)
	{
	testStepPass("Pass","i_S4_SRR_RL_Clu_Locationvalid_171 :%f",signalvalue1);
	}
	else
	{
	testStepFail("Fail","i_S4_SRR_RL_Clu_Locationvalid_171 :%f",signalvalue1);
	}
}

testcase S4_SRR_RL_Clu_Mes_24_S4_SRR_RL_Clu_Theta_172()
{
	signalvalue1 = getSignal(S4_SRR_RL_Clu_Theta_172);
	write("S4_SRR_RL_Clu_Theta_172 :%f",signalvalue1);
	write("i_S4_SRR_RL_Clu_Theta_172 :%f",@ecu_Signals::i_S4_SRR_RL_Clu_Theta_172);

	testStep("get expect variable value: ","i_S4_SRR_RL_Clu_Theta_172 :%f",@ecu_Signals::i_S4_SRR_RL_Clu_Theta_172);

	if((abs(@ecu_Signals::i_S4_SRR_RL_Clu_Theta_172)*0.9<=abs(signalvalue1))&&(abs(signalvalue1)<=abs(@ecu_Signals::i_S4_SRR_RL_Clu_Theta_172)*1.1))
	{
	testStepPass("Pass","i_S4_SRR_RL_Clu_Theta_172 :%f",signalvalue1);
	}
	else
	{
	testStepFail("Fail","i_S4_SRR_RL_Clu_Theta_172 :%f",signalvalue1);
	}
}

testcase S4_SRR_RL_Clu_Mes_24_S4_SRR_RL_Clu_Dist_172()
{
	signalvalue1 = getSignal(S4_SRR_RL_Clu_Dist_172);
	write("S4_SRR_RL_Clu_Dist_172 :%f",signalvalue1);
	write("i_S4_SRR_RL_Clu_Dist_172 :%f",@ecu_Signals::i_S4_SRR_RL_Clu_Dist_172);

	testStep("get expect variable value: ","i_S4_SRR_RL_Clu_Dist_172 :%f",@ecu_Signals::i_S4_SRR_RL_Clu_Dist_172);

	if((abs(@ecu_Signals::i_S4_SRR_RL_Clu_Dist_172)*0.9<=abs(signalvalue1))&&(abs(signalvalue1)<=abs(@ecu_Signals::i_S4_SRR_RL_Clu_Dist_172)*1.1))
	{
	testStepPass("Pass","i_S4_SRR_RL_Clu_Dist_172 :%f",signalvalue1);
	}
	else
	{
	testStepFail("Fail","i_S4_SRR_RL_Clu_Dist_172 :%f",signalvalue1);
	}
}

testcase S4_SRR_RL_Clu_Mes_24_S4_SRR_RL_Clu_Vel_172()
{
	signalvalue1 = getSignal(S4_SRR_RL_Clu_Vel_172);
	write("S4_SRR_RL_Clu_Vel_172 :%f",signalvalue1);
	write("i_S4_SRR_RL_Clu_Vel_172 :%f",@ecu_Signals::i_S4_SRR_RL_Clu_Vel_172);

	testStep("get expect variable value: ","i_S4_SRR_RL_Clu_Vel_172 :%f",@ecu_Signals::i_S4_SRR_RL_Clu_Vel_172);

	if((abs(@ecu_Signals::i_S4_SRR_RL_Clu_Vel_172)*0.9<=abs(signalvalue1))&&(abs(signalvalue1)<=abs(@ecu_Signals::i_S4_SRR_RL_Clu_Vel_172)*1.1))
	{
	testStepPass("Pass","i_S4_SRR_RL_Clu_Vel_172 :%f",signalvalue1);
	}
	else
	{
	testStepFail("Fail","i_S4_SRR_RL_Clu_Vel_172 :%f",signalvalue1);
	}
}

testcase S4_SRR_RL_Clu_Mes_24_S4_SRR_RL_Clu_SNR_172()
{
	signalvalue1 = getSignal(S4_SRR_RL_Clu_SNR_172);
	write("S4_SRR_RL_Clu_SNR_172 :%f",signalvalue1);
	write("i_S4_SRR_RL_Clu_SNR_172 :%f",@ecu_Signals::i_S4_SRR_RL_Clu_SNR_172);

	testStep("get expect variable value: ","i_S4_SRR_RL_Clu_SNR_172 :%f",@ecu_Signals::i_S4_SRR_RL_Clu_SNR_172);

	if((abs(@ecu_Signals::i_S4_SRR_RL_Clu_SNR_172)*0.9<=abs(signalvalue1))&&(abs(signalvalue1)<=abs(@ecu_Signals::i_S4_SRR_RL_Clu_SNR_172)*1.1))
	{
	testStepPass("Pass","i_S4_SRR_RL_Clu_SNR_172 :%f",signalvalue1);
	}
	else
	{
	testStepFail("Fail","i_S4_SRR_RL_Clu_SNR_172 :%f",signalvalue1);
	}
}

testcase S4_SRR_RL_Clu_Mes_24_S4_SRR_RL_Clu_DynProp_172()
{
	signalvalue1 = getSignal(S4_SRR_RL_Clu_DynProp_172);
	write("S4_SRR_RL_Clu_DynProp_172 :%f",signalvalue1);
	write("i_S4_SRR_RL_Clu_DynProp_172 :%o",@ecu_Signals::i_S4_SRR_RL_Clu_DynProp_172);

	testStep("get expect variable value: ","i_S4_SRR_RL_Clu_DynProp_172 :%o",@ecu_Signals::i_S4_SRR_RL_Clu_DynProp_172);

	if(signalvalue1==@ecu_Signals::i_S4_SRR_RL_Clu_DynProp_172)
	{
	testStepPass("Pass","i_S4_SRR_RL_Clu_DynProp_172 :%f",signalvalue1);
	}
	else
	{
	testStepFail("Fail","i_S4_SRR_RL_Clu_DynProp_172 :%f",signalvalue1);
	}
}

testcase S4_SRR_RL_Clu_Mes_24_S4_SRR_RL_Clu_Locationvalid_172()
{
	signalvalue1 = getSignal(S4_SRR_RL_Clu_Locationvalid_172);
	write("S4_SRR_RL_Clu_Locationvalid_172 :%f",signalvalue1);
	write("i_S4_SRR_RL_Clu_Locationvalid_172 :%o",@ecu_Signals::i_S4_SRR_RL_Clu_Locationvalid_172);

	testStep("get expect variable value: ","i_S4_SRR_RL_Clu_Locationvalid_172 :%o",@ecu_Signals::i_S4_SRR_RL_Clu_Locationvalid_172);

	if(signalvalue1==@ecu_Signals::i_S4_SRR_RL_Clu_Locationvalid_172)
	{
	testStepPass("Pass","i_S4_SRR_RL_Clu_Locationvalid_172 :%f",signalvalue1);
	}
	else
	{
	testStepFail("Fail","i_S4_SRR_RL_Clu_Locationvalid_172 :%f",signalvalue1);
	}
}

testcase S4_SRR_RL_Clu_Mes_24_S4_SRR_RL_Clu_Theta_173()
{
	signalvalue1 = getSignal(S4_SRR_RL_Clu_Theta_173);
	write("S4_SRR_RL_Clu_Theta_173 :%f",signalvalue1);
	write("i_S4_SRR_RL_Clu_Theta_173 :%f",@ecu_Signals::i_S4_SRR_RL_Clu_Theta_173);

	testStep("get expect variable value: ","i_S4_SRR_RL_Clu_Theta_173 :%f",@ecu_Signals::i_S4_SRR_RL_Clu_Theta_173);

	if((abs(@ecu_Signals::i_S4_SRR_RL_Clu_Theta_173)*0.9<=abs(signalvalue1))&&(abs(signalvalue1)<=abs(@ecu_Signals::i_S4_SRR_RL_Clu_Theta_173)*1.1))
	{
	testStepPass("Pass","i_S4_SRR_RL_Clu_Theta_173 :%f",signalvalue1);
	}
	else
	{
	testStepFail("Fail","i_S4_SRR_RL_Clu_Theta_173 :%f",signalvalue1);
	}
}

testcase S4_SRR_RL_Clu_Mes_24_S4_SRR_RL_Clu_Dist_173()
{
	signalvalue1 = getSignal(S4_SRR_RL_Clu_Dist_173);
	write("S4_SRR_RL_Clu_Dist_173 :%f",signalvalue1);
	write("i_S4_SRR_RL_Clu_Dist_173 :%f",@ecu_Signals::i_S4_SRR_RL_Clu_Dist_173);

	testStep("get expect variable value: ","i_S4_SRR_RL_Clu_Dist_173 :%f",@ecu_Signals::i_S4_SRR_RL_Clu_Dist_173);

	if((abs(@ecu_Signals::i_S4_SRR_RL_Clu_Dist_173)*0.9<=abs(signalvalue1))&&(abs(signalvalue1)<=abs(@ecu_Signals::i_S4_SRR_RL_Clu_Dist_173)*1.1))
	{
	testStepPass("Pass","i_S4_SRR_RL_Clu_Dist_173 :%f",signalvalue1);
	}
	else
	{
	testStepFail("Fail","i_S4_SRR_RL_Clu_Dist_173 :%f",signalvalue1);
	}
}

testcase S4_SRR_RL_Clu_Mes_24_S4_SRR_RL_Clu_Vel_173()
{
	signalvalue1 = getSignal(S4_SRR_RL_Clu_Vel_173);
	write("S4_SRR_RL_Clu_Vel_173 :%f",signalvalue1);
	write("i_S4_SRR_RL_Clu_Vel_173 :%f",@ecu_Signals::i_S4_SRR_RL_Clu_Vel_173);

	testStep("get expect variable value: ","i_S4_SRR_RL_Clu_Vel_173 :%f",@ecu_Signals::i_S4_SRR_RL_Clu_Vel_173);

	if((abs(@ecu_Signals::i_S4_SRR_RL_Clu_Vel_173)*0.9<=abs(signalvalue1))&&(abs(signalvalue1)<=abs(@ecu_Signals::i_S4_SRR_RL_Clu_Vel_173)*1.1))
	{
	testStepPass("Pass","i_S4_SRR_RL_Clu_Vel_173 :%f",signalvalue1);
	}
	else
	{
	testStepFail("Fail","i_S4_SRR_RL_Clu_Vel_173 :%f",signalvalue1);
	}
}

testcase S4_SRR_RL_Clu_Mes_24_S4_SRR_RL_Clu_SNR_173()
{
	signalvalue1 = getSignal(S4_SRR_RL_Clu_SNR_173);
	write("S4_SRR_RL_Clu_SNR_173 :%f",signalvalue1);
	write("i_S4_SRR_RL_Clu_SNR_173 :%f",@ecu_Signals::i_S4_SRR_RL_Clu_SNR_173);

	testStep("get expect variable value: ","i_S4_SRR_RL_Clu_SNR_173 :%f",@ecu_Signals::i_S4_SRR_RL_Clu_SNR_173);

	if((abs(@ecu_Signals::i_S4_SRR_RL_Clu_SNR_173)*0.9<=abs(signalvalue1))&&(abs(signalvalue1)<=abs(@ecu_Signals::i_S4_SRR_RL_Clu_SNR_173)*1.1))
	{
	testStepPass("Pass","i_S4_SRR_RL_Clu_SNR_173 :%f",signalvalue1);
	}
	else
	{
	testStepFail("Fail","i_S4_SRR_RL_Clu_SNR_173 :%f",signalvalue1);
	}
}

testcase S4_SRR_RL_Clu_Mes_24_S4_SRR_RL_Clu_DynProp_173()
{
	signalvalue1 = getSignal(S4_SRR_RL_Clu_DynProp_173);
	write("S4_SRR_RL_Clu_DynProp_173 :%f",signalvalue1);
	write("i_S4_SRR_RL_Clu_DynProp_173 :%o",@ecu_Signals::i_S4_SRR_RL_Clu_DynProp_173);

	testStep("get expect variable value: ","i_S4_SRR_RL_Clu_DynProp_173 :%o",@ecu_Signals::i_S4_SRR_RL_Clu_DynProp_173);

	if(signalvalue1==@ecu_Signals::i_S4_SRR_RL_Clu_DynProp_173)
	{
	testStepPass("Pass","i_S4_SRR_RL_Clu_DynProp_173 :%f",signalvalue1);
	}
	else
	{
	testStepFail("Fail","i_S4_SRR_RL_Clu_DynProp_173 :%f",signalvalue1);
	}
}

testcase S4_SRR_RL_Clu_Mes_24_S4_SRR_RL_Clu_Locationvalid_173()
{
	signalvalue1 = getSignal(S4_SRR_RL_Clu_Locationvalid_173);
	write("S4_SRR_RL_Clu_Locationvalid_173 :%f",signalvalue1);
	write("i_S4_SRR_RL_Clu_Locationvalid_173 :%o",@ecu_Signals::i_S4_SRR_RL_Clu_Locationvalid_173);

	testStep("get expect variable value: ","i_S4_SRR_RL_Clu_Locationvalid_173 :%o",@ecu_Signals::i_S4_SRR_RL_Clu_Locationvalid_173);

	if(signalvalue1==@ecu_Signals::i_S4_SRR_RL_Clu_Locationvalid_173)
	{
	testStepPass("Pass","i_S4_SRR_RL_Clu_Locationvalid_173 :%f",signalvalue1);
	}
	else
	{
	testStepFail("Fail","i_S4_SRR_RL_Clu_Locationvalid_173 :%f",signalvalue1);
	}
}

testcase S4_SRR_RL_Clu_Mes_24_S4_SRR_RL_Clu_Theta_174()
{
	signalvalue1 = getSignal(S4_SRR_RL_Clu_Theta_174);
	write("S4_SRR_RL_Clu_Theta_174 :%f",signalvalue1);
	write("i_S4_SRR_RL_Clu_Theta_174 :%f",@ecu_Signals::i_S4_SRR_RL_Clu_Theta_174);

	testStep("get expect variable value: ","i_S4_SRR_RL_Clu_Theta_174 :%f",@ecu_Signals::i_S4_SRR_RL_Clu_Theta_174);

	if((abs(@ecu_Signals::i_S4_SRR_RL_Clu_Theta_174)*0.9<=abs(signalvalue1))&&(abs(signalvalue1)<=abs(@ecu_Signals::i_S4_SRR_RL_Clu_Theta_174)*1.1))
	{
	testStepPass("Pass","i_S4_SRR_RL_Clu_Theta_174 :%f",signalvalue1);
	}
	else
	{
	testStepFail("Fail","i_S4_SRR_RL_Clu_Theta_174 :%f",signalvalue1);
	}
}

testcase S4_SRR_RL_Clu_Mes_24_S4_SRR_RL_Clu_Dist_174()
{
	signalvalue1 = getSignal(S4_SRR_RL_Clu_Dist_174);
	write("S4_SRR_RL_Clu_Dist_174 :%f",signalvalue1);
	write("i_S4_SRR_RL_Clu_Dist_174 :%f",@ecu_Signals::i_S4_SRR_RL_Clu_Dist_174);

	testStep("get expect variable value: ","i_S4_SRR_RL_Clu_Dist_174 :%f",@ecu_Signals::i_S4_SRR_RL_Clu_Dist_174);

	if((abs(@ecu_Signals::i_S4_SRR_RL_Clu_Dist_174)*0.9<=abs(signalvalue1))&&(abs(signalvalue1)<=abs(@ecu_Signals::i_S4_SRR_RL_Clu_Dist_174)*1.1))
	{
	testStepPass("Pass","i_S4_SRR_RL_Clu_Dist_174 :%f",signalvalue1);
	}
	else
	{
	testStepFail("Fail","i_S4_SRR_RL_Clu_Dist_174 :%f",signalvalue1);
	}
}

testcase S4_SRR_RL_Clu_Mes_24_S4_SRR_RL_Clu_Vel_174()
{
	signalvalue1 = getSignal(S4_SRR_RL_Clu_Vel_174);
	write("S4_SRR_RL_Clu_Vel_174 :%f",signalvalue1);
	write("i_S4_SRR_RL_Clu_Vel_174 :%f",@ecu_Signals::i_S4_SRR_RL_Clu_Vel_174);

	testStep("get expect variable value: ","i_S4_SRR_RL_Clu_Vel_174 :%f",@ecu_Signals::i_S4_SRR_RL_Clu_Vel_174);

	if((abs(@ecu_Signals::i_S4_SRR_RL_Clu_Vel_174)*0.9<=abs(signalvalue1))&&(abs(signalvalue1)<=abs(@ecu_Signals::i_S4_SRR_RL_Clu_Vel_174)*1.1))
	{
	testStepPass("Pass","i_S4_SRR_RL_Clu_Vel_174 :%f",signalvalue1);
	}
	else
	{
	testStepFail("Fail","i_S4_SRR_RL_Clu_Vel_174 :%f",signalvalue1);
	}
}

testcase S4_SRR_RL_Clu_Mes_24_S4_SRR_RL_Clu_SNR_174()
{
	signalvalue1 = getSignal(S4_SRR_RL_Clu_SNR_174);
	write("S4_SRR_RL_Clu_SNR_174 :%f",signalvalue1);
	write("i_S4_SRR_RL_Clu_SNR_174 :%f",@ecu_Signals::i_S4_SRR_RL_Clu_SNR_174);

	testStep("get expect variable value: ","i_S4_SRR_RL_Clu_SNR_174 :%f",@ecu_Signals::i_S4_SRR_RL_Clu_SNR_174);

	if((abs(@ecu_Signals::i_S4_SRR_RL_Clu_SNR_174)*0.9<=abs(signalvalue1))&&(abs(signalvalue1)<=abs(@ecu_Signals::i_S4_SRR_RL_Clu_SNR_174)*1.1))
	{
	testStepPass("Pass","i_S4_SRR_RL_Clu_SNR_174 :%f",signalvalue1);
	}
	else
	{
	testStepFail("Fail","i_S4_SRR_RL_Clu_SNR_174 :%f",signalvalue1);
	}
}

testcase S4_SRR_RL_Clu_Mes_24_S4_SRR_RL_Clu_DynProp_174()
{
	signalvalue1 = getSignal(S4_SRR_RL_Clu_DynProp_174);
	write("S4_SRR_RL_Clu_DynProp_174 :%f",signalvalue1);
	write("i_S4_SRR_RL_Clu_DynProp_174 :%o",@ecu_Signals::i_S4_SRR_RL_Clu_DynProp_174);

	testStep("get expect variable value: ","i_S4_SRR_RL_Clu_DynProp_174 :%o",@ecu_Signals::i_S4_SRR_RL_Clu_DynProp_174);

	if(signalvalue1==@ecu_Signals::i_S4_SRR_RL_Clu_DynProp_174)
	{
	testStepPass("Pass","i_S4_SRR_RL_Clu_DynProp_174 :%f",signalvalue1);
	}
	else
	{
	testStepFail("Fail","i_S4_SRR_RL_Clu_DynProp_174 :%f",signalvalue1);
	}
}

testcase S4_SRR_RL_Clu_Mes_24_S4_SRR_RL_Clu_Locationvalid_174()
{
	signalvalue1 = getSignal(S4_SRR_RL_Clu_Locationvalid_174);
	write("S4_SRR_RL_Clu_Locationvalid_174 :%f",signalvalue1);
	write("i_S4_SRR_RL_Clu_Locationvalid_174 :%o",@ecu_Signals::i_S4_SRR_RL_Clu_Locationvalid_174);

	testStep("get expect variable value: ","i_S4_SRR_RL_Clu_Locationvalid_174 :%o",@ecu_Signals::i_S4_SRR_RL_Clu_Locationvalid_174);

	if(signalvalue1==@ecu_Signals::i_S4_SRR_RL_Clu_Locationvalid_174)
	{
	testStepPass("Pass","i_S4_SRR_RL_Clu_Locationvalid_174 :%f",signalvalue1);
	}
	else
	{
	testStepFail("Fail","i_S4_SRR_RL_Clu_Locationvalid_174 :%f",signalvalue1);
	}
}

testcase S4_SRR_RL_Clu_Mes_25_S4_SRR_RL_Clu_Theta_175()
{
	signalvalue1 = getSignal(S4_SRR_RL_Clu_Theta_175);
	write("S4_SRR_RL_Clu_Theta_175 :%f",signalvalue1);
	write("i_S4_SRR_RL_Clu_Theta_175 :%f",@ecu_Signals::i_S4_SRR_RL_Clu_Theta_175);

	testStep("get expect variable value: ","i_S4_SRR_RL_Clu_Theta_175 :%f",@ecu_Signals::i_S4_SRR_RL_Clu_Theta_175);

	if((abs(@ecu_Signals::i_S4_SRR_RL_Clu_Theta_175)*0.9<=abs(signalvalue1))&&(abs(signalvalue1)<=abs(@ecu_Signals::i_S4_SRR_RL_Clu_Theta_175)*1.1))
	{
	testStepPass("Pass","i_S4_SRR_RL_Clu_Theta_175 :%f",signalvalue1);
	}
	else
	{
	testStepFail("Fail","i_S4_SRR_RL_Clu_Theta_175 :%f",signalvalue1);
	}
}

testcase S4_SRR_RL_Clu_Mes_25_S4_SRR_RL_Clu_Dist_175()
{
	signalvalue1 = getSignal(S4_SRR_RL_Clu_Dist_175);
	write("S4_SRR_RL_Clu_Dist_175 :%f",signalvalue1);
	write("i_S4_SRR_RL_Clu_Dist_175 :%f",@ecu_Signals::i_S4_SRR_RL_Clu_Dist_175);

	testStep("get expect variable value: ","i_S4_SRR_RL_Clu_Dist_175 :%f",@ecu_Signals::i_S4_SRR_RL_Clu_Dist_175);

	if((abs(@ecu_Signals::i_S4_SRR_RL_Clu_Dist_175)*0.9<=abs(signalvalue1))&&(abs(signalvalue1)<=abs(@ecu_Signals::i_S4_SRR_RL_Clu_Dist_175)*1.1))
	{
	testStepPass("Pass","i_S4_SRR_RL_Clu_Dist_175 :%f",signalvalue1);
	}
	else
	{
	testStepFail("Fail","i_S4_SRR_RL_Clu_Dist_175 :%f",signalvalue1);
	}
}

testcase S4_SRR_RL_Clu_Mes_25_S4_SRR_RL_Clu_Vel_175()
{
	signalvalue1 = getSignal(S4_SRR_RL_Clu_Vel_175);
	write("S4_SRR_RL_Clu_Vel_175 :%f",signalvalue1);
	write("i_S4_SRR_RL_Clu_Vel_175 :%f",@ecu_Signals::i_S4_SRR_RL_Clu_Vel_175);

	testStep("get expect variable value: ","i_S4_SRR_RL_Clu_Vel_175 :%f",@ecu_Signals::i_S4_SRR_RL_Clu_Vel_175);

	if((abs(@ecu_Signals::i_S4_SRR_RL_Clu_Vel_175)*0.9<=abs(signalvalue1))&&(abs(signalvalue1)<=abs(@ecu_Signals::i_S4_SRR_RL_Clu_Vel_175)*1.1))
	{
	testStepPass("Pass","i_S4_SRR_RL_Clu_Vel_175 :%f",signalvalue1);
	}
	else
	{
	testStepFail("Fail","i_S4_SRR_RL_Clu_Vel_175 :%f",signalvalue1);
	}
}

testcase S4_SRR_RL_Clu_Mes_25_S4_SRR_RL_Clu_SNR_175()
{
	signalvalue1 = getSignal(S4_SRR_RL_Clu_SNR_175);
	write("S4_SRR_RL_Clu_SNR_175 :%f",signalvalue1);
	write("i_S4_SRR_RL_Clu_SNR_175 :%f",@ecu_Signals::i_S4_SRR_RL_Clu_SNR_175);

	testStep("get expect variable value: ","i_S4_SRR_RL_Clu_SNR_175 :%f",@ecu_Signals::i_S4_SRR_RL_Clu_SNR_175);

	if((abs(@ecu_Signals::i_S4_SRR_RL_Clu_SNR_175)*0.9<=abs(signalvalue1))&&(abs(signalvalue1)<=abs(@ecu_Signals::i_S4_SRR_RL_Clu_SNR_175)*1.1))
	{
	testStepPass("Pass","i_S4_SRR_RL_Clu_SNR_175 :%f",signalvalue1);
	}
	else
	{
	testStepFail("Fail","i_S4_SRR_RL_Clu_SNR_175 :%f",signalvalue1);
	}
}

testcase S4_SRR_RL_Clu_Mes_25_S4_SRR_RL_Clu_DynProp_175()
{
	signalvalue1 = getSignal(S4_SRR_RL_Clu_DynProp_175);
	write("S4_SRR_RL_Clu_DynProp_175 :%f",signalvalue1);
	write("i_S4_SRR_RL_Clu_DynProp_175 :%o",@ecu_Signals::i_S4_SRR_RL_Clu_DynProp_175);

	testStep("get expect variable value: ","i_S4_SRR_RL_Clu_DynProp_175 :%o",@ecu_Signals::i_S4_SRR_RL_Clu_DynProp_175);

	if(signalvalue1==@ecu_Signals::i_S4_SRR_RL_Clu_DynProp_175)
	{
	testStepPass("Pass","i_S4_SRR_RL_Clu_DynProp_175 :%f",signalvalue1);
	}
	else
	{
	testStepFail("Fail","i_S4_SRR_RL_Clu_DynProp_175 :%f",signalvalue1);
	}
}

testcase S4_SRR_RL_Clu_Mes_25_S4_SRR_RL_Clu_Locationvalid_175()
{
	signalvalue1 = getSignal(S4_SRR_RL_Clu_Locationvalid_175);
	write("S4_SRR_RL_Clu_Locationvalid_175 :%f",signalvalue1);
	write("i_S4_SRR_RL_Clu_Locationvalid_175 :%o",@ecu_Signals::i_S4_SRR_RL_Clu_Locationvalid_175);

	testStep("get expect variable value: ","i_S4_SRR_RL_Clu_Locationvalid_175 :%o",@ecu_Signals::i_S4_SRR_RL_Clu_Locationvalid_175);

	if(signalvalue1==@ecu_Signals::i_S4_SRR_RL_Clu_Locationvalid_175)
	{
	testStepPass("Pass","i_S4_SRR_RL_Clu_Locationvalid_175 :%f",signalvalue1);
	}
	else
	{
	testStepFail("Fail","i_S4_SRR_RL_Clu_Locationvalid_175 :%f",signalvalue1);
	}
}

testcase S4_SRR_RL_Clu_Mes_25_S4_SRR_RL_Clu_Theta_176()
{
	signalvalue1 = getSignal(S4_SRR_RL_Clu_Theta_176);
	write("S4_SRR_RL_Clu_Theta_176 :%f",signalvalue1);
	write("i_S4_SRR_RL_Clu_Theta_176 :%f",@ecu_Signals::i_S4_SRR_RL_Clu_Theta_176);

	testStep("get expect variable value: ","i_S4_SRR_RL_Clu_Theta_176 :%f",@ecu_Signals::i_S4_SRR_RL_Clu_Theta_176);

	if((abs(@ecu_Signals::i_S4_SRR_RL_Clu_Theta_176)*0.9<=abs(signalvalue1))&&(abs(signalvalue1)<=abs(@ecu_Signals::i_S4_SRR_RL_Clu_Theta_176)*1.1))
	{
	testStepPass("Pass","i_S4_SRR_RL_Clu_Theta_176 :%f",signalvalue1);
	}
	else
	{
	testStepFail("Fail","i_S4_SRR_RL_Clu_Theta_176 :%f",signalvalue1);
	}
}

testcase S4_SRR_RL_Clu_Mes_25_S4_SRR_RL_Clu_Dist_176()
{
	signalvalue1 = getSignal(S4_SRR_RL_Clu_Dist_176);
	write("S4_SRR_RL_Clu_Dist_176 :%f",signalvalue1);
	write("i_S4_SRR_RL_Clu_Dist_176 :%f",@ecu_Signals::i_S4_SRR_RL_Clu_Dist_176);

	testStep("get expect variable value: ","i_S4_SRR_RL_Clu_Dist_176 :%f",@ecu_Signals::i_S4_SRR_RL_Clu_Dist_176);

	if((abs(@ecu_Signals::i_S4_SRR_RL_Clu_Dist_176)*0.9<=abs(signalvalue1))&&(abs(signalvalue1)<=abs(@ecu_Signals::i_S4_SRR_RL_Clu_Dist_176)*1.1))
	{
	testStepPass("Pass","i_S4_SRR_RL_Clu_Dist_176 :%f",signalvalue1);
	}
	else
	{
	testStepFail("Fail","i_S4_SRR_RL_Clu_Dist_176 :%f",signalvalue1);
	}
}

testcase S4_SRR_RL_Clu_Mes_25_S4_SRR_RL_Clu_Vel_176()
{
	signalvalue1 = getSignal(S4_SRR_RL_Clu_Vel_176);
	write("S4_SRR_RL_Clu_Vel_176 :%f",signalvalue1);
	write("i_S4_SRR_RL_Clu_Vel_176 :%f",@ecu_Signals::i_S4_SRR_RL_Clu_Vel_176);

	testStep("get expect variable value: ","i_S4_SRR_RL_Clu_Vel_176 :%f",@ecu_Signals::i_S4_SRR_RL_Clu_Vel_176);

	if((abs(@ecu_Signals::i_S4_SRR_RL_Clu_Vel_176)*0.9<=abs(signalvalue1))&&(abs(signalvalue1)<=abs(@ecu_Signals::i_S4_SRR_RL_Clu_Vel_176)*1.1))
	{
	testStepPass("Pass","i_S4_SRR_RL_Clu_Vel_176 :%f",signalvalue1);
	}
	else
	{
	testStepFail("Fail","i_S4_SRR_RL_Clu_Vel_176 :%f",signalvalue1);
	}
}

testcase S4_SRR_RL_Clu_Mes_25_S4_SRR_RL_Clu_SNR_176()
{
	signalvalue1 = getSignal(S4_SRR_RL_Clu_SNR_176);
	write("S4_SRR_RL_Clu_SNR_176 :%f",signalvalue1);
	write("i_S4_SRR_RL_Clu_SNR_176 :%f",@ecu_Signals::i_S4_SRR_RL_Clu_SNR_176);

	testStep("get expect variable value: ","i_S4_SRR_RL_Clu_SNR_176 :%f",@ecu_Signals::i_S4_SRR_RL_Clu_SNR_176);

	if((abs(@ecu_Signals::i_S4_SRR_RL_Clu_SNR_176)*0.9<=abs(signalvalue1))&&(abs(signalvalue1)<=abs(@ecu_Signals::i_S4_SRR_RL_Clu_SNR_176)*1.1))
	{
	testStepPass("Pass","i_S4_SRR_RL_Clu_SNR_176 :%f",signalvalue1);
	}
	else
	{
	testStepFail("Fail","i_S4_SRR_RL_Clu_SNR_176 :%f",signalvalue1);
	}
}

testcase S4_SRR_RL_Clu_Mes_25_S4_SRR_RL_Clu_DynProp_176()
{
	signalvalue1 = getSignal(S4_SRR_RL_Clu_DynProp_176);
	write("S4_SRR_RL_Clu_DynProp_176 :%f",signalvalue1);
	write("i_S4_SRR_RL_Clu_DynProp_176 :%o",@ecu_Signals::i_S4_SRR_RL_Clu_DynProp_176);

	testStep("get expect variable value: ","i_S4_SRR_RL_Clu_DynProp_176 :%o",@ecu_Signals::i_S4_SRR_RL_Clu_DynProp_176);

	if(signalvalue1==@ecu_Signals::i_S4_SRR_RL_Clu_DynProp_176)
	{
	testStepPass("Pass","i_S4_SRR_RL_Clu_DynProp_176 :%f",signalvalue1);
	}
	else
	{
	testStepFail("Fail","i_S4_SRR_RL_Clu_DynProp_176 :%f",signalvalue1);
	}
}

testcase S4_SRR_RL_Clu_Mes_25_S4_SRR_RL_Clu_Locationvalid_176()
{
	signalvalue1 = getSignal(S4_SRR_RL_Clu_Locationvalid_176);
	write("S4_SRR_RL_Clu_Locationvalid_176 :%f",signalvalue1);
	write("i_S4_SRR_RL_Clu_Locationvalid_176 :%o",@ecu_Signals::i_S4_SRR_RL_Clu_Locationvalid_176);

	testStep("get expect variable value: ","i_S4_SRR_RL_Clu_Locationvalid_176 :%o",@ecu_Signals::i_S4_SRR_RL_Clu_Locationvalid_176);

	if(signalvalue1==@ecu_Signals::i_S4_SRR_RL_Clu_Locationvalid_176)
	{
	testStepPass("Pass","i_S4_SRR_RL_Clu_Locationvalid_176 :%f",signalvalue1);
	}
	else
	{
	testStepFail("Fail","i_S4_SRR_RL_Clu_Locationvalid_176 :%f",signalvalue1);
	}
}

testcase S4_SRR_RL_Clu_Mes_25_S4_SRR_RL_Clu_Theta_177()
{
	signalvalue1 = getSignal(S4_SRR_RL_Clu_Theta_177);
	write("S4_SRR_RL_Clu_Theta_177 :%f",signalvalue1);
	write("i_S4_SRR_RL_Clu_Theta_177 :%f",@ecu_Signals::i_S4_SRR_RL_Clu_Theta_177);

	testStep("get expect variable value: ","i_S4_SRR_RL_Clu_Theta_177 :%f",@ecu_Signals::i_S4_SRR_RL_Clu_Theta_177);

	if((abs(@ecu_Signals::i_S4_SRR_RL_Clu_Theta_177)*0.9<=abs(signalvalue1))&&(abs(signalvalue1)<=abs(@ecu_Signals::i_S4_SRR_RL_Clu_Theta_177)*1.1))
	{
	testStepPass("Pass","i_S4_SRR_RL_Clu_Theta_177 :%f",signalvalue1);
	}
	else
	{
	testStepFail("Fail","i_S4_SRR_RL_Clu_Theta_177 :%f",signalvalue1);
	}
}

testcase S4_SRR_RL_Clu_Mes_25_S4_SRR_RL_Clu_Dist_177()
{
	signalvalue1 = getSignal(S4_SRR_RL_Clu_Dist_177);
	write("S4_SRR_RL_Clu_Dist_177 :%f",signalvalue1);
	write("i_S4_SRR_RL_Clu_Dist_177 :%f",@ecu_Signals::i_S4_SRR_RL_Clu_Dist_177);

	testStep("get expect variable value: ","i_S4_SRR_RL_Clu_Dist_177 :%f",@ecu_Signals::i_S4_SRR_RL_Clu_Dist_177);

	if((abs(@ecu_Signals::i_S4_SRR_RL_Clu_Dist_177)*0.9<=abs(signalvalue1))&&(abs(signalvalue1)<=abs(@ecu_Signals::i_S4_SRR_RL_Clu_Dist_177)*1.1))
	{
	testStepPass("Pass","i_S4_SRR_RL_Clu_Dist_177 :%f",signalvalue1);
	}
	else
	{
	testStepFail("Fail","i_S4_SRR_RL_Clu_Dist_177 :%f",signalvalue1);
	}
}

testcase S4_SRR_RL_Clu_Mes_25_S4_SRR_RL_Clu_Vel_177()
{
	signalvalue1 = getSignal(S4_SRR_RL_Clu_Vel_177);
	write("S4_SRR_RL_Clu_Vel_177 :%f",signalvalue1);
	write("i_S4_SRR_RL_Clu_Vel_177 :%f",@ecu_Signals::i_S4_SRR_RL_Clu_Vel_177);

	testStep("get expect variable value: ","i_S4_SRR_RL_Clu_Vel_177 :%f",@ecu_Signals::i_S4_SRR_RL_Clu_Vel_177);

	if((abs(@ecu_Signals::i_S4_SRR_RL_Clu_Vel_177)*0.9<=abs(signalvalue1))&&(abs(signalvalue1)<=abs(@ecu_Signals::i_S4_SRR_RL_Clu_Vel_177)*1.1))
	{
	testStepPass("Pass","i_S4_SRR_RL_Clu_Vel_177 :%f",signalvalue1);
	}
	else
	{
	testStepFail("Fail","i_S4_SRR_RL_Clu_Vel_177 :%f",signalvalue1);
	}
}

testcase S4_SRR_RL_Clu_Mes_25_S4_SRR_RL_Clu_SNR_177()
{
	signalvalue1 = getSignal(S4_SRR_RL_Clu_SNR_177);
	write("S4_SRR_RL_Clu_SNR_177 :%f",signalvalue1);
	write("i_S4_SRR_RL_Clu_SNR_177 :%f",@ecu_Signals::i_S4_SRR_RL_Clu_SNR_177);

	testStep("get expect variable value: ","i_S4_SRR_RL_Clu_SNR_177 :%f",@ecu_Signals::i_S4_SRR_RL_Clu_SNR_177);

	if((abs(@ecu_Signals::i_S4_SRR_RL_Clu_SNR_177)*0.9<=abs(signalvalue1))&&(abs(signalvalue1)<=abs(@ecu_Signals::i_S4_SRR_RL_Clu_SNR_177)*1.1))
	{
	testStepPass("Pass","i_S4_SRR_RL_Clu_SNR_177 :%f",signalvalue1);
	}
	else
	{
	testStepFail("Fail","i_S4_SRR_RL_Clu_SNR_177 :%f",signalvalue1);
	}
}

testcase S4_SRR_RL_Clu_Mes_25_S4_SRR_RL_Clu_DynProp_177()
{
	signalvalue1 = getSignal(S4_SRR_RL_Clu_DynProp_177);
	write("S4_SRR_RL_Clu_DynProp_177 :%f",signalvalue1);
	write("i_S4_SRR_RL_Clu_DynProp_177 :%o",@ecu_Signals::i_S4_SRR_RL_Clu_DynProp_177);

	testStep("get expect variable value: ","i_S4_SRR_RL_Clu_DynProp_177 :%o",@ecu_Signals::i_S4_SRR_RL_Clu_DynProp_177);

	if(signalvalue1==@ecu_Signals::i_S4_SRR_RL_Clu_DynProp_177)
	{
	testStepPass("Pass","i_S4_SRR_RL_Clu_DynProp_177 :%f",signalvalue1);
	}
	else
	{
	testStepFail("Fail","i_S4_SRR_RL_Clu_DynProp_177 :%f",signalvalue1);
	}
}

testcase S4_SRR_RL_Clu_Mes_25_S4_SRR_RL_Clu_Locationvalid_177()
{
	signalvalue1 = getSignal(S4_SRR_RL_Clu_Locationvalid_177);
	write("S4_SRR_RL_Clu_Locationvalid_177 :%f",signalvalue1);
	write("i_S4_SRR_RL_Clu_Locationvalid_177 :%o",@ecu_Signals::i_S4_SRR_RL_Clu_Locationvalid_177);

	testStep("get expect variable value: ","i_S4_SRR_RL_Clu_Locationvalid_177 :%o",@ecu_Signals::i_S4_SRR_RL_Clu_Locationvalid_177);

	if(signalvalue1==@ecu_Signals::i_S4_SRR_RL_Clu_Locationvalid_177)
	{
	testStepPass("Pass","i_S4_SRR_RL_Clu_Locationvalid_177 :%f",signalvalue1);
	}
	else
	{
	testStepFail("Fail","i_S4_SRR_RL_Clu_Locationvalid_177 :%f",signalvalue1);
	}
}

testcase S4_SRR_RL_Clu_Mes_25_S4_SRR_RL_Clu_Theta_178()
{
	signalvalue1 = getSignal(S4_SRR_RL_Clu_Theta_178);
	write("S4_SRR_RL_Clu_Theta_178 :%f",signalvalue1);
	write("i_S4_SRR_RL_Clu_Theta_178 :%f",@ecu_Signals::i_S4_SRR_RL_Clu_Theta_178);

	testStep("get expect variable value: ","i_S4_SRR_RL_Clu_Theta_178 :%f",@ecu_Signals::i_S4_SRR_RL_Clu_Theta_178);

	if((abs(@ecu_Signals::i_S4_SRR_RL_Clu_Theta_178)*0.9<=abs(signalvalue1))&&(abs(signalvalue1)<=abs(@ecu_Signals::i_S4_SRR_RL_Clu_Theta_178)*1.1))
	{
	testStepPass("Pass","i_S4_SRR_RL_Clu_Theta_178 :%f",signalvalue1);
	}
	else
	{
	testStepFail("Fail","i_S4_SRR_RL_Clu_Theta_178 :%f",signalvalue1);
	}
}

testcase S4_SRR_RL_Clu_Mes_25_S4_SRR_RL_Clu_Dist_178()
{
	signalvalue1 = getSignal(S4_SRR_RL_Clu_Dist_178);
	write("S4_SRR_RL_Clu_Dist_178 :%f",signalvalue1);
	write("i_S4_SRR_RL_Clu_Dist_178 :%f",@ecu_Signals::i_S4_SRR_RL_Clu_Dist_178);

	testStep("get expect variable value: ","i_S4_SRR_RL_Clu_Dist_178 :%f",@ecu_Signals::i_S4_SRR_RL_Clu_Dist_178);

	if((abs(@ecu_Signals::i_S4_SRR_RL_Clu_Dist_178)*0.9<=abs(signalvalue1))&&(abs(signalvalue1)<=abs(@ecu_Signals::i_S4_SRR_RL_Clu_Dist_178)*1.1))
	{
	testStepPass("Pass","i_S4_SRR_RL_Clu_Dist_178 :%f",signalvalue1);
	}
	else
	{
	testStepFail("Fail","i_S4_SRR_RL_Clu_Dist_178 :%f",signalvalue1);
	}
}

testcase S4_SRR_RL_Clu_Mes_25_S4_SRR_RL_Clu_Vel_178()
{
	signalvalue1 = getSignal(S4_SRR_RL_Clu_Vel_178);
	write("S4_SRR_RL_Clu_Vel_178 :%f",signalvalue1);
	write("i_S4_SRR_RL_Clu_Vel_178 :%f",@ecu_Signals::i_S4_SRR_RL_Clu_Vel_178);

	testStep("get expect variable value: ","i_S4_SRR_RL_Clu_Vel_178 :%f",@ecu_Signals::i_S4_SRR_RL_Clu_Vel_178);

	if((abs(@ecu_Signals::i_S4_SRR_RL_Clu_Vel_178)*0.9<=abs(signalvalue1))&&(abs(signalvalue1)<=abs(@ecu_Signals::i_S4_SRR_RL_Clu_Vel_178)*1.1))
	{
	testStepPass("Pass","i_S4_SRR_RL_Clu_Vel_178 :%f",signalvalue1);
	}
	else
	{
	testStepFail("Fail","i_S4_SRR_RL_Clu_Vel_178 :%f",signalvalue1);
	}
}

testcase S4_SRR_RL_Clu_Mes_25_S4_SRR_RL_Clu_SNR_178()
{
	signalvalue1 = getSignal(S4_SRR_RL_Clu_SNR_178);
	write("S4_SRR_RL_Clu_SNR_178 :%f",signalvalue1);
	write("i_S4_SRR_RL_Clu_SNR_178 :%f",@ecu_Signals::i_S4_SRR_RL_Clu_SNR_178);

	testStep("get expect variable value: ","i_S4_SRR_RL_Clu_SNR_178 :%f",@ecu_Signals::i_S4_SRR_RL_Clu_SNR_178);

	if((abs(@ecu_Signals::i_S4_SRR_RL_Clu_SNR_178)*0.9<=abs(signalvalue1))&&(abs(signalvalue1)<=abs(@ecu_Signals::i_S4_SRR_RL_Clu_SNR_178)*1.1))
	{
	testStepPass("Pass","i_S4_SRR_RL_Clu_SNR_178 :%f",signalvalue1);
	}
	else
	{
	testStepFail("Fail","i_S4_SRR_RL_Clu_SNR_178 :%f",signalvalue1);
	}
}

testcase S4_SRR_RL_Clu_Mes_25_S4_SRR_RL_Clu_DynProp_178()
{
	signalvalue1 = getSignal(S4_SRR_RL_Clu_DynProp_178);
	write("S4_SRR_RL_Clu_DynProp_178 :%f",signalvalue1);
	write("i_S4_SRR_RL_Clu_DynProp_178 :%o",@ecu_Signals::i_S4_SRR_RL_Clu_DynProp_178);

	testStep("get expect variable value: ","i_S4_SRR_RL_Clu_DynProp_178 :%o",@ecu_Signals::i_S4_SRR_RL_Clu_DynProp_178);

	if(signalvalue1==@ecu_Signals::i_S4_SRR_RL_Clu_DynProp_178)
	{
	testStepPass("Pass","i_S4_SRR_RL_Clu_DynProp_178 :%f",signalvalue1);
	}
	else
	{
	testStepFail("Fail","i_S4_SRR_RL_Clu_DynProp_178 :%f",signalvalue1);
	}
}

testcase S4_SRR_RL_Clu_Mes_25_S4_SRR_RL_Clu_Locationvalid_178()
{
	signalvalue1 = getSignal(S4_SRR_RL_Clu_Locationvalid_178);
	write("S4_SRR_RL_Clu_Locationvalid_178 :%f",signalvalue1);
	write("i_S4_SRR_RL_Clu_Locationvalid_178 :%o",@ecu_Signals::i_S4_SRR_RL_Clu_Locationvalid_178);

	testStep("get expect variable value: ","i_S4_SRR_RL_Clu_Locationvalid_178 :%o",@ecu_Signals::i_S4_SRR_RL_Clu_Locationvalid_178);

	if(signalvalue1==@ecu_Signals::i_S4_SRR_RL_Clu_Locationvalid_178)
	{
	testStepPass("Pass","i_S4_SRR_RL_Clu_Locationvalid_178 :%f",signalvalue1);
	}
	else
	{
	testStepFail("Fail","i_S4_SRR_RL_Clu_Locationvalid_178 :%f",signalvalue1);
	}
}

testcase S4_SRR_RL_Clu_Mes_25_S4_SRR_RL_Clu_Theta_179()
{
	signalvalue1 = getSignal(S4_SRR_RL_Clu_Theta_179);
	write("S4_SRR_RL_Clu_Theta_179 :%f",signalvalue1);
	write("i_S4_SRR_RL_Clu_Theta_179 :%f",@ecu_Signals::i_S4_SRR_RL_Clu_Theta_179);

	testStep("get expect variable value: ","i_S4_SRR_RL_Clu_Theta_179 :%f",@ecu_Signals::i_S4_SRR_RL_Clu_Theta_179);

	if((abs(@ecu_Signals::i_S4_SRR_RL_Clu_Theta_179)*0.9<=abs(signalvalue1))&&(abs(signalvalue1)<=abs(@ecu_Signals::i_S4_SRR_RL_Clu_Theta_179)*1.1))
	{
	testStepPass("Pass","i_S4_SRR_RL_Clu_Theta_179 :%f",signalvalue1);
	}
	else
	{
	testStepFail("Fail","i_S4_SRR_RL_Clu_Theta_179 :%f",signalvalue1);
	}
}

testcase S4_SRR_RL_Clu_Mes_25_S4_SRR_RL_Clu_Dist_179()
{
	signalvalue1 = getSignal(S4_SRR_RL_Clu_Dist_179);
	write("S4_SRR_RL_Clu_Dist_179 :%f",signalvalue1);
	write("i_S4_SRR_RL_Clu_Dist_179 :%f",@ecu_Signals::i_S4_SRR_RL_Clu_Dist_179);

	testStep("get expect variable value: ","i_S4_SRR_RL_Clu_Dist_179 :%f",@ecu_Signals::i_S4_SRR_RL_Clu_Dist_179);

	if((abs(@ecu_Signals::i_S4_SRR_RL_Clu_Dist_179)*0.9<=abs(signalvalue1))&&(abs(signalvalue1)<=abs(@ecu_Signals::i_S4_SRR_RL_Clu_Dist_179)*1.1))
	{
	testStepPass("Pass","i_S4_SRR_RL_Clu_Dist_179 :%f",signalvalue1);
	}
	else
	{
	testStepFail("Fail","i_S4_SRR_RL_Clu_Dist_179 :%f",signalvalue1);
	}
}

testcase S4_SRR_RL_Clu_Mes_25_S4_SRR_RL_Clu_Vel_179()
{
	signalvalue1 = getSignal(S4_SRR_RL_Clu_Vel_179);
	write("S4_SRR_RL_Clu_Vel_179 :%f",signalvalue1);
	write("i_S4_SRR_RL_Clu_Vel_179 :%f",@ecu_Signals::i_S4_SRR_RL_Clu_Vel_179);

	testStep("get expect variable value: ","i_S4_SRR_RL_Clu_Vel_179 :%f",@ecu_Signals::i_S4_SRR_RL_Clu_Vel_179);

	if((abs(@ecu_Signals::i_S4_SRR_RL_Clu_Vel_179)*0.9<=abs(signalvalue1))&&(abs(signalvalue1)<=abs(@ecu_Signals::i_S4_SRR_RL_Clu_Vel_179)*1.1))
	{
	testStepPass("Pass","i_S4_SRR_RL_Clu_Vel_179 :%f",signalvalue1);
	}
	else
	{
	testStepFail("Fail","i_S4_SRR_RL_Clu_Vel_179 :%f",signalvalue1);
	}
}

testcase S4_SRR_RL_Clu_Mes_25_S4_SRR_RL_Clu_SNR_179()
{
	signalvalue1 = getSignal(S4_SRR_RL_Clu_SNR_179);
	write("S4_SRR_RL_Clu_SNR_179 :%f",signalvalue1);
	write("i_S4_SRR_RL_Clu_SNR_179 :%f",@ecu_Signals::i_S4_SRR_RL_Clu_SNR_179);

	testStep("get expect variable value: ","i_S4_SRR_RL_Clu_SNR_179 :%f",@ecu_Signals::i_S4_SRR_RL_Clu_SNR_179);

	if((abs(@ecu_Signals::i_S4_SRR_RL_Clu_SNR_179)*0.9<=abs(signalvalue1))&&(abs(signalvalue1)<=abs(@ecu_Signals::i_S4_SRR_RL_Clu_SNR_179)*1.1))
	{
	testStepPass("Pass","i_S4_SRR_RL_Clu_SNR_179 :%f",signalvalue1);
	}
	else
	{
	testStepFail("Fail","i_S4_SRR_RL_Clu_SNR_179 :%f",signalvalue1);
	}
}

testcase S4_SRR_RL_Clu_Mes_25_S4_SRR_RL_Clu_DynProp_179()
{
	signalvalue1 = getSignal(S4_SRR_RL_Clu_DynProp_179);
	write("S4_SRR_RL_Clu_DynProp_179 :%f",signalvalue1);
	write("i_S4_SRR_RL_Clu_DynProp_179 :%o",@ecu_Signals::i_S4_SRR_RL_Clu_DynProp_179);

	testStep("get expect variable value: ","i_S4_SRR_RL_Clu_DynProp_179 :%o",@ecu_Signals::i_S4_SRR_RL_Clu_DynProp_179);

	if(signalvalue1==@ecu_Signals::i_S4_SRR_RL_Clu_DynProp_179)
	{
	testStepPass("Pass","i_S4_SRR_RL_Clu_DynProp_179 :%f",signalvalue1);
	}
	else
	{
	testStepFail("Fail","i_S4_SRR_RL_Clu_DynProp_179 :%f",signalvalue1);
	}
}

testcase S4_SRR_RL_Clu_Mes_25_S4_SRR_RL_Clu_Locationvalid_179()
{
	signalvalue1 = getSignal(S4_SRR_RL_Clu_Locationvalid_179);
	write("S4_SRR_RL_Clu_Locationvalid_179 :%f",signalvalue1);
	write("i_S4_SRR_RL_Clu_Locationvalid_179 :%o",@ecu_Signals::i_S4_SRR_RL_Clu_Locationvalid_179);

	testStep("get expect variable value: ","i_S4_SRR_RL_Clu_Locationvalid_179 :%o",@ecu_Signals::i_S4_SRR_RL_Clu_Locationvalid_179);

	if(signalvalue1==@ecu_Signals::i_S4_SRR_RL_Clu_Locationvalid_179)
	{
	testStepPass("Pass","i_S4_SRR_RL_Clu_Locationvalid_179 :%f",signalvalue1);
	}
	else
	{
	testStepFail("Fail","i_S4_SRR_RL_Clu_Locationvalid_179 :%f",signalvalue1);
	}
}

testcase S4_SRR_RL_Clu_Mes_25_S4_SRR_RL_Clu_Theta_180()
{
	signalvalue1 = getSignal(S4_SRR_RL_Clu_Theta_180);
	write("S4_SRR_RL_Clu_Theta_180 :%f",signalvalue1);
	write("i_S4_SRR_RL_Clu_Theta_180 :%f",@ecu_Signals::i_S4_SRR_RL_Clu_Theta_180);

	testStep("get expect variable value: ","i_S4_SRR_RL_Clu_Theta_180 :%f",@ecu_Signals::i_S4_SRR_RL_Clu_Theta_180);

	if((abs(@ecu_Signals::i_S4_SRR_RL_Clu_Theta_180)*0.9<=abs(signalvalue1))&&(abs(signalvalue1)<=abs(@ecu_Signals::i_S4_SRR_RL_Clu_Theta_180)*1.1))
	{
	testStepPass("Pass","i_S4_SRR_RL_Clu_Theta_180 :%f",signalvalue1);
	}
	else
	{
	testStepFail("Fail","i_S4_SRR_RL_Clu_Theta_180 :%f",signalvalue1);
	}
}

testcase S4_SRR_RL_Clu_Mes_25_S4_SRR_RL_Clu_Dist_180()
{
	signalvalue1 = getSignal(S4_SRR_RL_Clu_Dist_180);
	write("S4_SRR_RL_Clu_Dist_180 :%f",signalvalue1);
	write("i_S4_SRR_RL_Clu_Dist_180 :%f",@ecu_Signals::i_S4_SRR_RL_Clu_Dist_180);

	testStep("get expect variable value: ","i_S4_SRR_RL_Clu_Dist_180 :%f",@ecu_Signals::i_S4_SRR_RL_Clu_Dist_180);

	if((abs(@ecu_Signals::i_S4_SRR_RL_Clu_Dist_180)*0.9<=abs(signalvalue1))&&(abs(signalvalue1)<=abs(@ecu_Signals::i_S4_SRR_RL_Clu_Dist_180)*1.1))
	{
	testStepPass("Pass","i_S4_SRR_RL_Clu_Dist_180 :%f",signalvalue1);
	}
	else
	{
	testStepFail("Fail","i_S4_SRR_RL_Clu_Dist_180 :%f",signalvalue1);
	}
}

testcase S4_SRR_RL_Clu_Mes_25_S4_SRR_RL_Clu_Vel_180()
{
	signalvalue1 = getSignal(S4_SRR_RL_Clu_Vel_180);
	write("S4_SRR_RL_Clu_Vel_180 :%f",signalvalue1);
	write("i_S4_SRR_RL_Clu_Vel_180 :%f",@ecu_Signals::i_S4_SRR_RL_Clu_Vel_180);

	testStep("get expect variable value: ","i_S4_SRR_RL_Clu_Vel_180 :%f",@ecu_Signals::i_S4_SRR_RL_Clu_Vel_180);

	if((abs(@ecu_Signals::i_S4_SRR_RL_Clu_Vel_180)*0.9<=abs(signalvalue1))&&(abs(signalvalue1)<=abs(@ecu_Signals::i_S4_SRR_RL_Clu_Vel_180)*1.1))
	{
	testStepPass("Pass","i_S4_SRR_RL_Clu_Vel_180 :%f",signalvalue1);
	}
	else
	{
	testStepFail("Fail","i_S4_SRR_RL_Clu_Vel_180 :%f",signalvalue1);
	}
}

testcase S4_SRR_RL_Clu_Mes_25_S4_SRR_RL_Clu_SNR_180()
{
	signalvalue1 = getSignal(S4_SRR_RL_Clu_SNR_180);
	write("S4_SRR_RL_Clu_SNR_180 :%f",signalvalue1);
	write("i_S4_SRR_RL_Clu_SNR_180 :%f",@ecu_Signals::i_S4_SRR_RL_Clu_SNR_180);

	testStep("get expect variable value: ","i_S4_SRR_RL_Clu_SNR_180 :%f",@ecu_Signals::i_S4_SRR_RL_Clu_SNR_180);

	if((abs(@ecu_Signals::i_S4_SRR_RL_Clu_SNR_180)*0.9<=abs(signalvalue1))&&(abs(signalvalue1)<=abs(@ecu_Signals::i_S4_SRR_RL_Clu_SNR_180)*1.1))
	{
	testStepPass("Pass","i_S4_SRR_RL_Clu_SNR_180 :%f",signalvalue1);
	}
	else
	{
	testStepFail("Fail","i_S4_SRR_RL_Clu_SNR_180 :%f",signalvalue1);
	}
}

testcase S4_SRR_RL_Clu_Mes_25_S4_SRR_RL_Clu_DynProp_180()
{
	signalvalue1 = getSignal(S4_SRR_RL_Clu_DynProp_180);
	write("S4_SRR_RL_Clu_DynProp_180 :%f",signalvalue1);
	write("i_S4_SRR_RL_Clu_DynProp_180 :%o",@ecu_Signals::i_S4_SRR_RL_Clu_DynProp_180);

	testStep("get expect variable value: ","i_S4_SRR_RL_Clu_DynProp_180 :%o",@ecu_Signals::i_S4_SRR_RL_Clu_DynProp_180);

	if(signalvalue1==@ecu_Signals::i_S4_SRR_RL_Clu_DynProp_180)
	{
	testStepPass("Pass","i_S4_SRR_RL_Clu_DynProp_180 :%f",signalvalue1);
	}
	else
	{
	testStepFail("Fail","i_S4_SRR_RL_Clu_DynProp_180 :%f",signalvalue1);
	}
}

testcase S4_SRR_RL_Clu_Mes_25_S4_SRR_RL_Clu_Locationvalid_180()
{
	signalvalue1 = getSignal(S4_SRR_RL_Clu_Locationvalid_180);
	write("S4_SRR_RL_Clu_Locationvalid_180 :%f",signalvalue1);
	write("i_S4_SRR_RL_Clu_Locationvalid_180 :%o",@ecu_Signals::i_S4_SRR_RL_Clu_Locationvalid_180);

	testStep("get expect variable value: ","i_S4_SRR_RL_Clu_Locationvalid_180 :%o",@ecu_Signals::i_S4_SRR_RL_Clu_Locationvalid_180);

	if(signalvalue1==@ecu_Signals::i_S4_SRR_RL_Clu_Locationvalid_180)
	{
	testStepPass("Pass","i_S4_SRR_RL_Clu_Locationvalid_180 :%f",signalvalue1);
	}
	else
	{
	testStepFail("Fail","i_S4_SRR_RL_Clu_Locationvalid_180 :%f",signalvalue1);
	}
}

testcase S4_SRR_RL_Clu_Mes_25_S4_SRR_RL_Clu_Theta_181()
{
	signalvalue1 = getSignal(S4_SRR_RL_Clu_Theta_181);
	write("S4_SRR_RL_Clu_Theta_181 :%f",signalvalue1);
	write("i_S4_SRR_RL_Clu_Theta_181 :%f",@ecu_Signals::i_S4_SRR_RL_Clu_Theta_181);

	testStep("get expect variable value: ","i_S4_SRR_RL_Clu_Theta_181 :%f",@ecu_Signals::i_S4_SRR_RL_Clu_Theta_181);

	if((abs(@ecu_Signals::i_S4_SRR_RL_Clu_Theta_181)*0.9<=abs(signalvalue1))&&(abs(signalvalue1)<=abs(@ecu_Signals::i_S4_SRR_RL_Clu_Theta_181)*1.1))
	{
	testStepPass("Pass","i_S4_SRR_RL_Clu_Theta_181 :%f",signalvalue1);
	}
	else
	{
	testStepFail("Fail","i_S4_SRR_RL_Clu_Theta_181 :%f",signalvalue1);
	}
}

testcase S4_SRR_RL_Clu_Mes_25_S4_SRR_RL_Clu_Dist_181()
{
	signalvalue1 = getSignal(S4_SRR_RL_Clu_Dist_181);
	write("S4_SRR_RL_Clu_Dist_181 :%f",signalvalue1);
	write("i_S4_SRR_RL_Clu_Dist_181 :%f",@ecu_Signals::i_S4_SRR_RL_Clu_Dist_181);

	testStep("get expect variable value: ","i_S4_SRR_RL_Clu_Dist_181 :%f",@ecu_Signals::i_S4_SRR_RL_Clu_Dist_181);

	if((abs(@ecu_Signals::i_S4_SRR_RL_Clu_Dist_181)*0.9<=abs(signalvalue1))&&(abs(signalvalue1)<=abs(@ecu_Signals::i_S4_SRR_RL_Clu_Dist_181)*1.1))
	{
	testStepPass("Pass","i_S4_SRR_RL_Clu_Dist_181 :%f",signalvalue1);
	}
	else
	{
	testStepFail("Fail","i_S4_SRR_RL_Clu_Dist_181 :%f",signalvalue1);
	}
}

testcase S4_SRR_RL_Clu_Mes_25_S4_SRR_RL_Clu_Vel_181()
{
	signalvalue1 = getSignal(S4_SRR_RL_Clu_Vel_181);
	write("S4_SRR_RL_Clu_Vel_181 :%f",signalvalue1);
	write("i_S4_SRR_RL_Clu_Vel_181 :%f",@ecu_Signals::i_S4_SRR_RL_Clu_Vel_181);

	testStep("get expect variable value: ","i_S4_SRR_RL_Clu_Vel_181 :%f",@ecu_Signals::i_S4_SRR_RL_Clu_Vel_181);

	if((abs(@ecu_Signals::i_S4_SRR_RL_Clu_Vel_181)*0.9<=abs(signalvalue1))&&(abs(signalvalue1)<=abs(@ecu_Signals::i_S4_SRR_RL_Clu_Vel_181)*1.1))
	{
	testStepPass("Pass","i_S4_SRR_RL_Clu_Vel_181 :%f",signalvalue1);
	}
	else
	{
	testStepFail("Fail","i_S4_SRR_RL_Clu_Vel_181 :%f",signalvalue1);
	}
}

testcase S4_SRR_RL_Clu_Mes_25_S4_SRR_RL_Clu_SNR_181()
{
	signalvalue1 = getSignal(S4_SRR_RL_Clu_SNR_181);
	write("S4_SRR_RL_Clu_SNR_181 :%f",signalvalue1);
	write("i_S4_SRR_RL_Clu_SNR_181 :%f",@ecu_Signals::i_S4_SRR_RL_Clu_SNR_181);

	testStep("get expect variable value: ","i_S4_SRR_RL_Clu_SNR_181 :%f",@ecu_Signals::i_S4_SRR_RL_Clu_SNR_181);

	if((abs(@ecu_Signals::i_S4_SRR_RL_Clu_SNR_181)*0.9<=abs(signalvalue1))&&(abs(signalvalue1)<=abs(@ecu_Signals::i_S4_SRR_RL_Clu_SNR_181)*1.1))
	{
	testStepPass("Pass","i_S4_SRR_RL_Clu_SNR_181 :%f",signalvalue1);
	}
	else
	{
	testStepFail("Fail","i_S4_SRR_RL_Clu_SNR_181 :%f",signalvalue1);
	}
}

testcase S4_SRR_RL_Clu_Mes_25_S4_SRR_RL_Clu_DynProp_181()
{
	signalvalue1 = getSignal(S4_SRR_RL_Clu_DynProp_181);
	write("S4_SRR_RL_Clu_DynProp_181 :%f",signalvalue1);
	write("i_S4_SRR_RL_Clu_DynProp_181 :%o",@ecu_Signals::i_S4_SRR_RL_Clu_DynProp_181);

	testStep("get expect variable value: ","i_S4_SRR_RL_Clu_DynProp_181 :%o",@ecu_Signals::i_S4_SRR_RL_Clu_DynProp_181);

	if(signalvalue1==@ecu_Signals::i_S4_SRR_RL_Clu_DynProp_181)
	{
	testStepPass("Pass","i_S4_SRR_RL_Clu_DynProp_181 :%f",signalvalue1);
	}
	else
	{
	testStepFail("Fail","i_S4_SRR_RL_Clu_DynProp_181 :%f",signalvalue1);
	}
}

testcase S4_SRR_RL_Clu_Mes_25_S4_SRR_RL_Clu_Locationvalid_181()
{
	signalvalue1 = getSignal(S4_SRR_RL_Clu_Locationvalid_181);
	write("S4_SRR_RL_Clu_Locationvalid_181 :%f",signalvalue1);
	write("i_S4_SRR_RL_Clu_Locationvalid_181 :%o",@ecu_Signals::i_S4_SRR_RL_Clu_Locationvalid_181);

	testStep("get expect variable value: ","i_S4_SRR_RL_Clu_Locationvalid_181 :%o",@ecu_Signals::i_S4_SRR_RL_Clu_Locationvalid_181);

	if(signalvalue1==@ecu_Signals::i_S4_SRR_RL_Clu_Locationvalid_181)
	{
	testStepPass("Pass","i_S4_SRR_RL_Clu_Locationvalid_181 :%f",signalvalue1);
	}
	else
	{
	testStepFail("Fail","i_S4_SRR_RL_Clu_Locationvalid_181 :%f",signalvalue1);
	}
}

testcase S4_SRR_RL_Clu_Mes_26_S4_SRR_RL_Clu_Theta_182()
{
	signalvalue1 = getSignal(S4_SRR_RL_Clu_Theta_182);
	write("S4_SRR_RL_Clu_Theta_182 :%f",signalvalue1);
	write("i_S4_SRR_RL_Clu_Theta_182 :%f",@ecu_Signals::i_S4_SRR_RL_Clu_Theta_182);

	testStep("get expect variable value: ","i_S4_SRR_RL_Clu_Theta_182 :%f",@ecu_Signals::i_S4_SRR_RL_Clu_Theta_182);

	if((abs(@ecu_Signals::i_S4_SRR_RL_Clu_Theta_182)*0.9<=abs(signalvalue1))&&(abs(signalvalue1)<=abs(@ecu_Signals::i_S4_SRR_RL_Clu_Theta_182)*1.1))
	{
	testStepPass("Pass","i_S4_SRR_RL_Clu_Theta_182 :%f",signalvalue1);
	}
	else
	{
	testStepFail("Fail","i_S4_SRR_RL_Clu_Theta_182 :%f",signalvalue1);
	}
}

testcase S4_SRR_RL_Clu_Mes_26_S4_SRR_RL_Clu_Dist_182()
{
	signalvalue1 = getSignal(S4_SRR_RL_Clu_Dist_182);
	write("S4_SRR_RL_Clu_Dist_182 :%f",signalvalue1);
	write("i_S4_SRR_RL_Clu_Dist_182 :%f",@ecu_Signals::i_S4_SRR_RL_Clu_Dist_182);

	testStep("get expect variable value: ","i_S4_SRR_RL_Clu_Dist_182 :%f",@ecu_Signals::i_S4_SRR_RL_Clu_Dist_182);

	if((abs(@ecu_Signals::i_S4_SRR_RL_Clu_Dist_182)*0.9<=abs(signalvalue1))&&(abs(signalvalue1)<=abs(@ecu_Signals::i_S4_SRR_RL_Clu_Dist_182)*1.1))
	{
	testStepPass("Pass","i_S4_SRR_RL_Clu_Dist_182 :%f",signalvalue1);
	}
	else
	{
	testStepFail("Fail","i_S4_SRR_RL_Clu_Dist_182 :%f",signalvalue1);
	}
}

testcase S4_SRR_RL_Clu_Mes_26_S4_SRR_RL_Clu_Vel_182()
{
	signalvalue1 = getSignal(S4_SRR_RL_Clu_Vel_182);
	write("S4_SRR_RL_Clu_Vel_182 :%f",signalvalue1);
	write("i_S4_SRR_RL_Clu_Vel_182 :%f",@ecu_Signals::i_S4_SRR_RL_Clu_Vel_182);

	testStep("get expect variable value: ","i_S4_SRR_RL_Clu_Vel_182 :%f",@ecu_Signals::i_S4_SRR_RL_Clu_Vel_182);

	if((abs(@ecu_Signals::i_S4_SRR_RL_Clu_Vel_182)*0.9<=abs(signalvalue1))&&(abs(signalvalue1)<=abs(@ecu_Signals::i_S4_SRR_RL_Clu_Vel_182)*1.1))
	{
	testStepPass("Pass","i_S4_SRR_RL_Clu_Vel_182 :%f",signalvalue1);
	}
	else
	{
	testStepFail("Fail","i_S4_SRR_RL_Clu_Vel_182 :%f",signalvalue1);
	}
}

testcase S4_SRR_RL_Clu_Mes_26_S4_SRR_RL_Clu_SNR_182()
{
	signalvalue1 = getSignal(S4_SRR_RL_Clu_SNR_182);
	write("S4_SRR_RL_Clu_SNR_182 :%f",signalvalue1);
	write("i_S4_SRR_RL_Clu_SNR_182 :%f",@ecu_Signals::i_S4_SRR_RL_Clu_SNR_182);

	testStep("get expect variable value: ","i_S4_SRR_RL_Clu_SNR_182 :%f",@ecu_Signals::i_S4_SRR_RL_Clu_SNR_182);

	if((abs(@ecu_Signals::i_S4_SRR_RL_Clu_SNR_182)*0.9<=abs(signalvalue1))&&(abs(signalvalue1)<=abs(@ecu_Signals::i_S4_SRR_RL_Clu_SNR_182)*1.1))
	{
	testStepPass("Pass","i_S4_SRR_RL_Clu_SNR_182 :%f",signalvalue1);
	}
	else
	{
	testStepFail("Fail","i_S4_SRR_RL_Clu_SNR_182 :%f",signalvalue1);
	}
}

testcase S4_SRR_RL_Clu_Mes_26_S4_SRR_RL_Clu_DynProp_182()
{
	signalvalue1 = getSignal(S4_SRR_RL_Clu_DynProp_182);
	write("S4_SRR_RL_Clu_DynProp_182 :%f",signalvalue1);
	write("i_S4_SRR_RL_Clu_DynProp_182 :%o",@ecu_Signals::i_S4_SRR_RL_Clu_DynProp_182);

	testStep("get expect variable value: ","i_S4_SRR_RL_Clu_DynProp_182 :%o",@ecu_Signals::i_S4_SRR_RL_Clu_DynProp_182);

	if(signalvalue1==@ecu_Signals::i_S4_SRR_RL_Clu_DynProp_182)
	{
	testStepPass("Pass","i_S4_SRR_RL_Clu_DynProp_182 :%f",signalvalue1);
	}
	else
	{
	testStepFail("Fail","i_S4_SRR_RL_Clu_DynProp_182 :%f",signalvalue1);
	}
}

testcase S4_SRR_RL_Clu_Mes_26_S4_SRR_RL_Clu_Locationvalid_182()
{
	signalvalue1 = getSignal(S4_SRR_RL_Clu_Locationvalid_182);
	write("S4_SRR_RL_Clu_Locationvalid_182 :%f",signalvalue1);
	write("i_S4_SRR_RL_Clu_Locationvalid_182 :%o",@ecu_Signals::i_S4_SRR_RL_Clu_Locationvalid_182);

	testStep("get expect variable value: ","i_S4_SRR_RL_Clu_Locationvalid_182 :%o",@ecu_Signals::i_S4_SRR_RL_Clu_Locationvalid_182);

	if(signalvalue1==@ecu_Signals::i_S4_SRR_RL_Clu_Locationvalid_182)
	{
	testStepPass("Pass","i_S4_SRR_RL_Clu_Locationvalid_182 :%f",signalvalue1);
	}
	else
	{
	testStepFail("Fail","i_S4_SRR_RL_Clu_Locationvalid_182 :%f",signalvalue1);
	}
}

testcase S4_SRR_RL_Clu_Mes_26_S4_SRR_RL_Clu_Theta_183()
{
	signalvalue1 = getSignal(S4_SRR_RL_Clu_Theta_183);
	write("S4_SRR_RL_Clu_Theta_183 :%f",signalvalue1);
	write("i_S4_SRR_RL_Clu_Theta_183 :%f",@ecu_Signals::i_S4_SRR_RL_Clu_Theta_183);

	testStep("get expect variable value: ","i_S4_SRR_RL_Clu_Theta_183 :%f",@ecu_Signals::i_S4_SRR_RL_Clu_Theta_183);

	if((abs(@ecu_Signals::i_S4_SRR_RL_Clu_Theta_183)*0.9<=abs(signalvalue1))&&(abs(signalvalue1)<=abs(@ecu_Signals::i_S4_SRR_RL_Clu_Theta_183)*1.1))
	{
	testStepPass("Pass","i_S4_SRR_RL_Clu_Theta_183 :%f",signalvalue1);
	}
	else
	{
	testStepFail("Fail","i_S4_SRR_RL_Clu_Theta_183 :%f",signalvalue1);
	}
}

testcase S4_SRR_RL_Clu_Mes_26_S4_SRR_RL_Clu_Dist_183()
{
	signalvalue1 = getSignal(S4_SRR_RL_Clu_Dist_183);
	write("S4_SRR_RL_Clu_Dist_183 :%f",signalvalue1);
	write("i_S4_SRR_RL_Clu_Dist_183 :%f",@ecu_Signals::i_S4_SRR_RL_Clu_Dist_183);

	testStep("get expect variable value: ","i_S4_SRR_RL_Clu_Dist_183 :%f",@ecu_Signals::i_S4_SRR_RL_Clu_Dist_183);

	if((abs(@ecu_Signals::i_S4_SRR_RL_Clu_Dist_183)*0.9<=abs(signalvalue1))&&(abs(signalvalue1)<=abs(@ecu_Signals::i_S4_SRR_RL_Clu_Dist_183)*1.1))
	{
	testStepPass("Pass","i_S4_SRR_RL_Clu_Dist_183 :%f",signalvalue1);
	}
	else
	{
	testStepFail("Fail","i_S4_SRR_RL_Clu_Dist_183 :%f",signalvalue1);
	}
}

testcase S4_SRR_RL_Clu_Mes_26_S4_SRR_RL_Clu_Vel_183()
{
	signalvalue1 = getSignal(S4_SRR_RL_Clu_Vel_183);
	write("S4_SRR_RL_Clu_Vel_183 :%f",signalvalue1);
	write("i_S4_SRR_RL_Clu_Vel_183 :%f",@ecu_Signals::i_S4_SRR_RL_Clu_Vel_183);

	testStep("get expect variable value: ","i_S4_SRR_RL_Clu_Vel_183 :%f",@ecu_Signals::i_S4_SRR_RL_Clu_Vel_183);

	if((abs(@ecu_Signals::i_S4_SRR_RL_Clu_Vel_183)*0.9<=abs(signalvalue1))&&(abs(signalvalue1)<=abs(@ecu_Signals::i_S4_SRR_RL_Clu_Vel_183)*1.1))
	{
	testStepPass("Pass","i_S4_SRR_RL_Clu_Vel_183 :%f",signalvalue1);
	}
	else
	{
	testStepFail("Fail","i_S4_SRR_RL_Clu_Vel_183 :%f",signalvalue1);
	}
}

testcase S4_SRR_RL_Clu_Mes_26_S4_SRR_RL_Clu_SNR_183()
{
	signalvalue1 = getSignal(S4_SRR_RL_Clu_SNR_183);
	write("S4_SRR_RL_Clu_SNR_183 :%f",signalvalue1);
	write("i_S4_SRR_RL_Clu_SNR_183 :%f",@ecu_Signals::i_S4_SRR_RL_Clu_SNR_183);

	testStep("get expect variable value: ","i_S4_SRR_RL_Clu_SNR_183 :%f",@ecu_Signals::i_S4_SRR_RL_Clu_SNR_183);

	if((abs(@ecu_Signals::i_S4_SRR_RL_Clu_SNR_183)*0.9<=abs(signalvalue1))&&(abs(signalvalue1)<=abs(@ecu_Signals::i_S4_SRR_RL_Clu_SNR_183)*1.1))
	{
	testStepPass("Pass","i_S4_SRR_RL_Clu_SNR_183 :%f",signalvalue1);
	}
	else
	{
	testStepFail("Fail","i_S4_SRR_RL_Clu_SNR_183 :%f",signalvalue1);
	}
}

testcase S4_SRR_RL_Clu_Mes_26_S4_SRR_RL_Clu_DynProp_183()
{
	signalvalue1 = getSignal(S4_SRR_RL_Clu_DynProp_183);
	write("S4_SRR_RL_Clu_DynProp_183 :%f",signalvalue1);
	write("i_S4_SRR_RL_Clu_DynProp_183 :%o",@ecu_Signals::i_S4_SRR_RL_Clu_DynProp_183);

	testStep("get expect variable value: ","i_S4_SRR_RL_Clu_DynProp_183 :%o",@ecu_Signals::i_S4_SRR_RL_Clu_DynProp_183);

	if(signalvalue1==@ecu_Signals::i_S4_SRR_RL_Clu_DynProp_183)
	{
	testStepPass("Pass","i_S4_SRR_RL_Clu_DynProp_183 :%f",signalvalue1);
	}
	else
	{
	testStepFail("Fail","i_S4_SRR_RL_Clu_DynProp_183 :%f",signalvalue1);
	}
}

testcase S4_SRR_RL_Clu_Mes_26_S4_SRR_RL_Clu_Locationvalid_183()
{
	signalvalue1 = getSignal(S4_SRR_RL_Clu_Locationvalid_183);
	write("S4_SRR_RL_Clu_Locationvalid_183 :%f",signalvalue1);
	write("i_S4_SRR_RL_Clu_Locationvalid_183 :%o",@ecu_Signals::i_S4_SRR_RL_Clu_Locationvalid_183);

	testStep("get expect variable value: ","i_S4_SRR_RL_Clu_Locationvalid_183 :%o",@ecu_Signals::i_S4_SRR_RL_Clu_Locationvalid_183);

	if(signalvalue1==@ecu_Signals::i_S4_SRR_RL_Clu_Locationvalid_183)
	{
	testStepPass("Pass","i_S4_SRR_RL_Clu_Locationvalid_183 :%f",signalvalue1);
	}
	else
	{
	testStepFail("Fail","i_S4_SRR_RL_Clu_Locationvalid_183 :%f",signalvalue1);
	}
}

testcase S4_SRR_RL_Clu_Mes_26_S4_SRR_RL_Clu_Theta_184()
{
	signalvalue1 = getSignal(S4_SRR_RL_Clu_Theta_184);
	write("S4_SRR_RL_Clu_Theta_184 :%f",signalvalue1);
	write("i_S4_SRR_RL_Clu_Theta_184 :%f",@ecu_Signals::i_S4_SRR_RL_Clu_Theta_184);

	testStep("get expect variable value: ","i_S4_SRR_RL_Clu_Theta_184 :%f",@ecu_Signals::i_S4_SRR_RL_Clu_Theta_184);

	if((abs(@ecu_Signals::i_S4_SRR_RL_Clu_Theta_184)*0.9<=abs(signalvalue1))&&(abs(signalvalue1)<=abs(@ecu_Signals::i_S4_SRR_RL_Clu_Theta_184)*1.1))
	{
	testStepPass("Pass","i_S4_SRR_RL_Clu_Theta_184 :%f",signalvalue1);
	}
	else
	{
	testStepFail("Fail","i_S4_SRR_RL_Clu_Theta_184 :%f",signalvalue1);
	}
}

testcase S4_SRR_RL_Clu_Mes_26_S4_SRR_RL_Clu_Dist_184()
{
	signalvalue1 = getSignal(S4_SRR_RL_Clu_Dist_184);
	write("S4_SRR_RL_Clu_Dist_184 :%f",signalvalue1);
	write("i_S4_SRR_RL_Clu_Dist_184 :%f",@ecu_Signals::i_S4_SRR_RL_Clu_Dist_184);

	testStep("get expect variable value: ","i_S4_SRR_RL_Clu_Dist_184 :%f",@ecu_Signals::i_S4_SRR_RL_Clu_Dist_184);

	if((abs(@ecu_Signals::i_S4_SRR_RL_Clu_Dist_184)*0.9<=abs(signalvalue1))&&(abs(signalvalue1)<=abs(@ecu_Signals::i_S4_SRR_RL_Clu_Dist_184)*1.1))
	{
	testStepPass("Pass","i_S4_SRR_RL_Clu_Dist_184 :%f",signalvalue1);
	}
	else
	{
	testStepFail("Fail","i_S4_SRR_RL_Clu_Dist_184 :%f",signalvalue1);
	}
}

testcase S4_SRR_RL_Clu_Mes_26_S4_SRR_RL_Clu_Vel_184()
{
	signalvalue1 = getSignal(S4_SRR_RL_Clu_Vel_184);
	write("S4_SRR_RL_Clu_Vel_184 :%f",signalvalue1);
	write("i_S4_SRR_RL_Clu_Vel_184 :%f",@ecu_Signals::i_S4_SRR_RL_Clu_Vel_184);

	testStep("get expect variable value: ","i_S4_SRR_RL_Clu_Vel_184 :%f",@ecu_Signals::i_S4_SRR_RL_Clu_Vel_184);

	if((abs(@ecu_Signals::i_S4_SRR_RL_Clu_Vel_184)*0.9<=abs(signalvalue1))&&(abs(signalvalue1)<=abs(@ecu_Signals::i_S4_SRR_RL_Clu_Vel_184)*1.1))
	{
	testStepPass("Pass","i_S4_SRR_RL_Clu_Vel_184 :%f",signalvalue1);
	}
	else
	{
	testStepFail("Fail","i_S4_SRR_RL_Clu_Vel_184 :%f",signalvalue1);
	}
}

testcase S4_SRR_RL_Clu_Mes_26_S4_SRR_RL_Clu_SNR_184()
{
	signalvalue1 = getSignal(S4_SRR_RL_Clu_SNR_184);
	write("S4_SRR_RL_Clu_SNR_184 :%f",signalvalue1);
	write("i_S4_SRR_RL_Clu_SNR_184 :%f",@ecu_Signals::i_S4_SRR_RL_Clu_SNR_184);

	testStep("get expect variable value: ","i_S4_SRR_RL_Clu_SNR_184 :%f",@ecu_Signals::i_S4_SRR_RL_Clu_SNR_184);

	if((abs(@ecu_Signals::i_S4_SRR_RL_Clu_SNR_184)*0.9<=abs(signalvalue1))&&(abs(signalvalue1)<=abs(@ecu_Signals::i_S4_SRR_RL_Clu_SNR_184)*1.1))
	{
	testStepPass("Pass","i_S4_SRR_RL_Clu_SNR_184 :%f",signalvalue1);
	}
	else
	{
	testStepFail("Fail","i_S4_SRR_RL_Clu_SNR_184 :%f",signalvalue1);
	}
}

testcase S4_SRR_RL_Clu_Mes_26_S4_SRR_RL_Clu_DynProp_184()
{
	signalvalue1 = getSignal(S4_SRR_RL_Clu_DynProp_184);
	write("S4_SRR_RL_Clu_DynProp_184 :%f",signalvalue1);
	write("i_S4_SRR_RL_Clu_DynProp_184 :%o",@ecu_Signals::i_S4_SRR_RL_Clu_DynProp_184);

	testStep("get expect variable value: ","i_S4_SRR_RL_Clu_DynProp_184 :%o",@ecu_Signals::i_S4_SRR_RL_Clu_DynProp_184);

	if(signalvalue1==@ecu_Signals::i_S4_SRR_RL_Clu_DynProp_184)
	{
	testStepPass("Pass","i_S4_SRR_RL_Clu_DynProp_184 :%f",signalvalue1);
	}
	else
	{
	testStepFail("Fail","i_S4_SRR_RL_Clu_DynProp_184 :%f",signalvalue1);
	}
}

testcase S4_SRR_RL_Clu_Mes_26_S4_SRR_RL_Clu_Locationvalid_184()
{
	signalvalue1 = getSignal(S4_SRR_RL_Clu_Locationvalid_184);
	write("S4_SRR_RL_Clu_Locationvalid_184 :%f",signalvalue1);
	write("i_S4_SRR_RL_Clu_Locationvalid_184 :%o",@ecu_Signals::i_S4_SRR_RL_Clu_Locationvalid_184);

	testStep("get expect variable value: ","i_S4_SRR_RL_Clu_Locationvalid_184 :%o",@ecu_Signals::i_S4_SRR_RL_Clu_Locationvalid_184);

	if(signalvalue1==@ecu_Signals::i_S4_SRR_RL_Clu_Locationvalid_184)
	{
	testStepPass("Pass","i_S4_SRR_RL_Clu_Locationvalid_184 :%f",signalvalue1);
	}
	else
	{
	testStepFail("Fail","i_S4_SRR_RL_Clu_Locationvalid_184 :%f",signalvalue1);
	}
}

testcase S4_SRR_RL_Clu_Mes_26_S4_SRR_RL_Clu_Theta_185()
{
	signalvalue1 = getSignal(S4_SRR_RL_Clu_Theta_185);
	write("S4_SRR_RL_Clu_Theta_185 :%f",signalvalue1);
	write("i_S4_SRR_RL_Clu_Theta_185 :%f",@ecu_Signals::i_S4_SRR_RL_Clu_Theta_185);

	testStep("get expect variable value: ","i_S4_SRR_RL_Clu_Theta_185 :%f",@ecu_Signals::i_S4_SRR_RL_Clu_Theta_185);

	if((abs(@ecu_Signals::i_S4_SRR_RL_Clu_Theta_185)*0.9<=abs(signalvalue1))&&(abs(signalvalue1)<=abs(@ecu_Signals::i_S4_SRR_RL_Clu_Theta_185)*1.1))
	{
	testStepPass("Pass","i_S4_SRR_RL_Clu_Theta_185 :%f",signalvalue1);
	}
	else
	{
	testStepFail("Fail","i_S4_SRR_RL_Clu_Theta_185 :%f",signalvalue1);
	}
}

testcase S4_SRR_RL_Clu_Mes_26_S4_SRR_RL_Clu_Dist_185()
{
	signalvalue1 = getSignal(S4_SRR_RL_Clu_Dist_185);
	write("S4_SRR_RL_Clu_Dist_185 :%f",signalvalue1);
	write("i_S4_SRR_RL_Clu_Dist_185 :%f",@ecu_Signals::i_S4_SRR_RL_Clu_Dist_185);

	testStep("get expect variable value: ","i_S4_SRR_RL_Clu_Dist_185 :%f",@ecu_Signals::i_S4_SRR_RL_Clu_Dist_185);

	if((abs(@ecu_Signals::i_S4_SRR_RL_Clu_Dist_185)*0.9<=abs(signalvalue1))&&(abs(signalvalue1)<=abs(@ecu_Signals::i_S4_SRR_RL_Clu_Dist_185)*1.1))
	{
	testStepPass("Pass","i_S4_SRR_RL_Clu_Dist_185 :%f",signalvalue1);
	}
	else
	{
	testStepFail("Fail","i_S4_SRR_RL_Clu_Dist_185 :%f",signalvalue1);
	}
}

testcase S4_SRR_RL_Clu_Mes_26_S4_SRR_RL_Clu_Vel_185()
{
	signalvalue1 = getSignal(S4_SRR_RL_Clu_Vel_185);
	write("S4_SRR_RL_Clu_Vel_185 :%f",signalvalue1);
	write("i_S4_SRR_RL_Clu_Vel_185 :%f",@ecu_Signals::i_S4_SRR_RL_Clu_Vel_185);

	testStep("get expect variable value: ","i_S4_SRR_RL_Clu_Vel_185 :%f",@ecu_Signals::i_S4_SRR_RL_Clu_Vel_185);

	if((abs(@ecu_Signals::i_S4_SRR_RL_Clu_Vel_185)*0.9<=abs(signalvalue1))&&(abs(signalvalue1)<=abs(@ecu_Signals::i_S4_SRR_RL_Clu_Vel_185)*1.1))
	{
	testStepPass("Pass","i_S4_SRR_RL_Clu_Vel_185 :%f",signalvalue1);
	}
	else
	{
	testStepFail("Fail","i_S4_SRR_RL_Clu_Vel_185 :%f",signalvalue1);
	}
}

testcase S4_SRR_RL_Clu_Mes_26_S4_SRR_RL_Clu_SNR_185()
{
	signalvalue1 = getSignal(S4_SRR_RL_Clu_SNR_185);
	write("S4_SRR_RL_Clu_SNR_185 :%f",signalvalue1);
	write("i_S4_SRR_RL_Clu_SNR_185 :%f",@ecu_Signals::i_S4_SRR_RL_Clu_SNR_185);

	testStep("get expect variable value: ","i_S4_SRR_RL_Clu_SNR_185 :%f",@ecu_Signals::i_S4_SRR_RL_Clu_SNR_185);

	if((abs(@ecu_Signals::i_S4_SRR_RL_Clu_SNR_185)*0.9<=abs(signalvalue1))&&(abs(signalvalue1)<=abs(@ecu_Signals::i_S4_SRR_RL_Clu_SNR_185)*1.1))
	{
	testStepPass("Pass","i_S4_SRR_RL_Clu_SNR_185 :%f",signalvalue1);
	}
	else
	{
	testStepFail("Fail","i_S4_SRR_RL_Clu_SNR_185 :%f",signalvalue1);
	}
}

testcase S4_SRR_RL_Clu_Mes_26_S4_SRR_RL_Clu_DynProp_185()
{
	signalvalue1 = getSignal(S4_SRR_RL_Clu_DynProp_185);
	write("S4_SRR_RL_Clu_DynProp_185 :%f",signalvalue1);
	write("i_S4_SRR_RL_Clu_DynProp_185 :%o",@ecu_Signals::i_S4_SRR_RL_Clu_DynProp_185);

	testStep("get expect variable value: ","i_S4_SRR_RL_Clu_DynProp_185 :%o",@ecu_Signals::i_S4_SRR_RL_Clu_DynProp_185);

	if(signalvalue1==@ecu_Signals::i_S4_SRR_RL_Clu_DynProp_185)
	{
	testStepPass("Pass","i_S4_SRR_RL_Clu_DynProp_185 :%f",signalvalue1);
	}
	else
	{
	testStepFail("Fail","i_S4_SRR_RL_Clu_DynProp_185 :%f",signalvalue1);
	}
}

testcase S4_SRR_RL_Clu_Mes_26_S4_SRR_RL_Clu_Locationvalid_185()
{
	signalvalue1 = getSignal(S4_SRR_RL_Clu_Locationvalid_185);
	write("S4_SRR_RL_Clu_Locationvalid_185 :%f",signalvalue1);
	write("i_S4_SRR_RL_Clu_Locationvalid_185 :%o",@ecu_Signals::i_S4_SRR_RL_Clu_Locationvalid_185);

	testStep("get expect variable value: ","i_S4_SRR_RL_Clu_Locationvalid_185 :%o",@ecu_Signals::i_S4_SRR_RL_Clu_Locationvalid_185);

	if(signalvalue1==@ecu_Signals::i_S4_SRR_RL_Clu_Locationvalid_185)
	{
	testStepPass("Pass","i_S4_SRR_RL_Clu_Locationvalid_185 :%f",signalvalue1);
	}
	else
	{
	testStepFail("Fail","i_S4_SRR_RL_Clu_Locationvalid_185 :%f",signalvalue1);
	}
}

testcase S4_SRR_RL_Clu_Mes_26_S4_SRR_RL_Clu_Theta_186()
{
	signalvalue1 = getSignal(S4_SRR_RL_Clu_Theta_186);
	write("S4_SRR_RL_Clu_Theta_186 :%f",signalvalue1);
	write("i_S4_SRR_RL_Clu_Theta_186 :%f",@ecu_Signals::i_S4_SRR_RL_Clu_Theta_186);

	testStep("get expect variable value: ","i_S4_SRR_RL_Clu_Theta_186 :%f",@ecu_Signals::i_S4_SRR_RL_Clu_Theta_186);

	if((abs(@ecu_Signals::i_S4_SRR_RL_Clu_Theta_186)*0.9<=abs(signalvalue1))&&(abs(signalvalue1)<=abs(@ecu_Signals::i_S4_SRR_RL_Clu_Theta_186)*1.1))
	{
	testStepPass("Pass","i_S4_SRR_RL_Clu_Theta_186 :%f",signalvalue1);
	}
	else
	{
	testStepFail("Fail","i_S4_SRR_RL_Clu_Theta_186 :%f",signalvalue1);
	}
}

testcase S4_SRR_RL_Clu_Mes_26_S4_SRR_RL_Clu_Dist_186()
{
	signalvalue1 = getSignal(S4_SRR_RL_Clu_Dist_186);
	write("S4_SRR_RL_Clu_Dist_186 :%f",signalvalue1);
	write("i_S4_SRR_RL_Clu_Dist_186 :%f",@ecu_Signals::i_S4_SRR_RL_Clu_Dist_186);

	testStep("get expect variable value: ","i_S4_SRR_RL_Clu_Dist_186 :%f",@ecu_Signals::i_S4_SRR_RL_Clu_Dist_186);

	if((abs(@ecu_Signals::i_S4_SRR_RL_Clu_Dist_186)*0.9<=abs(signalvalue1))&&(abs(signalvalue1)<=abs(@ecu_Signals::i_S4_SRR_RL_Clu_Dist_186)*1.1))
	{
	testStepPass("Pass","i_S4_SRR_RL_Clu_Dist_186 :%f",signalvalue1);
	}
	else
	{
	testStepFail("Fail","i_S4_SRR_RL_Clu_Dist_186 :%f",signalvalue1);
	}
}

testcase S4_SRR_RL_Clu_Mes_26_S4_SRR_RL_Clu_Vel_186()
{
	signalvalue1 = getSignal(S4_SRR_RL_Clu_Vel_186);
	write("S4_SRR_RL_Clu_Vel_186 :%f",signalvalue1);
	write("i_S4_SRR_RL_Clu_Vel_186 :%f",@ecu_Signals::i_S4_SRR_RL_Clu_Vel_186);

	testStep("get expect variable value: ","i_S4_SRR_RL_Clu_Vel_186 :%f",@ecu_Signals::i_S4_SRR_RL_Clu_Vel_186);

	if((abs(@ecu_Signals::i_S4_SRR_RL_Clu_Vel_186)*0.9<=abs(signalvalue1))&&(abs(signalvalue1)<=abs(@ecu_Signals::i_S4_SRR_RL_Clu_Vel_186)*1.1))
	{
	testStepPass("Pass","i_S4_SRR_RL_Clu_Vel_186 :%f",signalvalue1);
	}
	else
	{
	testStepFail("Fail","i_S4_SRR_RL_Clu_Vel_186 :%f",signalvalue1);
	}
}

testcase S4_SRR_RL_Clu_Mes_26_S4_SRR_RL_Clu_SNR_186()
{
	signalvalue1 = getSignal(S4_SRR_RL_Clu_SNR_186);
	write("S4_SRR_RL_Clu_SNR_186 :%f",signalvalue1);
	write("i_S4_SRR_RL_Clu_SNR_186 :%f",@ecu_Signals::i_S4_SRR_RL_Clu_SNR_186);

	testStep("get expect variable value: ","i_S4_SRR_RL_Clu_SNR_186 :%f",@ecu_Signals::i_S4_SRR_RL_Clu_SNR_186);

	if((abs(@ecu_Signals::i_S4_SRR_RL_Clu_SNR_186)*0.9<=abs(signalvalue1))&&(abs(signalvalue1)<=abs(@ecu_Signals::i_S4_SRR_RL_Clu_SNR_186)*1.1))
	{
	testStepPass("Pass","i_S4_SRR_RL_Clu_SNR_186 :%f",signalvalue1);
	}
	else
	{
	testStepFail("Fail","i_S4_SRR_RL_Clu_SNR_186 :%f",signalvalue1);
	}
}

testcase S4_SRR_RL_Clu_Mes_26_S4_SRR_RL_Clu_DynProp_186()
{
	signalvalue1 = getSignal(S4_SRR_RL_Clu_DynProp_186);
	write("S4_SRR_RL_Clu_DynProp_186 :%f",signalvalue1);
	write("i_S4_SRR_RL_Clu_DynProp_186 :%o",@ecu_Signals::i_S4_SRR_RL_Clu_DynProp_186);

	testStep("get expect variable value: ","i_S4_SRR_RL_Clu_DynProp_186 :%o",@ecu_Signals::i_S4_SRR_RL_Clu_DynProp_186);

	if(signalvalue1==@ecu_Signals::i_S4_SRR_RL_Clu_DynProp_186)
	{
	testStepPass("Pass","i_S4_SRR_RL_Clu_DynProp_186 :%f",signalvalue1);
	}
	else
	{
	testStepFail("Fail","i_S4_SRR_RL_Clu_DynProp_186 :%f",signalvalue1);
	}
}

testcase S4_SRR_RL_Clu_Mes_26_S4_SRR_RL_Clu_Locationvalid_186()
{
	signalvalue1 = getSignal(S4_SRR_RL_Clu_Locationvalid_186);
	write("S4_SRR_RL_Clu_Locationvalid_186 :%f",signalvalue1);
	write("i_S4_SRR_RL_Clu_Locationvalid_186 :%o",@ecu_Signals::i_S4_SRR_RL_Clu_Locationvalid_186);

	testStep("get expect variable value: ","i_S4_SRR_RL_Clu_Locationvalid_186 :%o",@ecu_Signals::i_S4_SRR_RL_Clu_Locationvalid_186);

	if(signalvalue1==@ecu_Signals::i_S4_SRR_RL_Clu_Locationvalid_186)
	{
	testStepPass("Pass","i_S4_SRR_RL_Clu_Locationvalid_186 :%f",signalvalue1);
	}
	else
	{
	testStepFail("Fail","i_S4_SRR_RL_Clu_Locationvalid_186 :%f",signalvalue1);
	}
}

testcase S4_SRR_RL_Clu_Mes_26_S4_SRR_RL_Clu_Theta_187()
{
	signalvalue1 = getSignal(S4_SRR_RL_Clu_Theta_187);
	write("S4_SRR_RL_Clu_Theta_187 :%f",signalvalue1);
	write("i_S4_SRR_RL_Clu_Theta_187 :%f",@ecu_Signals::i_S4_SRR_RL_Clu_Theta_187);

	testStep("get expect variable value: ","i_S4_SRR_RL_Clu_Theta_187 :%f",@ecu_Signals::i_S4_SRR_RL_Clu_Theta_187);

	if((abs(@ecu_Signals::i_S4_SRR_RL_Clu_Theta_187)*0.9<=abs(signalvalue1))&&(abs(signalvalue1)<=abs(@ecu_Signals::i_S4_SRR_RL_Clu_Theta_187)*1.1))
	{
	testStepPass("Pass","i_S4_SRR_RL_Clu_Theta_187 :%f",signalvalue1);
	}
	else
	{
	testStepFail("Fail","i_S4_SRR_RL_Clu_Theta_187 :%f",signalvalue1);
	}
}

testcase S4_SRR_RL_Clu_Mes_26_S4_SRR_RL_Clu_Dist_187()
{
	signalvalue1 = getSignal(S4_SRR_RL_Clu_Dist_187);
	write("S4_SRR_RL_Clu_Dist_187 :%f",signalvalue1);
	write("i_S4_SRR_RL_Clu_Dist_187 :%f",@ecu_Signals::i_S4_SRR_RL_Clu_Dist_187);

	testStep("get expect variable value: ","i_S4_SRR_RL_Clu_Dist_187 :%f",@ecu_Signals::i_S4_SRR_RL_Clu_Dist_187);

	if((abs(@ecu_Signals::i_S4_SRR_RL_Clu_Dist_187)*0.9<=abs(signalvalue1))&&(abs(signalvalue1)<=abs(@ecu_Signals::i_S4_SRR_RL_Clu_Dist_187)*1.1))
	{
	testStepPass("Pass","i_S4_SRR_RL_Clu_Dist_187 :%f",signalvalue1);
	}
	else
	{
	testStepFail("Fail","i_S4_SRR_RL_Clu_Dist_187 :%f",signalvalue1);
	}
}

testcase S4_SRR_RL_Clu_Mes_26_S4_SRR_RL_Clu_Vel_187()
{
	signalvalue1 = getSignal(S4_SRR_RL_Clu_Vel_187);
	write("S4_SRR_RL_Clu_Vel_187 :%f",signalvalue1);
	write("i_S4_SRR_RL_Clu_Vel_187 :%f",@ecu_Signals::i_S4_SRR_RL_Clu_Vel_187);

	testStep("get expect variable value: ","i_S4_SRR_RL_Clu_Vel_187 :%f",@ecu_Signals::i_S4_SRR_RL_Clu_Vel_187);

	if((abs(@ecu_Signals::i_S4_SRR_RL_Clu_Vel_187)*0.9<=abs(signalvalue1))&&(abs(signalvalue1)<=abs(@ecu_Signals::i_S4_SRR_RL_Clu_Vel_187)*1.1))
	{
	testStepPass("Pass","i_S4_SRR_RL_Clu_Vel_187 :%f",signalvalue1);
	}
	else
	{
	testStepFail("Fail","i_S4_SRR_RL_Clu_Vel_187 :%f",signalvalue1);
	}
}

testcase S4_SRR_RL_Clu_Mes_26_S4_SRR_RL_Clu_SNR_187()
{
	signalvalue1 = getSignal(S4_SRR_RL_Clu_SNR_187);
	write("S4_SRR_RL_Clu_SNR_187 :%f",signalvalue1);
	write("i_S4_SRR_RL_Clu_SNR_187 :%f",@ecu_Signals::i_S4_SRR_RL_Clu_SNR_187);

	testStep("get expect variable value: ","i_S4_SRR_RL_Clu_SNR_187 :%f",@ecu_Signals::i_S4_SRR_RL_Clu_SNR_187);

	if((abs(@ecu_Signals::i_S4_SRR_RL_Clu_SNR_187)*0.9<=abs(signalvalue1))&&(abs(signalvalue1)<=abs(@ecu_Signals::i_S4_SRR_RL_Clu_SNR_187)*1.1))
	{
	testStepPass("Pass","i_S4_SRR_RL_Clu_SNR_187 :%f",signalvalue1);
	}
	else
	{
	testStepFail("Fail","i_S4_SRR_RL_Clu_SNR_187 :%f",signalvalue1);
	}
}

testcase S4_SRR_RL_Clu_Mes_26_S4_SRR_RL_Clu_DynProp_187()
{
	signalvalue1 = getSignal(S4_SRR_RL_Clu_DynProp_187);
	write("S4_SRR_RL_Clu_DynProp_187 :%f",signalvalue1);
	write("i_S4_SRR_RL_Clu_DynProp_187 :%o",@ecu_Signals::i_S4_SRR_RL_Clu_DynProp_187);

	testStep("get expect variable value: ","i_S4_SRR_RL_Clu_DynProp_187 :%o",@ecu_Signals::i_S4_SRR_RL_Clu_DynProp_187);

	if(signalvalue1==@ecu_Signals::i_S4_SRR_RL_Clu_DynProp_187)
	{
	testStepPass("Pass","i_S4_SRR_RL_Clu_DynProp_187 :%f",signalvalue1);
	}
	else
	{
	testStepFail("Fail","i_S4_SRR_RL_Clu_DynProp_187 :%f",signalvalue1);
	}
}

testcase S4_SRR_RL_Clu_Mes_26_S4_SRR_RL_Clu_Locationvalid_187()
{
	signalvalue1 = getSignal(S4_SRR_RL_Clu_Locationvalid_187);
	write("S4_SRR_RL_Clu_Locationvalid_187 :%f",signalvalue1);
	write("i_S4_SRR_RL_Clu_Locationvalid_187 :%o",@ecu_Signals::i_S4_SRR_RL_Clu_Locationvalid_187);

	testStep("get expect variable value: ","i_S4_SRR_RL_Clu_Locationvalid_187 :%o",@ecu_Signals::i_S4_SRR_RL_Clu_Locationvalid_187);

	if(signalvalue1==@ecu_Signals::i_S4_SRR_RL_Clu_Locationvalid_187)
	{
	testStepPass("Pass","i_S4_SRR_RL_Clu_Locationvalid_187 :%f",signalvalue1);
	}
	else
	{
	testStepFail("Fail","i_S4_SRR_RL_Clu_Locationvalid_187 :%f",signalvalue1);
	}
}

testcase S4_SRR_RL_Clu_Mes_26_S4_SRR_RL_Clu_Theta_188()
{
	signalvalue1 = getSignal(S4_SRR_RL_Clu_Theta_188);
	write("S4_SRR_RL_Clu_Theta_188 :%f",signalvalue1);
	write("i_S4_SRR_RL_Clu_Theta_188 :%f",@ecu_Signals::i_S4_SRR_RL_Clu_Theta_188);

	testStep("get expect variable value: ","i_S4_SRR_RL_Clu_Theta_188 :%f",@ecu_Signals::i_S4_SRR_RL_Clu_Theta_188);

	if((abs(@ecu_Signals::i_S4_SRR_RL_Clu_Theta_188)*0.9<=abs(signalvalue1))&&(abs(signalvalue1)<=abs(@ecu_Signals::i_S4_SRR_RL_Clu_Theta_188)*1.1))
	{
	testStepPass("Pass","i_S4_SRR_RL_Clu_Theta_188 :%f",signalvalue1);
	}
	else
	{
	testStepFail("Fail","i_S4_SRR_RL_Clu_Theta_188 :%f",signalvalue1);
	}
}

testcase S4_SRR_RL_Clu_Mes_26_S4_SRR_RL_Clu_Dist_188()
{
	signalvalue1 = getSignal(S4_SRR_RL_Clu_Dist_188);
	write("S4_SRR_RL_Clu_Dist_188 :%f",signalvalue1);
	write("i_S4_SRR_RL_Clu_Dist_188 :%f",@ecu_Signals::i_S4_SRR_RL_Clu_Dist_188);

	testStep("get expect variable value: ","i_S4_SRR_RL_Clu_Dist_188 :%f",@ecu_Signals::i_S4_SRR_RL_Clu_Dist_188);

	if((abs(@ecu_Signals::i_S4_SRR_RL_Clu_Dist_188)*0.9<=abs(signalvalue1))&&(abs(signalvalue1)<=abs(@ecu_Signals::i_S4_SRR_RL_Clu_Dist_188)*1.1))
	{
	testStepPass("Pass","i_S4_SRR_RL_Clu_Dist_188 :%f",signalvalue1);
	}
	else
	{
	testStepFail("Fail","i_S4_SRR_RL_Clu_Dist_188 :%f",signalvalue1);
	}
}

testcase S4_SRR_RL_Clu_Mes_26_S4_SRR_RL_Clu_Vel_188()
{
	signalvalue1 = getSignal(S4_SRR_RL_Clu_Vel_188);
	write("S4_SRR_RL_Clu_Vel_188 :%f",signalvalue1);
	write("i_S4_SRR_RL_Clu_Vel_188 :%f",@ecu_Signals::i_S4_SRR_RL_Clu_Vel_188);

	testStep("get expect variable value: ","i_S4_SRR_RL_Clu_Vel_188 :%f",@ecu_Signals::i_S4_SRR_RL_Clu_Vel_188);

	if((abs(@ecu_Signals::i_S4_SRR_RL_Clu_Vel_188)*0.9<=abs(signalvalue1))&&(abs(signalvalue1)<=abs(@ecu_Signals::i_S4_SRR_RL_Clu_Vel_188)*1.1))
	{
	testStepPass("Pass","i_S4_SRR_RL_Clu_Vel_188 :%f",signalvalue1);
	}
	else
	{
	testStepFail("Fail","i_S4_SRR_RL_Clu_Vel_188 :%f",signalvalue1);
	}
}

testcase S4_SRR_RL_Clu_Mes_26_S4_SRR_RL_Clu_SNR_188()
{
	signalvalue1 = getSignal(S4_SRR_RL_Clu_SNR_188);
	write("S4_SRR_RL_Clu_SNR_188 :%f",signalvalue1);
	write("i_S4_SRR_RL_Clu_SNR_188 :%f",@ecu_Signals::i_S4_SRR_RL_Clu_SNR_188);

	testStep("get expect variable value: ","i_S4_SRR_RL_Clu_SNR_188 :%f",@ecu_Signals::i_S4_SRR_RL_Clu_SNR_188);

	if((abs(@ecu_Signals::i_S4_SRR_RL_Clu_SNR_188)*0.9<=abs(signalvalue1))&&(abs(signalvalue1)<=abs(@ecu_Signals::i_S4_SRR_RL_Clu_SNR_188)*1.1))
	{
	testStepPass("Pass","i_S4_SRR_RL_Clu_SNR_188 :%f",signalvalue1);
	}
	else
	{
	testStepFail("Fail","i_S4_SRR_RL_Clu_SNR_188 :%f",signalvalue1);
	}
}

testcase S4_SRR_RL_Clu_Mes_26_S4_SRR_RL_Clu_DynProp_188()
{
	signalvalue1 = getSignal(S4_SRR_RL_Clu_DynProp_188);
	write("S4_SRR_RL_Clu_DynProp_188 :%f",signalvalue1);
	write("i_S4_SRR_RL_Clu_DynProp_188 :%o",@ecu_Signals::i_S4_SRR_RL_Clu_DynProp_188);

	testStep("get expect variable value: ","i_S4_SRR_RL_Clu_DynProp_188 :%o",@ecu_Signals::i_S4_SRR_RL_Clu_DynProp_188);

	if(signalvalue1==@ecu_Signals::i_S4_SRR_RL_Clu_DynProp_188)
	{
	testStepPass("Pass","i_S4_SRR_RL_Clu_DynProp_188 :%f",signalvalue1);
	}
	else
	{
	testStepFail("Fail","i_S4_SRR_RL_Clu_DynProp_188 :%f",signalvalue1);
	}
}

testcase S4_SRR_RL_Clu_Mes_26_S4_SRR_RL_Clu_Locationvalid_188()
{
	signalvalue1 = getSignal(S4_SRR_RL_Clu_Locationvalid_188);
	write("S4_SRR_RL_Clu_Locationvalid_188 :%f",signalvalue1);
	write("i_S4_SRR_RL_Clu_Locationvalid_188 :%o",@ecu_Signals::i_S4_SRR_RL_Clu_Locationvalid_188);

	testStep("get expect variable value: ","i_S4_SRR_RL_Clu_Locationvalid_188 :%o",@ecu_Signals::i_S4_SRR_RL_Clu_Locationvalid_188);

	if(signalvalue1==@ecu_Signals::i_S4_SRR_RL_Clu_Locationvalid_188)
	{
	testStepPass("Pass","i_S4_SRR_RL_Clu_Locationvalid_188 :%f",signalvalue1);
	}
	else
	{
	testStepFail("Fail","i_S4_SRR_RL_Clu_Locationvalid_188 :%f",signalvalue1);
	}
}

testcase S4_SRR_RL_Clu_Mes_27_S4_SRR_RL_Clu_Theta_189()
{
	signalvalue1 = getSignal(S4_SRR_RL_Clu_Theta_189);
	write("S4_SRR_RL_Clu_Theta_189 :%f",signalvalue1);
	write("i_S4_SRR_RL_Clu_Theta_189 :%f",@ecu_Signals::i_S4_SRR_RL_Clu_Theta_189);

	testStep("get expect variable value: ","i_S4_SRR_RL_Clu_Theta_189 :%f",@ecu_Signals::i_S4_SRR_RL_Clu_Theta_189);

	if((abs(@ecu_Signals::i_S4_SRR_RL_Clu_Theta_189)*0.9<=abs(signalvalue1))&&(abs(signalvalue1)<=abs(@ecu_Signals::i_S4_SRR_RL_Clu_Theta_189)*1.1))
	{
	testStepPass("Pass","i_S4_SRR_RL_Clu_Theta_189 :%f",signalvalue1);
	}
	else
	{
	testStepFail("Fail","i_S4_SRR_RL_Clu_Theta_189 :%f",signalvalue1);
	}
}

testcase S4_SRR_RL_Clu_Mes_27_S4_SRR_RL_Clu_Dist_189()
{
	signalvalue1 = getSignal(S4_SRR_RL_Clu_Dist_189);
	write("S4_SRR_RL_Clu_Dist_189 :%f",signalvalue1);
	write("i_S4_SRR_RL_Clu_Dist_189 :%f",@ecu_Signals::i_S4_SRR_RL_Clu_Dist_189);

	testStep("get expect variable value: ","i_S4_SRR_RL_Clu_Dist_189 :%f",@ecu_Signals::i_S4_SRR_RL_Clu_Dist_189);

	if((abs(@ecu_Signals::i_S4_SRR_RL_Clu_Dist_189)*0.9<=abs(signalvalue1))&&(abs(signalvalue1)<=abs(@ecu_Signals::i_S4_SRR_RL_Clu_Dist_189)*1.1))
	{
	testStepPass("Pass","i_S4_SRR_RL_Clu_Dist_189 :%f",signalvalue1);
	}
	else
	{
	testStepFail("Fail","i_S4_SRR_RL_Clu_Dist_189 :%f",signalvalue1);
	}
}

testcase S4_SRR_RL_Clu_Mes_27_S4_SRR_RL_Clu_Vel_189()
{
	signalvalue1 = getSignal(S4_SRR_RL_Clu_Vel_189);
	write("S4_SRR_RL_Clu_Vel_189 :%f",signalvalue1);
	write("i_S4_SRR_RL_Clu_Vel_189 :%f",@ecu_Signals::i_S4_SRR_RL_Clu_Vel_189);

	testStep("get expect variable value: ","i_S4_SRR_RL_Clu_Vel_189 :%f",@ecu_Signals::i_S4_SRR_RL_Clu_Vel_189);

	if((abs(@ecu_Signals::i_S4_SRR_RL_Clu_Vel_189)*0.9<=abs(signalvalue1))&&(abs(signalvalue1)<=abs(@ecu_Signals::i_S4_SRR_RL_Clu_Vel_189)*1.1))
	{
	testStepPass("Pass","i_S4_SRR_RL_Clu_Vel_189 :%f",signalvalue1);
	}
	else
	{
	testStepFail("Fail","i_S4_SRR_RL_Clu_Vel_189 :%f",signalvalue1);
	}
}

testcase S4_SRR_RL_Clu_Mes_27_S4_SRR_RL_Clu_SNR_189()
{
	signalvalue1 = getSignal(S4_SRR_RL_Clu_SNR_189);
	write("S4_SRR_RL_Clu_SNR_189 :%f",signalvalue1);
	write("i_S4_SRR_RL_Clu_SNR_189 :%f",@ecu_Signals::i_S4_SRR_RL_Clu_SNR_189);

	testStep("get expect variable value: ","i_S4_SRR_RL_Clu_SNR_189 :%f",@ecu_Signals::i_S4_SRR_RL_Clu_SNR_189);

	if((abs(@ecu_Signals::i_S4_SRR_RL_Clu_SNR_189)*0.9<=abs(signalvalue1))&&(abs(signalvalue1)<=abs(@ecu_Signals::i_S4_SRR_RL_Clu_SNR_189)*1.1))
	{
	testStepPass("Pass","i_S4_SRR_RL_Clu_SNR_189 :%f",signalvalue1);
	}
	else
	{
	testStepFail("Fail","i_S4_SRR_RL_Clu_SNR_189 :%f",signalvalue1);
	}
}

testcase S4_SRR_RL_Clu_Mes_27_S4_SRR_RL_Clu_DynProp_189()
{
	signalvalue1 = getSignal(S4_SRR_RL_Clu_DynProp_189);
	write("S4_SRR_RL_Clu_DynProp_189 :%f",signalvalue1);
	write("i_S4_SRR_RL_Clu_DynProp_189 :%o",@ecu_Signals::i_S4_SRR_RL_Clu_DynProp_189);

	testStep("get expect variable value: ","i_S4_SRR_RL_Clu_DynProp_189 :%o",@ecu_Signals::i_S4_SRR_RL_Clu_DynProp_189);

	if(signalvalue1==@ecu_Signals::i_S4_SRR_RL_Clu_DynProp_189)
	{
	testStepPass("Pass","i_S4_SRR_RL_Clu_DynProp_189 :%f",signalvalue1);
	}
	else
	{
	testStepFail("Fail","i_S4_SRR_RL_Clu_DynProp_189 :%f",signalvalue1);
	}
}

testcase S4_SRR_RL_Clu_Mes_27_S4_SRR_RL_Clu_Locationvalid_189()
{
	signalvalue1 = getSignal(S4_SRR_RL_Clu_Locationvalid_189);
	write("S4_SRR_RL_Clu_Locationvalid_189 :%f",signalvalue1);
	write("i_S4_SRR_RL_Clu_Locationvalid_189 :%o",@ecu_Signals::i_S4_SRR_RL_Clu_Locationvalid_189);

	testStep("get expect variable value: ","i_S4_SRR_RL_Clu_Locationvalid_189 :%o",@ecu_Signals::i_S4_SRR_RL_Clu_Locationvalid_189);

	if(signalvalue1==@ecu_Signals::i_S4_SRR_RL_Clu_Locationvalid_189)
	{
	testStepPass("Pass","i_S4_SRR_RL_Clu_Locationvalid_189 :%f",signalvalue1);
	}
	else
	{
	testStepFail("Fail","i_S4_SRR_RL_Clu_Locationvalid_189 :%f",signalvalue1);
	}
}

testcase S4_SRR_RL_Clu_Mes_27_S4_SRR_RL_Clu_Theta_190()
{
	signalvalue1 = getSignal(S4_SRR_RL_Clu_Theta_190);
	write("S4_SRR_RL_Clu_Theta_190 :%f",signalvalue1);
	write("i_S4_SRR_RL_Clu_Theta_190 :%f",@ecu_Signals::i_S4_SRR_RL_Clu_Theta_190);

	testStep("get expect variable value: ","i_S4_SRR_RL_Clu_Theta_190 :%f",@ecu_Signals::i_S4_SRR_RL_Clu_Theta_190);

	if((abs(@ecu_Signals::i_S4_SRR_RL_Clu_Theta_190)*0.9<=abs(signalvalue1))&&(abs(signalvalue1)<=abs(@ecu_Signals::i_S4_SRR_RL_Clu_Theta_190)*1.1))
	{
	testStepPass("Pass","i_S4_SRR_RL_Clu_Theta_190 :%f",signalvalue1);
	}
	else
	{
	testStepFail("Fail","i_S4_SRR_RL_Clu_Theta_190 :%f",signalvalue1);
	}
}

testcase S4_SRR_RL_Clu_Mes_27_S4_SRR_RL_Clu_Dist_190()
{
	signalvalue1 = getSignal(S4_SRR_RL_Clu_Dist_190);
	write("S4_SRR_RL_Clu_Dist_190 :%f",signalvalue1);
	write("i_S4_SRR_RL_Clu_Dist_190 :%f",@ecu_Signals::i_S4_SRR_RL_Clu_Dist_190);

	testStep("get expect variable value: ","i_S4_SRR_RL_Clu_Dist_190 :%f",@ecu_Signals::i_S4_SRR_RL_Clu_Dist_190);

	if((abs(@ecu_Signals::i_S4_SRR_RL_Clu_Dist_190)*0.9<=abs(signalvalue1))&&(abs(signalvalue1)<=abs(@ecu_Signals::i_S4_SRR_RL_Clu_Dist_190)*1.1))
	{
	testStepPass("Pass","i_S4_SRR_RL_Clu_Dist_190 :%f",signalvalue1);
	}
	else
	{
	testStepFail("Fail","i_S4_SRR_RL_Clu_Dist_190 :%f",signalvalue1);
	}
}

testcase S4_SRR_RL_Clu_Mes_27_S4_SRR_RL_Clu_Vel_190()
{
	signalvalue1 = getSignal(S4_SRR_RL_Clu_Vel_190);
	write("S4_SRR_RL_Clu_Vel_190 :%f",signalvalue1);
	write("i_S4_SRR_RL_Clu_Vel_190 :%f",@ecu_Signals::i_S4_SRR_RL_Clu_Vel_190);

	testStep("get expect variable value: ","i_S4_SRR_RL_Clu_Vel_190 :%f",@ecu_Signals::i_S4_SRR_RL_Clu_Vel_190);

	if((abs(@ecu_Signals::i_S4_SRR_RL_Clu_Vel_190)*0.9<=abs(signalvalue1))&&(abs(signalvalue1)<=abs(@ecu_Signals::i_S4_SRR_RL_Clu_Vel_190)*1.1))
	{
	testStepPass("Pass","i_S4_SRR_RL_Clu_Vel_190 :%f",signalvalue1);
	}
	else
	{
	testStepFail("Fail","i_S4_SRR_RL_Clu_Vel_190 :%f",signalvalue1);
	}
}

testcase S4_SRR_RL_Clu_Mes_27_S4_SRR_RL_Clu_SNR_190()
{
	signalvalue1 = getSignal(S4_SRR_RL_Clu_SNR_190);
	write("S4_SRR_RL_Clu_SNR_190 :%f",signalvalue1);
	write("i_S4_SRR_RL_Clu_SNR_190 :%f",@ecu_Signals::i_S4_SRR_RL_Clu_SNR_190);

	testStep("get expect variable value: ","i_S4_SRR_RL_Clu_SNR_190 :%f",@ecu_Signals::i_S4_SRR_RL_Clu_SNR_190);

	if((abs(@ecu_Signals::i_S4_SRR_RL_Clu_SNR_190)*0.9<=abs(signalvalue1))&&(abs(signalvalue1)<=abs(@ecu_Signals::i_S4_SRR_RL_Clu_SNR_190)*1.1))
	{
	testStepPass("Pass","i_S4_SRR_RL_Clu_SNR_190 :%f",signalvalue1);
	}
	else
	{
	testStepFail("Fail","i_S4_SRR_RL_Clu_SNR_190 :%f",signalvalue1);
	}
}

testcase S4_SRR_RL_Clu_Mes_27_S4_SRR_RL_Clu_DynProp_190()
{
	signalvalue1 = getSignal(S4_SRR_RL_Clu_DynProp_190);
	write("S4_SRR_RL_Clu_DynProp_190 :%f",signalvalue1);
	write("i_S4_SRR_RL_Clu_DynProp_190 :%o",@ecu_Signals::i_S4_SRR_RL_Clu_DynProp_190);

	testStep("get expect variable value: ","i_S4_SRR_RL_Clu_DynProp_190 :%o",@ecu_Signals::i_S4_SRR_RL_Clu_DynProp_190);

	if(signalvalue1==@ecu_Signals::i_S4_SRR_RL_Clu_DynProp_190)
	{
	testStepPass("Pass","i_S4_SRR_RL_Clu_DynProp_190 :%f",signalvalue1);
	}
	else
	{
	testStepFail("Fail","i_S4_SRR_RL_Clu_DynProp_190 :%f",signalvalue1);
	}
}

testcase S4_SRR_RL_Clu_Mes_27_S4_SRR_RL_Clu_Locationvalid_190()
{
	signalvalue1 = getSignal(S4_SRR_RL_Clu_Locationvalid_190);
	write("S4_SRR_RL_Clu_Locationvalid_190 :%f",signalvalue1);
	write("i_S4_SRR_RL_Clu_Locationvalid_190 :%o",@ecu_Signals::i_S4_SRR_RL_Clu_Locationvalid_190);

	testStep("get expect variable value: ","i_S4_SRR_RL_Clu_Locationvalid_190 :%o",@ecu_Signals::i_S4_SRR_RL_Clu_Locationvalid_190);

	if(signalvalue1==@ecu_Signals::i_S4_SRR_RL_Clu_Locationvalid_190)
	{
	testStepPass("Pass","i_S4_SRR_RL_Clu_Locationvalid_190 :%f",signalvalue1);
	}
	else
	{
	testStepFail("Fail","i_S4_SRR_RL_Clu_Locationvalid_190 :%f",signalvalue1);
	}
}

testcase S4_SRR_RL_Clu_Mes_27_S4_SRR_RL_Clu_Theta_191()
{
	signalvalue1 = getSignal(S4_SRR_RL_Clu_Theta_191);
	write("S4_SRR_RL_Clu_Theta_191 :%f",signalvalue1);
	write("i_S4_SRR_RL_Clu_Theta_191 :%f",@ecu_Signals::i_S4_SRR_RL_Clu_Theta_191);

	testStep("get expect variable value: ","i_S4_SRR_RL_Clu_Theta_191 :%f",@ecu_Signals::i_S4_SRR_RL_Clu_Theta_191);

	if((abs(@ecu_Signals::i_S4_SRR_RL_Clu_Theta_191)*0.9<=abs(signalvalue1))&&(abs(signalvalue1)<=abs(@ecu_Signals::i_S4_SRR_RL_Clu_Theta_191)*1.1))
	{
	testStepPass("Pass","i_S4_SRR_RL_Clu_Theta_191 :%f",signalvalue1);
	}
	else
	{
	testStepFail("Fail","i_S4_SRR_RL_Clu_Theta_191 :%f",signalvalue1);
	}
}

testcase S4_SRR_RL_Clu_Mes_27_S4_SRR_RL_Clu_Dist_191()
{
	signalvalue1 = getSignal(S4_SRR_RL_Clu_Dist_191);
	write("S4_SRR_RL_Clu_Dist_191 :%f",signalvalue1);
	write("i_S4_SRR_RL_Clu_Dist_191 :%f",@ecu_Signals::i_S4_SRR_RL_Clu_Dist_191);

	testStep("get expect variable value: ","i_S4_SRR_RL_Clu_Dist_191 :%f",@ecu_Signals::i_S4_SRR_RL_Clu_Dist_191);

	if((abs(@ecu_Signals::i_S4_SRR_RL_Clu_Dist_191)*0.9<=abs(signalvalue1))&&(abs(signalvalue1)<=abs(@ecu_Signals::i_S4_SRR_RL_Clu_Dist_191)*1.1))
	{
	testStepPass("Pass","i_S4_SRR_RL_Clu_Dist_191 :%f",signalvalue1);
	}
	else
	{
	testStepFail("Fail","i_S4_SRR_RL_Clu_Dist_191 :%f",signalvalue1);
	}
}

testcase S4_SRR_RL_Clu_Mes_27_S4_SRR_RL_Clu_Vel_191()
{
	signalvalue1 = getSignal(S4_SRR_RL_Clu_Vel_191);
	write("S4_SRR_RL_Clu_Vel_191 :%f",signalvalue1);
	write("i_S4_SRR_RL_Clu_Vel_191 :%f",@ecu_Signals::i_S4_SRR_RL_Clu_Vel_191);

	testStep("get expect variable value: ","i_S4_SRR_RL_Clu_Vel_191 :%f",@ecu_Signals::i_S4_SRR_RL_Clu_Vel_191);

	if((abs(@ecu_Signals::i_S4_SRR_RL_Clu_Vel_191)*0.9<=abs(signalvalue1))&&(abs(signalvalue1)<=abs(@ecu_Signals::i_S4_SRR_RL_Clu_Vel_191)*1.1))
	{
	testStepPass("Pass","i_S4_SRR_RL_Clu_Vel_191 :%f",signalvalue1);
	}
	else
	{
	testStepFail("Fail","i_S4_SRR_RL_Clu_Vel_191 :%f",signalvalue1);
	}
}

testcase S4_SRR_RL_Clu_Mes_27_S4_SRR_RL_Clu_SNR_191()
{
	signalvalue1 = getSignal(S4_SRR_RL_Clu_SNR_191);
	write("S4_SRR_RL_Clu_SNR_191 :%f",signalvalue1);
	write("i_S4_SRR_RL_Clu_SNR_191 :%f",@ecu_Signals::i_S4_SRR_RL_Clu_SNR_191);

	testStep("get expect variable value: ","i_S4_SRR_RL_Clu_SNR_191 :%f",@ecu_Signals::i_S4_SRR_RL_Clu_SNR_191);

	if((abs(@ecu_Signals::i_S4_SRR_RL_Clu_SNR_191)*0.9<=abs(signalvalue1))&&(abs(signalvalue1)<=abs(@ecu_Signals::i_S4_SRR_RL_Clu_SNR_191)*1.1))
	{
	testStepPass("Pass","i_S4_SRR_RL_Clu_SNR_191 :%f",signalvalue1);
	}
	else
	{
	testStepFail("Fail","i_S4_SRR_RL_Clu_SNR_191 :%f",signalvalue1);
	}
}

testcase S4_SRR_RL_Clu_Mes_27_S4_SRR_RL_Clu_DynProp_191()
{
	signalvalue1 = getSignal(S4_SRR_RL_Clu_DynProp_191);
	write("S4_SRR_RL_Clu_DynProp_191 :%f",signalvalue1);
	write("i_S4_SRR_RL_Clu_DynProp_191 :%o",@ecu_Signals::i_S4_SRR_RL_Clu_DynProp_191);

	testStep("get expect variable value: ","i_S4_SRR_RL_Clu_DynProp_191 :%o",@ecu_Signals::i_S4_SRR_RL_Clu_DynProp_191);

	if(signalvalue1==@ecu_Signals::i_S4_SRR_RL_Clu_DynProp_191)
	{
	testStepPass("Pass","i_S4_SRR_RL_Clu_DynProp_191 :%f",signalvalue1);
	}
	else
	{
	testStepFail("Fail","i_S4_SRR_RL_Clu_DynProp_191 :%f",signalvalue1);
	}
}

testcase S4_SRR_RL_Clu_Mes_27_S4_SRR_RL_Clu_Locationvalid_191()
{
	signalvalue1 = getSignal(S4_SRR_RL_Clu_Locationvalid_191);
	write("S4_SRR_RL_Clu_Locationvalid_191 :%f",signalvalue1);
	write("i_S4_SRR_RL_Clu_Locationvalid_191 :%o",@ecu_Signals::i_S4_SRR_RL_Clu_Locationvalid_191);

	testStep("get expect variable value: ","i_S4_SRR_RL_Clu_Locationvalid_191 :%o",@ecu_Signals::i_S4_SRR_RL_Clu_Locationvalid_191);

	if(signalvalue1==@ecu_Signals::i_S4_SRR_RL_Clu_Locationvalid_191)
	{
	testStepPass("Pass","i_S4_SRR_RL_Clu_Locationvalid_191 :%f",signalvalue1);
	}
	else
	{
	testStepFail("Fail","i_S4_SRR_RL_Clu_Locationvalid_191 :%f",signalvalue1);
	}
}

testcase S4_SRR_RL_Clu_Mes_27_S4_SRR_RL_Clu_Theta_192()
{
	signalvalue1 = getSignal(S4_SRR_RL_Clu_Theta_192);
	write("S4_SRR_RL_Clu_Theta_192 :%f",signalvalue1);
	write("i_S4_SRR_RL_Clu_Theta_192 :%f",@ecu_Signals::i_S4_SRR_RL_Clu_Theta_192);

	testStep("get expect variable value: ","i_S4_SRR_RL_Clu_Theta_192 :%f",@ecu_Signals::i_S4_SRR_RL_Clu_Theta_192);

	if((abs(@ecu_Signals::i_S4_SRR_RL_Clu_Theta_192)*0.9<=abs(signalvalue1))&&(abs(signalvalue1)<=abs(@ecu_Signals::i_S4_SRR_RL_Clu_Theta_192)*1.1))
	{
	testStepPass("Pass","i_S4_SRR_RL_Clu_Theta_192 :%f",signalvalue1);
	}
	else
	{
	testStepFail("Fail","i_S4_SRR_RL_Clu_Theta_192 :%f",signalvalue1);
	}
}

testcase S4_SRR_RL_Clu_Mes_27_S4_SRR_RL_Clu_Dist_192()
{
	signalvalue1 = getSignal(S4_SRR_RL_Clu_Dist_192);
	write("S4_SRR_RL_Clu_Dist_192 :%f",signalvalue1);
	write("i_S4_SRR_RL_Clu_Dist_192 :%f",@ecu_Signals::i_S4_SRR_RL_Clu_Dist_192);

	testStep("get expect variable value: ","i_S4_SRR_RL_Clu_Dist_192 :%f",@ecu_Signals::i_S4_SRR_RL_Clu_Dist_192);

	if((abs(@ecu_Signals::i_S4_SRR_RL_Clu_Dist_192)*0.9<=abs(signalvalue1))&&(abs(signalvalue1)<=abs(@ecu_Signals::i_S4_SRR_RL_Clu_Dist_192)*1.1))
	{
	testStepPass("Pass","i_S4_SRR_RL_Clu_Dist_192 :%f",signalvalue1);
	}
	else
	{
	testStepFail("Fail","i_S4_SRR_RL_Clu_Dist_192 :%f",signalvalue1);
	}
}

testcase S4_SRR_RL_Clu_Mes_27_S4_SRR_RL_Clu_Vel_192()
{
	signalvalue1 = getSignal(S4_SRR_RL_Clu_Vel_192);
	write("S4_SRR_RL_Clu_Vel_192 :%f",signalvalue1);
	write("i_S4_SRR_RL_Clu_Vel_192 :%f",@ecu_Signals::i_S4_SRR_RL_Clu_Vel_192);

	testStep("get expect variable value: ","i_S4_SRR_RL_Clu_Vel_192 :%f",@ecu_Signals::i_S4_SRR_RL_Clu_Vel_192);

	if((abs(@ecu_Signals::i_S4_SRR_RL_Clu_Vel_192)*0.9<=abs(signalvalue1))&&(abs(signalvalue1)<=abs(@ecu_Signals::i_S4_SRR_RL_Clu_Vel_192)*1.1))
	{
	testStepPass("Pass","i_S4_SRR_RL_Clu_Vel_192 :%f",signalvalue1);
	}
	else
	{
	testStepFail("Fail","i_S4_SRR_RL_Clu_Vel_192 :%f",signalvalue1);
	}
}

testcase S4_SRR_RL_Clu_Mes_27_S4_SRR_RL_Clu_SNR_192()
{
	signalvalue1 = getSignal(S4_SRR_RL_Clu_SNR_192);
	write("S4_SRR_RL_Clu_SNR_192 :%f",signalvalue1);
	write("i_S4_SRR_RL_Clu_SNR_192 :%f",@ecu_Signals::i_S4_SRR_RL_Clu_SNR_192);

	testStep("get expect variable value: ","i_S4_SRR_RL_Clu_SNR_192 :%f",@ecu_Signals::i_S4_SRR_RL_Clu_SNR_192);

	if((abs(@ecu_Signals::i_S4_SRR_RL_Clu_SNR_192)*0.9<=abs(signalvalue1))&&(abs(signalvalue1)<=abs(@ecu_Signals::i_S4_SRR_RL_Clu_SNR_192)*1.1))
	{
	testStepPass("Pass","i_S4_SRR_RL_Clu_SNR_192 :%f",signalvalue1);
	}
	else
	{
	testStepFail("Fail","i_S4_SRR_RL_Clu_SNR_192 :%f",signalvalue1);
	}
}

testcase S4_SRR_RL_Clu_Mes_27_S4_SRR_RL_Clu_DynProp_192()
{
	signalvalue1 = getSignal(S4_SRR_RL_Clu_DynProp_192);
	write("S4_SRR_RL_Clu_DynProp_192 :%f",signalvalue1);
	write("i_S4_SRR_RL_Clu_DynProp_192 :%o",@ecu_Signals::i_S4_SRR_RL_Clu_DynProp_192);

	testStep("get expect variable value: ","i_S4_SRR_RL_Clu_DynProp_192 :%o",@ecu_Signals::i_S4_SRR_RL_Clu_DynProp_192);

	if(signalvalue1==@ecu_Signals::i_S4_SRR_RL_Clu_DynProp_192)
	{
	testStepPass("Pass","i_S4_SRR_RL_Clu_DynProp_192 :%f",signalvalue1);
	}
	else
	{
	testStepFail("Fail","i_S4_SRR_RL_Clu_DynProp_192 :%f",signalvalue1);
	}
}

testcase S4_SRR_RL_Clu_Mes_27_S4_SRR_RL_Clu_Locationvalid_192()
{
	signalvalue1 = getSignal(S4_SRR_RL_Clu_Locationvalid_192);
	write("S4_SRR_RL_Clu_Locationvalid_192 :%f",signalvalue1);
	write("i_S4_SRR_RL_Clu_Locationvalid_192 :%o",@ecu_Signals::i_S4_SRR_RL_Clu_Locationvalid_192);

	testStep("get expect variable value: ","i_S4_SRR_RL_Clu_Locationvalid_192 :%o",@ecu_Signals::i_S4_SRR_RL_Clu_Locationvalid_192);

	if(signalvalue1==@ecu_Signals::i_S4_SRR_RL_Clu_Locationvalid_192)
	{
	testStepPass("Pass","i_S4_SRR_RL_Clu_Locationvalid_192 :%f",signalvalue1);
	}
	else
	{
	testStepFail("Fail","i_S4_SRR_RL_Clu_Locationvalid_192 :%f",signalvalue1);
	}
}

testcase S4_SRR_RL_Clu_Mes_27_S4_SRR_RL_Clu_Theta_193()
{
	signalvalue1 = getSignal(S4_SRR_RL_Clu_Theta_193);
	write("S4_SRR_RL_Clu_Theta_193 :%f",signalvalue1);
	write("i_S4_SRR_RL_Clu_Theta_193 :%f",@ecu_Signals::i_S4_SRR_RL_Clu_Theta_193);

	testStep("get expect variable value: ","i_S4_SRR_RL_Clu_Theta_193 :%f",@ecu_Signals::i_S4_SRR_RL_Clu_Theta_193);

	if((abs(@ecu_Signals::i_S4_SRR_RL_Clu_Theta_193)*0.9<=abs(signalvalue1))&&(abs(signalvalue1)<=abs(@ecu_Signals::i_S4_SRR_RL_Clu_Theta_193)*1.1))
	{
	testStepPass("Pass","i_S4_SRR_RL_Clu_Theta_193 :%f",signalvalue1);
	}
	else
	{
	testStepFail("Fail","i_S4_SRR_RL_Clu_Theta_193 :%f",signalvalue1);
	}
}

testcase S4_SRR_RL_Clu_Mes_27_S4_SRR_RL_Clu_Dist_193()
{
	signalvalue1 = getSignal(S4_SRR_RL_Clu_Dist_193);
	write("S4_SRR_RL_Clu_Dist_193 :%f",signalvalue1);
	write("i_S4_SRR_RL_Clu_Dist_193 :%f",@ecu_Signals::i_S4_SRR_RL_Clu_Dist_193);

	testStep("get expect variable value: ","i_S4_SRR_RL_Clu_Dist_193 :%f",@ecu_Signals::i_S4_SRR_RL_Clu_Dist_193);

	if((abs(@ecu_Signals::i_S4_SRR_RL_Clu_Dist_193)*0.9<=abs(signalvalue1))&&(abs(signalvalue1)<=abs(@ecu_Signals::i_S4_SRR_RL_Clu_Dist_193)*1.1))
	{
	testStepPass("Pass","i_S4_SRR_RL_Clu_Dist_193 :%f",signalvalue1);
	}
	else
	{
	testStepFail("Fail","i_S4_SRR_RL_Clu_Dist_193 :%f",signalvalue1);
	}
}

testcase S4_SRR_RL_Clu_Mes_27_S4_SRR_RL_Clu_Vel_193()
{
	signalvalue1 = getSignal(S4_SRR_RL_Clu_Vel_193);
	write("S4_SRR_RL_Clu_Vel_193 :%f",signalvalue1);
	write("i_S4_SRR_RL_Clu_Vel_193 :%f",@ecu_Signals::i_S4_SRR_RL_Clu_Vel_193);

	testStep("get expect variable value: ","i_S4_SRR_RL_Clu_Vel_193 :%f",@ecu_Signals::i_S4_SRR_RL_Clu_Vel_193);

	if((abs(@ecu_Signals::i_S4_SRR_RL_Clu_Vel_193)*0.9<=abs(signalvalue1))&&(abs(signalvalue1)<=abs(@ecu_Signals::i_S4_SRR_RL_Clu_Vel_193)*1.1))
	{
	testStepPass("Pass","i_S4_SRR_RL_Clu_Vel_193 :%f",signalvalue1);
	}
	else
	{
	testStepFail("Fail","i_S4_SRR_RL_Clu_Vel_193 :%f",signalvalue1);
	}
}

testcase S4_SRR_RL_Clu_Mes_27_S4_SRR_RL_Clu_SNR_193()
{
	signalvalue1 = getSignal(S4_SRR_RL_Clu_SNR_193);
	write("S4_SRR_RL_Clu_SNR_193 :%f",signalvalue1);
	write("i_S4_SRR_RL_Clu_SNR_193 :%f",@ecu_Signals::i_S4_SRR_RL_Clu_SNR_193);

	testStep("get expect variable value: ","i_S4_SRR_RL_Clu_SNR_193 :%f",@ecu_Signals::i_S4_SRR_RL_Clu_SNR_193);

	if((abs(@ecu_Signals::i_S4_SRR_RL_Clu_SNR_193)*0.9<=abs(signalvalue1))&&(abs(signalvalue1)<=abs(@ecu_Signals::i_S4_SRR_RL_Clu_SNR_193)*1.1))
	{
	testStepPass("Pass","i_S4_SRR_RL_Clu_SNR_193 :%f",signalvalue1);
	}
	else
	{
	testStepFail("Fail","i_S4_SRR_RL_Clu_SNR_193 :%f",signalvalue1);
	}
}

testcase S4_SRR_RL_Clu_Mes_27_S4_SRR_RL_Clu_DynProp_193()
{
	signalvalue1 = getSignal(S4_SRR_RL_Clu_DynProp_193);
	write("S4_SRR_RL_Clu_DynProp_193 :%f",signalvalue1);
	write("i_S4_SRR_RL_Clu_DynProp_193 :%o",@ecu_Signals::i_S4_SRR_RL_Clu_DynProp_193);

	testStep("get expect variable value: ","i_S4_SRR_RL_Clu_DynProp_193 :%o",@ecu_Signals::i_S4_SRR_RL_Clu_DynProp_193);

	if(signalvalue1==@ecu_Signals::i_S4_SRR_RL_Clu_DynProp_193)
	{
	testStepPass("Pass","i_S4_SRR_RL_Clu_DynProp_193 :%f",signalvalue1);
	}
	else
	{
	testStepFail("Fail","i_S4_SRR_RL_Clu_DynProp_193 :%f",signalvalue1);
	}
}

testcase S4_SRR_RL_Clu_Mes_27_S4_SRR_RL_Clu_Locationvalid_193()
{
	signalvalue1 = getSignal(S4_SRR_RL_Clu_Locationvalid_193);
	write("S4_SRR_RL_Clu_Locationvalid_193 :%f",signalvalue1);
	write("i_S4_SRR_RL_Clu_Locationvalid_193 :%o",@ecu_Signals::i_S4_SRR_RL_Clu_Locationvalid_193);

	testStep("get expect variable value: ","i_S4_SRR_RL_Clu_Locationvalid_193 :%o",@ecu_Signals::i_S4_SRR_RL_Clu_Locationvalid_193);

	if(signalvalue1==@ecu_Signals::i_S4_SRR_RL_Clu_Locationvalid_193)
	{
	testStepPass("Pass","i_S4_SRR_RL_Clu_Locationvalid_193 :%f",signalvalue1);
	}
	else
	{
	testStepFail("Fail","i_S4_SRR_RL_Clu_Locationvalid_193 :%f",signalvalue1);
	}
}

testcase S4_SRR_RL_Clu_Mes_27_S4_SRR_RL_Clu_Theta_194()
{
	signalvalue1 = getSignal(S4_SRR_RL_Clu_Theta_194);
	write("S4_SRR_RL_Clu_Theta_194 :%f",signalvalue1);
	write("i_S4_SRR_RL_Clu_Theta_194 :%f",@ecu_Signals::i_S4_SRR_RL_Clu_Theta_194);

	testStep("get expect variable value: ","i_S4_SRR_RL_Clu_Theta_194 :%f",@ecu_Signals::i_S4_SRR_RL_Clu_Theta_194);

	if((abs(@ecu_Signals::i_S4_SRR_RL_Clu_Theta_194)*0.9<=abs(signalvalue1))&&(abs(signalvalue1)<=abs(@ecu_Signals::i_S4_SRR_RL_Clu_Theta_194)*1.1))
	{
	testStepPass("Pass","i_S4_SRR_RL_Clu_Theta_194 :%f",signalvalue1);
	}
	else
	{
	testStepFail("Fail","i_S4_SRR_RL_Clu_Theta_194 :%f",signalvalue1);
	}
}

testcase S4_SRR_RL_Clu_Mes_27_S4_SRR_RL_Clu_Dist_194()
{
	signalvalue1 = getSignal(S4_SRR_RL_Clu_Dist_194);
	write("S4_SRR_RL_Clu_Dist_194 :%f",signalvalue1);
	write("i_S4_SRR_RL_Clu_Dist_194 :%f",@ecu_Signals::i_S4_SRR_RL_Clu_Dist_194);

	testStep("get expect variable value: ","i_S4_SRR_RL_Clu_Dist_194 :%f",@ecu_Signals::i_S4_SRR_RL_Clu_Dist_194);

	if((abs(@ecu_Signals::i_S4_SRR_RL_Clu_Dist_194)*0.9<=abs(signalvalue1))&&(abs(signalvalue1)<=abs(@ecu_Signals::i_S4_SRR_RL_Clu_Dist_194)*1.1))
	{
	testStepPass("Pass","i_S4_SRR_RL_Clu_Dist_194 :%f",signalvalue1);
	}
	else
	{
	testStepFail("Fail","i_S4_SRR_RL_Clu_Dist_194 :%f",signalvalue1);
	}
}

testcase S4_SRR_RL_Clu_Mes_27_S4_SRR_RL_Clu_Vel_194()
{
	signalvalue1 = getSignal(S4_SRR_RL_Clu_Vel_194);
	write("S4_SRR_RL_Clu_Vel_194 :%f",signalvalue1);
	write("i_S4_SRR_RL_Clu_Vel_194 :%f",@ecu_Signals::i_S4_SRR_RL_Clu_Vel_194);

	testStep("get expect variable value: ","i_S4_SRR_RL_Clu_Vel_194 :%f",@ecu_Signals::i_S4_SRR_RL_Clu_Vel_194);

	if((abs(@ecu_Signals::i_S4_SRR_RL_Clu_Vel_194)*0.9<=abs(signalvalue1))&&(abs(signalvalue1)<=abs(@ecu_Signals::i_S4_SRR_RL_Clu_Vel_194)*1.1))
	{
	testStepPass("Pass","i_S4_SRR_RL_Clu_Vel_194 :%f",signalvalue1);
	}
	else
	{
	testStepFail("Fail","i_S4_SRR_RL_Clu_Vel_194 :%f",signalvalue1);
	}
}

testcase S4_SRR_RL_Clu_Mes_27_S4_SRR_RL_Clu_SNR_194()
{
	signalvalue1 = getSignal(S4_SRR_RL_Clu_SNR_194);
	write("S4_SRR_RL_Clu_SNR_194 :%f",signalvalue1);
	write("i_S4_SRR_RL_Clu_SNR_194 :%f",@ecu_Signals::i_S4_SRR_RL_Clu_SNR_194);

	testStep("get expect variable value: ","i_S4_SRR_RL_Clu_SNR_194 :%f",@ecu_Signals::i_S4_SRR_RL_Clu_SNR_194);

	if((abs(@ecu_Signals::i_S4_SRR_RL_Clu_SNR_194)*0.9<=abs(signalvalue1))&&(abs(signalvalue1)<=abs(@ecu_Signals::i_S4_SRR_RL_Clu_SNR_194)*1.1))
	{
	testStepPass("Pass","i_S4_SRR_RL_Clu_SNR_194 :%f",signalvalue1);
	}
	else
	{
	testStepFail("Fail","i_S4_SRR_RL_Clu_SNR_194 :%f",signalvalue1);
	}
}

testcase S4_SRR_RL_Clu_Mes_27_S4_SRR_RL_Clu_DynProp_194()
{
	signalvalue1 = getSignal(S4_SRR_RL_Clu_DynProp_194);
	write("S4_SRR_RL_Clu_DynProp_194 :%f",signalvalue1);
	write("i_S4_SRR_RL_Clu_DynProp_194 :%o",@ecu_Signals::i_S4_SRR_RL_Clu_DynProp_194);

	testStep("get expect variable value: ","i_S4_SRR_RL_Clu_DynProp_194 :%o",@ecu_Signals::i_S4_SRR_RL_Clu_DynProp_194);

	if(signalvalue1==@ecu_Signals::i_S4_SRR_RL_Clu_DynProp_194)
	{
	testStepPass("Pass","i_S4_SRR_RL_Clu_DynProp_194 :%f",signalvalue1);
	}
	else
	{
	testStepFail("Fail","i_S4_SRR_RL_Clu_DynProp_194 :%f",signalvalue1);
	}
}

testcase S4_SRR_RL_Clu_Mes_27_S4_SRR_RL_Clu_Locationvalid_194()
{
	signalvalue1 = getSignal(S4_SRR_RL_Clu_Locationvalid_194);
	write("S4_SRR_RL_Clu_Locationvalid_194 :%f",signalvalue1);
	write("i_S4_SRR_RL_Clu_Locationvalid_194 :%o",@ecu_Signals::i_S4_SRR_RL_Clu_Locationvalid_194);

	testStep("get expect variable value: ","i_S4_SRR_RL_Clu_Locationvalid_194 :%o",@ecu_Signals::i_S4_SRR_RL_Clu_Locationvalid_194);

	if(signalvalue1==@ecu_Signals::i_S4_SRR_RL_Clu_Locationvalid_194)
	{
	testStepPass("Pass","i_S4_SRR_RL_Clu_Locationvalid_194 :%f",signalvalue1);
	}
	else
	{
	testStepFail("Fail","i_S4_SRR_RL_Clu_Locationvalid_194 :%f",signalvalue1);
	}
}

testcase S4_SRR_RL_Clu_Mes_27_S4_SRR_RL_Clu_Theta_195()
{
	signalvalue1 = getSignal(S4_SRR_RL_Clu_Theta_195);
	write("S4_SRR_RL_Clu_Theta_195 :%f",signalvalue1);
	write("i_S4_SRR_RL_Clu_Theta_195 :%f",@ecu_Signals::i_S4_SRR_RL_Clu_Theta_195);

	testStep("get expect variable value: ","i_S4_SRR_RL_Clu_Theta_195 :%f",@ecu_Signals::i_S4_SRR_RL_Clu_Theta_195);

	if((abs(@ecu_Signals::i_S4_SRR_RL_Clu_Theta_195)*0.9<=abs(signalvalue1))&&(abs(signalvalue1)<=abs(@ecu_Signals::i_S4_SRR_RL_Clu_Theta_195)*1.1))
	{
	testStepPass("Pass","i_S4_SRR_RL_Clu_Theta_195 :%f",signalvalue1);
	}
	else
	{
	testStepFail("Fail","i_S4_SRR_RL_Clu_Theta_195 :%f",signalvalue1);
	}
}

testcase S4_SRR_RL_Clu_Mes_27_S4_SRR_RL_Clu_Dist_195()
{
	signalvalue1 = getSignal(S4_SRR_RL_Clu_Dist_195);
	write("S4_SRR_RL_Clu_Dist_195 :%f",signalvalue1);
	write("i_S4_SRR_RL_Clu_Dist_195 :%f",@ecu_Signals::i_S4_SRR_RL_Clu_Dist_195);

	testStep("get expect variable value: ","i_S4_SRR_RL_Clu_Dist_195 :%f",@ecu_Signals::i_S4_SRR_RL_Clu_Dist_195);

	if((abs(@ecu_Signals::i_S4_SRR_RL_Clu_Dist_195)*0.9<=abs(signalvalue1))&&(abs(signalvalue1)<=abs(@ecu_Signals::i_S4_SRR_RL_Clu_Dist_195)*1.1))
	{
	testStepPass("Pass","i_S4_SRR_RL_Clu_Dist_195 :%f",signalvalue1);
	}
	else
	{
	testStepFail("Fail","i_S4_SRR_RL_Clu_Dist_195 :%f",signalvalue1);
	}
}

testcase S4_SRR_RL_Clu_Mes_27_S4_SRR_RL_Clu_Vel_195()
{
	signalvalue1 = getSignal(S4_SRR_RL_Clu_Vel_195);
	write("S4_SRR_RL_Clu_Vel_195 :%f",signalvalue1);
	write("i_S4_SRR_RL_Clu_Vel_195 :%f",@ecu_Signals::i_S4_SRR_RL_Clu_Vel_195);

	testStep("get expect variable value: ","i_S4_SRR_RL_Clu_Vel_195 :%f",@ecu_Signals::i_S4_SRR_RL_Clu_Vel_195);

	if((abs(@ecu_Signals::i_S4_SRR_RL_Clu_Vel_195)*0.9<=abs(signalvalue1))&&(abs(signalvalue1)<=abs(@ecu_Signals::i_S4_SRR_RL_Clu_Vel_195)*1.1))
	{
	testStepPass("Pass","i_S4_SRR_RL_Clu_Vel_195 :%f",signalvalue1);
	}
	else
	{
	testStepFail("Fail","i_S4_SRR_RL_Clu_Vel_195 :%f",signalvalue1);
	}
}

testcase S4_SRR_RL_Clu_Mes_27_S4_SRR_RL_Clu_SNR_195()
{
	signalvalue1 = getSignal(S4_SRR_RL_Clu_SNR_195);
	write("S4_SRR_RL_Clu_SNR_195 :%f",signalvalue1);
	write("i_S4_SRR_RL_Clu_SNR_195 :%f",@ecu_Signals::i_S4_SRR_RL_Clu_SNR_195);

	testStep("get expect variable value: ","i_S4_SRR_RL_Clu_SNR_195 :%f",@ecu_Signals::i_S4_SRR_RL_Clu_SNR_195);

	if((abs(@ecu_Signals::i_S4_SRR_RL_Clu_SNR_195)*0.9<=abs(signalvalue1))&&(abs(signalvalue1)<=abs(@ecu_Signals::i_S4_SRR_RL_Clu_SNR_195)*1.1))
	{
	testStepPass("Pass","i_S4_SRR_RL_Clu_SNR_195 :%f",signalvalue1);
	}
	else
	{
	testStepFail("Fail","i_S4_SRR_RL_Clu_SNR_195 :%f",signalvalue1);
	}
}

testcase S4_SRR_RL_Clu_Mes_27_S4_SRR_RL_Clu_DynProp_195()
{
	signalvalue1 = getSignal(S4_SRR_RL_Clu_DynProp_195);
	write("S4_SRR_RL_Clu_DynProp_195 :%f",signalvalue1);
	write("i_S4_SRR_RL_Clu_DynProp_195 :%o",@ecu_Signals::i_S4_SRR_RL_Clu_DynProp_195);

	testStep("get expect variable value: ","i_S4_SRR_RL_Clu_DynProp_195 :%o",@ecu_Signals::i_S4_SRR_RL_Clu_DynProp_195);

	if(signalvalue1==@ecu_Signals::i_S4_SRR_RL_Clu_DynProp_195)
	{
	testStepPass("Pass","i_S4_SRR_RL_Clu_DynProp_195 :%f",signalvalue1);
	}
	else
	{
	testStepFail("Fail","i_S4_SRR_RL_Clu_DynProp_195 :%f",signalvalue1);
	}
}

testcase S4_SRR_RL_Clu_Mes_27_S4_SRR_RL_Clu_Locationvalid_195()
{
	signalvalue1 = getSignal(S4_SRR_RL_Clu_Locationvalid_195);
	write("S4_SRR_RL_Clu_Locationvalid_195 :%f",signalvalue1);
	write("i_S4_SRR_RL_Clu_Locationvalid_195 :%o",@ecu_Signals::i_S4_SRR_RL_Clu_Locationvalid_195);

	testStep("get expect variable value: ","i_S4_SRR_RL_Clu_Locationvalid_195 :%o",@ecu_Signals::i_S4_SRR_RL_Clu_Locationvalid_195);

	if(signalvalue1==@ecu_Signals::i_S4_SRR_RL_Clu_Locationvalid_195)
	{
	testStepPass("Pass","i_S4_SRR_RL_Clu_Locationvalid_195 :%f",signalvalue1);
	}
	else
	{
	testStepFail("Fail","i_S4_SRR_RL_Clu_Locationvalid_195 :%f",signalvalue1);
	}
}

testcase S4_SRR_RL_Clu_Mes_28_S4_SRR_RL_Clu_Theta_196()
{
	signalvalue1 = getSignal(S4_SRR_RL_Clu_Theta_196);
	write("S4_SRR_RL_Clu_Theta_196 :%f",signalvalue1);
	write("i_S4_SRR_RL_Clu_Theta_196 :%f",@ecu_Signals::i_S4_SRR_RL_Clu_Theta_196);

	testStep("get expect variable value: ","i_S4_SRR_RL_Clu_Theta_196 :%f",@ecu_Signals::i_S4_SRR_RL_Clu_Theta_196);

	if((abs(@ecu_Signals::i_S4_SRR_RL_Clu_Theta_196)*0.9<=abs(signalvalue1))&&(abs(signalvalue1)<=abs(@ecu_Signals::i_S4_SRR_RL_Clu_Theta_196)*1.1))
	{
	testStepPass("Pass","i_S4_SRR_RL_Clu_Theta_196 :%f",signalvalue1);
	}
	else
	{
	testStepFail("Fail","i_S4_SRR_RL_Clu_Theta_196 :%f",signalvalue1);
	}
}

testcase S4_SRR_RL_Clu_Mes_28_S4_SRR_RL_Clu_Dist_196()
{
	signalvalue1 = getSignal(S4_SRR_RL_Clu_Dist_196);
	write("S4_SRR_RL_Clu_Dist_196 :%f",signalvalue1);
	write("i_S4_SRR_RL_Clu_Dist_196 :%f",@ecu_Signals::i_S4_SRR_RL_Clu_Dist_196);

	testStep("get expect variable value: ","i_S4_SRR_RL_Clu_Dist_196 :%f",@ecu_Signals::i_S4_SRR_RL_Clu_Dist_196);

	if((abs(@ecu_Signals::i_S4_SRR_RL_Clu_Dist_196)*0.9<=abs(signalvalue1))&&(abs(signalvalue1)<=abs(@ecu_Signals::i_S4_SRR_RL_Clu_Dist_196)*1.1))
	{
	testStepPass("Pass","i_S4_SRR_RL_Clu_Dist_196 :%f",signalvalue1);
	}
	else
	{
	testStepFail("Fail","i_S4_SRR_RL_Clu_Dist_196 :%f",signalvalue1);
	}
}

testcase S4_SRR_RL_Clu_Mes_28_S4_SRR_RL_Clu_Vel_196()
{
	signalvalue1 = getSignal(S4_SRR_RL_Clu_Vel_196);
	write("S4_SRR_RL_Clu_Vel_196 :%f",signalvalue1);
	write("i_S4_SRR_RL_Clu_Vel_196 :%f",@ecu_Signals::i_S4_SRR_RL_Clu_Vel_196);

	testStep("get expect variable value: ","i_S4_SRR_RL_Clu_Vel_196 :%f",@ecu_Signals::i_S4_SRR_RL_Clu_Vel_196);

	if((abs(@ecu_Signals::i_S4_SRR_RL_Clu_Vel_196)*0.9<=abs(signalvalue1))&&(abs(signalvalue1)<=abs(@ecu_Signals::i_S4_SRR_RL_Clu_Vel_196)*1.1))
	{
	testStepPass("Pass","i_S4_SRR_RL_Clu_Vel_196 :%f",signalvalue1);
	}
	else
	{
	testStepFail("Fail","i_S4_SRR_RL_Clu_Vel_196 :%f",signalvalue1);
	}
}

testcase S4_SRR_RL_Clu_Mes_28_S4_SRR_RL_Clu_SNR_196()
{
	signalvalue1 = getSignal(S4_SRR_RL_Clu_SNR_196);
	write("S4_SRR_RL_Clu_SNR_196 :%f",signalvalue1);
	write("i_S4_SRR_RL_Clu_SNR_196 :%f",@ecu_Signals::i_S4_SRR_RL_Clu_SNR_196);

	testStep("get expect variable value: ","i_S4_SRR_RL_Clu_SNR_196 :%f",@ecu_Signals::i_S4_SRR_RL_Clu_SNR_196);

	if((abs(@ecu_Signals::i_S4_SRR_RL_Clu_SNR_196)*0.9<=abs(signalvalue1))&&(abs(signalvalue1)<=abs(@ecu_Signals::i_S4_SRR_RL_Clu_SNR_196)*1.1))
	{
	testStepPass("Pass","i_S4_SRR_RL_Clu_SNR_196 :%f",signalvalue1);
	}
	else
	{
	testStepFail("Fail","i_S4_SRR_RL_Clu_SNR_196 :%f",signalvalue1);
	}
}

testcase S4_SRR_RL_Clu_Mes_28_S4_SRR_RL_Clu_DynProp_196()
{
	signalvalue1 = getSignal(S4_SRR_RL_Clu_DynProp_196);
	write("S4_SRR_RL_Clu_DynProp_196 :%f",signalvalue1);
	write("i_S4_SRR_RL_Clu_DynProp_196 :%o",@ecu_Signals::i_S4_SRR_RL_Clu_DynProp_196);

	testStep("get expect variable value: ","i_S4_SRR_RL_Clu_DynProp_196 :%o",@ecu_Signals::i_S4_SRR_RL_Clu_DynProp_196);

	if(signalvalue1==@ecu_Signals::i_S4_SRR_RL_Clu_DynProp_196)
	{
	testStepPass("Pass","i_S4_SRR_RL_Clu_DynProp_196 :%f",signalvalue1);
	}
	else
	{
	testStepFail("Fail","i_S4_SRR_RL_Clu_DynProp_196 :%f",signalvalue1);
	}
}

testcase S4_SRR_RL_Clu_Mes_28_S4_SRR_RL_Clu_Locationvalid_196()
{
	signalvalue1 = getSignal(S4_SRR_RL_Clu_Locationvalid_196);
	write("S4_SRR_RL_Clu_Locationvalid_196 :%f",signalvalue1);
	write("i_S4_SRR_RL_Clu_Locationvalid_196 :%o",@ecu_Signals::i_S4_SRR_RL_Clu_Locationvalid_196);

	testStep("get expect variable value: ","i_S4_SRR_RL_Clu_Locationvalid_196 :%o",@ecu_Signals::i_S4_SRR_RL_Clu_Locationvalid_196);

	if(signalvalue1==@ecu_Signals::i_S4_SRR_RL_Clu_Locationvalid_196)
	{
	testStepPass("Pass","i_S4_SRR_RL_Clu_Locationvalid_196 :%f",signalvalue1);
	}
	else
	{
	testStepFail("Fail","i_S4_SRR_RL_Clu_Locationvalid_196 :%f",signalvalue1);
	}
}

testcase S4_SRR_RL_Clu_Mes_28_S4_SRR_RL_Clu_Theta_197()
{
	signalvalue1 = getSignal(S4_SRR_RL_Clu_Theta_197);
	write("S4_SRR_RL_Clu_Theta_197 :%f",signalvalue1);
	write("i_S4_SRR_RL_Clu_Theta_197 :%f",@ecu_Signals::i_S4_SRR_RL_Clu_Theta_197);

	testStep("get expect variable value: ","i_S4_SRR_RL_Clu_Theta_197 :%f",@ecu_Signals::i_S4_SRR_RL_Clu_Theta_197);

	if((abs(@ecu_Signals::i_S4_SRR_RL_Clu_Theta_197)*0.9<=abs(signalvalue1))&&(abs(signalvalue1)<=abs(@ecu_Signals::i_S4_SRR_RL_Clu_Theta_197)*1.1))
	{
	testStepPass("Pass","i_S4_SRR_RL_Clu_Theta_197 :%f",signalvalue1);
	}
	else
	{
	testStepFail("Fail","i_S4_SRR_RL_Clu_Theta_197 :%f",signalvalue1);
	}
}

testcase S4_SRR_RL_Clu_Mes_28_S4_SRR_RL_Clu_Dist_197()
{
	signalvalue1 = getSignal(S4_SRR_RL_Clu_Dist_197);
	write("S4_SRR_RL_Clu_Dist_197 :%f",signalvalue1);
	write("i_S4_SRR_RL_Clu_Dist_197 :%f",@ecu_Signals::i_S4_SRR_RL_Clu_Dist_197);

	testStep("get expect variable value: ","i_S4_SRR_RL_Clu_Dist_197 :%f",@ecu_Signals::i_S4_SRR_RL_Clu_Dist_197);

	if((abs(@ecu_Signals::i_S4_SRR_RL_Clu_Dist_197)*0.9<=abs(signalvalue1))&&(abs(signalvalue1)<=abs(@ecu_Signals::i_S4_SRR_RL_Clu_Dist_197)*1.1))
	{
	testStepPass("Pass","i_S4_SRR_RL_Clu_Dist_197 :%f",signalvalue1);
	}
	else
	{
	testStepFail("Fail","i_S4_SRR_RL_Clu_Dist_197 :%f",signalvalue1);
	}
}

testcase S4_SRR_RL_Clu_Mes_28_S4_SRR_RL_Clu_Vel_197()
{
	signalvalue1 = getSignal(S4_SRR_RL_Clu_Vel_197);
	write("S4_SRR_RL_Clu_Vel_197 :%f",signalvalue1);
	write("i_S4_SRR_RL_Clu_Vel_197 :%f",@ecu_Signals::i_S4_SRR_RL_Clu_Vel_197);

	testStep("get expect variable value: ","i_S4_SRR_RL_Clu_Vel_197 :%f",@ecu_Signals::i_S4_SRR_RL_Clu_Vel_197);

	if((abs(@ecu_Signals::i_S4_SRR_RL_Clu_Vel_197)*0.9<=abs(signalvalue1))&&(abs(signalvalue1)<=abs(@ecu_Signals::i_S4_SRR_RL_Clu_Vel_197)*1.1))
	{
	testStepPass("Pass","i_S4_SRR_RL_Clu_Vel_197 :%f",signalvalue1);
	}
	else
	{
	testStepFail("Fail","i_S4_SRR_RL_Clu_Vel_197 :%f",signalvalue1);
	}
}

testcase S4_SRR_RL_Clu_Mes_28_S4_SRR_RL_Clu_SNR_197()
{
	signalvalue1 = getSignal(S4_SRR_RL_Clu_SNR_197);
	write("S4_SRR_RL_Clu_SNR_197 :%f",signalvalue1);
	write("i_S4_SRR_RL_Clu_SNR_197 :%f",@ecu_Signals::i_S4_SRR_RL_Clu_SNR_197);

	testStep("get expect variable value: ","i_S4_SRR_RL_Clu_SNR_197 :%f",@ecu_Signals::i_S4_SRR_RL_Clu_SNR_197);

	if((abs(@ecu_Signals::i_S4_SRR_RL_Clu_SNR_197)*0.9<=abs(signalvalue1))&&(abs(signalvalue1)<=abs(@ecu_Signals::i_S4_SRR_RL_Clu_SNR_197)*1.1))
	{
	testStepPass("Pass","i_S4_SRR_RL_Clu_SNR_197 :%f",signalvalue1);
	}
	else
	{
	testStepFail("Fail","i_S4_SRR_RL_Clu_SNR_197 :%f",signalvalue1);
	}
}

testcase S4_SRR_RL_Clu_Mes_28_S4_SRR_RL_Clu_DynProp_197()
{
	signalvalue1 = getSignal(S4_SRR_RL_Clu_DynProp_197);
	write("S4_SRR_RL_Clu_DynProp_197 :%f",signalvalue1);
	write("i_S4_SRR_RL_Clu_DynProp_197 :%o",@ecu_Signals::i_S4_SRR_RL_Clu_DynProp_197);

	testStep("get expect variable value: ","i_S4_SRR_RL_Clu_DynProp_197 :%o",@ecu_Signals::i_S4_SRR_RL_Clu_DynProp_197);

	if(signalvalue1==@ecu_Signals::i_S4_SRR_RL_Clu_DynProp_197)
	{
	testStepPass("Pass","i_S4_SRR_RL_Clu_DynProp_197 :%f",signalvalue1);
	}
	else
	{
	testStepFail("Fail","i_S4_SRR_RL_Clu_DynProp_197 :%f",signalvalue1);
	}
}

testcase S4_SRR_RL_Clu_Mes_28_S4_SRR_RL_Clu_Locationvalid_197()
{
	signalvalue1 = getSignal(S4_SRR_RL_Clu_Locationvalid_197);
	write("S4_SRR_RL_Clu_Locationvalid_197 :%f",signalvalue1);
	write("i_S4_SRR_RL_Clu_Locationvalid_197 :%o",@ecu_Signals::i_S4_SRR_RL_Clu_Locationvalid_197);

	testStep("get expect variable value: ","i_S4_SRR_RL_Clu_Locationvalid_197 :%o",@ecu_Signals::i_S4_SRR_RL_Clu_Locationvalid_197);

	if(signalvalue1==@ecu_Signals::i_S4_SRR_RL_Clu_Locationvalid_197)
	{
	testStepPass("Pass","i_S4_SRR_RL_Clu_Locationvalid_197 :%f",signalvalue1);
	}
	else
	{
	testStepFail("Fail","i_S4_SRR_RL_Clu_Locationvalid_197 :%f",signalvalue1);
	}
}

testcase S4_SRR_RL_Clu_Mes_28_S4_SRR_RL_Clu_Theta_198()
{
	signalvalue1 = getSignal(S4_SRR_RL_Clu_Theta_198);
	write("S4_SRR_RL_Clu_Theta_198 :%f",signalvalue1);
	write("i_S4_SRR_RL_Clu_Theta_198 :%f",@ecu_Signals::i_S4_SRR_RL_Clu_Theta_198);

	testStep("get expect variable value: ","i_S4_SRR_RL_Clu_Theta_198 :%f",@ecu_Signals::i_S4_SRR_RL_Clu_Theta_198);

	if((abs(@ecu_Signals::i_S4_SRR_RL_Clu_Theta_198)*0.9<=abs(signalvalue1))&&(abs(signalvalue1)<=abs(@ecu_Signals::i_S4_SRR_RL_Clu_Theta_198)*1.1))
	{
	testStepPass("Pass","i_S4_SRR_RL_Clu_Theta_198 :%f",signalvalue1);
	}
	else
	{
	testStepFail("Fail","i_S4_SRR_RL_Clu_Theta_198 :%f",signalvalue1);
	}
}

testcase S4_SRR_RL_Clu_Mes_28_S4_SRR_RL_Clu_Dist_198()
{
	signalvalue1 = getSignal(S4_SRR_RL_Clu_Dist_198);
	write("S4_SRR_RL_Clu_Dist_198 :%f",signalvalue1);
	write("i_S4_SRR_RL_Clu_Dist_198 :%f",@ecu_Signals::i_S4_SRR_RL_Clu_Dist_198);

	testStep("get expect variable value: ","i_S4_SRR_RL_Clu_Dist_198 :%f",@ecu_Signals::i_S4_SRR_RL_Clu_Dist_198);

	if((abs(@ecu_Signals::i_S4_SRR_RL_Clu_Dist_198)*0.9<=abs(signalvalue1))&&(abs(signalvalue1)<=abs(@ecu_Signals::i_S4_SRR_RL_Clu_Dist_198)*1.1))
	{
	testStepPass("Pass","i_S4_SRR_RL_Clu_Dist_198 :%f",signalvalue1);
	}
	else
	{
	testStepFail("Fail","i_S4_SRR_RL_Clu_Dist_198 :%f",signalvalue1);
	}
}

testcase S4_SRR_RL_Clu_Mes_28_S4_SRR_RL_Clu_Vel_198()
{
	signalvalue1 = getSignal(S4_SRR_RL_Clu_Vel_198);
	write("S4_SRR_RL_Clu_Vel_198 :%f",signalvalue1);
	write("i_S4_SRR_RL_Clu_Vel_198 :%f",@ecu_Signals::i_S4_SRR_RL_Clu_Vel_198);

	testStep("get expect variable value: ","i_S4_SRR_RL_Clu_Vel_198 :%f",@ecu_Signals::i_S4_SRR_RL_Clu_Vel_198);

	if((abs(@ecu_Signals::i_S4_SRR_RL_Clu_Vel_198)*0.9<=abs(signalvalue1))&&(abs(signalvalue1)<=abs(@ecu_Signals::i_S4_SRR_RL_Clu_Vel_198)*1.1))
	{
	testStepPass("Pass","i_S4_SRR_RL_Clu_Vel_198 :%f",signalvalue1);
	}
	else
	{
	testStepFail("Fail","i_S4_SRR_RL_Clu_Vel_198 :%f",signalvalue1);
	}
}

testcase S4_SRR_RL_Clu_Mes_28_S4_SRR_RL_Clu_SNR_198()
{
	signalvalue1 = getSignal(S4_SRR_RL_Clu_SNR_198);
	write("S4_SRR_RL_Clu_SNR_198 :%f",signalvalue1);
	write("i_S4_SRR_RL_Clu_SNR_198 :%f",@ecu_Signals::i_S4_SRR_RL_Clu_SNR_198);

	testStep("get expect variable value: ","i_S4_SRR_RL_Clu_SNR_198 :%f",@ecu_Signals::i_S4_SRR_RL_Clu_SNR_198);

	if((abs(@ecu_Signals::i_S4_SRR_RL_Clu_SNR_198)*0.9<=abs(signalvalue1))&&(abs(signalvalue1)<=abs(@ecu_Signals::i_S4_SRR_RL_Clu_SNR_198)*1.1))
	{
	testStepPass("Pass","i_S4_SRR_RL_Clu_SNR_198 :%f",signalvalue1);
	}
	else
	{
	testStepFail("Fail","i_S4_SRR_RL_Clu_SNR_198 :%f",signalvalue1);
	}
}

testcase S4_SRR_RL_Clu_Mes_28_S4_SRR_RL_Clu_DynProp_198()
{
	signalvalue1 = getSignal(S4_SRR_RL_Clu_DynProp_198);
	write("S4_SRR_RL_Clu_DynProp_198 :%f",signalvalue1);
	write("i_S4_SRR_RL_Clu_DynProp_198 :%o",@ecu_Signals::i_S4_SRR_RL_Clu_DynProp_198);

	testStep("get expect variable value: ","i_S4_SRR_RL_Clu_DynProp_198 :%o",@ecu_Signals::i_S4_SRR_RL_Clu_DynProp_198);

	if(signalvalue1==@ecu_Signals::i_S4_SRR_RL_Clu_DynProp_198)
	{
	testStepPass("Pass","i_S4_SRR_RL_Clu_DynProp_198 :%f",signalvalue1);
	}
	else
	{
	testStepFail("Fail","i_S4_SRR_RL_Clu_DynProp_198 :%f",signalvalue1);
	}
}

testcase S4_SRR_RL_Clu_Mes_28_S4_SRR_RL_Clu_Locationvalid_198()
{
	signalvalue1 = getSignal(S4_SRR_RL_Clu_Locationvalid_198);
	write("S4_SRR_RL_Clu_Locationvalid_198 :%f",signalvalue1);
	write("i_S4_SRR_RL_Clu_Locationvalid_198 :%o",@ecu_Signals::i_S4_SRR_RL_Clu_Locationvalid_198);

	testStep("get expect variable value: ","i_S4_SRR_RL_Clu_Locationvalid_198 :%o",@ecu_Signals::i_S4_SRR_RL_Clu_Locationvalid_198);

	if(signalvalue1==@ecu_Signals::i_S4_SRR_RL_Clu_Locationvalid_198)
	{
	testStepPass("Pass","i_S4_SRR_RL_Clu_Locationvalid_198 :%f",signalvalue1);
	}
	else
	{
	testStepFail("Fail","i_S4_SRR_RL_Clu_Locationvalid_198 :%f",signalvalue1);
	}
}

testcase S4_SRR_RL_Clu_Mes_28_S4_SRR_RL_Clu_Theta_199()
{
	signalvalue1 = getSignal(S4_SRR_RL_Clu_Theta_199);
	write("S4_SRR_RL_Clu_Theta_199 :%f",signalvalue1);
	write("i_S4_SRR_RL_Clu_Theta_199 :%f",@ecu_Signals::i_S4_SRR_RL_Clu_Theta_199);

	testStep("get expect variable value: ","i_S4_SRR_RL_Clu_Theta_199 :%f",@ecu_Signals::i_S4_SRR_RL_Clu_Theta_199);

	if((abs(@ecu_Signals::i_S4_SRR_RL_Clu_Theta_199)*0.9<=abs(signalvalue1))&&(abs(signalvalue1)<=abs(@ecu_Signals::i_S4_SRR_RL_Clu_Theta_199)*1.1))
	{
	testStepPass("Pass","i_S4_SRR_RL_Clu_Theta_199 :%f",signalvalue1);
	}
	else
	{
	testStepFail("Fail","i_S4_SRR_RL_Clu_Theta_199 :%f",signalvalue1);
	}
}

testcase S4_SRR_RL_Clu_Mes_28_S4_SRR_RL_Clu_Dist_199()
{
	signalvalue1 = getSignal(S4_SRR_RL_Clu_Dist_199);
	write("S4_SRR_RL_Clu_Dist_199 :%f",signalvalue1);
	write("i_S4_SRR_RL_Clu_Dist_199 :%f",@ecu_Signals::i_S4_SRR_RL_Clu_Dist_199);

	testStep("get expect variable value: ","i_S4_SRR_RL_Clu_Dist_199 :%f",@ecu_Signals::i_S4_SRR_RL_Clu_Dist_199);

	if((abs(@ecu_Signals::i_S4_SRR_RL_Clu_Dist_199)*0.9<=abs(signalvalue1))&&(abs(signalvalue1)<=abs(@ecu_Signals::i_S4_SRR_RL_Clu_Dist_199)*1.1))
	{
	testStepPass("Pass","i_S4_SRR_RL_Clu_Dist_199 :%f",signalvalue1);
	}
	else
	{
	testStepFail("Fail","i_S4_SRR_RL_Clu_Dist_199 :%f",signalvalue1);
	}
}

testcase S4_SRR_RL_Clu_Mes_28_S4_SRR_RL_Clu_Vel_199()
{
	signalvalue1 = getSignal(S4_SRR_RL_Clu_Vel_199);
	write("S4_SRR_RL_Clu_Vel_199 :%f",signalvalue1);
	write("i_S4_SRR_RL_Clu_Vel_199 :%f",@ecu_Signals::i_S4_SRR_RL_Clu_Vel_199);

	testStep("get expect variable value: ","i_S4_SRR_RL_Clu_Vel_199 :%f",@ecu_Signals::i_S4_SRR_RL_Clu_Vel_199);

	if((abs(@ecu_Signals::i_S4_SRR_RL_Clu_Vel_199)*0.9<=abs(signalvalue1))&&(abs(signalvalue1)<=abs(@ecu_Signals::i_S4_SRR_RL_Clu_Vel_199)*1.1))
	{
	testStepPass("Pass","i_S4_SRR_RL_Clu_Vel_199 :%f",signalvalue1);
	}
	else
	{
	testStepFail("Fail","i_S4_SRR_RL_Clu_Vel_199 :%f",signalvalue1);
	}
}

testcase S4_SRR_RL_Clu_Mes_28_S4_SRR_RL_Clu_SNR_199()
{
	signalvalue1 = getSignal(S4_SRR_RL_Clu_SNR_199);
	write("S4_SRR_RL_Clu_SNR_199 :%f",signalvalue1);
	write("i_S4_SRR_RL_Clu_SNR_199 :%f",@ecu_Signals::i_S4_SRR_RL_Clu_SNR_199);

	testStep("get expect variable value: ","i_S4_SRR_RL_Clu_SNR_199 :%f",@ecu_Signals::i_S4_SRR_RL_Clu_SNR_199);

	if((abs(@ecu_Signals::i_S4_SRR_RL_Clu_SNR_199)*0.9<=abs(signalvalue1))&&(abs(signalvalue1)<=abs(@ecu_Signals::i_S4_SRR_RL_Clu_SNR_199)*1.1))
	{
	testStepPass("Pass","i_S4_SRR_RL_Clu_SNR_199 :%f",signalvalue1);
	}
	else
	{
	testStepFail("Fail","i_S4_SRR_RL_Clu_SNR_199 :%f",signalvalue1);
	}
}

testcase S4_SRR_RL_Clu_Mes_28_S4_SRR_RL_Clu_DynProp_199()
{
	signalvalue1 = getSignal(S4_SRR_RL_Clu_DynProp_199);
	write("S4_SRR_RL_Clu_DynProp_199 :%f",signalvalue1);
	write("i_S4_SRR_RL_Clu_DynProp_199 :%o",@ecu_Signals::i_S4_SRR_RL_Clu_DynProp_199);

	testStep("get expect variable value: ","i_S4_SRR_RL_Clu_DynProp_199 :%o",@ecu_Signals::i_S4_SRR_RL_Clu_DynProp_199);

	if(signalvalue1==@ecu_Signals::i_S4_SRR_RL_Clu_DynProp_199)
	{
	testStepPass("Pass","i_S4_SRR_RL_Clu_DynProp_199 :%f",signalvalue1);
	}
	else
	{
	testStepFail("Fail","i_S4_SRR_RL_Clu_DynProp_199 :%f",signalvalue1);
	}
}

testcase S4_SRR_RL_Clu_Mes_28_S4_SRR_RL_Clu_Locationvalid_199()
{
	signalvalue1 = getSignal(S4_SRR_RL_Clu_Locationvalid_199);
	write("S4_SRR_RL_Clu_Locationvalid_199 :%f",signalvalue1);
	write("i_S4_SRR_RL_Clu_Locationvalid_199 :%o",@ecu_Signals::i_S4_SRR_RL_Clu_Locationvalid_199);

	testStep("get expect variable value: ","i_S4_SRR_RL_Clu_Locationvalid_199 :%o",@ecu_Signals::i_S4_SRR_RL_Clu_Locationvalid_199);

	if(signalvalue1==@ecu_Signals::i_S4_SRR_RL_Clu_Locationvalid_199)
	{
	testStepPass("Pass","i_S4_SRR_RL_Clu_Locationvalid_199 :%f",signalvalue1);
	}
	else
	{
	testStepFail("Fail","i_S4_SRR_RL_Clu_Locationvalid_199 :%f",signalvalue1);
	}
}

testcase S4_SRR_RL_Obj_Mes_0_S4_SRR_RL_Obj_ID_1()
{
	signalvalue1 = getSignal(S4_SRR_RL_Obj_ID_1);
	write("S4_SRR_RL_Obj_ID_1 :%f",signalvalue1);
	write("i_S4_SRR_RL_Obj_ID_1 :%o",@ecu_Signals::i_S4_SRR_RL_Obj_ID_1);

	testStep("get expect variable value: ","i_S4_SRR_RL_Obj_ID_1 :%o",@ecu_Signals::i_S4_SRR_RL_Obj_ID_1);

	if(signalvalue1==@ecu_Signals::i_S4_SRR_RL_Obj_ID_1)
	{
	testStepPass("Pass","i_S4_SRR_RL_Obj_ID_1 :%f",signalvalue1);
	}
	else
	{
	testStepFail("Fail","i_S4_SRR_RL_Obj_ID_1 :%f",signalvalue1);
	}
}

testcase S4_SRR_RL_Obj_Mes_0_S4_SRR_RL_Obj_DistX_1()
{
	signalvalue1 = getSignal(S4_SRR_RL_Obj_DistX_1);
	write("S4_SRR_RL_Obj_DistX_1 :%f",signalvalue1);
	write("i_S4_SRR_RL_Obj_DistX_1 :%f",@ecu_Signals::i_S4_SRR_RL_Obj_DistX_1);

	testStep("get expect variable value: ","i_S4_SRR_RL_Obj_DistX_1 :%f",@ecu_Signals::i_S4_SRR_RL_Obj_DistX_1);

	if((abs(@ecu_Signals::i_S4_SRR_RL_Obj_DistX_1)*0.9<=abs(signalvalue1))&&(abs(signalvalue1)<=abs(@ecu_Signals::i_S4_SRR_RL_Obj_DistX_1)*1.1))
	{
	testStepPass("Pass","i_S4_SRR_RL_Obj_DistX_1 :%f",signalvalue1);
	}
	else
	{
	testStepFail("Fail","i_S4_SRR_RL_Obj_DistX_1 :%f",signalvalue1);
	}
}

testcase S4_SRR_RL_Obj_Mes_0_S4_SRR_RL_Obj_RelVelX_1()
{
	signalvalue1 = getSignal(S4_SRR_RL_Obj_RelVelX_1);
	write("S4_SRR_RL_Obj_RelVelX_1 :%f",signalvalue1);
	write("i_S4_SRR_RL_Obj_RelVelX_1 :%f",@ecu_Signals::i_S4_SRR_RL_Obj_RelVelX_1);

	testStep("get expect variable value: ","i_S4_SRR_RL_Obj_RelVelX_1 :%f",@ecu_Signals::i_S4_SRR_RL_Obj_RelVelX_1);

	if((abs(@ecu_Signals::i_S4_SRR_RL_Obj_RelVelX_1)*0.9<=abs(signalvalue1))&&(abs(signalvalue1)<=abs(@ecu_Signals::i_S4_SRR_RL_Obj_RelVelX_1)*1.1))
	{
	testStepPass("Pass","i_S4_SRR_RL_Obj_RelVelX_1 :%f",signalvalue1);
	}
	else
	{
	testStepFail("Fail","i_S4_SRR_RL_Obj_RelVelX_1 :%f",signalvalue1);
	}
}

testcase S4_SRR_RL_Obj_Mes_0_S4_SRR_RL_Obj_AccelX_1()
{
	signalvalue1 = getSignal(S4_SRR_RL_Obj_AccelX_1);
	write("S4_SRR_RL_Obj_AccelX_1 :%f",signalvalue1);
	write("i_S4_SRR_RL_Obj_AccelX_1 :%f",@ecu_Signals::i_S4_SRR_RL_Obj_AccelX_1);

	testStep("get expect variable value: ","i_S4_SRR_RL_Obj_AccelX_1 :%f",@ecu_Signals::i_S4_SRR_RL_Obj_AccelX_1);

	if((abs(@ecu_Signals::i_S4_SRR_RL_Obj_AccelX_1)*0.9<=abs(signalvalue1))&&(abs(signalvalue1)<=abs(@ecu_Signals::i_S4_SRR_RL_Obj_AccelX_1)*1.1))
	{
	testStepPass("Pass","i_S4_SRR_RL_Obj_AccelX_1 :%f",signalvalue1);
	}
	else
	{
	testStepFail("Fail","i_S4_SRR_RL_Obj_AccelX_1 :%f",signalvalue1);
	}
}

testcase S4_SRR_RL_Obj_Mes_0_S4_SRR_RL_Obj_DistY_1()
{
	signalvalue1 = getSignal(S4_SRR_RL_Obj_DistY_1);
	write("S4_SRR_RL_Obj_DistY_1 :%f",signalvalue1);
	write("i_S4_SRR_RL_Obj_DistY_1 :%f",@ecu_Signals::i_S4_SRR_RL_Obj_DistY_1);

	testStep("get expect variable value: ","i_S4_SRR_RL_Obj_DistY_1 :%f",@ecu_Signals::i_S4_SRR_RL_Obj_DistY_1);

	if((abs(@ecu_Signals::i_S4_SRR_RL_Obj_DistY_1)*0.9<=abs(signalvalue1))&&(abs(signalvalue1)<=abs(@ecu_Signals::i_S4_SRR_RL_Obj_DistY_1)*1.1))
	{
	testStepPass("Pass","i_S4_SRR_RL_Obj_DistY_1 :%f",signalvalue1);
	}
	else
	{
	testStepFail("Fail","i_S4_SRR_RL_Obj_DistY_1 :%f",signalvalue1);
	}
}

testcase S4_SRR_RL_Obj_Mes_0_S4_SRR_RL_Obj_RelVelY_1()
{
	signalvalue1 = getSignal(S4_SRR_RL_Obj_RelVelY_1);
	write("S4_SRR_RL_Obj_RelVelY_1 :%f",signalvalue1);
	write("i_S4_SRR_RL_Obj_RelVelY_1 :%f",@ecu_Signals::i_S4_SRR_RL_Obj_RelVelY_1);

	testStep("get expect variable value: ","i_S4_SRR_RL_Obj_RelVelY_1 :%f",@ecu_Signals::i_S4_SRR_RL_Obj_RelVelY_1);

	if((abs(@ecu_Signals::i_S4_SRR_RL_Obj_RelVelY_1)*0.9<=abs(signalvalue1))&&(abs(signalvalue1)<=abs(@ecu_Signals::i_S4_SRR_RL_Obj_RelVelY_1)*1.1))
	{
	testStepPass("Pass","i_S4_SRR_RL_Obj_RelVelY_1 :%f",signalvalue1);
	}
	else
	{
	testStepFail("Fail","i_S4_SRR_RL_Obj_RelVelY_1 :%f",signalvalue1);
	}
}

testcase S4_SRR_RL_Obj_Mes_0_S4_SRR_RL_Obj_AccelY_1()
{
	signalvalue1 = getSignal(S4_SRR_RL_Obj_AccelY_1);
	write("S4_SRR_RL_Obj_AccelY_1 :%f",signalvalue1);
	write("i_S4_SRR_RL_Obj_AccelY_1 :%f",@ecu_Signals::i_S4_SRR_RL_Obj_AccelY_1);

	testStep("get expect variable value: ","i_S4_SRR_RL_Obj_AccelY_1 :%f",@ecu_Signals::i_S4_SRR_RL_Obj_AccelY_1);

	if((abs(@ecu_Signals::i_S4_SRR_RL_Obj_AccelY_1)*0.9<=abs(signalvalue1))&&(abs(signalvalue1)<=abs(@ecu_Signals::i_S4_SRR_RL_Obj_AccelY_1)*1.1))
	{
	testStepPass("Pass","i_S4_SRR_RL_Obj_AccelY_1 :%f",signalvalue1);
	}
	else
	{
	testStepFail("Fail","i_S4_SRR_RL_Obj_AccelY_1 :%f",signalvalue1);
	}
}

testcase S4_SRR_RL_Obj_Mes_0_S4_SRR_RL_Obj_DistXStd_1()
{
	signalvalue1 = getSignal(S4_SRR_RL_Obj_DistXStd_1);
	write("S4_SRR_RL_Obj_DistXStd_1 :%f",signalvalue1);
	write("i_S4_SRR_RL_Obj_DistXStd_1 :%f",@ecu_Signals::i_S4_SRR_RL_Obj_DistXStd_1);

	testStep("get expect variable value: ","i_S4_SRR_RL_Obj_DistXStd_1 :%f",@ecu_Signals::i_S4_SRR_RL_Obj_DistXStd_1);

	if((abs(@ecu_Signals::i_S4_SRR_RL_Obj_DistXStd_1)*0.9<=abs(signalvalue1))&&(abs(signalvalue1)<=abs(@ecu_Signals::i_S4_SRR_RL_Obj_DistXStd_1)*1.1))
	{
	testStepPass("Pass","i_S4_SRR_RL_Obj_DistXStd_1 :%f",signalvalue1);
	}
	else
	{
	testStepFail("Fail","i_S4_SRR_RL_Obj_DistXStd_1 :%f",signalvalue1);
	}
}

testcase S4_SRR_RL_Obj_Mes_0_S4_SRR_RL_Obj_RelVelXStd_1()
{
	signalvalue1 = getSignal(S4_SRR_RL_Obj_RelVelXStd_1);
	write("S4_SRR_RL_Obj_RelVelXStd_1 :%f",signalvalue1);
	write("i_S4_SRR_RL_Obj_RelVelXStd_1 :%f",@ecu_Signals::i_S4_SRR_RL_Obj_RelVelXStd_1);

	testStep("get expect variable value: ","i_S4_SRR_RL_Obj_RelVelXStd_1 :%f",@ecu_Signals::i_S4_SRR_RL_Obj_RelVelXStd_1);

	if((abs(@ecu_Signals::i_S4_SRR_RL_Obj_RelVelXStd_1)*0.9<=abs(signalvalue1))&&(abs(signalvalue1)<=abs(@ecu_Signals::i_S4_SRR_RL_Obj_RelVelXStd_1)*1.1))
	{
	testStepPass("Pass","i_S4_SRR_RL_Obj_RelVelXStd_1 :%f",signalvalue1);
	}
	else
	{
	testStepFail("Fail","i_S4_SRR_RL_Obj_RelVelXStd_1 :%f",signalvalue1);
	}
}

testcase S4_SRR_RL_Obj_Mes_0_S4_SRR_RL_Obj_DistYStd_1()
{
	signalvalue1 = getSignal(S4_SRR_RL_Obj_DistYStd_1);
	write("S4_SRR_RL_Obj_DistYStd_1 :%f",signalvalue1);
	write("i_S4_SRR_RL_Obj_DistYStd_1 :%f",@ecu_Signals::i_S4_SRR_RL_Obj_DistYStd_1);

	testStep("get expect variable value: ","i_S4_SRR_RL_Obj_DistYStd_1 :%f",@ecu_Signals::i_S4_SRR_RL_Obj_DistYStd_1);

	if((abs(@ecu_Signals::i_S4_SRR_RL_Obj_DistYStd_1)*0.9<=abs(signalvalue1))&&(abs(signalvalue1)<=abs(@ecu_Signals::i_S4_SRR_RL_Obj_DistYStd_1)*1.1))
	{
	testStepPass("Pass","i_S4_SRR_RL_Obj_DistYStd_1 :%f",signalvalue1);
	}
	else
	{
	testStepFail("Fail","i_S4_SRR_RL_Obj_DistYStd_1 :%f",signalvalue1);
	}
}

testcase S4_SRR_RL_Obj_Mes_0_S4_SRR_RL_Obj_RelVelYStd_1()
{
	signalvalue1 = getSignal(S4_SRR_RL_Obj_RelVelYStd_1);
	write("S4_SRR_RL_Obj_RelVelYStd_1 :%f",signalvalue1);
	write("i_S4_SRR_RL_Obj_RelVelYStd_1 :%f",@ecu_Signals::i_S4_SRR_RL_Obj_RelVelYStd_1);

	testStep("get expect variable value: ","i_S4_SRR_RL_Obj_RelVelYStd_1 :%f",@ecu_Signals::i_S4_SRR_RL_Obj_RelVelYStd_1);

	if((abs(@ecu_Signals::i_S4_SRR_RL_Obj_RelVelYStd_1)*0.9<=abs(signalvalue1))&&(abs(signalvalue1)<=abs(@ecu_Signals::i_S4_SRR_RL_Obj_RelVelYStd_1)*1.1))
	{
	testStepPass("Pass","i_S4_SRR_RL_Obj_RelVelYStd_1 :%f",signalvalue1);
	}
	else
	{
	testStepFail("Fail","i_S4_SRR_RL_Obj_RelVelYStd_1 :%f",signalvalue1);
	}
}

testcase S4_SRR_RL_Obj_Mes_0_S4_SRR_RL_Obj_UpdateFlag_1()
{
	signalvalue1 = getSignal(S4_SRR_RL_Obj_UpdateFlag_1);
	write("S4_SRR_RL_Obj_UpdateFlag_1 :%f",signalvalue1);
	write("i_S4_SRR_RL_Obj_UpdateFlag_1 :%o",@ecu_Signals::i_S4_SRR_RL_Obj_UpdateFlag_1);

	testStep("get expect variable value: ","i_S4_SRR_RL_Obj_UpdateFlag_1 :%o",@ecu_Signals::i_S4_SRR_RL_Obj_UpdateFlag_1);

	if(signalvalue1==@ecu_Signals::i_S4_SRR_RL_Obj_UpdateFlag_1)
	{
	testStepPass("Pass","i_S4_SRR_RL_Obj_UpdateFlag_1 :%f",signalvalue1);
	}
	else
	{
	testStepFail("Fail","i_S4_SRR_RL_Obj_UpdateFlag_1 :%f",signalvalue1);
	}
}

testcase S4_SRR_RL_Obj_Mes_0_S4_SRR_RL_Obj_ExistProb_1()
{
	signalvalue1 = getSignal(S4_SRR_RL_Obj_ExistProb_1);
	write("S4_SRR_RL_Obj_ExistProb_1 :%f",signalvalue1);
	write("i_S4_SRR_RL_Obj_ExistProb_1 :%o",@ecu_Signals::i_S4_SRR_RL_Obj_ExistProb_1);

	testStep("get expect variable value: ","i_S4_SRR_RL_Obj_ExistProb_1 :%o",@ecu_Signals::i_S4_SRR_RL_Obj_ExistProb_1);

	if(signalvalue1==@ecu_Signals::i_S4_SRR_RL_Obj_ExistProb_1)
	{
	testStepPass("Pass","i_S4_SRR_RL_Obj_ExistProb_1 :%f",signalvalue1);
	}
	else
	{
	testStepFail("Fail","i_S4_SRR_RL_Obj_ExistProb_1 :%f",signalvalue1);
	}
}

testcase S4_SRR_RL_Obj_Mes_0_S4_SRR_RL_Obj_Type_1()
{
	signalvalue1 = getSignal(S4_SRR_RL_Obj_Type_1);
	write("S4_SRR_RL_Obj_Type_1 :%f",signalvalue1);
	write("i_S4_SRR_RL_Obj_Type_1 :%o",@ecu_Signals::i_S4_SRR_RL_Obj_Type_1);

	testStep("get expect variable value: ","i_S4_SRR_RL_Obj_Type_1 :%o",@ecu_Signals::i_S4_SRR_RL_Obj_Type_1);

	if(signalvalue1==@ecu_Signals::i_S4_SRR_RL_Obj_Type_1)
	{
	testStepPass("Pass","i_S4_SRR_RL_Obj_Type_1 :%f",signalvalue1);
	}
	else
	{
	testStepFail("Fail","i_S4_SRR_RL_Obj_Type_1 :%f",signalvalue1);
	}
}

testcase S4_SRR_RL_Obj_Mes_0_S4_SRR_RL_Obj_EDynProp_1()
{
	signalvalue1 = getSignal(S4_SRR_RL_Obj_EDynProp_1);
	write("S4_SRR_RL_Obj_EDynProp_1 :%f",signalvalue1);
	write("i_S4_SRR_RL_Obj_EDynProp_1 :%o",@ecu_Signals::i_S4_SRR_RL_Obj_EDynProp_1);

	testStep("get expect variable value: ","i_S4_SRR_RL_Obj_EDynProp_1 :%o",@ecu_Signals::i_S4_SRR_RL_Obj_EDynProp_1);

	if(signalvalue1==@ecu_Signals::i_S4_SRR_RL_Obj_EDynProp_1)
	{
	testStepPass("Pass","i_S4_SRR_RL_Obj_EDynProp_1 :%f",signalvalue1);
	}
	else
	{
	testStepFail("Fail","i_S4_SRR_RL_Obj_EDynProp_1 :%f",signalvalue1);
	}
}

testcase S4_SRR_RL_Obj_Mes_0_S4_SRR_RL_Obj_UiLifeCycles_1()
{
	signalvalue1 = getSignal(S4_SRR_RL_Obj_UiLifeCycles_1);
	write("S4_SRR_RL_Obj_UiLifeCycles_1 :%f",signalvalue1);
	write("i_S4_SRR_RL_Obj_UiLifeCycles_1 :%o",@ecu_Signals::i_S4_SRR_RL_Obj_UiLifeCycles_1);

	testStep("get expect variable value: ","i_S4_SRR_RL_Obj_UiLifeCycles_1 :%o",@ecu_Signals::i_S4_SRR_RL_Obj_UiLifeCycles_1);

	if(signalvalue1==@ecu_Signals::i_S4_SRR_RL_Obj_UiLifeCycles_1)
	{
	testStepPass("Pass","i_S4_SRR_RL_Obj_UiLifeCycles_1 :%f",signalvalue1);
	}
	else
	{
	testStepFail("Fail","i_S4_SRR_RL_Obj_UiLifeCycles_1 :%f",signalvalue1);
	}
}

testcase S4_SRR_RL_Obj_Mes_0_S4_SRR_RL_Obj_ID_2()
{
	signalvalue1 = getSignal(S4_SRR_RL_Obj_ID_2);
	write("S4_SRR_RL_Obj_ID_2 :%f",signalvalue1);
	write("i_S4_SRR_RL_Obj_ID_2 :%o",@ecu_Signals::i_S4_SRR_RL_Obj_ID_2);

	testStep("get expect variable value: ","i_S4_SRR_RL_Obj_ID_2 :%o",@ecu_Signals::i_S4_SRR_RL_Obj_ID_2);

	if(signalvalue1==@ecu_Signals::i_S4_SRR_RL_Obj_ID_2)
	{
	testStepPass("Pass","i_S4_SRR_RL_Obj_ID_2 :%f",signalvalue1);
	}
	else
	{
	testStepFail("Fail","i_S4_SRR_RL_Obj_ID_2 :%f",signalvalue1);
	}
}

testcase S4_SRR_RL_Obj_Mes_0_S4_SRR_RL_Obj_DistX_2()
{
	signalvalue1 = getSignal(S4_SRR_RL_Obj_DistX_2);
	write("S4_SRR_RL_Obj_DistX_2 :%f",signalvalue1);
	write("i_S4_SRR_RL_Obj_DistX_2 :%f",@ecu_Signals::i_S4_SRR_RL_Obj_DistX_2);

	testStep("get expect variable value: ","i_S4_SRR_RL_Obj_DistX_2 :%f",@ecu_Signals::i_S4_SRR_RL_Obj_DistX_2);

	if((abs(@ecu_Signals::i_S4_SRR_RL_Obj_DistX_2)*0.9<=abs(signalvalue1))&&(abs(signalvalue1)<=abs(@ecu_Signals::i_S4_SRR_RL_Obj_DistX_2)*1.1))
	{
	testStepPass("Pass","i_S4_SRR_RL_Obj_DistX_2 :%f",signalvalue1);
	}
	else
	{
	testStepFail("Fail","i_S4_SRR_RL_Obj_DistX_2 :%f",signalvalue1);
	}
}

testcase S4_SRR_RL_Obj_Mes_0_S4_SRR_RL_Obj_RelVelX_2()
{
	signalvalue1 = getSignal(S4_SRR_RL_Obj_RelVelX_2);
	write("S4_SRR_RL_Obj_RelVelX_2 :%f",signalvalue1);
	write("i_S4_SRR_RL_Obj_RelVelX_2 :%f",@ecu_Signals::i_S4_SRR_RL_Obj_RelVelX_2);

	testStep("get expect variable value: ","i_S4_SRR_RL_Obj_RelVelX_2 :%f",@ecu_Signals::i_S4_SRR_RL_Obj_RelVelX_2);

	if((abs(@ecu_Signals::i_S4_SRR_RL_Obj_RelVelX_2)*0.9<=abs(signalvalue1))&&(abs(signalvalue1)<=abs(@ecu_Signals::i_S4_SRR_RL_Obj_RelVelX_2)*1.1))
	{
	testStepPass("Pass","i_S4_SRR_RL_Obj_RelVelX_2 :%f",signalvalue1);
	}
	else
	{
	testStepFail("Fail","i_S4_SRR_RL_Obj_RelVelX_2 :%f",signalvalue1);
	}
}

testcase S4_SRR_RL_Obj_Mes_0_S4_SRR_RL_Obj_AccelX_2()
{
	signalvalue1 = getSignal(S4_SRR_RL_Obj_AccelX_2);
	write("S4_SRR_RL_Obj_AccelX_2 :%f",signalvalue1);
	write("i_S4_SRR_RL_Obj_AccelX_2 :%f",@ecu_Signals::i_S4_SRR_RL_Obj_AccelX_2);

	testStep("get expect variable value: ","i_S4_SRR_RL_Obj_AccelX_2 :%f",@ecu_Signals::i_S4_SRR_RL_Obj_AccelX_2);

	if((abs(@ecu_Signals::i_S4_SRR_RL_Obj_AccelX_2)*0.9<=abs(signalvalue1))&&(abs(signalvalue1)<=abs(@ecu_Signals::i_S4_SRR_RL_Obj_AccelX_2)*1.1))
	{
	testStepPass("Pass","i_S4_SRR_RL_Obj_AccelX_2 :%f",signalvalue1);
	}
	else
	{
	testStepFail("Fail","i_S4_SRR_RL_Obj_AccelX_2 :%f",signalvalue1);
	}
}

testcase S4_SRR_RL_Obj_Mes_0_S4_SRR_RL_Obj_DistY_2()
{
	signalvalue1 = getSignal(S4_SRR_RL_Obj_DistY_2);
	write("S4_SRR_RL_Obj_DistY_2 :%f",signalvalue1);
	write("i_S4_SRR_RL_Obj_DistY_2 :%f",@ecu_Signals::i_S4_SRR_RL_Obj_DistY_2);

	testStep("get expect variable value: ","i_S4_SRR_RL_Obj_DistY_2 :%f",@ecu_Signals::i_S4_SRR_RL_Obj_DistY_2);

	if((abs(@ecu_Signals::i_S4_SRR_RL_Obj_DistY_2)*0.9<=abs(signalvalue1))&&(abs(signalvalue1)<=abs(@ecu_Signals::i_S4_SRR_RL_Obj_DistY_2)*1.1))
	{
	testStepPass("Pass","i_S4_SRR_RL_Obj_DistY_2 :%f",signalvalue1);
	}
	else
	{
	testStepFail("Fail","i_S4_SRR_RL_Obj_DistY_2 :%f",signalvalue1);
	}
}

testcase S4_SRR_RL_Obj_Mes_0_S4_SRR_RL_Obj_RelVelY_2()
{
	signalvalue1 = getSignal(S4_SRR_RL_Obj_RelVelY_2);
	write("S4_SRR_RL_Obj_RelVelY_2 :%f",signalvalue1);
	write("i_S4_SRR_RL_Obj_RelVelY_2 :%f",@ecu_Signals::i_S4_SRR_RL_Obj_RelVelY_2);

	testStep("get expect variable value: ","i_S4_SRR_RL_Obj_RelVelY_2 :%f",@ecu_Signals::i_S4_SRR_RL_Obj_RelVelY_2);

	if((abs(@ecu_Signals::i_S4_SRR_RL_Obj_RelVelY_2)*0.9<=abs(signalvalue1))&&(abs(signalvalue1)<=abs(@ecu_Signals::i_S4_SRR_RL_Obj_RelVelY_2)*1.1))
	{
	testStepPass("Pass","i_S4_SRR_RL_Obj_RelVelY_2 :%f",signalvalue1);
	}
	else
	{
	testStepFail("Fail","i_S4_SRR_RL_Obj_RelVelY_2 :%f",signalvalue1);
	}
}

testcase S4_SRR_RL_Obj_Mes_0_S4_SRR_RL_Obj_AccelY_2()
{
	signalvalue1 = getSignal(S4_SRR_RL_Obj_AccelY_2);
	write("S4_SRR_RL_Obj_AccelY_2 :%f",signalvalue1);
	write("i_S4_SRR_RL_Obj_AccelY_2 :%f",@ecu_Signals::i_S4_SRR_RL_Obj_AccelY_2);

	testStep("get expect variable value: ","i_S4_SRR_RL_Obj_AccelY_2 :%f",@ecu_Signals::i_S4_SRR_RL_Obj_AccelY_2);

	if((abs(@ecu_Signals::i_S4_SRR_RL_Obj_AccelY_2)*0.9<=abs(signalvalue1))&&(abs(signalvalue1)<=abs(@ecu_Signals::i_S4_SRR_RL_Obj_AccelY_2)*1.1))
	{
	testStepPass("Pass","i_S4_SRR_RL_Obj_AccelY_2 :%f",signalvalue1);
	}
	else
	{
	testStepFail("Fail","i_S4_SRR_RL_Obj_AccelY_2 :%f",signalvalue1);
	}
}

testcase S4_SRR_RL_Obj_Mes_0_S4_SRR_RL_Obj_DistXStd_2()
{
	signalvalue1 = getSignal(S4_SRR_RL_Obj_DistXStd_2);
	write("S4_SRR_RL_Obj_DistXStd_2 :%f",signalvalue1);
	write("i_S4_SRR_RL_Obj_DistXStd_2 :%f",@ecu_Signals::i_S4_SRR_RL_Obj_DistXStd_2);

	testStep("get expect variable value: ","i_S4_SRR_RL_Obj_DistXStd_2 :%f",@ecu_Signals::i_S4_SRR_RL_Obj_DistXStd_2);

	if((abs(@ecu_Signals::i_S4_SRR_RL_Obj_DistXStd_2)*0.9<=abs(signalvalue1))&&(abs(signalvalue1)<=abs(@ecu_Signals::i_S4_SRR_RL_Obj_DistXStd_2)*1.1))
	{
	testStepPass("Pass","i_S4_SRR_RL_Obj_DistXStd_2 :%f",signalvalue1);
	}
	else
	{
	testStepFail("Fail","i_S4_SRR_RL_Obj_DistXStd_2 :%f",signalvalue1);
	}
}

testcase S4_SRR_RL_Obj_Mes_0_S4_SRR_RL_Obj_RelVelXStd_2()
{
	signalvalue1 = getSignal(S4_SRR_RL_Obj_RelVelXStd_2);
	write("S4_SRR_RL_Obj_RelVelXStd_2 :%f",signalvalue1);
	write("i_S4_SRR_RL_Obj_RelVelXStd_2 :%f",@ecu_Signals::i_S4_SRR_RL_Obj_RelVelXStd_2);

	testStep("get expect variable value: ","i_S4_SRR_RL_Obj_RelVelXStd_2 :%f",@ecu_Signals::i_S4_SRR_RL_Obj_RelVelXStd_2);

	if((abs(@ecu_Signals::i_S4_SRR_RL_Obj_RelVelXStd_2)*0.9<=abs(signalvalue1))&&(abs(signalvalue1)<=abs(@ecu_Signals::i_S4_SRR_RL_Obj_RelVelXStd_2)*1.1))
	{
	testStepPass("Pass","i_S4_SRR_RL_Obj_RelVelXStd_2 :%f",signalvalue1);
	}
	else
	{
	testStepFail("Fail","i_S4_SRR_RL_Obj_RelVelXStd_2 :%f",signalvalue1);
	}
}

testcase S4_SRR_RL_Obj_Mes_0_S4_SRR_RL_Obj_DistYStd_2()
{
	signalvalue1 = getSignal(S4_SRR_RL_Obj_DistYStd_2);
	write("S4_SRR_RL_Obj_DistYStd_2 :%f",signalvalue1);
	write("i_S4_SRR_RL_Obj_DistYStd_2 :%f",@ecu_Signals::i_S4_SRR_RL_Obj_DistYStd_2);

	testStep("get expect variable value: ","i_S4_SRR_RL_Obj_DistYStd_2 :%f",@ecu_Signals::i_S4_SRR_RL_Obj_DistYStd_2);

	if((abs(@ecu_Signals::i_S4_SRR_RL_Obj_DistYStd_2)*0.9<=abs(signalvalue1))&&(abs(signalvalue1)<=abs(@ecu_Signals::i_S4_SRR_RL_Obj_DistYStd_2)*1.1))
	{
	testStepPass("Pass","i_S4_SRR_RL_Obj_DistYStd_2 :%f",signalvalue1);
	}
	else
	{
	testStepFail("Fail","i_S4_SRR_RL_Obj_DistYStd_2 :%f",signalvalue1);
	}
}

testcase S4_SRR_RL_Obj_Mes_0_S4_SRR_RL_Obj_RelVelYStd_2()
{
	signalvalue1 = getSignal(S4_SRR_RL_Obj_RelVelYStd_2);
	write("S4_SRR_RL_Obj_RelVelYStd_2 :%f",signalvalue1);
	write("i_S4_SRR_RL_Obj_RelVelYStd_2 :%f",@ecu_Signals::i_S4_SRR_RL_Obj_RelVelYStd_2);

	testStep("get expect variable value: ","i_S4_SRR_RL_Obj_RelVelYStd_2 :%f",@ecu_Signals::i_S4_SRR_RL_Obj_RelVelYStd_2);

	if((abs(@ecu_Signals::i_S4_SRR_RL_Obj_RelVelYStd_2)*0.9<=abs(signalvalue1))&&(abs(signalvalue1)<=abs(@ecu_Signals::i_S4_SRR_RL_Obj_RelVelYStd_2)*1.1))
	{
	testStepPass("Pass","i_S4_SRR_RL_Obj_RelVelYStd_2 :%f",signalvalue1);
	}
	else
	{
	testStepFail("Fail","i_S4_SRR_RL_Obj_RelVelYStd_2 :%f",signalvalue1);
	}
}

testcase S4_SRR_RL_Obj_Mes_0_S4_SRR_RL_Obj_UpdateFlag_2()
{
	signalvalue1 = getSignal(S4_SRR_RL_Obj_UpdateFlag_2);
	write("S4_SRR_RL_Obj_UpdateFlag_2 :%f",signalvalue1);
	write("i_S4_SRR_RL_Obj_UpdateFlag_2 :%o",@ecu_Signals::i_S4_SRR_RL_Obj_UpdateFlag_2);

	testStep("get expect variable value: ","i_S4_SRR_RL_Obj_UpdateFlag_2 :%o",@ecu_Signals::i_S4_SRR_RL_Obj_UpdateFlag_2);

	if(signalvalue1==@ecu_Signals::i_S4_SRR_RL_Obj_UpdateFlag_2)
	{
	testStepPass("Pass","i_S4_SRR_RL_Obj_UpdateFlag_2 :%f",signalvalue1);
	}
	else
	{
	testStepFail("Fail","i_S4_SRR_RL_Obj_UpdateFlag_2 :%f",signalvalue1);
	}
}

testcase S4_SRR_RL_Obj_Mes_0_S4_SRR_RL_Obj_ExistProb_2()
{
	signalvalue1 = getSignal(S4_SRR_RL_Obj_ExistProb_2);
	write("S4_SRR_RL_Obj_ExistProb_2 :%f",signalvalue1);
	write("i_S4_SRR_RL_Obj_ExistProb_2 :%o",@ecu_Signals::i_S4_SRR_RL_Obj_ExistProb_2);

	testStep("get expect variable value: ","i_S4_SRR_RL_Obj_ExistProb_2 :%o",@ecu_Signals::i_S4_SRR_RL_Obj_ExistProb_2);

	if(signalvalue1==@ecu_Signals::i_S4_SRR_RL_Obj_ExistProb_2)
	{
	testStepPass("Pass","i_S4_SRR_RL_Obj_ExistProb_2 :%f",signalvalue1);
	}
	else
	{
	testStepFail("Fail","i_S4_SRR_RL_Obj_ExistProb_2 :%f",signalvalue1);
	}
}

testcase S4_SRR_RL_Obj_Mes_0_S4_SRR_RL_Obj_Type_2()
{
	signalvalue1 = getSignal(S4_SRR_RL_Obj_Type_2);
	write("S4_SRR_RL_Obj_Type_2 :%f",signalvalue1);
	write("i_S4_SRR_RL_Obj_Type_2 :%o",@ecu_Signals::i_S4_SRR_RL_Obj_Type_2);

	testStep("get expect variable value: ","i_S4_SRR_RL_Obj_Type_2 :%o",@ecu_Signals::i_S4_SRR_RL_Obj_Type_2);

	if(signalvalue1==@ecu_Signals::i_S4_SRR_RL_Obj_Type_2)
	{
	testStepPass("Pass","i_S4_SRR_RL_Obj_Type_2 :%f",signalvalue1);
	}
	else
	{
	testStepFail("Fail","i_S4_SRR_RL_Obj_Type_2 :%f",signalvalue1);
	}
}

testcase S4_SRR_RL_Obj_Mes_0_S4_SRR_RL_Obj_EDynProp_2()
{
	signalvalue1 = getSignal(S4_SRR_RL_Obj_EDynProp_2);
	write("S4_SRR_RL_Obj_EDynProp_2 :%f",signalvalue1);
	write("i_S4_SRR_RL_Obj_EDynProp_2 :%o",@ecu_Signals::i_S4_SRR_RL_Obj_EDynProp_2);

	testStep("get expect variable value: ","i_S4_SRR_RL_Obj_EDynProp_2 :%o",@ecu_Signals::i_S4_SRR_RL_Obj_EDynProp_2);

	if(signalvalue1==@ecu_Signals::i_S4_SRR_RL_Obj_EDynProp_2)
	{
	testStepPass("Pass","i_S4_SRR_RL_Obj_EDynProp_2 :%f",signalvalue1);
	}
	else
	{
	testStepFail("Fail","i_S4_SRR_RL_Obj_EDynProp_2 :%f",signalvalue1);
	}
}

testcase S4_SRR_RL_Obj_Mes_0_S4_SRR_RL_Obj_UiLifeCycles_2()
{
	signalvalue1 = getSignal(S4_SRR_RL_Obj_UiLifeCycles_2);
	write("S4_SRR_RL_Obj_UiLifeCycles_2 :%f",signalvalue1);
	write("i_S4_SRR_RL_Obj_UiLifeCycles_2 :%o",@ecu_Signals::i_S4_SRR_RL_Obj_UiLifeCycles_2);

	testStep("get expect variable value: ","i_S4_SRR_RL_Obj_UiLifeCycles_2 :%o",@ecu_Signals::i_S4_SRR_RL_Obj_UiLifeCycles_2);

	if(signalvalue1==@ecu_Signals::i_S4_SRR_RL_Obj_UiLifeCycles_2)
	{
	testStepPass("Pass","i_S4_SRR_RL_Obj_UiLifeCycles_2 :%f",signalvalue1);
	}
	else
	{
	testStepFail("Fail","i_S4_SRR_RL_Obj_UiLifeCycles_2 :%f",signalvalue1);
	}
}

testcase S4_SRR_RL_Obj_Mes_1_S4_SRR_RL_Obj_ID_3()
{
	signalvalue1 = getSignal(S4_SRR_RL_Obj_ID_3);
	write("S4_SRR_RL_Obj_ID_3 :%f",signalvalue1);
	write("i_S4_SRR_RL_Obj_ID_3 :%o",@ecu_Signals::i_S4_SRR_RL_Obj_ID_3);

	testStep("get expect variable value: ","i_S4_SRR_RL_Obj_ID_3 :%o",@ecu_Signals::i_S4_SRR_RL_Obj_ID_3);

	if(signalvalue1==@ecu_Signals::i_S4_SRR_RL_Obj_ID_3)
	{
	testStepPass("Pass","i_S4_SRR_RL_Obj_ID_3 :%f",signalvalue1);
	}
	else
	{
	testStepFail("Fail","i_S4_SRR_RL_Obj_ID_3 :%f",signalvalue1);
	}
}

testcase S4_SRR_RL_Obj_Mes_1_S4_SRR_RL_Obj_DistX_3()
{
	signalvalue1 = getSignal(S4_SRR_RL_Obj_DistX_3);
	write("S4_SRR_RL_Obj_DistX_3 :%f",signalvalue1);
	write("i_S4_SRR_RL_Obj_DistX_3 :%f",@ecu_Signals::i_S4_SRR_RL_Obj_DistX_3);

	testStep("get expect variable value: ","i_S4_SRR_RL_Obj_DistX_3 :%f",@ecu_Signals::i_S4_SRR_RL_Obj_DistX_3);

	if((abs(@ecu_Signals::i_S4_SRR_RL_Obj_DistX_3)*0.9<=abs(signalvalue1))&&(abs(signalvalue1)<=abs(@ecu_Signals::i_S4_SRR_RL_Obj_DistX_3)*1.1))
	{
	testStepPass("Pass","i_S4_SRR_RL_Obj_DistX_3 :%f",signalvalue1);
	}
	else
	{
	testStepFail("Fail","i_S4_SRR_RL_Obj_DistX_3 :%f",signalvalue1);
	}
}

testcase S4_SRR_RL_Obj_Mes_1_S4_SRR_RL_Obj_RelVelX_3()
{
	signalvalue1 = getSignal(S4_SRR_RL_Obj_RelVelX_3);
	write("S4_SRR_RL_Obj_RelVelX_3 :%f",signalvalue1);
	write("i_S4_SRR_RL_Obj_RelVelX_3 :%f",@ecu_Signals::i_S4_SRR_RL_Obj_RelVelX_3);

	testStep("get expect variable value: ","i_S4_SRR_RL_Obj_RelVelX_3 :%f",@ecu_Signals::i_S4_SRR_RL_Obj_RelVelX_3);

	if((abs(@ecu_Signals::i_S4_SRR_RL_Obj_RelVelX_3)*0.9<=abs(signalvalue1))&&(abs(signalvalue1)<=abs(@ecu_Signals::i_S4_SRR_RL_Obj_RelVelX_3)*1.1))
	{
	testStepPass("Pass","i_S4_SRR_RL_Obj_RelVelX_3 :%f",signalvalue1);
	}
	else
	{
	testStepFail("Fail","i_S4_SRR_RL_Obj_RelVelX_3 :%f",signalvalue1);
	}
}

testcase S4_SRR_RL_Obj_Mes_1_S4_SRR_RL_Obj_AccelX_3()
{
	signalvalue1 = getSignal(S4_SRR_RL_Obj_AccelX_3);
	write("S4_SRR_RL_Obj_AccelX_3 :%f",signalvalue1);
	write("i_S4_SRR_RL_Obj_AccelX_3 :%f",@ecu_Signals::i_S4_SRR_RL_Obj_AccelX_3);

	testStep("get expect variable value: ","i_S4_SRR_RL_Obj_AccelX_3 :%f",@ecu_Signals::i_S4_SRR_RL_Obj_AccelX_3);

	if((abs(@ecu_Signals::i_S4_SRR_RL_Obj_AccelX_3)*0.9<=abs(signalvalue1))&&(abs(signalvalue1)<=abs(@ecu_Signals::i_S4_SRR_RL_Obj_AccelX_3)*1.1))
	{
	testStepPass("Pass","i_S4_SRR_RL_Obj_AccelX_3 :%f",signalvalue1);
	}
	else
	{
	testStepFail("Fail","i_S4_SRR_RL_Obj_AccelX_3 :%f",signalvalue1);
	}
}

testcase S4_SRR_RL_Obj_Mes_1_S4_SRR_RL_Obj_DistY_3()
{
	signalvalue1 = getSignal(S4_SRR_RL_Obj_DistY_3);
	write("S4_SRR_RL_Obj_DistY_3 :%f",signalvalue1);
	write("i_S4_SRR_RL_Obj_DistY_3 :%f",@ecu_Signals::i_S4_SRR_RL_Obj_DistY_3);

	testStep("get expect variable value: ","i_S4_SRR_RL_Obj_DistY_3 :%f",@ecu_Signals::i_S4_SRR_RL_Obj_DistY_3);

	if((abs(@ecu_Signals::i_S4_SRR_RL_Obj_DistY_3)*0.9<=abs(signalvalue1))&&(abs(signalvalue1)<=abs(@ecu_Signals::i_S4_SRR_RL_Obj_DistY_3)*1.1))
	{
	testStepPass("Pass","i_S4_SRR_RL_Obj_DistY_3 :%f",signalvalue1);
	}
	else
	{
	testStepFail("Fail","i_S4_SRR_RL_Obj_DistY_3 :%f",signalvalue1);
	}
}

testcase S4_SRR_RL_Obj_Mes_1_S4_SRR_RL_Obj_RelVelY_3()
{
	signalvalue1 = getSignal(S4_SRR_RL_Obj_RelVelY_3);
	write("S4_SRR_RL_Obj_RelVelY_3 :%f",signalvalue1);
	write("i_S4_SRR_RL_Obj_RelVelY_3 :%f",@ecu_Signals::i_S4_SRR_RL_Obj_RelVelY_3);

	testStep("get expect variable value: ","i_S4_SRR_RL_Obj_RelVelY_3 :%f",@ecu_Signals::i_S4_SRR_RL_Obj_RelVelY_3);

	if((abs(@ecu_Signals::i_S4_SRR_RL_Obj_RelVelY_3)*0.9<=abs(signalvalue1))&&(abs(signalvalue1)<=abs(@ecu_Signals::i_S4_SRR_RL_Obj_RelVelY_3)*1.1))
	{
	testStepPass("Pass","i_S4_SRR_RL_Obj_RelVelY_3 :%f",signalvalue1);
	}
	else
	{
	testStepFail("Fail","i_S4_SRR_RL_Obj_RelVelY_3 :%f",signalvalue1);
	}
}

testcase S4_SRR_RL_Obj_Mes_1_S4_SRR_RL_Obj_AccelY_3()
{
	signalvalue1 = getSignal(S4_SRR_RL_Obj_AccelY_3);
	write("S4_SRR_RL_Obj_AccelY_3 :%f",signalvalue1);
	write("i_S4_SRR_RL_Obj_AccelY_3 :%f",@ecu_Signals::i_S4_SRR_RL_Obj_AccelY_3);

	testStep("get expect variable value: ","i_S4_SRR_RL_Obj_AccelY_3 :%f",@ecu_Signals::i_S4_SRR_RL_Obj_AccelY_3);

	if((abs(@ecu_Signals::i_S4_SRR_RL_Obj_AccelY_3)*0.9<=abs(signalvalue1))&&(abs(signalvalue1)<=abs(@ecu_Signals::i_S4_SRR_RL_Obj_AccelY_3)*1.1))
	{
	testStepPass("Pass","i_S4_SRR_RL_Obj_AccelY_3 :%f",signalvalue1);
	}
	else
	{
	testStepFail("Fail","i_S4_SRR_RL_Obj_AccelY_3 :%f",signalvalue1);
	}
}

testcase S4_SRR_RL_Obj_Mes_1_S4_SRR_RL_Obj_DistXStd_3()
{
	signalvalue1 = getSignal(S4_SRR_RL_Obj_DistXStd_3);
	write("S4_SRR_RL_Obj_DistXStd_3 :%f",signalvalue1);
	write("i_S4_SRR_RL_Obj_DistXStd_3 :%f",@ecu_Signals::i_S4_SRR_RL_Obj_DistXStd_3);

	testStep("get expect variable value: ","i_S4_SRR_RL_Obj_DistXStd_3 :%f",@ecu_Signals::i_S4_SRR_RL_Obj_DistXStd_3);

	if((abs(@ecu_Signals::i_S4_SRR_RL_Obj_DistXStd_3)*0.9<=abs(signalvalue1))&&(abs(signalvalue1)<=abs(@ecu_Signals::i_S4_SRR_RL_Obj_DistXStd_3)*1.1))
	{
	testStepPass("Pass","i_S4_SRR_RL_Obj_DistXStd_3 :%f",signalvalue1);
	}
	else
	{
	testStepFail("Fail","i_S4_SRR_RL_Obj_DistXStd_3 :%f",signalvalue1);
	}
}

testcase S4_SRR_RL_Obj_Mes_1_S4_SRR_RL_Obj_RelVelXStd_3()
{
	signalvalue1 = getSignal(S4_SRR_RL_Obj_RelVelXStd_3);
	write("S4_SRR_RL_Obj_RelVelXStd_3 :%f",signalvalue1);
	write("i_S4_SRR_RL_Obj_RelVelXStd_3 :%f",@ecu_Signals::i_S4_SRR_RL_Obj_RelVelXStd_3);

	testStep("get expect variable value: ","i_S4_SRR_RL_Obj_RelVelXStd_3 :%f",@ecu_Signals::i_S4_SRR_RL_Obj_RelVelXStd_3);

	if((abs(@ecu_Signals::i_S4_SRR_RL_Obj_RelVelXStd_3)*0.9<=abs(signalvalue1))&&(abs(signalvalue1)<=abs(@ecu_Signals::i_S4_SRR_RL_Obj_RelVelXStd_3)*1.1))
	{
	testStepPass("Pass","i_S4_SRR_RL_Obj_RelVelXStd_3 :%f",signalvalue1);
	}
	else
	{
	testStepFail("Fail","i_S4_SRR_RL_Obj_RelVelXStd_3 :%f",signalvalue1);
	}
}

testcase S4_SRR_RL_Obj_Mes_1_S4_SRR_RL_Obj_DistYStd_3()
{
	signalvalue1 = getSignal(S4_SRR_RL_Obj_DistYStd_3);
	write("S4_SRR_RL_Obj_DistYStd_3 :%f",signalvalue1);
	write("i_S4_SRR_RL_Obj_DistYStd_3 :%f",@ecu_Signals::i_S4_SRR_RL_Obj_DistYStd_3);

	testStep("get expect variable value: ","i_S4_SRR_RL_Obj_DistYStd_3 :%f",@ecu_Signals::i_S4_SRR_RL_Obj_DistYStd_3);

	if((abs(@ecu_Signals::i_S4_SRR_RL_Obj_DistYStd_3)*0.9<=abs(signalvalue1))&&(abs(signalvalue1)<=abs(@ecu_Signals::i_S4_SRR_RL_Obj_DistYStd_3)*1.1))
	{
	testStepPass("Pass","i_S4_SRR_RL_Obj_DistYStd_3 :%f",signalvalue1);
	}
	else
	{
	testStepFail("Fail","i_S4_SRR_RL_Obj_DistYStd_3 :%f",signalvalue1);
	}
}

testcase S4_SRR_RL_Obj_Mes_1_S4_SRR_RL_Obj_RelVelYStd_3()
{
	signalvalue1 = getSignal(S4_SRR_RL_Obj_RelVelYStd_3);
	write("S4_SRR_RL_Obj_RelVelYStd_3 :%f",signalvalue1);
	write("i_S4_SRR_RL_Obj_RelVelYStd_3 :%f",@ecu_Signals::i_S4_SRR_RL_Obj_RelVelYStd_3);

	testStep("get expect variable value: ","i_S4_SRR_RL_Obj_RelVelYStd_3 :%f",@ecu_Signals::i_S4_SRR_RL_Obj_RelVelYStd_3);

	if((abs(@ecu_Signals::i_S4_SRR_RL_Obj_RelVelYStd_3)*0.9<=abs(signalvalue1))&&(abs(signalvalue1)<=abs(@ecu_Signals::i_S4_SRR_RL_Obj_RelVelYStd_3)*1.1))
	{
	testStepPass("Pass","i_S4_SRR_RL_Obj_RelVelYStd_3 :%f",signalvalue1);
	}
	else
	{
	testStepFail("Fail","i_S4_SRR_RL_Obj_RelVelYStd_3 :%f",signalvalue1);
	}
}

testcase S4_SRR_RL_Obj_Mes_1_S4_SRR_RL_Obj_UpdateFlag_3()
{
	signalvalue1 = getSignal(S4_SRR_RL_Obj_UpdateFlag_3);
	write("S4_SRR_RL_Obj_UpdateFlag_3 :%f",signalvalue1);
	write("i_S4_SRR_RL_Obj_UpdateFlag_3 :%o",@ecu_Signals::i_S4_SRR_RL_Obj_UpdateFlag_3);

	testStep("get expect variable value: ","i_S4_SRR_RL_Obj_UpdateFlag_3 :%o",@ecu_Signals::i_S4_SRR_RL_Obj_UpdateFlag_3);

	if(signalvalue1==@ecu_Signals::i_S4_SRR_RL_Obj_UpdateFlag_3)
	{
	testStepPass("Pass","i_S4_SRR_RL_Obj_UpdateFlag_3 :%f",signalvalue1);
	}
	else
	{
	testStepFail("Fail","i_S4_SRR_RL_Obj_UpdateFlag_3 :%f",signalvalue1);
	}
}

testcase S4_SRR_RL_Obj_Mes_1_S4_SRR_RL_Obj_ExistProb_3()
{
	signalvalue1 = getSignal(S4_SRR_RL_Obj_ExistProb_3);
	write("S4_SRR_RL_Obj_ExistProb_3 :%f",signalvalue1);
	write("i_S4_SRR_RL_Obj_ExistProb_3 :%o",@ecu_Signals::i_S4_SRR_RL_Obj_ExistProb_3);

	testStep("get expect variable value: ","i_S4_SRR_RL_Obj_ExistProb_3 :%o",@ecu_Signals::i_S4_SRR_RL_Obj_ExistProb_3);

	if(signalvalue1==@ecu_Signals::i_S4_SRR_RL_Obj_ExistProb_3)
	{
	testStepPass("Pass","i_S4_SRR_RL_Obj_ExistProb_3 :%f",signalvalue1);
	}
	else
	{
	testStepFail("Fail","i_S4_SRR_RL_Obj_ExistProb_3 :%f",signalvalue1);
	}
}

testcase S4_SRR_RL_Obj_Mes_1_S4_SRR_RL_Obj_Type_3()
{
	signalvalue1 = getSignal(S4_SRR_RL_Obj_Type_3);
	write("S4_SRR_RL_Obj_Type_3 :%f",signalvalue1);
	write("i_S4_SRR_RL_Obj_Type_3 :%o",@ecu_Signals::i_S4_SRR_RL_Obj_Type_3);

	testStep("get expect variable value: ","i_S4_SRR_RL_Obj_Type_3 :%o",@ecu_Signals::i_S4_SRR_RL_Obj_Type_3);

	if(signalvalue1==@ecu_Signals::i_S4_SRR_RL_Obj_Type_3)
	{
	testStepPass("Pass","i_S4_SRR_RL_Obj_Type_3 :%f",signalvalue1);
	}
	else
	{
	testStepFail("Fail","i_S4_SRR_RL_Obj_Type_3 :%f",signalvalue1);
	}
}

testcase S4_SRR_RL_Obj_Mes_1_S4_SRR_RL_Obj_EDynProp_3()
{
	signalvalue1 = getSignal(S4_SRR_RL_Obj_EDynProp_3);
	write("S4_SRR_RL_Obj_EDynProp_3 :%f",signalvalue1);
	write("i_S4_SRR_RL_Obj_EDynProp_3 :%o",@ecu_Signals::i_S4_SRR_RL_Obj_EDynProp_3);

	testStep("get expect variable value: ","i_S4_SRR_RL_Obj_EDynProp_3 :%o",@ecu_Signals::i_S4_SRR_RL_Obj_EDynProp_3);

	if(signalvalue1==@ecu_Signals::i_S4_SRR_RL_Obj_EDynProp_3)
	{
	testStepPass("Pass","i_S4_SRR_RL_Obj_EDynProp_3 :%f",signalvalue1);
	}
	else
	{
	testStepFail("Fail","i_S4_SRR_RL_Obj_EDynProp_3 :%f",signalvalue1);
	}
}

testcase S4_SRR_RL_Obj_Mes_1_S4_SRR_RL_Obj_UiLifeCycles_3()
{
	signalvalue1 = getSignal(S4_SRR_RL_Obj_UiLifeCycles_3);
	write("S4_SRR_RL_Obj_UiLifeCycles_3 :%f",signalvalue1);
	write("i_S4_SRR_RL_Obj_UiLifeCycles_3 :%o",@ecu_Signals::i_S4_SRR_RL_Obj_UiLifeCycles_3);

	testStep("get expect variable value: ","i_S4_SRR_RL_Obj_UiLifeCycles_3 :%o",@ecu_Signals::i_S4_SRR_RL_Obj_UiLifeCycles_3);

	if(signalvalue1==@ecu_Signals::i_S4_SRR_RL_Obj_UiLifeCycles_3)
	{
	testStepPass("Pass","i_S4_SRR_RL_Obj_UiLifeCycles_3 :%f",signalvalue1);
	}
	else
	{
	testStepFail("Fail","i_S4_SRR_RL_Obj_UiLifeCycles_3 :%f",signalvalue1);
	}
}

testcase S4_SRR_RL_Obj_Mes_1_S4_SRR_RL_Obj_ID_4()
{
	signalvalue1 = getSignal(S4_SRR_RL_Obj_ID_4);
	write("S4_SRR_RL_Obj_ID_4 :%f",signalvalue1);
	write("i_S4_SRR_RL_Obj_ID_4 :%o",@ecu_Signals::i_S4_SRR_RL_Obj_ID_4);

	testStep("get expect variable value: ","i_S4_SRR_RL_Obj_ID_4 :%o",@ecu_Signals::i_S4_SRR_RL_Obj_ID_4);

	if(signalvalue1==@ecu_Signals::i_S4_SRR_RL_Obj_ID_4)
	{
	testStepPass("Pass","i_S4_SRR_RL_Obj_ID_4 :%f",signalvalue1);
	}
	else
	{
	testStepFail("Fail","i_S4_SRR_RL_Obj_ID_4 :%f",signalvalue1);
	}
}

testcase S4_SRR_RL_Obj_Mes_1_S4_SRR_RL_Obj_DistX_4()
{
	signalvalue1 = getSignal(S4_SRR_RL_Obj_DistX_4);
	write("S4_SRR_RL_Obj_DistX_4 :%f",signalvalue1);
	write("i_S4_SRR_RL_Obj_DistX_4 :%f",@ecu_Signals::i_S4_SRR_RL_Obj_DistX_4);

	testStep("get expect variable value: ","i_S4_SRR_RL_Obj_DistX_4 :%f",@ecu_Signals::i_S4_SRR_RL_Obj_DistX_4);

	if((abs(@ecu_Signals::i_S4_SRR_RL_Obj_DistX_4)*0.9<=abs(signalvalue1))&&(abs(signalvalue1)<=abs(@ecu_Signals::i_S4_SRR_RL_Obj_DistX_4)*1.1))
	{
	testStepPass("Pass","i_S4_SRR_RL_Obj_DistX_4 :%f",signalvalue1);
	}
	else
	{
	testStepFail("Fail","i_S4_SRR_RL_Obj_DistX_4 :%f",signalvalue1);
	}
}

testcase S4_SRR_RL_Obj_Mes_1_S4_SRR_RL_Obj_RelVelX_4()
{
	signalvalue1 = getSignal(S4_SRR_RL_Obj_RelVelX_4);
	write("S4_SRR_RL_Obj_RelVelX_4 :%f",signalvalue1);
	write("i_S4_SRR_RL_Obj_RelVelX_4 :%f",@ecu_Signals::i_S4_SRR_RL_Obj_RelVelX_4);

	testStep("get expect variable value: ","i_S4_SRR_RL_Obj_RelVelX_4 :%f",@ecu_Signals::i_S4_SRR_RL_Obj_RelVelX_4);

	if((abs(@ecu_Signals::i_S4_SRR_RL_Obj_RelVelX_4)*0.9<=abs(signalvalue1))&&(abs(signalvalue1)<=abs(@ecu_Signals::i_S4_SRR_RL_Obj_RelVelX_4)*1.1))
	{
	testStepPass("Pass","i_S4_SRR_RL_Obj_RelVelX_4 :%f",signalvalue1);
	}
	else
	{
	testStepFail("Fail","i_S4_SRR_RL_Obj_RelVelX_4 :%f",signalvalue1);
	}
}

testcase S4_SRR_RL_Obj_Mes_1_S4_SRR_RL_Obj_AccelX_4()
{
	signalvalue1 = getSignal(S4_SRR_RL_Obj_AccelX_4);
	write("S4_SRR_RL_Obj_AccelX_4 :%f",signalvalue1);
	write("i_S4_SRR_RL_Obj_AccelX_4 :%f",@ecu_Signals::i_S4_SRR_RL_Obj_AccelX_4);

	testStep("get expect variable value: ","i_S4_SRR_RL_Obj_AccelX_4 :%f",@ecu_Signals::i_S4_SRR_RL_Obj_AccelX_4);

	if((abs(@ecu_Signals::i_S4_SRR_RL_Obj_AccelX_4)*0.9<=abs(signalvalue1))&&(abs(signalvalue1)<=abs(@ecu_Signals::i_S4_SRR_RL_Obj_AccelX_4)*1.1))
	{
	testStepPass("Pass","i_S4_SRR_RL_Obj_AccelX_4 :%f",signalvalue1);
	}
	else
	{
	testStepFail("Fail","i_S4_SRR_RL_Obj_AccelX_4 :%f",signalvalue1);
	}
}

testcase S4_SRR_RL_Obj_Mes_1_S4_SRR_RL_Obj_DistY_4()
{
	signalvalue1 = getSignal(S4_SRR_RL_Obj_DistY_4);
	write("S4_SRR_RL_Obj_DistY_4 :%f",signalvalue1);
	write("i_S4_SRR_RL_Obj_DistY_4 :%f",@ecu_Signals::i_S4_SRR_RL_Obj_DistY_4);

	testStep("get expect variable value: ","i_S4_SRR_RL_Obj_DistY_4 :%f",@ecu_Signals::i_S4_SRR_RL_Obj_DistY_4);

	if((abs(@ecu_Signals::i_S4_SRR_RL_Obj_DistY_4)*0.9<=abs(signalvalue1))&&(abs(signalvalue1)<=abs(@ecu_Signals::i_S4_SRR_RL_Obj_DistY_4)*1.1))
	{
	testStepPass("Pass","i_S4_SRR_RL_Obj_DistY_4 :%f",signalvalue1);
	}
	else
	{
	testStepFail("Fail","i_S4_SRR_RL_Obj_DistY_4 :%f",signalvalue1);
	}
}

testcase S4_SRR_RL_Obj_Mes_1_S4_SRR_RL_Obj_RelVelY_4()
{
	signalvalue1 = getSignal(S4_SRR_RL_Obj_RelVelY_4);
	write("S4_SRR_RL_Obj_RelVelY_4 :%f",signalvalue1);
	write("i_S4_SRR_RL_Obj_RelVelY_4 :%f",@ecu_Signals::i_S4_SRR_RL_Obj_RelVelY_4);

	testStep("get expect variable value: ","i_S4_SRR_RL_Obj_RelVelY_4 :%f",@ecu_Signals::i_S4_SRR_RL_Obj_RelVelY_4);

	if((abs(@ecu_Signals::i_S4_SRR_RL_Obj_RelVelY_4)*0.9<=abs(signalvalue1))&&(abs(signalvalue1)<=abs(@ecu_Signals::i_S4_SRR_RL_Obj_RelVelY_4)*1.1))
	{
	testStepPass("Pass","i_S4_SRR_RL_Obj_RelVelY_4 :%f",signalvalue1);
	}
	else
	{
	testStepFail("Fail","i_S4_SRR_RL_Obj_RelVelY_4 :%f",signalvalue1);
	}
}

testcase S4_SRR_RL_Obj_Mes_1_S4_SRR_RL_Obj_AccelY_4()
{
	signalvalue1 = getSignal(S4_SRR_RL_Obj_AccelY_4);
	write("S4_SRR_RL_Obj_AccelY_4 :%f",signalvalue1);
	write("i_S4_SRR_RL_Obj_AccelY_4 :%f",@ecu_Signals::i_S4_SRR_RL_Obj_AccelY_4);

	testStep("get expect variable value: ","i_S4_SRR_RL_Obj_AccelY_4 :%f",@ecu_Signals::i_S4_SRR_RL_Obj_AccelY_4);

	if((abs(@ecu_Signals::i_S4_SRR_RL_Obj_AccelY_4)*0.9<=abs(signalvalue1))&&(abs(signalvalue1)<=abs(@ecu_Signals::i_S4_SRR_RL_Obj_AccelY_4)*1.1))
	{
	testStepPass("Pass","i_S4_SRR_RL_Obj_AccelY_4 :%f",signalvalue1);
	}
	else
	{
	testStepFail("Fail","i_S4_SRR_RL_Obj_AccelY_4 :%f",signalvalue1);
	}
}

testcase S4_SRR_RL_Obj_Mes_1_S4_SRR_RL_Obj_DistXStd_4()
{
	signalvalue1 = getSignal(S4_SRR_RL_Obj_DistXStd_4);
	write("S4_SRR_RL_Obj_DistXStd_4 :%f",signalvalue1);
	write("i_S4_SRR_RL_Obj_DistXStd_4 :%f",@ecu_Signals::i_S4_SRR_RL_Obj_DistXStd_4);

	testStep("get expect variable value: ","i_S4_SRR_RL_Obj_DistXStd_4 :%f",@ecu_Signals::i_S4_SRR_RL_Obj_DistXStd_4);

	if((abs(@ecu_Signals::i_S4_SRR_RL_Obj_DistXStd_4)*0.9<=abs(signalvalue1))&&(abs(signalvalue1)<=abs(@ecu_Signals::i_S4_SRR_RL_Obj_DistXStd_4)*1.1))
	{
	testStepPass("Pass","i_S4_SRR_RL_Obj_DistXStd_4 :%f",signalvalue1);
	}
	else
	{
	testStepFail("Fail","i_S4_SRR_RL_Obj_DistXStd_4 :%f",signalvalue1);
	}
}

testcase S4_SRR_RL_Obj_Mes_1_S4_SRR_RL_Obj_RelVelXStd_4()
{
	signalvalue1 = getSignal(S4_SRR_RL_Obj_RelVelXStd_4);
	write("S4_SRR_RL_Obj_RelVelXStd_4 :%f",signalvalue1);
	write("i_S4_SRR_RL_Obj_RelVelXStd_4 :%f",@ecu_Signals::i_S4_SRR_RL_Obj_RelVelXStd_4);

	testStep("get expect variable value: ","i_S4_SRR_RL_Obj_RelVelXStd_4 :%f",@ecu_Signals::i_S4_SRR_RL_Obj_RelVelXStd_4);

	if((abs(@ecu_Signals::i_S4_SRR_RL_Obj_RelVelXStd_4)*0.9<=abs(signalvalue1))&&(abs(signalvalue1)<=abs(@ecu_Signals::i_S4_SRR_RL_Obj_RelVelXStd_4)*1.1))
	{
	testStepPass("Pass","i_S4_SRR_RL_Obj_RelVelXStd_4 :%f",signalvalue1);
	}
	else
	{
	testStepFail("Fail","i_S4_SRR_RL_Obj_RelVelXStd_4 :%f",signalvalue1);
	}
}

testcase S4_SRR_RL_Obj_Mes_1_S4_SRR_RL_Obj_DistYStd_4()
{
	signalvalue1 = getSignal(S4_SRR_RL_Obj_DistYStd_4);
	write("S4_SRR_RL_Obj_DistYStd_4 :%f",signalvalue1);
	write("i_S4_SRR_RL_Obj_DistYStd_4 :%f",@ecu_Signals::i_S4_SRR_RL_Obj_DistYStd_4);

	testStep("get expect variable value: ","i_S4_SRR_RL_Obj_DistYStd_4 :%f",@ecu_Signals::i_S4_SRR_RL_Obj_DistYStd_4);

	if((abs(@ecu_Signals::i_S4_SRR_RL_Obj_DistYStd_4)*0.9<=abs(signalvalue1))&&(abs(signalvalue1)<=abs(@ecu_Signals::i_S4_SRR_RL_Obj_DistYStd_4)*1.1))
	{
	testStepPass("Pass","i_S4_SRR_RL_Obj_DistYStd_4 :%f",signalvalue1);
	}
	else
	{
	testStepFail("Fail","i_S4_SRR_RL_Obj_DistYStd_4 :%f",signalvalue1);
	}
}

testcase S4_SRR_RL_Obj_Mes_1_S4_SRR_RL_Obj_RelVelYStd_4()
{
	signalvalue1 = getSignal(S4_SRR_RL_Obj_RelVelYStd_4);
	write("S4_SRR_RL_Obj_RelVelYStd_4 :%f",signalvalue1);
	write("i_S4_SRR_RL_Obj_RelVelYStd_4 :%f",@ecu_Signals::i_S4_SRR_RL_Obj_RelVelYStd_4);

	testStep("get expect variable value: ","i_S4_SRR_RL_Obj_RelVelYStd_4 :%f",@ecu_Signals::i_S4_SRR_RL_Obj_RelVelYStd_4);

	if((abs(@ecu_Signals::i_S4_SRR_RL_Obj_RelVelYStd_4)*0.9<=abs(signalvalue1))&&(abs(signalvalue1)<=abs(@ecu_Signals::i_S4_SRR_RL_Obj_RelVelYStd_4)*1.1))
	{
	testStepPass("Pass","i_S4_SRR_RL_Obj_RelVelYStd_4 :%f",signalvalue1);
	}
	else
	{
	testStepFail("Fail","i_S4_SRR_RL_Obj_RelVelYStd_4 :%f",signalvalue1);
	}
}

testcase S4_SRR_RL_Obj_Mes_1_S4_SRR_RL_Obj_UpdateFlag_4()
{
	signalvalue1 = getSignal(S4_SRR_RL_Obj_UpdateFlag_4);
	write("S4_SRR_RL_Obj_UpdateFlag_4 :%f",signalvalue1);
	write("i_S4_SRR_RL_Obj_UpdateFlag_4 :%o",@ecu_Signals::i_S4_SRR_RL_Obj_UpdateFlag_4);

	testStep("get expect variable value: ","i_S4_SRR_RL_Obj_UpdateFlag_4 :%o",@ecu_Signals::i_S4_SRR_RL_Obj_UpdateFlag_4);

	if(signalvalue1==@ecu_Signals::i_S4_SRR_RL_Obj_UpdateFlag_4)
	{
	testStepPass("Pass","i_S4_SRR_RL_Obj_UpdateFlag_4 :%f",signalvalue1);
	}
	else
	{
	testStepFail("Fail","i_S4_SRR_RL_Obj_UpdateFlag_4 :%f",signalvalue1);
	}
}

testcase S4_SRR_RL_Obj_Mes_1_S4_SRR_RL_Obj_ExistProb_4()
{
	signalvalue1 = getSignal(S4_SRR_RL_Obj_ExistProb_4);
	write("S4_SRR_RL_Obj_ExistProb_4 :%f",signalvalue1);
	write("i_S4_SRR_RL_Obj_ExistProb_4 :%o",@ecu_Signals::i_S4_SRR_RL_Obj_ExistProb_4);

	testStep("get expect variable value: ","i_S4_SRR_RL_Obj_ExistProb_4 :%o",@ecu_Signals::i_S4_SRR_RL_Obj_ExistProb_4);

	if(signalvalue1==@ecu_Signals::i_S4_SRR_RL_Obj_ExistProb_4)
	{
	testStepPass("Pass","i_S4_SRR_RL_Obj_ExistProb_4 :%f",signalvalue1);
	}
	else
	{
	testStepFail("Fail","i_S4_SRR_RL_Obj_ExistProb_4 :%f",signalvalue1);
	}
}

testcase S4_SRR_RL_Obj_Mes_1_S4_SRR_RL_Obj_Type_4()
{
	signalvalue1 = getSignal(S4_SRR_RL_Obj_Type_4);
	write("S4_SRR_RL_Obj_Type_4 :%f",signalvalue1);
	write("i_S4_SRR_RL_Obj_Type_4 :%o",@ecu_Signals::i_S4_SRR_RL_Obj_Type_4);

	testStep("get expect variable value: ","i_S4_SRR_RL_Obj_Type_4 :%o",@ecu_Signals::i_S4_SRR_RL_Obj_Type_4);

	if(signalvalue1==@ecu_Signals::i_S4_SRR_RL_Obj_Type_4)
	{
	testStepPass("Pass","i_S4_SRR_RL_Obj_Type_4 :%f",signalvalue1);
	}
	else
	{
	testStepFail("Fail","i_S4_SRR_RL_Obj_Type_4 :%f",signalvalue1);
	}
}

testcase S4_SRR_RL_Obj_Mes_1_S4_SRR_RL_Obj_EDynProp_4()
{
	signalvalue1 = getSignal(S4_SRR_RL_Obj_EDynProp_4);
	write("S4_SRR_RL_Obj_EDynProp_4 :%f",signalvalue1);
	write("i_S4_SRR_RL_Obj_EDynProp_4 :%o",@ecu_Signals::i_S4_SRR_RL_Obj_EDynProp_4);

	testStep("get expect variable value: ","i_S4_SRR_RL_Obj_EDynProp_4 :%o",@ecu_Signals::i_S4_SRR_RL_Obj_EDynProp_4);

	if(signalvalue1==@ecu_Signals::i_S4_SRR_RL_Obj_EDynProp_4)
	{
	testStepPass("Pass","i_S4_SRR_RL_Obj_EDynProp_4 :%f",signalvalue1);
	}
	else
	{
	testStepFail("Fail","i_S4_SRR_RL_Obj_EDynProp_4 :%f",signalvalue1);
	}
}

testcase S4_SRR_RL_Obj_Mes_1_S4_SRR_RL_Obj_UiLifeCycles_4()
{
	signalvalue1 = getSignal(S4_SRR_RL_Obj_UiLifeCycles_4);
	write("S4_SRR_RL_Obj_UiLifeCycles_4 :%f",signalvalue1);
	write("i_S4_SRR_RL_Obj_UiLifeCycles_4 :%o",@ecu_Signals::i_S4_SRR_RL_Obj_UiLifeCycles_4);

	testStep("get expect variable value: ","i_S4_SRR_RL_Obj_UiLifeCycles_4 :%o",@ecu_Signals::i_S4_SRR_RL_Obj_UiLifeCycles_4);

	if(signalvalue1==@ecu_Signals::i_S4_SRR_RL_Obj_UiLifeCycles_4)
	{
	testStepPass("Pass","i_S4_SRR_RL_Obj_UiLifeCycles_4 :%f",signalvalue1);
	}
	else
	{
	testStepFail("Fail","i_S4_SRR_RL_Obj_UiLifeCycles_4 :%f",signalvalue1);
	}
}

testcase S4_SRR_RL_Obj_Mes_1_S4_SRR_RL_Obj_ID_5()
{
	signalvalue1 = getSignal(S4_SRR_RL_Obj_ID_5);
	write("S4_SRR_RL_Obj_ID_5 :%f",signalvalue1);
	write("i_S4_SRR_RL_Obj_ID_5 :%o",@ecu_Signals::i_S4_SRR_RL_Obj_ID_5);

	testStep("get expect variable value: ","i_S4_SRR_RL_Obj_ID_5 :%o",@ecu_Signals::i_S4_SRR_RL_Obj_ID_5);

	if(signalvalue1==@ecu_Signals::i_S4_SRR_RL_Obj_ID_5)
	{
	testStepPass("Pass","i_S4_SRR_RL_Obj_ID_5 :%f",signalvalue1);
	}
	else
	{
	testStepFail("Fail","i_S4_SRR_RL_Obj_ID_5 :%f",signalvalue1);
	}
}

testcase S4_SRR_RL_Obj_Mes_1_S4_SRR_RL_Obj_DistX_5()
{
	signalvalue1 = getSignal(S4_SRR_RL_Obj_DistX_5);
	write("S4_SRR_RL_Obj_DistX_5 :%f",signalvalue1);
	write("i_S4_SRR_RL_Obj_DistX_5 :%f",@ecu_Signals::i_S4_SRR_RL_Obj_DistX_5);

	testStep("get expect variable value: ","i_S4_SRR_RL_Obj_DistX_5 :%f",@ecu_Signals::i_S4_SRR_RL_Obj_DistX_5);

	if((abs(@ecu_Signals::i_S4_SRR_RL_Obj_DistX_5)*0.9<=abs(signalvalue1))&&(abs(signalvalue1)<=abs(@ecu_Signals::i_S4_SRR_RL_Obj_DistX_5)*1.1))
	{
	testStepPass("Pass","i_S4_SRR_RL_Obj_DistX_5 :%f",signalvalue1);
	}
	else
	{
	testStepFail("Fail","i_S4_SRR_RL_Obj_DistX_5 :%f",signalvalue1);
	}
}

testcase S4_SRR_RL_Obj_Mes_1_S4_SRR_RL_Obj_RelVelX_5()
{
	signalvalue1 = getSignal(S4_SRR_RL_Obj_RelVelX_5);
	write("S4_SRR_RL_Obj_RelVelX_5 :%f",signalvalue1);
	write("i_S4_SRR_RL_Obj_RelVelX_5 :%f",@ecu_Signals::i_S4_SRR_RL_Obj_RelVelX_5);

	testStep("get expect variable value: ","i_S4_SRR_RL_Obj_RelVelX_5 :%f",@ecu_Signals::i_S4_SRR_RL_Obj_RelVelX_5);

	if((abs(@ecu_Signals::i_S4_SRR_RL_Obj_RelVelX_5)*0.9<=abs(signalvalue1))&&(abs(signalvalue1)<=abs(@ecu_Signals::i_S4_SRR_RL_Obj_RelVelX_5)*1.1))
	{
	testStepPass("Pass","i_S4_SRR_RL_Obj_RelVelX_5 :%f",signalvalue1);
	}
	else
	{
	testStepFail("Fail","i_S4_SRR_RL_Obj_RelVelX_5 :%f",signalvalue1);
	}
}

testcase S4_SRR_RL_Obj_Mes_1_S4_SRR_RL_Obj_AccelX_5()
{
	signalvalue1 = getSignal(S4_SRR_RL_Obj_AccelX_5);
	write("S4_SRR_RL_Obj_AccelX_5 :%f",signalvalue1);
	write("i_S4_SRR_RL_Obj_AccelX_5 :%f",@ecu_Signals::i_S4_SRR_RL_Obj_AccelX_5);

	testStep("get expect variable value: ","i_S4_SRR_RL_Obj_AccelX_5 :%f",@ecu_Signals::i_S4_SRR_RL_Obj_AccelX_5);

	if((abs(@ecu_Signals::i_S4_SRR_RL_Obj_AccelX_5)*0.9<=abs(signalvalue1))&&(abs(signalvalue1)<=abs(@ecu_Signals::i_S4_SRR_RL_Obj_AccelX_5)*1.1))
	{
	testStepPass("Pass","i_S4_SRR_RL_Obj_AccelX_5 :%f",signalvalue1);
	}
	else
	{
	testStepFail("Fail","i_S4_SRR_RL_Obj_AccelX_5 :%f",signalvalue1);
	}
}

testcase S4_SRR_RL_Obj_Mes_1_S4_SRR_RL_Obj_DistY_5()
{
	signalvalue1 = getSignal(S4_SRR_RL_Obj_DistY_5);
	write("S4_SRR_RL_Obj_DistY_5 :%f",signalvalue1);
	write("i_S4_SRR_RL_Obj_DistY_5 :%f",@ecu_Signals::i_S4_SRR_RL_Obj_DistY_5);

	testStep("get expect variable value: ","i_S4_SRR_RL_Obj_DistY_5 :%f",@ecu_Signals::i_S4_SRR_RL_Obj_DistY_5);

	if((abs(@ecu_Signals::i_S4_SRR_RL_Obj_DistY_5)*0.9<=abs(signalvalue1))&&(abs(signalvalue1)<=abs(@ecu_Signals::i_S4_SRR_RL_Obj_DistY_5)*1.1))
	{
	testStepPass("Pass","i_S4_SRR_RL_Obj_DistY_5 :%f",signalvalue1);
	}
	else
	{
	testStepFail("Fail","i_S4_SRR_RL_Obj_DistY_5 :%f",signalvalue1);
	}
}

testcase S4_SRR_RL_Obj_Mes_1_S4_SRR_RL_Obj_RelVelY_5()
{
	signalvalue1 = getSignal(S4_SRR_RL_Obj_RelVelY_5);
	write("S4_SRR_RL_Obj_RelVelY_5 :%f",signalvalue1);
	write("i_S4_SRR_RL_Obj_RelVelY_5 :%f",@ecu_Signals::i_S4_SRR_RL_Obj_RelVelY_5);

	testStep("get expect variable value: ","i_S4_SRR_RL_Obj_RelVelY_5 :%f",@ecu_Signals::i_S4_SRR_RL_Obj_RelVelY_5);

	if((abs(@ecu_Signals::i_S4_SRR_RL_Obj_RelVelY_5)*0.9<=abs(signalvalue1))&&(abs(signalvalue1)<=abs(@ecu_Signals::i_S4_SRR_RL_Obj_RelVelY_5)*1.1))
	{
	testStepPass("Pass","i_S4_SRR_RL_Obj_RelVelY_5 :%f",signalvalue1);
	}
	else
	{
	testStepFail("Fail","i_S4_SRR_RL_Obj_RelVelY_5 :%f",signalvalue1);
	}
}

testcase S4_SRR_RL_Obj_Mes_1_S4_SRR_RL_Obj_AccelY_5()
{
	signalvalue1 = getSignal(S4_SRR_RL_Obj_AccelY_5);
	write("S4_SRR_RL_Obj_AccelY_5 :%f",signalvalue1);
	write("i_S4_SRR_RL_Obj_AccelY_5 :%f",@ecu_Signals::i_S4_SRR_RL_Obj_AccelY_5);

	testStep("get expect variable value: ","i_S4_SRR_RL_Obj_AccelY_5 :%f",@ecu_Signals::i_S4_SRR_RL_Obj_AccelY_5);

	if((abs(@ecu_Signals::i_S4_SRR_RL_Obj_AccelY_5)*0.9<=abs(signalvalue1))&&(abs(signalvalue1)<=abs(@ecu_Signals::i_S4_SRR_RL_Obj_AccelY_5)*1.1))
	{
	testStepPass("Pass","i_S4_SRR_RL_Obj_AccelY_5 :%f",signalvalue1);
	}
	else
	{
	testStepFail("Fail","i_S4_SRR_RL_Obj_AccelY_5 :%f",signalvalue1);
	}
}

testcase S4_SRR_RL_Obj_Mes_1_S4_SRR_RL_Obj_DistXStd_5()
{
	signalvalue1 = getSignal(S4_SRR_RL_Obj_DistXStd_5);
	write("S4_SRR_RL_Obj_DistXStd_5 :%f",signalvalue1);
	write("i_S4_SRR_RL_Obj_DistXStd_5 :%f",@ecu_Signals::i_S4_SRR_RL_Obj_DistXStd_5);

	testStep("get expect variable value: ","i_S4_SRR_RL_Obj_DistXStd_5 :%f",@ecu_Signals::i_S4_SRR_RL_Obj_DistXStd_5);

	if((abs(@ecu_Signals::i_S4_SRR_RL_Obj_DistXStd_5)*0.9<=abs(signalvalue1))&&(abs(signalvalue1)<=abs(@ecu_Signals::i_S4_SRR_RL_Obj_DistXStd_5)*1.1))
	{
	testStepPass("Pass","i_S4_SRR_RL_Obj_DistXStd_5 :%f",signalvalue1);
	}
	else
	{
	testStepFail("Fail","i_S4_SRR_RL_Obj_DistXStd_5 :%f",signalvalue1);
	}
}

testcase S4_SRR_RL_Obj_Mes_1_S4_SRR_RL_Obj_RelVelXStd_5()
{
	signalvalue1 = getSignal(S4_SRR_RL_Obj_RelVelXStd_5);
	write("S4_SRR_RL_Obj_RelVelXStd_5 :%f",signalvalue1);
	write("i_S4_SRR_RL_Obj_RelVelXStd_5 :%f",@ecu_Signals::i_S4_SRR_RL_Obj_RelVelXStd_5);

	testStep("get expect variable value: ","i_S4_SRR_RL_Obj_RelVelXStd_5 :%f",@ecu_Signals::i_S4_SRR_RL_Obj_RelVelXStd_5);

	if((abs(@ecu_Signals::i_S4_SRR_RL_Obj_RelVelXStd_5)*0.9<=abs(signalvalue1))&&(abs(signalvalue1)<=abs(@ecu_Signals::i_S4_SRR_RL_Obj_RelVelXStd_5)*1.1))
	{
	testStepPass("Pass","i_S4_SRR_RL_Obj_RelVelXStd_5 :%f",signalvalue1);
	}
	else
	{
	testStepFail("Fail","i_S4_SRR_RL_Obj_RelVelXStd_5 :%f",signalvalue1);
	}
}

testcase S4_SRR_RL_Obj_Mes_1_S4_SRR_RL_Obj_DistYStd_5()
{
	signalvalue1 = getSignal(S4_SRR_RL_Obj_DistYStd_5);
	write("S4_SRR_RL_Obj_DistYStd_5 :%f",signalvalue1);
	write("i_S4_SRR_RL_Obj_DistYStd_5 :%f",@ecu_Signals::i_S4_SRR_RL_Obj_DistYStd_5);

	testStep("get expect variable value: ","i_S4_SRR_RL_Obj_DistYStd_5 :%f",@ecu_Signals::i_S4_SRR_RL_Obj_DistYStd_5);

	if((abs(@ecu_Signals::i_S4_SRR_RL_Obj_DistYStd_5)*0.9<=abs(signalvalue1))&&(abs(signalvalue1)<=abs(@ecu_Signals::i_S4_SRR_RL_Obj_DistYStd_5)*1.1))
	{
	testStepPass("Pass","i_S4_SRR_RL_Obj_DistYStd_5 :%f",signalvalue1);
	}
	else
	{
	testStepFail("Fail","i_S4_SRR_RL_Obj_DistYStd_5 :%f",signalvalue1);
	}
}

testcase S4_SRR_RL_Obj_Mes_1_S4_SRR_RL_Obj_RelVelYStd_5()
{
	signalvalue1 = getSignal(S4_SRR_RL_Obj_RelVelYStd_5);
	write("S4_SRR_RL_Obj_RelVelYStd_5 :%f",signalvalue1);
	write("i_S4_SRR_RL_Obj_RelVelYStd_5 :%f",@ecu_Signals::i_S4_SRR_RL_Obj_RelVelYStd_5);

	testStep("get expect variable value: ","i_S4_SRR_RL_Obj_RelVelYStd_5 :%f",@ecu_Signals::i_S4_SRR_RL_Obj_RelVelYStd_5);

	if((abs(@ecu_Signals::i_S4_SRR_RL_Obj_RelVelYStd_5)*0.9<=abs(signalvalue1))&&(abs(signalvalue1)<=abs(@ecu_Signals::i_S4_SRR_RL_Obj_RelVelYStd_5)*1.1))
	{
	testStepPass("Pass","i_S4_SRR_RL_Obj_RelVelYStd_5 :%f",signalvalue1);
	}
	else
	{
	testStepFail("Fail","i_S4_SRR_RL_Obj_RelVelYStd_5 :%f",signalvalue1);
	}
}

testcase S4_SRR_RL_Obj_Mes_1_S4_SRR_RL_Obj_UpdateFlag_5()
{
	signalvalue1 = getSignal(S4_SRR_RL_Obj_UpdateFlag_5);
	write("S4_SRR_RL_Obj_UpdateFlag_5 :%f",signalvalue1);
	write("i_S4_SRR_RL_Obj_UpdateFlag_5 :%o",@ecu_Signals::i_S4_SRR_RL_Obj_UpdateFlag_5);

	testStep("get expect variable value: ","i_S4_SRR_RL_Obj_UpdateFlag_5 :%o",@ecu_Signals::i_S4_SRR_RL_Obj_UpdateFlag_5);

	if(signalvalue1==@ecu_Signals::i_S4_SRR_RL_Obj_UpdateFlag_5)
	{
	testStepPass("Pass","i_S4_SRR_RL_Obj_UpdateFlag_5 :%f",signalvalue1);
	}
	else
	{
	testStepFail("Fail","i_S4_SRR_RL_Obj_UpdateFlag_5 :%f",signalvalue1);
	}
}

testcase S4_SRR_RL_Obj_Mes_1_S4_SRR_RL_Obj_ExistProb_5()
{
	signalvalue1 = getSignal(S4_SRR_RL_Obj_ExistProb_5);
	write("S4_SRR_RL_Obj_ExistProb_5 :%f",signalvalue1);
	write("i_S4_SRR_RL_Obj_ExistProb_5 :%o",@ecu_Signals::i_S4_SRR_RL_Obj_ExistProb_5);

	testStep("get expect variable value: ","i_S4_SRR_RL_Obj_ExistProb_5 :%o",@ecu_Signals::i_S4_SRR_RL_Obj_ExistProb_5);

	if(signalvalue1==@ecu_Signals::i_S4_SRR_RL_Obj_ExistProb_5)
	{
	testStepPass("Pass","i_S4_SRR_RL_Obj_ExistProb_5 :%f",signalvalue1);
	}
	else
	{
	testStepFail("Fail","i_S4_SRR_RL_Obj_ExistProb_5 :%f",signalvalue1);
	}
}

testcase S4_SRR_RL_Obj_Mes_1_S4_SRR_RL_Obj_Type_5()
{
	signalvalue1 = getSignal(S4_SRR_RL_Obj_Type_5);
	write("S4_SRR_RL_Obj_Type_5 :%f",signalvalue1);
	write("i_S4_SRR_RL_Obj_Type_5 :%o",@ecu_Signals::i_S4_SRR_RL_Obj_Type_5);

	testStep("get expect variable value: ","i_S4_SRR_RL_Obj_Type_5 :%o",@ecu_Signals::i_S4_SRR_RL_Obj_Type_5);

	if(signalvalue1==@ecu_Signals::i_S4_SRR_RL_Obj_Type_5)
	{
	testStepPass("Pass","i_S4_SRR_RL_Obj_Type_5 :%f",signalvalue1);
	}
	else
	{
	testStepFail("Fail","i_S4_SRR_RL_Obj_Type_5 :%f",signalvalue1);
	}
}

testcase S4_SRR_RL_Obj_Mes_1_S4_SRR_RL_Obj_EDynProp_5()
{
	signalvalue1 = getSignal(S4_SRR_RL_Obj_EDynProp_5);
	write("S4_SRR_RL_Obj_EDynProp_5 :%f",signalvalue1);
	write("i_S4_SRR_RL_Obj_EDynProp_5 :%o",@ecu_Signals::i_S4_SRR_RL_Obj_EDynProp_5);

	testStep("get expect variable value: ","i_S4_SRR_RL_Obj_EDynProp_5 :%o",@ecu_Signals::i_S4_SRR_RL_Obj_EDynProp_5);

	if(signalvalue1==@ecu_Signals::i_S4_SRR_RL_Obj_EDynProp_5)
	{
	testStepPass("Pass","i_S4_SRR_RL_Obj_EDynProp_5 :%f",signalvalue1);
	}
	else
	{
	testStepFail("Fail","i_S4_SRR_RL_Obj_EDynProp_5 :%f",signalvalue1);
	}
}

testcase S4_SRR_RL_Obj_Mes_1_S4_SRR_RL_Obj_UiLifeCycles_5()
{
	signalvalue1 = getSignal(S4_SRR_RL_Obj_UiLifeCycles_5);
	write("S4_SRR_RL_Obj_UiLifeCycles_5 :%f",signalvalue1);
	write("i_S4_SRR_RL_Obj_UiLifeCycles_5 :%o",@ecu_Signals::i_S4_SRR_RL_Obj_UiLifeCycles_5);

	testStep("get expect variable value: ","i_S4_SRR_RL_Obj_UiLifeCycles_5 :%o",@ecu_Signals::i_S4_SRR_RL_Obj_UiLifeCycles_5);

	if(signalvalue1==@ecu_Signals::i_S4_SRR_RL_Obj_UiLifeCycles_5)
	{
	testStepPass("Pass","i_S4_SRR_RL_Obj_UiLifeCycles_5 :%f",signalvalue1);
	}
	else
	{
	testStepFail("Fail","i_S4_SRR_RL_Obj_UiLifeCycles_5 :%f",signalvalue1);
	}
}

testcase S4_SRR_RL_Obj_Mes_2_S4_SRR_RL_Obj_ID_6()
{
	signalvalue1 = getSignal(S4_SRR_RL_Obj_ID_6);
	write("S4_SRR_RL_Obj_ID_6 :%f",signalvalue1);
	write("i_S4_SRR_RL_Obj_ID_6 :%o",@ecu_Signals::i_S4_SRR_RL_Obj_ID_6);

	testStep("get expect variable value: ","i_S4_SRR_RL_Obj_ID_6 :%o",@ecu_Signals::i_S4_SRR_RL_Obj_ID_6);

	if(signalvalue1==@ecu_Signals::i_S4_SRR_RL_Obj_ID_6)
	{
	testStepPass("Pass","i_S4_SRR_RL_Obj_ID_6 :%f",signalvalue1);
	}
	else
	{
	testStepFail("Fail","i_S4_SRR_RL_Obj_ID_6 :%f",signalvalue1);
	}
}

testcase S4_SRR_RL_Obj_Mes_2_S4_SRR_RL_Obj_DistX_6()
{
	signalvalue1 = getSignal(S4_SRR_RL_Obj_DistX_6);
	write("S4_SRR_RL_Obj_DistX_6 :%f",signalvalue1);
	write("i_S4_SRR_RL_Obj_DistX_6 :%f",@ecu_Signals::i_S4_SRR_RL_Obj_DistX_6);

	testStep("get expect variable value: ","i_S4_SRR_RL_Obj_DistX_6 :%f",@ecu_Signals::i_S4_SRR_RL_Obj_DistX_6);

	if((abs(@ecu_Signals::i_S4_SRR_RL_Obj_DistX_6)*0.9<=abs(signalvalue1))&&(abs(signalvalue1)<=abs(@ecu_Signals::i_S4_SRR_RL_Obj_DistX_6)*1.1))
	{
	testStepPass("Pass","i_S4_SRR_RL_Obj_DistX_6 :%f",signalvalue1);
	}
	else
	{
	testStepFail("Fail","i_S4_SRR_RL_Obj_DistX_6 :%f",signalvalue1);
	}
}

testcase S4_SRR_RL_Obj_Mes_2_S4_SRR_RL_Obj_RelVelX_6()
{
	signalvalue1 = getSignal(S4_SRR_RL_Obj_RelVelX_6);
	write("S4_SRR_RL_Obj_RelVelX_6 :%f",signalvalue1);
	write("i_S4_SRR_RL_Obj_RelVelX_6 :%f",@ecu_Signals::i_S4_SRR_RL_Obj_RelVelX_6);

	testStep("get expect variable value: ","i_S4_SRR_RL_Obj_RelVelX_6 :%f",@ecu_Signals::i_S4_SRR_RL_Obj_RelVelX_6);

	if((abs(@ecu_Signals::i_S4_SRR_RL_Obj_RelVelX_6)*0.9<=abs(signalvalue1))&&(abs(signalvalue1)<=abs(@ecu_Signals::i_S4_SRR_RL_Obj_RelVelX_6)*1.1))
	{
	testStepPass("Pass","i_S4_SRR_RL_Obj_RelVelX_6 :%f",signalvalue1);
	}
	else
	{
	testStepFail("Fail","i_S4_SRR_RL_Obj_RelVelX_6 :%f",signalvalue1);
	}
}

testcase S4_SRR_RL_Obj_Mes_2_S4_SRR_RL_Obj_AccelX_6()
{
	signalvalue1 = getSignal(S4_SRR_RL_Obj_AccelX_6);
	write("S4_SRR_RL_Obj_AccelX_6 :%f",signalvalue1);
	write("i_S4_SRR_RL_Obj_AccelX_6 :%f",@ecu_Signals::i_S4_SRR_RL_Obj_AccelX_6);

	testStep("get expect variable value: ","i_S4_SRR_RL_Obj_AccelX_6 :%f",@ecu_Signals::i_S4_SRR_RL_Obj_AccelX_6);

	if((abs(@ecu_Signals::i_S4_SRR_RL_Obj_AccelX_6)*0.9<=abs(signalvalue1))&&(abs(signalvalue1)<=abs(@ecu_Signals::i_S4_SRR_RL_Obj_AccelX_6)*1.1))
	{
	testStepPass("Pass","i_S4_SRR_RL_Obj_AccelX_6 :%f",signalvalue1);
	}
	else
	{
	testStepFail("Fail","i_S4_SRR_RL_Obj_AccelX_6 :%f",signalvalue1);
	}
}

testcase S4_SRR_RL_Obj_Mes_2_S4_SRR_RL_Obj_DistY_6()
{
	signalvalue1 = getSignal(S4_SRR_RL_Obj_DistY_6);
	write("S4_SRR_RL_Obj_DistY_6 :%f",signalvalue1);
	write("i_S4_SRR_RL_Obj_DistY_6 :%f",@ecu_Signals::i_S4_SRR_RL_Obj_DistY_6);

	testStep("get expect variable value: ","i_S4_SRR_RL_Obj_DistY_6 :%f",@ecu_Signals::i_S4_SRR_RL_Obj_DistY_6);

	if((abs(@ecu_Signals::i_S4_SRR_RL_Obj_DistY_6)*0.9<=abs(signalvalue1))&&(abs(signalvalue1)<=abs(@ecu_Signals::i_S4_SRR_RL_Obj_DistY_6)*1.1))
	{
	testStepPass("Pass","i_S4_SRR_RL_Obj_DistY_6 :%f",signalvalue1);
	}
	else
	{
	testStepFail("Fail","i_S4_SRR_RL_Obj_DistY_6 :%f",signalvalue1);
	}
}

testcase S4_SRR_RL_Obj_Mes_2_S4_SRR_RL_Obj_RelVelY_6()
{
	signalvalue1 = getSignal(S4_SRR_RL_Obj_RelVelY_6);
	write("S4_SRR_RL_Obj_RelVelY_6 :%f",signalvalue1);
	write("i_S4_SRR_RL_Obj_RelVelY_6 :%f",@ecu_Signals::i_S4_SRR_RL_Obj_RelVelY_6);

	testStep("get expect variable value: ","i_S4_SRR_RL_Obj_RelVelY_6 :%f",@ecu_Signals::i_S4_SRR_RL_Obj_RelVelY_6);

	if((abs(@ecu_Signals::i_S4_SRR_RL_Obj_RelVelY_6)*0.9<=abs(signalvalue1))&&(abs(signalvalue1)<=abs(@ecu_Signals::i_S4_SRR_RL_Obj_RelVelY_6)*1.1))
	{
	testStepPass("Pass","i_S4_SRR_RL_Obj_RelVelY_6 :%f",signalvalue1);
	}
	else
	{
	testStepFail("Fail","i_S4_SRR_RL_Obj_RelVelY_6 :%f",signalvalue1);
	}
}

testcase S4_SRR_RL_Obj_Mes_2_S4_SRR_RL_Obj_AccelY_6()
{
	signalvalue1 = getSignal(S4_SRR_RL_Obj_AccelY_6);
	write("S4_SRR_RL_Obj_AccelY_6 :%f",signalvalue1);
	write("i_S4_SRR_RL_Obj_AccelY_6 :%f",@ecu_Signals::i_S4_SRR_RL_Obj_AccelY_6);

	testStep("get expect variable value: ","i_S4_SRR_RL_Obj_AccelY_6 :%f",@ecu_Signals::i_S4_SRR_RL_Obj_AccelY_6);

	if((abs(@ecu_Signals::i_S4_SRR_RL_Obj_AccelY_6)*0.9<=abs(signalvalue1))&&(abs(signalvalue1)<=abs(@ecu_Signals::i_S4_SRR_RL_Obj_AccelY_6)*1.1))
	{
	testStepPass("Pass","i_S4_SRR_RL_Obj_AccelY_6 :%f",signalvalue1);
	}
	else
	{
	testStepFail("Fail","i_S4_SRR_RL_Obj_AccelY_6 :%f",signalvalue1);
	}
}

testcase S4_SRR_RL_Obj_Mes_2_S4_SRR_RL_Obj_DistXStd_6()
{
	signalvalue1 = getSignal(S4_SRR_RL_Obj_DistXStd_6);
	write("S4_SRR_RL_Obj_DistXStd_6 :%f",signalvalue1);
	write("i_S4_SRR_RL_Obj_DistXStd_6 :%f",@ecu_Signals::i_S4_SRR_RL_Obj_DistXStd_6);

	testStep("get expect variable value: ","i_S4_SRR_RL_Obj_DistXStd_6 :%f",@ecu_Signals::i_S4_SRR_RL_Obj_DistXStd_6);

	if((abs(@ecu_Signals::i_S4_SRR_RL_Obj_DistXStd_6)*0.9<=abs(signalvalue1))&&(abs(signalvalue1)<=abs(@ecu_Signals::i_S4_SRR_RL_Obj_DistXStd_6)*1.1))
	{
	testStepPass("Pass","i_S4_SRR_RL_Obj_DistXStd_6 :%f",signalvalue1);
	}
	else
	{
	testStepFail("Fail","i_S4_SRR_RL_Obj_DistXStd_6 :%f",signalvalue1);
	}
}

testcase S4_SRR_RL_Obj_Mes_2_S4_SRR_RL_Obj_RelVelXStd_6()
{
	signalvalue1 = getSignal(S4_SRR_RL_Obj_RelVelXStd_6);
	write("S4_SRR_RL_Obj_RelVelXStd_6 :%f",signalvalue1);
	write("i_S4_SRR_RL_Obj_RelVelXStd_6 :%f",@ecu_Signals::i_S4_SRR_RL_Obj_RelVelXStd_6);

	testStep("get expect variable value: ","i_S4_SRR_RL_Obj_RelVelXStd_6 :%f",@ecu_Signals::i_S4_SRR_RL_Obj_RelVelXStd_6);

	if((abs(@ecu_Signals::i_S4_SRR_RL_Obj_RelVelXStd_6)*0.9<=abs(signalvalue1))&&(abs(signalvalue1)<=abs(@ecu_Signals::i_S4_SRR_RL_Obj_RelVelXStd_6)*1.1))
	{
	testStepPass("Pass","i_S4_SRR_RL_Obj_RelVelXStd_6 :%f",signalvalue1);
	}
	else
	{
	testStepFail("Fail","i_S4_SRR_RL_Obj_RelVelXStd_6 :%f",signalvalue1);
	}
}

testcase S4_SRR_RL_Obj_Mes_2_S4_SRR_RL_Obj_DistYStd_6()
{
	signalvalue1 = getSignal(S4_SRR_RL_Obj_DistYStd_6);
	write("S4_SRR_RL_Obj_DistYStd_6 :%f",signalvalue1);
	write("i_S4_SRR_RL_Obj_DistYStd_6 :%f",@ecu_Signals::i_S4_SRR_RL_Obj_DistYStd_6);

	testStep("get expect variable value: ","i_S4_SRR_RL_Obj_DistYStd_6 :%f",@ecu_Signals::i_S4_SRR_RL_Obj_DistYStd_6);

	if((abs(@ecu_Signals::i_S4_SRR_RL_Obj_DistYStd_6)*0.9<=abs(signalvalue1))&&(abs(signalvalue1)<=abs(@ecu_Signals::i_S4_SRR_RL_Obj_DistYStd_6)*1.1))
	{
	testStepPass("Pass","i_S4_SRR_RL_Obj_DistYStd_6 :%f",signalvalue1);
	}
	else
	{
	testStepFail("Fail","i_S4_SRR_RL_Obj_DistYStd_6 :%f",signalvalue1);
	}
}

testcase S4_SRR_RL_Obj_Mes_2_S4_SRR_RL_Obj_RelVelYStd_6()
{
	signalvalue1 = getSignal(S4_SRR_RL_Obj_RelVelYStd_6);
	write("S4_SRR_RL_Obj_RelVelYStd_6 :%f",signalvalue1);
	write("i_S4_SRR_RL_Obj_RelVelYStd_6 :%f",@ecu_Signals::i_S4_SRR_RL_Obj_RelVelYStd_6);

	testStep("get expect variable value: ","i_S4_SRR_RL_Obj_RelVelYStd_6 :%f",@ecu_Signals::i_S4_SRR_RL_Obj_RelVelYStd_6);

	if((abs(@ecu_Signals::i_S4_SRR_RL_Obj_RelVelYStd_6)*0.9<=abs(signalvalue1))&&(abs(signalvalue1)<=abs(@ecu_Signals::i_S4_SRR_RL_Obj_RelVelYStd_6)*1.1))
	{
	testStepPass("Pass","i_S4_SRR_RL_Obj_RelVelYStd_6 :%f",signalvalue1);
	}
	else
	{
	testStepFail("Fail","i_S4_SRR_RL_Obj_RelVelYStd_6 :%f",signalvalue1);
	}
}

testcase S4_SRR_RL_Obj_Mes_2_S4_SRR_RL_Obj_UpdateFlag_6()
{
	signalvalue1 = getSignal(S4_SRR_RL_Obj_UpdateFlag_6);
	write("S4_SRR_RL_Obj_UpdateFlag_6 :%f",signalvalue1);
	write("i_S4_SRR_RL_Obj_UpdateFlag_6 :%o",@ecu_Signals::i_S4_SRR_RL_Obj_UpdateFlag_6);

	testStep("get expect variable value: ","i_S4_SRR_RL_Obj_UpdateFlag_6 :%o",@ecu_Signals::i_S4_SRR_RL_Obj_UpdateFlag_6);

	if(signalvalue1==@ecu_Signals::i_S4_SRR_RL_Obj_UpdateFlag_6)
	{
	testStepPass("Pass","i_S4_SRR_RL_Obj_UpdateFlag_6 :%f",signalvalue1);
	}
	else
	{
	testStepFail("Fail","i_S4_SRR_RL_Obj_UpdateFlag_6 :%f",signalvalue1);
	}
}

testcase S4_SRR_RL_Obj_Mes_2_S4_SRR_RL_Obj_ExistProb_6()
{
	signalvalue1 = getSignal(S4_SRR_RL_Obj_ExistProb_6);
	write("S4_SRR_RL_Obj_ExistProb_6 :%f",signalvalue1);
	write("i_S4_SRR_RL_Obj_ExistProb_6 :%o",@ecu_Signals::i_S4_SRR_RL_Obj_ExistProb_6);

	testStep("get expect variable value: ","i_S4_SRR_RL_Obj_ExistProb_6 :%o",@ecu_Signals::i_S4_SRR_RL_Obj_ExistProb_6);

	if(signalvalue1==@ecu_Signals::i_S4_SRR_RL_Obj_ExistProb_6)
	{
	testStepPass("Pass","i_S4_SRR_RL_Obj_ExistProb_6 :%f",signalvalue1);
	}
	else
	{
	testStepFail("Fail","i_S4_SRR_RL_Obj_ExistProb_6 :%f",signalvalue1);
	}
}

testcase S4_SRR_RL_Obj_Mes_2_S4_SRR_RL_Obj_Type_6()
{
	signalvalue1 = getSignal(S4_SRR_RL_Obj_Type_6);
	write("S4_SRR_RL_Obj_Type_6 :%f",signalvalue1);
	write("i_S4_SRR_RL_Obj_Type_6 :%o",@ecu_Signals::i_S4_SRR_RL_Obj_Type_6);

	testStep("get expect variable value: ","i_S4_SRR_RL_Obj_Type_6 :%o",@ecu_Signals::i_S4_SRR_RL_Obj_Type_6);

	if(signalvalue1==@ecu_Signals::i_S4_SRR_RL_Obj_Type_6)
	{
	testStepPass("Pass","i_S4_SRR_RL_Obj_Type_6 :%f",signalvalue1);
	}
	else
	{
	testStepFail("Fail","i_S4_SRR_RL_Obj_Type_6 :%f",signalvalue1);
	}
}

testcase S4_SRR_RL_Obj_Mes_2_S4_SRR_RL_Obj_EDynProp_6()
{
	signalvalue1 = getSignal(S4_SRR_RL_Obj_EDynProp_6);
	write("S4_SRR_RL_Obj_EDynProp_6 :%f",signalvalue1);
	write("i_S4_SRR_RL_Obj_EDynProp_6 :%o",@ecu_Signals::i_S4_SRR_RL_Obj_EDynProp_6);

	testStep("get expect variable value: ","i_S4_SRR_RL_Obj_EDynProp_6 :%o",@ecu_Signals::i_S4_SRR_RL_Obj_EDynProp_6);

	if(signalvalue1==@ecu_Signals::i_S4_SRR_RL_Obj_EDynProp_6)
	{
	testStepPass("Pass","i_S4_SRR_RL_Obj_EDynProp_6 :%f",signalvalue1);
	}
	else
	{
	testStepFail("Fail","i_S4_SRR_RL_Obj_EDynProp_6 :%f",signalvalue1);
	}
}

testcase S4_SRR_RL_Obj_Mes_2_S4_SRR_RL_Obj_UiLifeCycles_6()
{
	signalvalue1 = getSignal(S4_SRR_RL_Obj_UiLifeCycles_6);
	write("S4_SRR_RL_Obj_UiLifeCycles_6 :%f",signalvalue1);
	write("i_S4_SRR_RL_Obj_UiLifeCycles_6 :%o",@ecu_Signals::i_S4_SRR_RL_Obj_UiLifeCycles_6);

	testStep("get expect variable value: ","i_S4_SRR_RL_Obj_UiLifeCycles_6 :%o",@ecu_Signals::i_S4_SRR_RL_Obj_UiLifeCycles_6);

	if(signalvalue1==@ecu_Signals::i_S4_SRR_RL_Obj_UiLifeCycles_6)
	{
	testStepPass("Pass","i_S4_SRR_RL_Obj_UiLifeCycles_6 :%f",signalvalue1);
	}
	else
	{
	testStepFail("Fail","i_S4_SRR_RL_Obj_UiLifeCycles_6 :%f",signalvalue1);
	}
}

testcase S4_SRR_RL_Obj_Mes_2_S4_SRR_RL_Obj_ID_7()
{
	signalvalue1 = getSignal(S4_SRR_RL_Obj_ID_7);
	write("S4_SRR_RL_Obj_ID_7 :%f",signalvalue1);
	write("i_S4_SRR_RL_Obj_ID_7 :%o",@ecu_Signals::i_S4_SRR_RL_Obj_ID_7);

	testStep("get expect variable value: ","i_S4_SRR_RL_Obj_ID_7 :%o",@ecu_Signals::i_S4_SRR_RL_Obj_ID_7);

	if(signalvalue1==@ecu_Signals::i_S4_SRR_RL_Obj_ID_7)
	{
	testStepPass("Pass","i_S4_SRR_RL_Obj_ID_7 :%f",signalvalue1);
	}
	else
	{
	testStepFail("Fail","i_S4_SRR_RL_Obj_ID_7 :%f",signalvalue1);
	}
}

testcase S4_SRR_RL_Obj_Mes_2_S4_SRR_RL_Obj_DistX_7()
{
	signalvalue1 = getSignal(S4_SRR_RL_Obj_DistX_7);
	write("S4_SRR_RL_Obj_DistX_7 :%f",signalvalue1);
	write("i_S4_SRR_RL_Obj_DistX_7 :%f",@ecu_Signals::i_S4_SRR_RL_Obj_DistX_7);

	testStep("get expect variable value: ","i_S4_SRR_RL_Obj_DistX_7 :%f",@ecu_Signals::i_S4_SRR_RL_Obj_DistX_7);

	if((abs(@ecu_Signals::i_S4_SRR_RL_Obj_DistX_7)*0.9<=abs(signalvalue1))&&(abs(signalvalue1)<=abs(@ecu_Signals::i_S4_SRR_RL_Obj_DistX_7)*1.1))
	{
	testStepPass("Pass","i_S4_SRR_RL_Obj_DistX_7 :%f",signalvalue1);
	}
	else
	{
	testStepFail("Fail","i_S4_SRR_RL_Obj_DistX_7 :%f",signalvalue1);
	}
}

testcase S4_SRR_RL_Obj_Mes_2_S4_SRR_RL_Obj_RelVelX_7()
{
	signalvalue1 = getSignal(S4_SRR_RL_Obj_RelVelX_7);
	write("S4_SRR_RL_Obj_RelVelX_7 :%f",signalvalue1);
	write("i_S4_SRR_RL_Obj_RelVelX_7 :%f",@ecu_Signals::i_S4_SRR_RL_Obj_RelVelX_7);

	testStep("get expect variable value: ","i_S4_SRR_RL_Obj_RelVelX_7 :%f",@ecu_Signals::i_S4_SRR_RL_Obj_RelVelX_7);

	if((abs(@ecu_Signals::i_S4_SRR_RL_Obj_RelVelX_7)*0.9<=abs(signalvalue1))&&(abs(signalvalue1)<=abs(@ecu_Signals::i_S4_SRR_RL_Obj_RelVelX_7)*1.1))
	{
	testStepPass("Pass","i_S4_SRR_RL_Obj_RelVelX_7 :%f",signalvalue1);
	}
	else
	{
	testStepFail("Fail","i_S4_SRR_RL_Obj_RelVelX_7 :%f",signalvalue1);
	}
}

testcase S4_SRR_RL_Obj_Mes_2_S4_SRR_RL_Obj_AccelX_7()
{
	signalvalue1 = getSignal(S4_SRR_RL_Obj_AccelX_7);
	write("S4_SRR_RL_Obj_AccelX_7 :%f",signalvalue1);
	write("i_S4_SRR_RL_Obj_AccelX_7 :%f",@ecu_Signals::i_S4_SRR_RL_Obj_AccelX_7);

	testStep("get expect variable value: ","i_S4_SRR_RL_Obj_AccelX_7 :%f",@ecu_Signals::i_S4_SRR_RL_Obj_AccelX_7);

	if((abs(@ecu_Signals::i_S4_SRR_RL_Obj_AccelX_7)*0.9<=abs(signalvalue1))&&(abs(signalvalue1)<=abs(@ecu_Signals::i_S4_SRR_RL_Obj_AccelX_7)*1.1))
	{
	testStepPass("Pass","i_S4_SRR_RL_Obj_AccelX_7 :%f",signalvalue1);
	}
	else
	{
	testStepFail("Fail","i_S4_SRR_RL_Obj_AccelX_7 :%f",signalvalue1);
	}
}

testcase S4_SRR_RL_Obj_Mes_2_S4_SRR_RL_Obj_DistY_7()
{
	signalvalue1 = getSignal(S4_SRR_RL_Obj_DistY_7);
	write("S4_SRR_RL_Obj_DistY_7 :%f",signalvalue1);
	write("i_S4_SRR_RL_Obj_DistY_7 :%f",@ecu_Signals::i_S4_SRR_RL_Obj_DistY_7);

	testStep("get expect variable value: ","i_S4_SRR_RL_Obj_DistY_7 :%f",@ecu_Signals::i_S4_SRR_RL_Obj_DistY_7);

	if((abs(@ecu_Signals::i_S4_SRR_RL_Obj_DistY_7)*0.9<=abs(signalvalue1))&&(abs(signalvalue1)<=abs(@ecu_Signals::i_S4_SRR_RL_Obj_DistY_7)*1.1))
	{
	testStepPass("Pass","i_S4_SRR_RL_Obj_DistY_7 :%f",signalvalue1);
	}
	else
	{
	testStepFail("Fail","i_S4_SRR_RL_Obj_DistY_7 :%f",signalvalue1);
	}
}

testcase S4_SRR_RL_Obj_Mes_2_S4_SRR_RL_Obj_RelVelY_7()
{
	signalvalue1 = getSignal(S4_SRR_RL_Obj_RelVelY_7);
	write("S4_SRR_RL_Obj_RelVelY_7 :%f",signalvalue1);
	write("i_S4_SRR_RL_Obj_RelVelY_7 :%f",@ecu_Signals::i_S4_SRR_RL_Obj_RelVelY_7);

	testStep("get expect variable value: ","i_S4_SRR_RL_Obj_RelVelY_7 :%f",@ecu_Signals::i_S4_SRR_RL_Obj_RelVelY_7);

	if((abs(@ecu_Signals::i_S4_SRR_RL_Obj_RelVelY_7)*0.9<=abs(signalvalue1))&&(abs(signalvalue1)<=abs(@ecu_Signals::i_S4_SRR_RL_Obj_RelVelY_7)*1.1))
	{
	testStepPass("Pass","i_S4_SRR_RL_Obj_RelVelY_7 :%f",signalvalue1);
	}
	else
	{
	testStepFail("Fail","i_S4_SRR_RL_Obj_RelVelY_7 :%f",signalvalue1);
	}
}

testcase S4_SRR_RL_Obj_Mes_2_S4_SRR_RL_Obj_AccelY_7()
{
	signalvalue1 = getSignal(S4_SRR_RL_Obj_AccelY_7);
	write("S4_SRR_RL_Obj_AccelY_7 :%f",signalvalue1);
	write("i_S4_SRR_RL_Obj_AccelY_7 :%f",@ecu_Signals::i_S4_SRR_RL_Obj_AccelY_7);

	testStep("get expect variable value: ","i_S4_SRR_RL_Obj_AccelY_7 :%f",@ecu_Signals::i_S4_SRR_RL_Obj_AccelY_7);

	if((abs(@ecu_Signals::i_S4_SRR_RL_Obj_AccelY_7)*0.9<=abs(signalvalue1))&&(abs(signalvalue1)<=abs(@ecu_Signals::i_S4_SRR_RL_Obj_AccelY_7)*1.1))
	{
	testStepPass("Pass","i_S4_SRR_RL_Obj_AccelY_7 :%f",signalvalue1);
	}
	else
	{
	testStepFail("Fail","i_S4_SRR_RL_Obj_AccelY_7 :%f",signalvalue1);
	}
}

testcase S4_SRR_RL_Obj_Mes_2_S4_SRR_RL_Obj_DistXStd_7()
{
	signalvalue1 = getSignal(S4_SRR_RL_Obj_DistXStd_7);
	write("S4_SRR_RL_Obj_DistXStd_7 :%f",signalvalue1);
	write("i_S4_SRR_RL_Obj_DistXStd_7 :%f",@ecu_Signals::i_S4_SRR_RL_Obj_DistXStd_7);

	testStep("get expect variable value: ","i_S4_SRR_RL_Obj_DistXStd_7 :%f",@ecu_Signals::i_S4_SRR_RL_Obj_DistXStd_7);

	if((abs(@ecu_Signals::i_S4_SRR_RL_Obj_DistXStd_7)*0.9<=abs(signalvalue1))&&(abs(signalvalue1)<=abs(@ecu_Signals::i_S4_SRR_RL_Obj_DistXStd_7)*1.1))
	{
	testStepPass("Pass","i_S4_SRR_RL_Obj_DistXStd_7 :%f",signalvalue1);
	}
	else
	{
	testStepFail("Fail","i_S4_SRR_RL_Obj_DistXStd_7 :%f",signalvalue1);
	}
}

testcase S4_SRR_RL_Obj_Mes_2_S4_SRR_RL_Obj_RelVelXStd_7()
{
	signalvalue1 = getSignal(S4_SRR_RL_Obj_RelVelXStd_7);
	write("S4_SRR_RL_Obj_RelVelXStd_7 :%f",signalvalue1);
	write("i_S4_SRR_RL_Obj_RelVelXStd_7 :%f",@ecu_Signals::i_S4_SRR_RL_Obj_RelVelXStd_7);

	testStep("get expect variable value: ","i_S4_SRR_RL_Obj_RelVelXStd_7 :%f",@ecu_Signals::i_S4_SRR_RL_Obj_RelVelXStd_7);

	if((abs(@ecu_Signals::i_S4_SRR_RL_Obj_RelVelXStd_7)*0.9<=abs(signalvalue1))&&(abs(signalvalue1)<=abs(@ecu_Signals::i_S4_SRR_RL_Obj_RelVelXStd_7)*1.1))
	{
	testStepPass("Pass","i_S4_SRR_RL_Obj_RelVelXStd_7 :%f",signalvalue1);
	}
	else
	{
	testStepFail("Fail","i_S4_SRR_RL_Obj_RelVelXStd_7 :%f",signalvalue1);
	}
}

testcase S4_SRR_RL_Obj_Mes_2_S4_SRR_RL_Obj_DistYStd_7()
{
	signalvalue1 = getSignal(S4_SRR_RL_Obj_DistYStd_7);
	write("S4_SRR_RL_Obj_DistYStd_7 :%f",signalvalue1);
	write("i_S4_SRR_RL_Obj_DistYStd_7 :%f",@ecu_Signals::i_S4_SRR_RL_Obj_DistYStd_7);

	testStep("get expect variable value: ","i_S4_SRR_RL_Obj_DistYStd_7 :%f",@ecu_Signals::i_S4_SRR_RL_Obj_DistYStd_7);

	if((abs(@ecu_Signals::i_S4_SRR_RL_Obj_DistYStd_7)*0.9<=abs(signalvalue1))&&(abs(signalvalue1)<=abs(@ecu_Signals::i_S4_SRR_RL_Obj_DistYStd_7)*1.1))
	{
	testStepPass("Pass","i_S4_SRR_RL_Obj_DistYStd_7 :%f",signalvalue1);
	}
	else
	{
	testStepFail("Fail","i_S4_SRR_RL_Obj_DistYStd_7 :%f",signalvalue1);
	}
}

testcase S4_SRR_RL_Obj_Mes_2_S4_SRR_RL_Obj_RelVelYStd_7()
{
	signalvalue1 = getSignal(S4_SRR_RL_Obj_RelVelYStd_7);
	write("S4_SRR_RL_Obj_RelVelYStd_7 :%f",signalvalue1);
	write("i_S4_SRR_RL_Obj_RelVelYStd_7 :%f",@ecu_Signals::i_S4_SRR_RL_Obj_RelVelYStd_7);

	testStep("get expect variable value: ","i_S4_SRR_RL_Obj_RelVelYStd_7 :%f",@ecu_Signals::i_S4_SRR_RL_Obj_RelVelYStd_7);

	if((abs(@ecu_Signals::i_S4_SRR_RL_Obj_RelVelYStd_7)*0.9<=abs(signalvalue1))&&(abs(signalvalue1)<=abs(@ecu_Signals::i_S4_SRR_RL_Obj_RelVelYStd_7)*1.1))
	{
	testStepPass("Pass","i_S4_SRR_RL_Obj_RelVelYStd_7 :%f",signalvalue1);
	}
	else
	{
	testStepFail("Fail","i_S4_SRR_RL_Obj_RelVelYStd_7 :%f",signalvalue1);
	}
}

testcase S4_SRR_RL_Obj_Mes_2_S4_SRR_RL_Obj_UpdateFlag_7()
{
	signalvalue1 = getSignal(S4_SRR_RL_Obj_UpdateFlag_7);
	write("S4_SRR_RL_Obj_UpdateFlag_7 :%f",signalvalue1);
	write("i_S4_SRR_RL_Obj_UpdateFlag_7 :%o",@ecu_Signals::i_S4_SRR_RL_Obj_UpdateFlag_7);

	testStep("get expect variable value: ","i_S4_SRR_RL_Obj_UpdateFlag_7 :%o",@ecu_Signals::i_S4_SRR_RL_Obj_UpdateFlag_7);

	if(signalvalue1==@ecu_Signals::i_S4_SRR_RL_Obj_UpdateFlag_7)
	{
	testStepPass("Pass","i_S4_SRR_RL_Obj_UpdateFlag_7 :%f",signalvalue1);
	}
	else
	{
	testStepFail("Fail","i_S4_SRR_RL_Obj_UpdateFlag_7 :%f",signalvalue1);
	}
}

testcase S4_SRR_RL_Obj_Mes_2_S4_SRR_RL_Obj_ExistProb_7()
{
	signalvalue1 = getSignal(S4_SRR_RL_Obj_ExistProb_7);
	write("S4_SRR_RL_Obj_ExistProb_7 :%f",signalvalue1);
	write("i_S4_SRR_RL_Obj_ExistProb_7 :%o",@ecu_Signals::i_S4_SRR_RL_Obj_ExistProb_7);

	testStep("get expect variable value: ","i_S4_SRR_RL_Obj_ExistProb_7 :%o",@ecu_Signals::i_S4_SRR_RL_Obj_ExistProb_7);

	if(signalvalue1==@ecu_Signals::i_S4_SRR_RL_Obj_ExistProb_7)
	{
	testStepPass("Pass","i_S4_SRR_RL_Obj_ExistProb_7 :%f",signalvalue1);
	}
	else
	{
	testStepFail("Fail","i_S4_SRR_RL_Obj_ExistProb_7 :%f",signalvalue1);
	}
}

testcase S4_SRR_RL_Obj_Mes_2_S4_SRR_RL_Obj_Type_7()
{
	signalvalue1 = getSignal(S4_SRR_RL_Obj_Type_7);
	write("S4_SRR_RL_Obj_Type_7 :%f",signalvalue1);
	write("i_S4_SRR_RL_Obj_Type_7 :%o",@ecu_Signals::i_S4_SRR_RL_Obj_Type_7);

	testStep("get expect variable value: ","i_S4_SRR_RL_Obj_Type_7 :%o",@ecu_Signals::i_S4_SRR_RL_Obj_Type_7);

	if(signalvalue1==@ecu_Signals::i_S4_SRR_RL_Obj_Type_7)
	{
	testStepPass("Pass","i_S4_SRR_RL_Obj_Type_7 :%f",signalvalue1);
	}
	else
	{
	testStepFail("Fail","i_S4_SRR_RL_Obj_Type_7 :%f",signalvalue1);
	}
}

testcase S4_SRR_RL_Obj_Mes_2_S4_SRR_RL_Obj_EDynProp_7()
{
	signalvalue1 = getSignal(S4_SRR_RL_Obj_EDynProp_7);
	write("S4_SRR_RL_Obj_EDynProp_7 :%f",signalvalue1);
	write("i_S4_SRR_RL_Obj_EDynProp_7 :%o",@ecu_Signals::i_S4_SRR_RL_Obj_EDynProp_7);

	testStep("get expect variable value: ","i_S4_SRR_RL_Obj_EDynProp_7 :%o",@ecu_Signals::i_S4_SRR_RL_Obj_EDynProp_7);

	if(signalvalue1==@ecu_Signals::i_S4_SRR_RL_Obj_EDynProp_7)
	{
	testStepPass("Pass","i_S4_SRR_RL_Obj_EDynProp_7 :%f",signalvalue1);
	}
	else
	{
	testStepFail("Fail","i_S4_SRR_RL_Obj_EDynProp_7 :%f",signalvalue1);
	}
}

testcase S4_SRR_RL_Obj_Mes_2_S4_SRR_RL_Obj_UiLifeCycles_7()
{
	signalvalue1 = getSignal(S4_SRR_RL_Obj_UiLifeCycles_7);
	write("S4_SRR_RL_Obj_UiLifeCycles_7 :%f",signalvalue1);
	write("i_S4_SRR_RL_Obj_UiLifeCycles_7 :%o",@ecu_Signals::i_S4_SRR_RL_Obj_UiLifeCycles_7);

	testStep("get expect variable value: ","i_S4_SRR_RL_Obj_UiLifeCycles_7 :%o",@ecu_Signals::i_S4_SRR_RL_Obj_UiLifeCycles_7);

	if(signalvalue1==@ecu_Signals::i_S4_SRR_RL_Obj_UiLifeCycles_7)
	{
	testStepPass("Pass","i_S4_SRR_RL_Obj_UiLifeCycles_7 :%f",signalvalue1);
	}
	else
	{
	testStepFail("Fail","i_S4_SRR_RL_Obj_UiLifeCycles_7 :%f",signalvalue1);
	}
}

testcase S4_SRR_RL_Obj_Mes_2_S4_SRR_RL_Obj_ID_8()
{
	signalvalue1 = getSignal(S4_SRR_RL_Obj_ID_8);
	write("S4_SRR_RL_Obj_ID_8 :%f",signalvalue1);
	write("i_S4_SRR_RL_Obj_ID_8 :%o",@ecu_Signals::i_S4_SRR_RL_Obj_ID_8);

	testStep("get expect variable value: ","i_S4_SRR_RL_Obj_ID_8 :%o",@ecu_Signals::i_S4_SRR_RL_Obj_ID_8);

	if(signalvalue1==@ecu_Signals::i_S4_SRR_RL_Obj_ID_8)
	{
	testStepPass("Pass","i_S4_SRR_RL_Obj_ID_8 :%f",signalvalue1);
	}
	else
	{
	testStepFail("Fail","i_S4_SRR_RL_Obj_ID_8 :%f",signalvalue1);
	}
}

testcase S4_SRR_RL_Obj_Mes_2_S4_SRR_RL_Obj_DistX_8()
{
	signalvalue1 = getSignal(S4_SRR_RL_Obj_DistX_8);
	write("S4_SRR_RL_Obj_DistX_8 :%f",signalvalue1);
	write("i_S4_SRR_RL_Obj_DistX_8 :%f",@ecu_Signals::i_S4_SRR_RL_Obj_DistX_8);

	testStep("get expect variable value: ","i_S4_SRR_RL_Obj_DistX_8 :%f",@ecu_Signals::i_S4_SRR_RL_Obj_DistX_8);

	if((abs(@ecu_Signals::i_S4_SRR_RL_Obj_DistX_8)*0.9<=abs(signalvalue1))&&(abs(signalvalue1)<=abs(@ecu_Signals::i_S4_SRR_RL_Obj_DistX_8)*1.1))
	{
	testStepPass("Pass","i_S4_SRR_RL_Obj_DistX_8 :%f",signalvalue1);
	}
	else
	{
	testStepFail("Fail","i_S4_SRR_RL_Obj_DistX_8 :%f",signalvalue1);
	}
}

testcase S4_SRR_RL_Obj_Mes_2_S4_SRR_RL_Obj_RelVelX_8()
{
	signalvalue1 = getSignal(S4_SRR_RL_Obj_RelVelX_8);
	write("S4_SRR_RL_Obj_RelVelX_8 :%f",signalvalue1);
	write("i_S4_SRR_RL_Obj_RelVelX_8 :%f",@ecu_Signals::i_S4_SRR_RL_Obj_RelVelX_8);

	testStep("get expect variable value: ","i_S4_SRR_RL_Obj_RelVelX_8 :%f",@ecu_Signals::i_S4_SRR_RL_Obj_RelVelX_8);

	if((abs(@ecu_Signals::i_S4_SRR_RL_Obj_RelVelX_8)*0.9<=abs(signalvalue1))&&(abs(signalvalue1)<=abs(@ecu_Signals::i_S4_SRR_RL_Obj_RelVelX_8)*1.1))
	{
	testStepPass("Pass","i_S4_SRR_RL_Obj_RelVelX_8 :%f",signalvalue1);
	}
	else
	{
	testStepFail("Fail","i_S4_SRR_RL_Obj_RelVelX_8 :%f",signalvalue1);
	}
}

testcase S4_SRR_RL_Obj_Mes_2_S4_SRR_RL_Obj_AccelX_8()
{
	signalvalue1 = getSignal(S4_SRR_RL_Obj_AccelX_8);
	write("S4_SRR_RL_Obj_AccelX_8 :%f",signalvalue1);
	write("i_S4_SRR_RL_Obj_AccelX_8 :%f",@ecu_Signals::i_S4_SRR_RL_Obj_AccelX_8);

	testStep("get expect variable value: ","i_S4_SRR_RL_Obj_AccelX_8 :%f",@ecu_Signals::i_S4_SRR_RL_Obj_AccelX_8);

	if((abs(@ecu_Signals::i_S4_SRR_RL_Obj_AccelX_8)*0.9<=abs(signalvalue1))&&(abs(signalvalue1)<=abs(@ecu_Signals::i_S4_SRR_RL_Obj_AccelX_8)*1.1))
	{
	testStepPass("Pass","i_S4_SRR_RL_Obj_AccelX_8 :%f",signalvalue1);
	}
	else
	{
	testStepFail("Fail","i_S4_SRR_RL_Obj_AccelX_8 :%f",signalvalue1);
	}
}

testcase S4_SRR_RL_Obj_Mes_2_S4_SRR_RL_Obj_DistY_8()
{
	signalvalue1 = getSignal(S4_SRR_RL_Obj_DistY_8);
	write("S4_SRR_RL_Obj_DistY_8 :%f",signalvalue1);
	write("i_S4_SRR_RL_Obj_DistY_8 :%f",@ecu_Signals::i_S4_SRR_RL_Obj_DistY_8);

	testStep("get expect variable value: ","i_S4_SRR_RL_Obj_DistY_8 :%f",@ecu_Signals::i_S4_SRR_RL_Obj_DistY_8);

	if((abs(@ecu_Signals::i_S4_SRR_RL_Obj_DistY_8)*0.9<=abs(signalvalue1))&&(abs(signalvalue1)<=abs(@ecu_Signals::i_S4_SRR_RL_Obj_DistY_8)*1.1))
	{
	testStepPass("Pass","i_S4_SRR_RL_Obj_DistY_8 :%f",signalvalue1);
	}
	else
	{
	testStepFail("Fail","i_S4_SRR_RL_Obj_DistY_8 :%f",signalvalue1);
	}
}

testcase S4_SRR_RL_Obj_Mes_2_S4_SRR_RL_Obj_RelVelY_8()
{
	signalvalue1 = getSignal(S4_SRR_RL_Obj_RelVelY_8);
	write("S4_SRR_RL_Obj_RelVelY_8 :%f",signalvalue1);
	write("i_S4_SRR_RL_Obj_RelVelY_8 :%f",@ecu_Signals::i_S4_SRR_RL_Obj_RelVelY_8);

	testStep("get expect variable value: ","i_S4_SRR_RL_Obj_RelVelY_8 :%f",@ecu_Signals::i_S4_SRR_RL_Obj_RelVelY_8);

	if((abs(@ecu_Signals::i_S4_SRR_RL_Obj_RelVelY_8)*0.9<=abs(signalvalue1))&&(abs(signalvalue1)<=abs(@ecu_Signals::i_S4_SRR_RL_Obj_RelVelY_8)*1.1))
	{
	testStepPass("Pass","i_S4_SRR_RL_Obj_RelVelY_8 :%f",signalvalue1);
	}
	else
	{
	testStepFail("Fail","i_S4_SRR_RL_Obj_RelVelY_8 :%f",signalvalue1);
	}
}

testcase S4_SRR_RL_Obj_Mes_2_S4_SRR_RL_Obj_AccelY_8()
{
	signalvalue1 = getSignal(S4_SRR_RL_Obj_AccelY_8);
	write("S4_SRR_RL_Obj_AccelY_8 :%f",signalvalue1);
	write("i_S4_SRR_RL_Obj_AccelY_8 :%f",@ecu_Signals::i_S4_SRR_RL_Obj_AccelY_8);

	testStep("get expect variable value: ","i_S4_SRR_RL_Obj_AccelY_8 :%f",@ecu_Signals::i_S4_SRR_RL_Obj_AccelY_8);

	if((abs(@ecu_Signals::i_S4_SRR_RL_Obj_AccelY_8)*0.9<=abs(signalvalue1))&&(abs(signalvalue1)<=abs(@ecu_Signals::i_S4_SRR_RL_Obj_AccelY_8)*1.1))
	{
	testStepPass("Pass","i_S4_SRR_RL_Obj_AccelY_8 :%f",signalvalue1);
	}
	else
	{
	testStepFail("Fail","i_S4_SRR_RL_Obj_AccelY_8 :%f",signalvalue1);
	}
}

testcase S4_SRR_RL_Obj_Mes_2_S4_SRR_RL_Obj_DistXStd_8()
{
	signalvalue1 = getSignal(S4_SRR_RL_Obj_DistXStd_8);
	write("S4_SRR_RL_Obj_DistXStd_8 :%f",signalvalue1);
	write("i_S4_SRR_RL_Obj_DistXStd_8 :%f",@ecu_Signals::i_S4_SRR_RL_Obj_DistXStd_8);

	testStep("get expect variable value: ","i_S4_SRR_RL_Obj_DistXStd_8 :%f",@ecu_Signals::i_S4_SRR_RL_Obj_DistXStd_8);

	if((abs(@ecu_Signals::i_S4_SRR_RL_Obj_DistXStd_8)*0.9<=abs(signalvalue1))&&(abs(signalvalue1)<=abs(@ecu_Signals::i_S4_SRR_RL_Obj_DistXStd_8)*1.1))
	{
	testStepPass("Pass","i_S4_SRR_RL_Obj_DistXStd_8 :%f",signalvalue1);
	}
	else
	{
	testStepFail("Fail","i_S4_SRR_RL_Obj_DistXStd_8 :%f",signalvalue1);
	}
}

testcase S4_SRR_RL_Obj_Mes_2_S4_SRR_RL_Obj_RelVelXStd_8()
{
	signalvalue1 = getSignal(S4_SRR_RL_Obj_RelVelXStd_8);
	write("S4_SRR_RL_Obj_RelVelXStd_8 :%f",signalvalue1);
	write("i_S4_SRR_RL_Obj_RelVelXStd_8 :%f",@ecu_Signals::i_S4_SRR_RL_Obj_RelVelXStd_8);

	testStep("get expect variable value: ","i_S4_SRR_RL_Obj_RelVelXStd_8 :%f",@ecu_Signals::i_S4_SRR_RL_Obj_RelVelXStd_8);

	if((abs(@ecu_Signals::i_S4_SRR_RL_Obj_RelVelXStd_8)*0.9<=abs(signalvalue1))&&(abs(signalvalue1)<=abs(@ecu_Signals::i_S4_SRR_RL_Obj_RelVelXStd_8)*1.1))
	{
	testStepPass("Pass","i_S4_SRR_RL_Obj_RelVelXStd_8 :%f",signalvalue1);
	}
	else
	{
	testStepFail("Fail","i_S4_SRR_RL_Obj_RelVelXStd_8 :%f",signalvalue1);
	}
}

testcase S4_SRR_RL_Obj_Mes_2_S4_SRR_RL_Obj_DistYStd_8()
{
	signalvalue1 = getSignal(S4_SRR_RL_Obj_DistYStd_8);
	write("S4_SRR_RL_Obj_DistYStd_8 :%f",signalvalue1);
	write("i_S4_SRR_RL_Obj_DistYStd_8 :%f",@ecu_Signals::i_S4_SRR_RL_Obj_DistYStd_8);

	testStep("get expect variable value: ","i_S4_SRR_RL_Obj_DistYStd_8 :%f",@ecu_Signals::i_S4_SRR_RL_Obj_DistYStd_8);

	if((abs(@ecu_Signals::i_S4_SRR_RL_Obj_DistYStd_8)*0.9<=abs(signalvalue1))&&(abs(signalvalue1)<=abs(@ecu_Signals::i_S4_SRR_RL_Obj_DistYStd_8)*1.1))
	{
	testStepPass("Pass","i_S4_SRR_RL_Obj_DistYStd_8 :%f",signalvalue1);
	}
	else
	{
	testStepFail("Fail","i_S4_SRR_RL_Obj_DistYStd_8 :%f",signalvalue1);
	}
}

testcase S4_SRR_RL_Obj_Mes_2_S4_SRR_RL_Obj_RelVelYStd_8()
{
	signalvalue1 = getSignal(S4_SRR_RL_Obj_RelVelYStd_8);
	write("S4_SRR_RL_Obj_RelVelYStd_8 :%f",signalvalue1);
	write("i_S4_SRR_RL_Obj_RelVelYStd_8 :%f",@ecu_Signals::i_S4_SRR_RL_Obj_RelVelYStd_8);

	testStep("get expect variable value: ","i_S4_SRR_RL_Obj_RelVelYStd_8 :%f",@ecu_Signals::i_S4_SRR_RL_Obj_RelVelYStd_8);

	if((abs(@ecu_Signals::i_S4_SRR_RL_Obj_RelVelYStd_8)*0.9<=abs(signalvalue1))&&(abs(signalvalue1)<=abs(@ecu_Signals::i_S4_SRR_RL_Obj_RelVelYStd_8)*1.1))
	{
	testStepPass("Pass","i_S4_SRR_RL_Obj_RelVelYStd_8 :%f",signalvalue1);
	}
	else
	{
	testStepFail("Fail","i_S4_SRR_RL_Obj_RelVelYStd_8 :%f",signalvalue1);
	}
}

testcase S4_SRR_RL_Obj_Mes_2_S4_SRR_RL_Obj_UpdateFlag_8()
{
	signalvalue1 = getSignal(S4_SRR_RL_Obj_UpdateFlag_8);
	write("S4_SRR_RL_Obj_UpdateFlag_8 :%f",signalvalue1);
	write("i_S4_SRR_RL_Obj_UpdateFlag_8 :%o",@ecu_Signals::i_S4_SRR_RL_Obj_UpdateFlag_8);

	testStep("get expect variable value: ","i_S4_SRR_RL_Obj_UpdateFlag_8 :%o",@ecu_Signals::i_S4_SRR_RL_Obj_UpdateFlag_8);

	if(signalvalue1==@ecu_Signals::i_S4_SRR_RL_Obj_UpdateFlag_8)
	{
	testStepPass("Pass","i_S4_SRR_RL_Obj_UpdateFlag_8 :%f",signalvalue1);
	}
	else
	{
	testStepFail("Fail","i_S4_SRR_RL_Obj_UpdateFlag_8 :%f",signalvalue1);
	}
}

testcase S4_SRR_RL_Obj_Mes_2_S4_SRR_RL_Obj_ExistProb_8()
{
	signalvalue1 = getSignal(S4_SRR_RL_Obj_ExistProb_8);
	write("S4_SRR_RL_Obj_ExistProb_8 :%f",signalvalue1);
	write("i_S4_SRR_RL_Obj_ExistProb_8 :%o",@ecu_Signals::i_S4_SRR_RL_Obj_ExistProb_8);

	testStep("get expect variable value: ","i_S4_SRR_RL_Obj_ExistProb_8 :%o",@ecu_Signals::i_S4_SRR_RL_Obj_ExistProb_8);

	if(signalvalue1==@ecu_Signals::i_S4_SRR_RL_Obj_ExistProb_8)
	{
	testStepPass("Pass","i_S4_SRR_RL_Obj_ExistProb_8 :%f",signalvalue1);
	}
	else
	{
	testStepFail("Fail","i_S4_SRR_RL_Obj_ExistProb_8 :%f",signalvalue1);
	}
}

testcase S4_SRR_RL_Obj_Mes_2_S4_SRR_RL_Obj_Type_8()
{
	signalvalue1 = getSignal(S4_SRR_RL_Obj_Type_8);
	write("S4_SRR_RL_Obj_Type_8 :%f",signalvalue1);
	write("i_S4_SRR_RL_Obj_Type_8 :%o",@ecu_Signals::i_S4_SRR_RL_Obj_Type_8);

	testStep("get expect variable value: ","i_S4_SRR_RL_Obj_Type_8 :%o",@ecu_Signals::i_S4_SRR_RL_Obj_Type_8);

	if(signalvalue1==@ecu_Signals::i_S4_SRR_RL_Obj_Type_8)
	{
	testStepPass("Pass","i_S4_SRR_RL_Obj_Type_8 :%f",signalvalue1);
	}
	else
	{
	testStepFail("Fail","i_S4_SRR_RL_Obj_Type_8 :%f",signalvalue1);
	}
}

testcase S4_SRR_RL_Obj_Mes_2_S4_SRR_RL_Obj_EDynProp_8()
{
	signalvalue1 = getSignal(S4_SRR_RL_Obj_EDynProp_8);
	write("S4_SRR_RL_Obj_EDynProp_8 :%f",signalvalue1);
	write("i_S4_SRR_RL_Obj_EDynProp_8 :%o",@ecu_Signals::i_S4_SRR_RL_Obj_EDynProp_8);

	testStep("get expect variable value: ","i_S4_SRR_RL_Obj_EDynProp_8 :%o",@ecu_Signals::i_S4_SRR_RL_Obj_EDynProp_8);

	if(signalvalue1==@ecu_Signals::i_S4_SRR_RL_Obj_EDynProp_8)
	{
	testStepPass("Pass","i_S4_SRR_RL_Obj_EDynProp_8 :%f",signalvalue1);
	}
	else
	{
	testStepFail("Fail","i_S4_SRR_RL_Obj_EDynProp_8 :%f",signalvalue1);
	}
}

testcase S4_SRR_RL_Obj_Mes_2_S4_SRR_RL_Obj_UiLifeCycles_8()
{
	signalvalue1 = getSignal(S4_SRR_RL_Obj_UiLifeCycles_8);
	write("S4_SRR_RL_Obj_UiLifeCycles_8 :%f",signalvalue1);
	write("i_S4_SRR_RL_Obj_UiLifeCycles_8 :%o",@ecu_Signals::i_S4_SRR_RL_Obj_UiLifeCycles_8);

	testStep("get expect variable value: ","i_S4_SRR_RL_Obj_UiLifeCycles_8 :%o",@ecu_Signals::i_S4_SRR_RL_Obj_UiLifeCycles_8);

	if(signalvalue1==@ecu_Signals::i_S4_SRR_RL_Obj_UiLifeCycles_8)
	{
	testStepPass("Pass","i_S4_SRR_RL_Obj_UiLifeCycles_8 :%f",signalvalue1);
	}
	else
	{
	testStepFail("Fail","i_S4_SRR_RL_Obj_UiLifeCycles_8 :%f",signalvalue1);
	}
}

testcase S4_SRR_RL_Obj_Mes_3_S4_SRR_RL_Obj_ID_9()
{
	signalvalue1 = getSignal(S4_SRR_RL_Obj_ID_9);
	write("S4_SRR_RL_Obj_ID_9 :%f",signalvalue1);
	write("i_S4_SRR_RL_Obj_ID_9 :%o",@ecu_Signals::i_S4_SRR_RL_Obj_ID_9);

	testStep("get expect variable value: ","i_S4_SRR_RL_Obj_ID_9 :%o",@ecu_Signals::i_S4_SRR_RL_Obj_ID_9);

	if(signalvalue1==@ecu_Signals::i_S4_SRR_RL_Obj_ID_9)
	{
	testStepPass("Pass","i_S4_SRR_RL_Obj_ID_9 :%f",signalvalue1);
	}
	else
	{
	testStepFail("Fail","i_S4_SRR_RL_Obj_ID_9 :%f",signalvalue1);
	}
}

testcase S4_SRR_RL_Obj_Mes_3_S4_SRR_RL_Obj_DistX_9()
{
	signalvalue1 = getSignal(S4_SRR_RL_Obj_DistX_9);
	write("S4_SRR_RL_Obj_DistX_9 :%f",signalvalue1);
	write("i_S4_SRR_RL_Obj_DistX_9 :%f",@ecu_Signals::i_S4_SRR_RL_Obj_DistX_9);

	testStep("get expect variable value: ","i_S4_SRR_RL_Obj_DistX_9 :%f",@ecu_Signals::i_S4_SRR_RL_Obj_DistX_9);

	if((abs(@ecu_Signals::i_S4_SRR_RL_Obj_DistX_9)*0.9<=abs(signalvalue1))&&(abs(signalvalue1)<=abs(@ecu_Signals::i_S4_SRR_RL_Obj_DistX_9)*1.1))
	{
	testStepPass("Pass","i_S4_SRR_RL_Obj_DistX_9 :%f",signalvalue1);
	}
	else
	{
	testStepFail("Fail","i_S4_SRR_RL_Obj_DistX_9 :%f",signalvalue1);
	}
}

testcase S4_SRR_RL_Obj_Mes_3_S4_SRR_RL_Obj_RelVelX_9()
{
	signalvalue1 = getSignal(S4_SRR_RL_Obj_RelVelX_9);
	write("S4_SRR_RL_Obj_RelVelX_9 :%f",signalvalue1);
	write("i_S4_SRR_RL_Obj_RelVelX_9 :%f",@ecu_Signals::i_S4_SRR_RL_Obj_RelVelX_9);

	testStep("get expect variable value: ","i_S4_SRR_RL_Obj_RelVelX_9 :%f",@ecu_Signals::i_S4_SRR_RL_Obj_RelVelX_9);

	if((abs(@ecu_Signals::i_S4_SRR_RL_Obj_RelVelX_9)*0.9<=abs(signalvalue1))&&(abs(signalvalue1)<=abs(@ecu_Signals::i_S4_SRR_RL_Obj_RelVelX_9)*1.1))
	{
	testStepPass("Pass","i_S4_SRR_RL_Obj_RelVelX_9 :%f",signalvalue1);
	}
	else
	{
	testStepFail("Fail","i_S4_SRR_RL_Obj_RelVelX_9 :%f",signalvalue1);
	}
}

testcase S4_SRR_RL_Obj_Mes_3_S4_SRR_RL_Obj_AccelX_9()
{
	signalvalue1 = getSignal(S4_SRR_RL_Obj_AccelX_9);
	write("S4_SRR_RL_Obj_AccelX_9 :%f",signalvalue1);
	write("i_S4_SRR_RL_Obj_AccelX_9 :%f",@ecu_Signals::i_S4_SRR_RL_Obj_AccelX_9);

	testStep("get expect variable value: ","i_S4_SRR_RL_Obj_AccelX_9 :%f",@ecu_Signals::i_S4_SRR_RL_Obj_AccelX_9);

	if((abs(@ecu_Signals::i_S4_SRR_RL_Obj_AccelX_9)*0.9<=abs(signalvalue1))&&(abs(signalvalue1)<=abs(@ecu_Signals::i_S4_SRR_RL_Obj_AccelX_9)*1.1))
	{
	testStepPass("Pass","i_S4_SRR_RL_Obj_AccelX_9 :%f",signalvalue1);
	}
	else
	{
	testStepFail("Fail","i_S4_SRR_RL_Obj_AccelX_9 :%f",signalvalue1);
	}
}

testcase S4_SRR_RL_Obj_Mes_3_S4_SRR_RL_Obj_DistY_9()
{
	signalvalue1 = getSignal(S4_SRR_RL_Obj_DistY_9);
	write("S4_SRR_RL_Obj_DistY_9 :%f",signalvalue1);
	write("i_S4_SRR_RL_Obj_DistY_9 :%f",@ecu_Signals::i_S4_SRR_RL_Obj_DistY_9);

	testStep("get expect variable value: ","i_S4_SRR_RL_Obj_DistY_9 :%f",@ecu_Signals::i_S4_SRR_RL_Obj_DistY_9);

	if((abs(@ecu_Signals::i_S4_SRR_RL_Obj_DistY_9)*0.9<=abs(signalvalue1))&&(abs(signalvalue1)<=abs(@ecu_Signals::i_S4_SRR_RL_Obj_DistY_9)*1.1))
	{
	testStepPass("Pass","i_S4_SRR_RL_Obj_DistY_9 :%f",signalvalue1);
	}
	else
	{
	testStepFail("Fail","i_S4_SRR_RL_Obj_DistY_9 :%f",signalvalue1);
	}
}

testcase S4_SRR_RL_Obj_Mes_3_S4_SRR_RL_Obj_RelVelY_9()
{
	signalvalue1 = getSignal(S4_SRR_RL_Obj_RelVelY_9);
	write("S4_SRR_RL_Obj_RelVelY_9 :%f",signalvalue1);
	write("i_S4_SRR_RL_Obj_RelVelY_9 :%f",@ecu_Signals::i_S4_SRR_RL_Obj_RelVelY_9);

	testStep("get expect variable value: ","i_S4_SRR_RL_Obj_RelVelY_9 :%f",@ecu_Signals::i_S4_SRR_RL_Obj_RelVelY_9);

	if((abs(@ecu_Signals::i_S4_SRR_RL_Obj_RelVelY_9)*0.9<=abs(signalvalue1))&&(abs(signalvalue1)<=abs(@ecu_Signals::i_S4_SRR_RL_Obj_RelVelY_9)*1.1))
	{
	testStepPass("Pass","i_S4_SRR_RL_Obj_RelVelY_9 :%f",signalvalue1);
	}
	else
	{
	testStepFail("Fail","i_S4_SRR_RL_Obj_RelVelY_9 :%f",signalvalue1);
	}
}

testcase S4_SRR_RL_Obj_Mes_3_S4_SRR_RL_Obj_AccelY_9()
{
	signalvalue1 = getSignal(S4_SRR_RL_Obj_AccelY_9);
	write("S4_SRR_RL_Obj_AccelY_9 :%f",signalvalue1);
	write("i_S4_SRR_RL_Obj_AccelY_9 :%f",@ecu_Signals::i_S4_SRR_RL_Obj_AccelY_9);

	testStep("get expect variable value: ","i_S4_SRR_RL_Obj_AccelY_9 :%f",@ecu_Signals::i_S4_SRR_RL_Obj_AccelY_9);

	if((abs(@ecu_Signals::i_S4_SRR_RL_Obj_AccelY_9)*0.9<=abs(signalvalue1))&&(abs(signalvalue1)<=abs(@ecu_Signals::i_S4_SRR_RL_Obj_AccelY_9)*1.1))
	{
	testStepPass("Pass","i_S4_SRR_RL_Obj_AccelY_9 :%f",signalvalue1);
	}
	else
	{
	testStepFail("Fail","i_S4_SRR_RL_Obj_AccelY_9 :%f",signalvalue1);
	}
}

testcase S4_SRR_RL_Obj_Mes_3_S4_SRR_RL_Obj_DistXStd_9()
{
	signalvalue1 = getSignal(S4_SRR_RL_Obj_DistXStd_9);
	write("S4_SRR_RL_Obj_DistXStd_9 :%f",signalvalue1);
	write("i_S4_SRR_RL_Obj_DistXStd_9 :%f",@ecu_Signals::i_S4_SRR_RL_Obj_DistXStd_9);

	testStep("get expect variable value: ","i_S4_SRR_RL_Obj_DistXStd_9 :%f",@ecu_Signals::i_S4_SRR_RL_Obj_DistXStd_9);

	if((abs(@ecu_Signals::i_S4_SRR_RL_Obj_DistXStd_9)*0.9<=abs(signalvalue1))&&(abs(signalvalue1)<=abs(@ecu_Signals::i_S4_SRR_RL_Obj_DistXStd_9)*1.1))
	{
	testStepPass("Pass","i_S4_SRR_RL_Obj_DistXStd_9 :%f",signalvalue1);
	}
	else
	{
	testStepFail("Fail","i_S4_SRR_RL_Obj_DistXStd_9 :%f",signalvalue1);
	}
}

testcase S4_SRR_RL_Obj_Mes_3_S4_SRR_RL_Obj_RelVelXStd_9()
{
	signalvalue1 = getSignal(S4_SRR_RL_Obj_RelVelXStd_9);
	write("S4_SRR_RL_Obj_RelVelXStd_9 :%f",signalvalue1);
	write("i_S4_SRR_RL_Obj_RelVelXStd_9 :%f",@ecu_Signals::i_S4_SRR_RL_Obj_RelVelXStd_9);

	testStep("get expect variable value: ","i_S4_SRR_RL_Obj_RelVelXStd_9 :%f",@ecu_Signals::i_S4_SRR_RL_Obj_RelVelXStd_9);

	if((abs(@ecu_Signals::i_S4_SRR_RL_Obj_RelVelXStd_9)*0.9<=abs(signalvalue1))&&(abs(signalvalue1)<=abs(@ecu_Signals::i_S4_SRR_RL_Obj_RelVelXStd_9)*1.1))
	{
	testStepPass("Pass","i_S4_SRR_RL_Obj_RelVelXStd_9 :%f",signalvalue1);
	}
	else
	{
	testStepFail("Fail","i_S4_SRR_RL_Obj_RelVelXStd_9 :%f",signalvalue1);
	}
}

testcase S4_SRR_RL_Obj_Mes_3_S4_SRR_RL_Obj_DistYStd_9()
{
	signalvalue1 = getSignal(S4_SRR_RL_Obj_DistYStd_9);
	write("S4_SRR_RL_Obj_DistYStd_9 :%f",signalvalue1);
	write("i_S4_SRR_RL_Obj_DistYStd_9 :%f",@ecu_Signals::i_S4_SRR_RL_Obj_DistYStd_9);

	testStep("get expect variable value: ","i_S4_SRR_RL_Obj_DistYStd_9 :%f",@ecu_Signals::i_S4_SRR_RL_Obj_DistYStd_9);

	if((abs(@ecu_Signals::i_S4_SRR_RL_Obj_DistYStd_9)*0.9<=abs(signalvalue1))&&(abs(signalvalue1)<=abs(@ecu_Signals::i_S4_SRR_RL_Obj_DistYStd_9)*1.1))
	{
	testStepPass("Pass","i_S4_SRR_RL_Obj_DistYStd_9 :%f",signalvalue1);
	}
	else
	{
	testStepFail("Fail","i_S4_SRR_RL_Obj_DistYStd_9 :%f",signalvalue1);
	}
}

testcase S4_SRR_RL_Obj_Mes_3_S4_SRR_RL_Obj_RelVelYStd_9()
{
	signalvalue1 = getSignal(S4_SRR_RL_Obj_RelVelYStd_9);
	write("S4_SRR_RL_Obj_RelVelYStd_9 :%f",signalvalue1);
	write("i_S4_SRR_RL_Obj_RelVelYStd_9 :%f",@ecu_Signals::i_S4_SRR_RL_Obj_RelVelYStd_9);

	testStep("get expect variable value: ","i_S4_SRR_RL_Obj_RelVelYStd_9 :%f",@ecu_Signals::i_S4_SRR_RL_Obj_RelVelYStd_9);

	if((abs(@ecu_Signals::i_S4_SRR_RL_Obj_RelVelYStd_9)*0.9<=abs(signalvalue1))&&(abs(signalvalue1)<=abs(@ecu_Signals::i_S4_SRR_RL_Obj_RelVelYStd_9)*1.1))
	{
	testStepPass("Pass","i_S4_SRR_RL_Obj_RelVelYStd_9 :%f",signalvalue1);
	}
	else
	{
	testStepFail("Fail","i_S4_SRR_RL_Obj_RelVelYStd_9 :%f",signalvalue1);
	}
}

testcase S4_SRR_RL_Obj_Mes_3_S4_SRR_RL_Obj_UpdateFlag_9()
{
	signalvalue1 = getSignal(S4_SRR_RL_Obj_UpdateFlag_9);
	write("S4_SRR_RL_Obj_UpdateFlag_9 :%f",signalvalue1);
	write("i_S4_SRR_RL_Obj_UpdateFlag_9 :%o",@ecu_Signals::i_S4_SRR_RL_Obj_UpdateFlag_9);

	testStep("get expect variable value: ","i_S4_SRR_RL_Obj_UpdateFlag_9 :%o",@ecu_Signals::i_S4_SRR_RL_Obj_UpdateFlag_9);

	if(signalvalue1==@ecu_Signals::i_S4_SRR_RL_Obj_UpdateFlag_9)
	{
	testStepPass("Pass","i_S4_SRR_RL_Obj_UpdateFlag_9 :%f",signalvalue1);
	}
	else
	{
	testStepFail("Fail","i_S4_SRR_RL_Obj_UpdateFlag_9 :%f",signalvalue1);
	}
}

testcase S4_SRR_RL_Obj_Mes_3_S4_SRR_RL_Obj_ExistProb_9()
{
	signalvalue1 = getSignal(S4_SRR_RL_Obj_ExistProb_9);
	write("S4_SRR_RL_Obj_ExistProb_9 :%f",signalvalue1);
	write("i_S4_SRR_RL_Obj_ExistProb_9 :%o",@ecu_Signals::i_S4_SRR_RL_Obj_ExistProb_9);

	testStep("get expect variable value: ","i_S4_SRR_RL_Obj_ExistProb_9 :%o",@ecu_Signals::i_S4_SRR_RL_Obj_ExistProb_9);

	if(signalvalue1==@ecu_Signals::i_S4_SRR_RL_Obj_ExistProb_9)
	{
	testStepPass("Pass","i_S4_SRR_RL_Obj_ExistProb_9 :%f",signalvalue1);
	}
	else
	{
	testStepFail("Fail","i_S4_SRR_RL_Obj_ExistProb_9 :%f",signalvalue1);
	}
}

testcase S4_SRR_RL_Obj_Mes_3_S4_SRR_RL_Obj_Type_9()
{
	signalvalue1 = getSignal(S4_SRR_RL_Obj_Type_9);
	write("S4_SRR_RL_Obj_Type_9 :%f",signalvalue1);
	write("i_S4_SRR_RL_Obj_Type_9 :%o",@ecu_Signals::i_S4_SRR_RL_Obj_Type_9);

	testStep("get expect variable value: ","i_S4_SRR_RL_Obj_Type_9 :%o",@ecu_Signals::i_S4_SRR_RL_Obj_Type_9);

	if(signalvalue1==@ecu_Signals::i_S4_SRR_RL_Obj_Type_9)
	{
	testStepPass("Pass","i_S4_SRR_RL_Obj_Type_9 :%f",signalvalue1);
	}
	else
	{
	testStepFail("Fail","i_S4_SRR_RL_Obj_Type_9 :%f",signalvalue1);
	}
}

testcase S4_SRR_RL_Obj_Mes_3_S4_SRR_RL_Obj_EDynProp_9()
{
	signalvalue1 = getSignal(S4_SRR_RL_Obj_EDynProp_9);
	write("S4_SRR_RL_Obj_EDynProp_9 :%f",signalvalue1);
	write("i_S4_SRR_RL_Obj_EDynProp_9 :%o",@ecu_Signals::i_S4_SRR_RL_Obj_EDynProp_9);

	testStep("get expect variable value: ","i_S4_SRR_RL_Obj_EDynProp_9 :%o",@ecu_Signals::i_S4_SRR_RL_Obj_EDynProp_9);

	if(signalvalue1==@ecu_Signals::i_S4_SRR_RL_Obj_EDynProp_9)
	{
	testStepPass("Pass","i_S4_SRR_RL_Obj_EDynProp_9 :%f",signalvalue1);
	}
	else
	{
	testStepFail("Fail","i_S4_SRR_RL_Obj_EDynProp_9 :%f",signalvalue1);
	}
}

testcase S4_SRR_RL_Obj_Mes_3_S4_SRR_RL_Obj_UiLifeCycles_9()
{
	signalvalue1 = getSignal(S4_SRR_RL_Obj_UiLifeCycles_9);
	write("S4_SRR_RL_Obj_UiLifeCycles_9 :%f",signalvalue1);
	write("i_S4_SRR_RL_Obj_UiLifeCycles_9 :%o",@ecu_Signals::i_S4_SRR_RL_Obj_UiLifeCycles_9);

	testStep("get expect variable value: ","i_S4_SRR_RL_Obj_UiLifeCycles_9 :%o",@ecu_Signals::i_S4_SRR_RL_Obj_UiLifeCycles_9);

	if(signalvalue1==@ecu_Signals::i_S4_SRR_RL_Obj_UiLifeCycles_9)
	{
	testStepPass("Pass","i_S4_SRR_RL_Obj_UiLifeCycles_9 :%f",signalvalue1);
	}
	else
	{
	testStepFail("Fail","i_S4_SRR_RL_Obj_UiLifeCycles_9 :%f",signalvalue1);
	}
}

testcase S4_SRR_RL_Obj_Mes_3_S4_SRR_RL_Obj_ID_10()
{
	signalvalue1 = getSignal(S4_SRR_RL_Obj_ID_10);
	write("S4_SRR_RL_Obj_ID_10 :%f",signalvalue1);
	write("i_S4_SRR_RL_Obj_ID_10 :%o",@ecu_Signals::i_S4_SRR_RL_Obj_ID_10);

	testStep("get expect variable value: ","i_S4_SRR_RL_Obj_ID_10 :%o",@ecu_Signals::i_S4_SRR_RL_Obj_ID_10);

	if(signalvalue1==@ecu_Signals::i_S4_SRR_RL_Obj_ID_10)
	{
	testStepPass("Pass","i_S4_SRR_RL_Obj_ID_10 :%f",signalvalue1);
	}
	else
	{
	testStepFail("Fail","i_S4_SRR_RL_Obj_ID_10 :%f",signalvalue1);
	}
}

testcase S4_SRR_RL_Obj_Mes_3_S4_SRR_RL_Obj_DistX_10()
{
	signalvalue1 = getSignal(S4_SRR_RL_Obj_DistX_10);
	write("S4_SRR_RL_Obj_DistX_10 :%f",signalvalue1);
	write("i_S4_SRR_RL_Obj_DistX_10 :%f",@ecu_Signals::i_S4_SRR_RL_Obj_DistX_10);

	testStep("get expect variable value: ","i_S4_SRR_RL_Obj_DistX_10 :%f",@ecu_Signals::i_S4_SRR_RL_Obj_DistX_10);

	if((abs(@ecu_Signals::i_S4_SRR_RL_Obj_DistX_10)*0.9<=abs(signalvalue1))&&(abs(signalvalue1)<=abs(@ecu_Signals::i_S4_SRR_RL_Obj_DistX_10)*1.1))
	{
	testStepPass("Pass","i_S4_SRR_RL_Obj_DistX_10 :%f",signalvalue1);
	}
	else
	{
	testStepFail("Fail","i_S4_SRR_RL_Obj_DistX_10 :%f",signalvalue1);
	}
}

testcase S4_SRR_RL_Obj_Mes_3_S4_SRR_RL_Obj_RelVelX_10()
{
	signalvalue1 = getSignal(S4_SRR_RL_Obj_RelVelX_10);
	write("S4_SRR_RL_Obj_RelVelX_10 :%f",signalvalue1);
	write("i_S4_SRR_RL_Obj_RelVelX_10 :%f",@ecu_Signals::i_S4_SRR_RL_Obj_RelVelX_10);

	testStep("get expect variable value: ","i_S4_SRR_RL_Obj_RelVelX_10 :%f",@ecu_Signals::i_S4_SRR_RL_Obj_RelVelX_10);

	if((abs(@ecu_Signals::i_S4_SRR_RL_Obj_RelVelX_10)*0.9<=abs(signalvalue1))&&(abs(signalvalue1)<=abs(@ecu_Signals::i_S4_SRR_RL_Obj_RelVelX_10)*1.1))
	{
	testStepPass("Pass","i_S4_SRR_RL_Obj_RelVelX_10 :%f",signalvalue1);
	}
	else
	{
	testStepFail("Fail","i_S4_SRR_RL_Obj_RelVelX_10 :%f",signalvalue1);
	}
}

testcase S4_SRR_RL_Obj_Mes_3_S4_SRR_RL_Obj_AccelX_10()
{
	signalvalue1 = getSignal(S4_SRR_RL_Obj_AccelX_10);
	write("S4_SRR_RL_Obj_AccelX_10 :%f",signalvalue1);
	write("i_S4_SRR_RL_Obj_AccelX_10 :%f",@ecu_Signals::i_S4_SRR_RL_Obj_AccelX_10);

	testStep("get expect variable value: ","i_S4_SRR_RL_Obj_AccelX_10 :%f",@ecu_Signals::i_S4_SRR_RL_Obj_AccelX_10);

	if((abs(@ecu_Signals::i_S4_SRR_RL_Obj_AccelX_10)*0.9<=abs(signalvalue1))&&(abs(signalvalue1)<=abs(@ecu_Signals::i_S4_SRR_RL_Obj_AccelX_10)*1.1))
	{
	testStepPass("Pass","i_S4_SRR_RL_Obj_AccelX_10 :%f",signalvalue1);
	}
	else
	{
	testStepFail("Fail","i_S4_SRR_RL_Obj_AccelX_10 :%f",signalvalue1);
	}
}

testcase S4_SRR_RL_Obj_Mes_3_S4_SRR_RL_Obj_DistY_10()
{
	signalvalue1 = getSignal(S4_SRR_RL_Obj_DistY_10);
	write("S4_SRR_RL_Obj_DistY_10 :%f",signalvalue1);
	write("i_S4_SRR_RL_Obj_DistY_10 :%f",@ecu_Signals::i_S4_SRR_RL_Obj_DistY_10);

	testStep("get expect variable value: ","i_S4_SRR_RL_Obj_DistY_10 :%f",@ecu_Signals::i_S4_SRR_RL_Obj_DistY_10);

	if((abs(@ecu_Signals::i_S4_SRR_RL_Obj_DistY_10)*0.9<=abs(signalvalue1))&&(abs(signalvalue1)<=abs(@ecu_Signals::i_S4_SRR_RL_Obj_DistY_10)*1.1))
	{
	testStepPass("Pass","i_S4_SRR_RL_Obj_DistY_10 :%f",signalvalue1);
	}
	else
	{
	testStepFail("Fail","i_S4_SRR_RL_Obj_DistY_10 :%f",signalvalue1);
	}
}

testcase S4_SRR_RL_Obj_Mes_3_S4_SRR_RL_Obj_RelVelY_10()
{
	signalvalue1 = getSignal(S4_SRR_RL_Obj_RelVelY_10);
	write("S4_SRR_RL_Obj_RelVelY_10 :%f",signalvalue1);
	write("i_S4_SRR_RL_Obj_RelVelY_10 :%f",@ecu_Signals::i_S4_SRR_RL_Obj_RelVelY_10);

	testStep("get expect variable value: ","i_S4_SRR_RL_Obj_RelVelY_10 :%f",@ecu_Signals::i_S4_SRR_RL_Obj_RelVelY_10);

	if((abs(@ecu_Signals::i_S4_SRR_RL_Obj_RelVelY_10)*0.9<=abs(signalvalue1))&&(abs(signalvalue1)<=abs(@ecu_Signals::i_S4_SRR_RL_Obj_RelVelY_10)*1.1))
	{
	testStepPass("Pass","i_S4_SRR_RL_Obj_RelVelY_10 :%f",signalvalue1);
	}
	else
	{
	testStepFail("Fail","i_S4_SRR_RL_Obj_RelVelY_10 :%f",signalvalue1);
	}
}

testcase S4_SRR_RL_Obj_Mes_3_S4_SRR_RL_Obj_AccelY_10()
{
	signalvalue1 = getSignal(S4_SRR_RL_Obj_AccelY_10);
	write("S4_SRR_RL_Obj_AccelY_10 :%f",signalvalue1);
	write("i_S4_SRR_RL_Obj_AccelY_10 :%f",@ecu_Signals::i_S4_SRR_RL_Obj_AccelY_10);

	testStep("get expect variable value: ","i_S4_SRR_RL_Obj_AccelY_10 :%f",@ecu_Signals::i_S4_SRR_RL_Obj_AccelY_10);

	if((abs(@ecu_Signals::i_S4_SRR_RL_Obj_AccelY_10)*0.9<=abs(signalvalue1))&&(abs(signalvalue1)<=abs(@ecu_Signals::i_S4_SRR_RL_Obj_AccelY_10)*1.1))
	{
	testStepPass("Pass","i_S4_SRR_RL_Obj_AccelY_10 :%f",signalvalue1);
	}
	else
	{
	testStepFail("Fail","i_S4_SRR_RL_Obj_AccelY_10 :%f",signalvalue1);
	}
}

testcase S4_SRR_RL_Obj_Mes_3_S4_SRR_RL_Obj_DistXStd_10()
{
	signalvalue1 = getSignal(S4_SRR_RL_Obj_DistXStd_10);
	write("S4_SRR_RL_Obj_DistXStd_10 :%f",signalvalue1);
	write("i_S4_SRR_RL_Obj_DistXStd_10 :%f",@ecu_Signals::i_S4_SRR_RL_Obj_DistXStd_10);

	testStep("get expect variable value: ","i_S4_SRR_RL_Obj_DistXStd_10 :%f",@ecu_Signals::i_S4_SRR_RL_Obj_DistXStd_10);

	if((abs(@ecu_Signals::i_S4_SRR_RL_Obj_DistXStd_10)*0.9<=abs(signalvalue1))&&(abs(signalvalue1)<=abs(@ecu_Signals::i_S4_SRR_RL_Obj_DistXStd_10)*1.1))
	{
	testStepPass("Pass","i_S4_SRR_RL_Obj_DistXStd_10 :%f",signalvalue1);
	}
	else
	{
	testStepFail("Fail","i_S4_SRR_RL_Obj_DistXStd_10 :%f",signalvalue1);
	}
}

testcase S4_SRR_RL_Obj_Mes_3_S4_SRR_RL_Obj_RelVelXStd_10()
{
	signalvalue1 = getSignal(S4_SRR_RL_Obj_RelVelXStd_10);
	write("S4_SRR_RL_Obj_RelVelXStd_10 :%f",signalvalue1);
	write("i_S4_SRR_RL_Obj_RelVelXStd_10 :%f",@ecu_Signals::i_S4_SRR_RL_Obj_RelVelXStd_10);

	testStep("get expect variable value: ","i_S4_SRR_RL_Obj_RelVelXStd_10 :%f",@ecu_Signals::i_S4_SRR_RL_Obj_RelVelXStd_10);

	if((abs(@ecu_Signals::i_S4_SRR_RL_Obj_RelVelXStd_10)*0.9<=abs(signalvalue1))&&(abs(signalvalue1)<=abs(@ecu_Signals::i_S4_SRR_RL_Obj_RelVelXStd_10)*1.1))
	{
	testStepPass("Pass","i_S4_SRR_RL_Obj_RelVelXStd_10 :%f",signalvalue1);
	}
	else
	{
	testStepFail("Fail","i_S4_SRR_RL_Obj_RelVelXStd_10 :%f",signalvalue1);
	}
}

testcase S4_SRR_RL_Obj_Mes_3_S4_SRR_RL_Obj_DistYStd_10()
{
	signalvalue1 = getSignal(S4_SRR_RL_Obj_DistYStd_10);
	write("S4_SRR_RL_Obj_DistYStd_10 :%f",signalvalue1);
	write("i_S4_SRR_RL_Obj_DistYStd_10 :%f",@ecu_Signals::i_S4_SRR_RL_Obj_DistYStd_10);

	testStep("get expect variable value: ","i_S4_SRR_RL_Obj_DistYStd_10 :%f",@ecu_Signals::i_S4_SRR_RL_Obj_DistYStd_10);

	if((abs(@ecu_Signals::i_S4_SRR_RL_Obj_DistYStd_10)*0.9<=abs(signalvalue1))&&(abs(signalvalue1)<=abs(@ecu_Signals::i_S4_SRR_RL_Obj_DistYStd_10)*1.1))
	{
	testStepPass("Pass","i_S4_SRR_RL_Obj_DistYStd_10 :%f",signalvalue1);
	}
	else
	{
	testStepFail("Fail","i_S4_SRR_RL_Obj_DistYStd_10 :%f",signalvalue1);
	}
}

testcase S4_SRR_RL_Obj_Mes_3_S4_SRR_RL_Obj_RelVelYStd_10()
{
	signalvalue1 = getSignal(S4_SRR_RL_Obj_RelVelYStd_10);
	write("S4_SRR_RL_Obj_RelVelYStd_10 :%f",signalvalue1);
	write("i_S4_SRR_RL_Obj_RelVelYStd_10 :%f",@ecu_Signals::i_S4_SRR_RL_Obj_RelVelYStd_10);

	testStep("get expect variable value: ","i_S4_SRR_RL_Obj_RelVelYStd_10 :%f",@ecu_Signals::i_S4_SRR_RL_Obj_RelVelYStd_10);

	if((abs(@ecu_Signals::i_S4_SRR_RL_Obj_RelVelYStd_10)*0.9<=abs(signalvalue1))&&(abs(signalvalue1)<=abs(@ecu_Signals::i_S4_SRR_RL_Obj_RelVelYStd_10)*1.1))
	{
	testStepPass("Pass","i_S4_SRR_RL_Obj_RelVelYStd_10 :%f",signalvalue1);
	}
	else
	{
	testStepFail("Fail","i_S4_SRR_RL_Obj_RelVelYStd_10 :%f",signalvalue1);
	}
}

testcase S4_SRR_RL_Obj_Mes_3_S4_SRR_RL_Obj_UpdateFlag_10()
{
	signalvalue1 = getSignal(S4_SRR_RL_Obj_UpdateFlag_10);
	write("S4_SRR_RL_Obj_UpdateFlag_10 :%f",signalvalue1);
	write("i_S4_SRR_RL_Obj_UpdateFlag_10 :%o",@ecu_Signals::i_S4_SRR_RL_Obj_UpdateFlag_10);

	testStep("get expect variable value: ","i_S4_SRR_RL_Obj_UpdateFlag_10 :%o",@ecu_Signals::i_S4_SRR_RL_Obj_UpdateFlag_10);

	if(signalvalue1==@ecu_Signals::i_S4_SRR_RL_Obj_UpdateFlag_10)
	{
	testStepPass("Pass","i_S4_SRR_RL_Obj_UpdateFlag_10 :%f",signalvalue1);
	}
	else
	{
	testStepFail("Fail","i_S4_SRR_RL_Obj_UpdateFlag_10 :%f",signalvalue1);
	}
}

testcase S4_SRR_RL_Obj_Mes_3_S4_SRR_RL_Obj_ExistProb_10()
{
	signalvalue1 = getSignal(S4_SRR_RL_Obj_ExistProb_10);
	write("S4_SRR_RL_Obj_ExistProb_10 :%f",signalvalue1);
	write("i_S4_SRR_RL_Obj_ExistProb_10 :%o",@ecu_Signals::i_S4_SRR_RL_Obj_ExistProb_10);

	testStep("get expect variable value: ","i_S4_SRR_RL_Obj_ExistProb_10 :%o",@ecu_Signals::i_S4_SRR_RL_Obj_ExistProb_10);

	if(signalvalue1==@ecu_Signals::i_S4_SRR_RL_Obj_ExistProb_10)
	{
	testStepPass("Pass","i_S4_SRR_RL_Obj_ExistProb_10 :%f",signalvalue1);
	}
	else
	{
	testStepFail("Fail","i_S4_SRR_RL_Obj_ExistProb_10 :%f",signalvalue1);
	}
}

testcase S4_SRR_RL_Obj_Mes_3_S4_SRR_RL_Obj_Type_10()
{
	signalvalue1 = getSignal(S4_SRR_RL_Obj_Type_10);
	write("S4_SRR_RL_Obj_Type_10 :%f",signalvalue1);
	write("i_S4_SRR_RL_Obj_Type_10 :%o",@ecu_Signals::i_S4_SRR_RL_Obj_Type_10);

	testStep("get expect variable value: ","i_S4_SRR_RL_Obj_Type_10 :%o",@ecu_Signals::i_S4_SRR_RL_Obj_Type_10);

	if(signalvalue1==@ecu_Signals::i_S4_SRR_RL_Obj_Type_10)
	{
	testStepPass("Pass","i_S4_SRR_RL_Obj_Type_10 :%f",signalvalue1);
	}
	else
	{
	testStepFail("Fail","i_S4_SRR_RL_Obj_Type_10 :%f",signalvalue1);
	}
}

testcase S4_SRR_RL_Obj_Mes_3_S4_SRR_RL_Obj_EDynProp_10()
{
	signalvalue1 = getSignal(S4_SRR_RL_Obj_EDynProp_10);
	write("S4_SRR_RL_Obj_EDynProp_10 :%f",signalvalue1);
	write("i_S4_SRR_RL_Obj_EDynProp_10 :%o",@ecu_Signals::i_S4_SRR_RL_Obj_EDynProp_10);

	testStep("get expect variable value: ","i_S4_SRR_RL_Obj_EDynProp_10 :%o",@ecu_Signals::i_S4_SRR_RL_Obj_EDynProp_10);

	if(signalvalue1==@ecu_Signals::i_S4_SRR_RL_Obj_EDynProp_10)
	{
	testStepPass("Pass","i_S4_SRR_RL_Obj_EDynProp_10 :%f",signalvalue1);
	}
	else
	{
	testStepFail("Fail","i_S4_SRR_RL_Obj_EDynProp_10 :%f",signalvalue1);
	}
}

testcase S4_SRR_RL_Obj_Mes_3_S4_SRR_RL_Obj_UiLifeCycles_10()
{
	signalvalue1 = getSignal(S4_SRR_RL_Obj_UiLifeCycles_10);
	write("S4_SRR_RL_Obj_UiLifeCycles_10 :%f",signalvalue1);
	write("i_S4_SRR_RL_Obj_UiLifeCycles_10 :%o",@ecu_Signals::i_S4_SRR_RL_Obj_UiLifeCycles_10);

	testStep("get expect variable value: ","i_S4_SRR_RL_Obj_UiLifeCycles_10 :%o",@ecu_Signals::i_S4_SRR_RL_Obj_UiLifeCycles_10);

	if(signalvalue1==@ecu_Signals::i_S4_SRR_RL_Obj_UiLifeCycles_10)
	{
	testStepPass("Pass","i_S4_SRR_RL_Obj_UiLifeCycles_10 :%f",signalvalue1);
	}
	else
	{
	testStepFail("Fail","i_S4_SRR_RL_Obj_UiLifeCycles_10 :%f",signalvalue1);
	}
}

testcase S4_SRR_RL_Obj_Mes_3_S4_SRR_RL_Obj_ID_11()
{
	signalvalue1 = getSignal(S4_SRR_RL_Obj_ID_11);
	write("S4_SRR_RL_Obj_ID_11 :%f",signalvalue1);
	write("i_S4_SRR_RL_Obj_ID_11 :%o",@ecu_Signals::i_S4_SRR_RL_Obj_ID_11);

	testStep("get expect variable value: ","i_S4_SRR_RL_Obj_ID_11 :%o",@ecu_Signals::i_S4_SRR_RL_Obj_ID_11);

	if(signalvalue1==@ecu_Signals::i_S4_SRR_RL_Obj_ID_11)
	{
	testStepPass("Pass","i_S4_SRR_RL_Obj_ID_11 :%f",signalvalue1);
	}
	else
	{
	testStepFail("Fail","i_S4_SRR_RL_Obj_ID_11 :%f",signalvalue1);
	}
}

testcase S4_SRR_RL_Obj_Mes_3_S4_SRR_RL_Obj_DistX_11()
{
	signalvalue1 = getSignal(S4_SRR_RL_Obj_DistX_11);
	write("S4_SRR_RL_Obj_DistX_11 :%f",signalvalue1);
	write("i_S4_SRR_RL_Obj_DistX_11 :%f",@ecu_Signals::i_S4_SRR_RL_Obj_DistX_11);

	testStep("get expect variable value: ","i_S4_SRR_RL_Obj_DistX_11 :%f",@ecu_Signals::i_S4_SRR_RL_Obj_DistX_11);

	if((abs(@ecu_Signals::i_S4_SRR_RL_Obj_DistX_11)*0.9<=abs(signalvalue1))&&(abs(signalvalue1)<=abs(@ecu_Signals::i_S4_SRR_RL_Obj_DistX_11)*1.1))
	{
	testStepPass("Pass","i_S4_SRR_RL_Obj_DistX_11 :%f",signalvalue1);
	}
	else
	{
	testStepFail("Fail","i_S4_SRR_RL_Obj_DistX_11 :%f",signalvalue1);
	}
}

testcase S4_SRR_RL_Obj_Mes_3_S4_SRR_RL_Obj_RelVelX_11()
{
	signalvalue1 = getSignal(S4_SRR_RL_Obj_RelVelX_11);
	write("S4_SRR_RL_Obj_RelVelX_11 :%f",signalvalue1);
	write("i_S4_SRR_RL_Obj_RelVelX_11 :%f",@ecu_Signals::i_S4_SRR_RL_Obj_RelVelX_11);

	testStep("get expect variable value: ","i_S4_SRR_RL_Obj_RelVelX_11 :%f",@ecu_Signals::i_S4_SRR_RL_Obj_RelVelX_11);

	if((abs(@ecu_Signals::i_S4_SRR_RL_Obj_RelVelX_11)*0.9<=abs(signalvalue1))&&(abs(signalvalue1)<=abs(@ecu_Signals::i_S4_SRR_RL_Obj_RelVelX_11)*1.1))
	{
	testStepPass("Pass","i_S4_SRR_RL_Obj_RelVelX_11 :%f",signalvalue1);
	}
	else
	{
	testStepFail("Fail","i_S4_SRR_RL_Obj_RelVelX_11 :%f",signalvalue1);
	}
}

testcase S4_SRR_RL_Obj_Mes_3_S4_SRR_RL_Obj_AccelX_11()
{
	signalvalue1 = getSignal(S4_SRR_RL_Obj_AccelX_11);
	write("S4_SRR_RL_Obj_AccelX_11 :%f",signalvalue1);
	write("i_S4_SRR_RL_Obj_AccelX_11 :%f",@ecu_Signals::i_S4_SRR_RL_Obj_AccelX_11);

	testStep("get expect variable value: ","i_S4_SRR_RL_Obj_AccelX_11 :%f",@ecu_Signals::i_S4_SRR_RL_Obj_AccelX_11);

	if((abs(@ecu_Signals::i_S4_SRR_RL_Obj_AccelX_11)*0.9<=abs(signalvalue1))&&(abs(signalvalue1)<=abs(@ecu_Signals::i_S4_SRR_RL_Obj_AccelX_11)*1.1))
	{
	testStepPass("Pass","i_S4_SRR_RL_Obj_AccelX_11 :%f",signalvalue1);
	}
	else
	{
	testStepFail("Fail","i_S4_SRR_RL_Obj_AccelX_11 :%f",signalvalue1);
	}
}

testcase S4_SRR_RL_Obj_Mes_3_S4_SRR_RL_Obj_DistY_11()
{
	signalvalue1 = getSignal(S4_SRR_RL_Obj_DistY_11);
	write("S4_SRR_RL_Obj_DistY_11 :%f",signalvalue1);
	write("i_S4_SRR_RL_Obj_DistY_11 :%f",@ecu_Signals::i_S4_SRR_RL_Obj_DistY_11);

	testStep("get expect variable value: ","i_S4_SRR_RL_Obj_DistY_11 :%f",@ecu_Signals::i_S4_SRR_RL_Obj_DistY_11);

	if((abs(@ecu_Signals::i_S4_SRR_RL_Obj_DistY_11)*0.9<=abs(signalvalue1))&&(abs(signalvalue1)<=abs(@ecu_Signals::i_S4_SRR_RL_Obj_DistY_11)*1.1))
	{
	testStepPass("Pass","i_S4_SRR_RL_Obj_DistY_11 :%f",signalvalue1);
	}
	else
	{
	testStepFail("Fail","i_S4_SRR_RL_Obj_DistY_11 :%f",signalvalue1);
	}
}

testcase S4_SRR_RL_Obj_Mes_3_S4_SRR_RL_Obj_RelVelY_11()
{
	signalvalue1 = getSignal(S4_SRR_RL_Obj_RelVelY_11);
	write("S4_SRR_RL_Obj_RelVelY_11 :%f",signalvalue1);
	write("i_S4_SRR_RL_Obj_RelVelY_11 :%f",@ecu_Signals::i_S4_SRR_RL_Obj_RelVelY_11);

	testStep("get expect variable value: ","i_S4_SRR_RL_Obj_RelVelY_11 :%f",@ecu_Signals::i_S4_SRR_RL_Obj_RelVelY_11);

	if((abs(@ecu_Signals::i_S4_SRR_RL_Obj_RelVelY_11)*0.9<=abs(signalvalue1))&&(abs(signalvalue1)<=abs(@ecu_Signals::i_S4_SRR_RL_Obj_RelVelY_11)*1.1))
	{
	testStepPass("Pass","i_S4_SRR_RL_Obj_RelVelY_11 :%f",signalvalue1);
	}
	else
	{
	testStepFail("Fail","i_S4_SRR_RL_Obj_RelVelY_11 :%f",signalvalue1);
	}
}

testcase S4_SRR_RL_Obj_Mes_3_S4_SRR_RL_Obj_AccelY_11()
{
	signalvalue1 = getSignal(S4_SRR_RL_Obj_AccelY_11);
	write("S4_SRR_RL_Obj_AccelY_11 :%f",signalvalue1);
	write("i_S4_SRR_RL_Obj_AccelY_11 :%f",@ecu_Signals::i_S4_SRR_RL_Obj_AccelY_11);

	testStep("get expect variable value: ","i_S4_SRR_RL_Obj_AccelY_11 :%f",@ecu_Signals::i_S4_SRR_RL_Obj_AccelY_11);

	if((abs(@ecu_Signals::i_S4_SRR_RL_Obj_AccelY_11)*0.9<=abs(signalvalue1))&&(abs(signalvalue1)<=abs(@ecu_Signals::i_S4_SRR_RL_Obj_AccelY_11)*1.1))
	{
	testStepPass("Pass","i_S4_SRR_RL_Obj_AccelY_11 :%f",signalvalue1);
	}
	else
	{
	testStepFail("Fail","i_S4_SRR_RL_Obj_AccelY_11 :%f",signalvalue1);
	}
}

testcase S4_SRR_RL_Obj_Mes_3_S4_SRR_RL_Obj_DistXStd_11()
{
	signalvalue1 = getSignal(S4_SRR_RL_Obj_DistXStd_11);
	write("S4_SRR_RL_Obj_DistXStd_11 :%f",signalvalue1);
	write("i_S4_SRR_RL_Obj_DistXStd_11 :%f",@ecu_Signals::i_S4_SRR_RL_Obj_DistXStd_11);

	testStep("get expect variable value: ","i_S4_SRR_RL_Obj_DistXStd_11 :%f",@ecu_Signals::i_S4_SRR_RL_Obj_DistXStd_11);

	if((abs(@ecu_Signals::i_S4_SRR_RL_Obj_DistXStd_11)*0.9<=abs(signalvalue1))&&(abs(signalvalue1)<=abs(@ecu_Signals::i_S4_SRR_RL_Obj_DistXStd_11)*1.1))
	{
	testStepPass("Pass","i_S4_SRR_RL_Obj_DistXStd_11 :%f",signalvalue1);
	}
	else
	{
	testStepFail("Fail","i_S4_SRR_RL_Obj_DistXStd_11 :%f",signalvalue1);
	}
}

testcase S4_SRR_RL_Obj_Mes_3_S4_SRR_RL_Obj_RelVelXStd_11()
{
	signalvalue1 = getSignal(S4_SRR_RL_Obj_RelVelXStd_11);
	write("S4_SRR_RL_Obj_RelVelXStd_11 :%f",signalvalue1);
	write("i_S4_SRR_RL_Obj_RelVelXStd_11 :%f",@ecu_Signals::i_S4_SRR_RL_Obj_RelVelXStd_11);

	testStep("get expect variable value: ","i_S4_SRR_RL_Obj_RelVelXStd_11 :%f",@ecu_Signals::i_S4_SRR_RL_Obj_RelVelXStd_11);

	if((abs(@ecu_Signals::i_S4_SRR_RL_Obj_RelVelXStd_11)*0.9<=abs(signalvalue1))&&(abs(signalvalue1)<=abs(@ecu_Signals::i_S4_SRR_RL_Obj_RelVelXStd_11)*1.1))
	{
	testStepPass("Pass","i_S4_SRR_RL_Obj_RelVelXStd_11 :%f",signalvalue1);
	}
	else
	{
	testStepFail("Fail","i_S4_SRR_RL_Obj_RelVelXStd_11 :%f",signalvalue1);
	}
}

testcase S4_SRR_RL_Obj_Mes_3_S4_SRR_RL_Obj_DistYStd_11()
{
	signalvalue1 = getSignal(S4_SRR_RL_Obj_DistYStd_11);
	write("S4_SRR_RL_Obj_DistYStd_11 :%f",signalvalue1);
	write("i_S4_SRR_RL_Obj_DistYStd_11 :%f",@ecu_Signals::i_S4_SRR_RL_Obj_DistYStd_11);

	testStep("get expect variable value: ","i_S4_SRR_RL_Obj_DistYStd_11 :%f",@ecu_Signals::i_S4_SRR_RL_Obj_DistYStd_11);

	if((abs(@ecu_Signals::i_S4_SRR_RL_Obj_DistYStd_11)*0.9<=abs(signalvalue1))&&(abs(signalvalue1)<=abs(@ecu_Signals::i_S4_SRR_RL_Obj_DistYStd_11)*1.1))
	{
	testStepPass("Pass","i_S4_SRR_RL_Obj_DistYStd_11 :%f",signalvalue1);
	}
	else
	{
	testStepFail("Fail","i_S4_SRR_RL_Obj_DistYStd_11 :%f",signalvalue1);
	}
}

testcase S4_SRR_RL_Obj_Mes_3_S4_SRR_RL_Obj_RelVelYStd_11()
{
	signalvalue1 = getSignal(S4_SRR_RL_Obj_RelVelYStd_11);
	write("S4_SRR_RL_Obj_RelVelYStd_11 :%f",signalvalue1);
	write("i_S4_SRR_RL_Obj_RelVelYStd_11 :%f",@ecu_Signals::i_S4_SRR_RL_Obj_RelVelYStd_11);

	testStep("get expect variable value: ","i_S4_SRR_RL_Obj_RelVelYStd_11 :%f",@ecu_Signals::i_S4_SRR_RL_Obj_RelVelYStd_11);

	if((abs(@ecu_Signals::i_S4_SRR_RL_Obj_RelVelYStd_11)*0.9<=abs(signalvalue1))&&(abs(signalvalue1)<=abs(@ecu_Signals::i_S4_SRR_RL_Obj_RelVelYStd_11)*1.1))
	{
	testStepPass("Pass","i_S4_SRR_RL_Obj_RelVelYStd_11 :%f",signalvalue1);
	}
	else
	{
	testStepFail("Fail","i_S4_SRR_RL_Obj_RelVelYStd_11 :%f",signalvalue1);
	}
}

testcase S4_SRR_RL_Obj_Mes_3_S4_SRR_RL_Obj_UpdateFlag_11()
{
	signalvalue1 = getSignal(S4_SRR_RL_Obj_UpdateFlag_11);
	write("S4_SRR_RL_Obj_UpdateFlag_11 :%f",signalvalue1);
	write("i_S4_SRR_RL_Obj_UpdateFlag_11 :%o",@ecu_Signals::i_S4_SRR_RL_Obj_UpdateFlag_11);

	testStep("get expect variable value: ","i_S4_SRR_RL_Obj_UpdateFlag_11 :%o",@ecu_Signals::i_S4_SRR_RL_Obj_UpdateFlag_11);

	if(signalvalue1==@ecu_Signals::i_S4_SRR_RL_Obj_UpdateFlag_11)
	{
	testStepPass("Pass","i_S4_SRR_RL_Obj_UpdateFlag_11 :%f",signalvalue1);
	}
	else
	{
	testStepFail("Fail","i_S4_SRR_RL_Obj_UpdateFlag_11 :%f",signalvalue1);
	}
}

testcase S4_SRR_RL_Obj_Mes_3_S4_SRR_RL_Obj_ExistProb_11()
{
	signalvalue1 = getSignal(S4_SRR_RL_Obj_ExistProb_11);
	write("S4_SRR_RL_Obj_ExistProb_11 :%f",signalvalue1);
	write("i_S4_SRR_RL_Obj_ExistProb_11 :%o",@ecu_Signals::i_S4_SRR_RL_Obj_ExistProb_11);

	testStep("get expect variable value: ","i_S4_SRR_RL_Obj_ExistProb_11 :%o",@ecu_Signals::i_S4_SRR_RL_Obj_ExistProb_11);

	if(signalvalue1==@ecu_Signals::i_S4_SRR_RL_Obj_ExistProb_11)
	{
	testStepPass("Pass","i_S4_SRR_RL_Obj_ExistProb_11 :%f",signalvalue1);
	}
	else
	{
	testStepFail("Fail","i_S4_SRR_RL_Obj_ExistProb_11 :%f",signalvalue1);
	}
}

testcase S4_SRR_RL_Obj_Mes_3_S4_SRR_RL_Obj_Type_11()
{
	signalvalue1 = getSignal(S4_SRR_RL_Obj_Type_11);
	write("S4_SRR_RL_Obj_Type_11 :%f",signalvalue1);
	write("i_S4_SRR_RL_Obj_Type_11 :%o",@ecu_Signals::i_S4_SRR_RL_Obj_Type_11);

	testStep("get expect variable value: ","i_S4_SRR_RL_Obj_Type_11 :%o",@ecu_Signals::i_S4_SRR_RL_Obj_Type_11);

	if(signalvalue1==@ecu_Signals::i_S4_SRR_RL_Obj_Type_11)
	{
	testStepPass("Pass","i_S4_SRR_RL_Obj_Type_11 :%f",signalvalue1);
	}
	else
	{
	testStepFail("Fail","i_S4_SRR_RL_Obj_Type_11 :%f",signalvalue1);
	}
}

testcase S4_SRR_RL_Obj_Mes_3_S4_SRR_RL_Obj_EDynProp_11()
{
	signalvalue1 = getSignal(S4_SRR_RL_Obj_EDynProp_11);
	write("S4_SRR_RL_Obj_EDynProp_11 :%f",signalvalue1);
	write("i_S4_SRR_RL_Obj_EDynProp_11 :%o",@ecu_Signals::i_S4_SRR_RL_Obj_EDynProp_11);

	testStep("get expect variable value: ","i_S4_SRR_RL_Obj_EDynProp_11 :%o",@ecu_Signals::i_S4_SRR_RL_Obj_EDynProp_11);

	if(signalvalue1==@ecu_Signals::i_S4_SRR_RL_Obj_EDynProp_11)
	{
	testStepPass("Pass","i_S4_SRR_RL_Obj_EDynProp_11 :%f",signalvalue1);
	}
	else
	{
	testStepFail("Fail","i_S4_SRR_RL_Obj_EDynProp_11 :%f",signalvalue1);
	}
}

testcase S4_SRR_RL_Obj_Mes_3_S4_SRR_RL_Obj_UiLifeCycles_11()
{
	signalvalue1 = getSignal(S4_SRR_RL_Obj_UiLifeCycles_11);
	write("S4_SRR_RL_Obj_UiLifeCycles_11 :%f",signalvalue1);
	write("i_S4_SRR_RL_Obj_UiLifeCycles_11 :%o",@ecu_Signals::i_S4_SRR_RL_Obj_UiLifeCycles_11);

	testStep("get expect variable value: ","i_S4_SRR_RL_Obj_UiLifeCycles_11 :%o",@ecu_Signals::i_S4_SRR_RL_Obj_UiLifeCycles_11);

	if(signalvalue1==@ecu_Signals::i_S4_SRR_RL_Obj_UiLifeCycles_11)
	{
	testStepPass("Pass","i_S4_SRR_RL_Obj_UiLifeCycles_11 :%f",signalvalue1);
	}
	else
	{
	testStepFail("Fail","i_S4_SRR_RL_Obj_UiLifeCycles_11 :%f",signalvalue1);
	}
}

testcase S4_SRR_RL_Obj_Mes_4_S4_SRR_RL_Obj_ID_12()
{
	signalvalue1 = getSignal(S4_SRR_RL_Obj_ID_12);
	write("S4_SRR_RL_Obj_ID_12 :%f",signalvalue1);
	write("i_S4_SRR_RL_Obj_ID_12 :%o",@ecu_Signals::i_S4_SRR_RL_Obj_ID_12);

	testStep("get expect variable value: ","i_S4_SRR_RL_Obj_ID_12 :%o",@ecu_Signals::i_S4_SRR_RL_Obj_ID_12);

	if(signalvalue1==@ecu_Signals::i_S4_SRR_RL_Obj_ID_12)
	{
	testStepPass("Pass","i_S4_SRR_RL_Obj_ID_12 :%f",signalvalue1);
	}
	else
	{
	testStepFail("Fail","i_S4_SRR_RL_Obj_ID_12 :%f",signalvalue1);
	}
}

testcase S4_SRR_RL_Obj_Mes_4_S4_SRR_RL_Obj_DistX_12()
{
	signalvalue1 = getSignal(S4_SRR_RL_Obj_DistX_12);
	write("S4_SRR_RL_Obj_DistX_12 :%f",signalvalue1);
	write("i_S4_SRR_RL_Obj_DistX_12 :%f",@ecu_Signals::i_S4_SRR_RL_Obj_DistX_12);

	testStep("get expect variable value: ","i_S4_SRR_RL_Obj_DistX_12 :%f",@ecu_Signals::i_S4_SRR_RL_Obj_DistX_12);

	if((abs(@ecu_Signals::i_S4_SRR_RL_Obj_DistX_12)*0.9<=abs(signalvalue1))&&(abs(signalvalue1)<=abs(@ecu_Signals::i_S4_SRR_RL_Obj_DistX_12)*1.1))
	{
	testStepPass("Pass","i_S4_SRR_RL_Obj_DistX_12 :%f",signalvalue1);
	}
	else
	{
	testStepFail("Fail","i_S4_SRR_RL_Obj_DistX_12 :%f",signalvalue1);
	}
}

testcase S4_SRR_RL_Obj_Mes_4_S4_SRR_RL_Obj_RelVelX_12()
{
	signalvalue1 = getSignal(S4_SRR_RL_Obj_RelVelX_12);
	write("S4_SRR_RL_Obj_RelVelX_12 :%f",signalvalue1);
	write("i_S4_SRR_RL_Obj_RelVelX_12 :%f",@ecu_Signals::i_S4_SRR_RL_Obj_RelVelX_12);

	testStep("get expect variable value: ","i_S4_SRR_RL_Obj_RelVelX_12 :%f",@ecu_Signals::i_S4_SRR_RL_Obj_RelVelX_12);

	if((abs(@ecu_Signals::i_S4_SRR_RL_Obj_RelVelX_12)*0.9<=abs(signalvalue1))&&(abs(signalvalue1)<=abs(@ecu_Signals::i_S4_SRR_RL_Obj_RelVelX_12)*1.1))
	{
	testStepPass("Pass","i_S4_SRR_RL_Obj_RelVelX_12 :%f",signalvalue1);
	}
	else
	{
	testStepFail("Fail","i_S4_SRR_RL_Obj_RelVelX_12 :%f",signalvalue1);
	}
}

testcase S4_SRR_RL_Obj_Mes_4_S4_SRR_RL_Obj_AccelX_12()
{
	signalvalue1 = getSignal(S4_SRR_RL_Obj_AccelX_12);
	write("S4_SRR_RL_Obj_AccelX_12 :%f",signalvalue1);
	write("i_S4_SRR_RL_Obj_AccelX_12 :%f",@ecu_Signals::i_S4_SRR_RL_Obj_AccelX_12);

	testStep("get expect variable value: ","i_S4_SRR_RL_Obj_AccelX_12 :%f",@ecu_Signals::i_S4_SRR_RL_Obj_AccelX_12);

	if((abs(@ecu_Signals::i_S4_SRR_RL_Obj_AccelX_12)*0.9<=abs(signalvalue1))&&(abs(signalvalue1)<=abs(@ecu_Signals::i_S4_SRR_RL_Obj_AccelX_12)*1.1))
	{
	testStepPass("Pass","i_S4_SRR_RL_Obj_AccelX_12 :%f",signalvalue1);
	}
	else
	{
	testStepFail("Fail","i_S4_SRR_RL_Obj_AccelX_12 :%f",signalvalue1);
	}
}

testcase S4_SRR_RL_Obj_Mes_4_S4_SRR_RL_Obj_DistY_12()
{
	signalvalue1 = getSignal(S4_SRR_RL_Obj_DistY_12);
	write("S4_SRR_RL_Obj_DistY_12 :%f",signalvalue1);
	write("i_S4_SRR_RL_Obj_DistY_12 :%f",@ecu_Signals::i_S4_SRR_RL_Obj_DistY_12);

	testStep("get expect variable value: ","i_S4_SRR_RL_Obj_DistY_12 :%f",@ecu_Signals::i_S4_SRR_RL_Obj_DistY_12);

	if((abs(@ecu_Signals::i_S4_SRR_RL_Obj_DistY_12)*0.9<=abs(signalvalue1))&&(abs(signalvalue1)<=abs(@ecu_Signals::i_S4_SRR_RL_Obj_DistY_12)*1.1))
	{
	testStepPass("Pass","i_S4_SRR_RL_Obj_DistY_12 :%f",signalvalue1);
	}
	else
	{
	testStepFail("Fail","i_S4_SRR_RL_Obj_DistY_12 :%f",signalvalue1);
	}
}

testcase S4_SRR_RL_Obj_Mes_4_S4_SRR_RL_Obj_RelVelY_12()
{
	signalvalue1 = getSignal(S4_SRR_RL_Obj_RelVelY_12);
	write("S4_SRR_RL_Obj_RelVelY_12 :%f",signalvalue1);
	write("i_S4_SRR_RL_Obj_RelVelY_12 :%f",@ecu_Signals::i_S4_SRR_RL_Obj_RelVelY_12);

	testStep("get expect variable value: ","i_S4_SRR_RL_Obj_RelVelY_12 :%f",@ecu_Signals::i_S4_SRR_RL_Obj_RelVelY_12);

	if((abs(@ecu_Signals::i_S4_SRR_RL_Obj_RelVelY_12)*0.9<=abs(signalvalue1))&&(abs(signalvalue1)<=abs(@ecu_Signals::i_S4_SRR_RL_Obj_RelVelY_12)*1.1))
	{
	testStepPass("Pass","i_S4_SRR_RL_Obj_RelVelY_12 :%f",signalvalue1);
	}
	else
	{
	testStepFail("Fail","i_S4_SRR_RL_Obj_RelVelY_12 :%f",signalvalue1);
	}
}

testcase S4_SRR_RL_Obj_Mes_4_S4_SRR_RL_Obj_AccelY_12()
{
	signalvalue1 = getSignal(S4_SRR_RL_Obj_AccelY_12);
	write("S4_SRR_RL_Obj_AccelY_12 :%f",signalvalue1);
	write("i_S4_SRR_RL_Obj_AccelY_12 :%f",@ecu_Signals::i_S4_SRR_RL_Obj_AccelY_12);

	testStep("get expect variable value: ","i_S4_SRR_RL_Obj_AccelY_12 :%f",@ecu_Signals::i_S4_SRR_RL_Obj_AccelY_12);

	if((abs(@ecu_Signals::i_S4_SRR_RL_Obj_AccelY_12)*0.9<=abs(signalvalue1))&&(abs(signalvalue1)<=abs(@ecu_Signals::i_S4_SRR_RL_Obj_AccelY_12)*1.1))
	{
	testStepPass("Pass","i_S4_SRR_RL_Obj_AccelY_12 :%f",signalvalue1);
	}
	else
	{
	testStepFail("Fail","i_S4_SRR_RL_Obj_AccelY_12 :%f",signalvalue1);
	}
}

testcase S4_SRR_RL_Obj_Mes_4_S4_SRR_RL_Obj_DistXStd_12()
{
	signalvalue1 = getSignal(S4_SRR_RL_Obj_DistXStd_12);
	write("S4_SRR_RL_Obj_DistXStd_12 :%f",signalvalue1);
	write("i_S4_SRR_RL_Obj_DistXStd_12 :%f",@ecu_Signals::i_S4_SRR_RL_Obj_DistXStd_12);

	testStep("get expect variable value: ","i_S4_SRR_RL_Obj_DistXStd_12 :%f",@ecu_Signals::i_S4_SRR_RL_Obj_DistXStd_12);

	if((abs(@ecu_Signals::i_S4_SRR_RL_Obj_DistXStd_12)*0.9<=abs(signalvalue1))&&(abs(signalvalue1)<=abs(@ecu_Signals::i_S4_SRR_RL_Obj_DistXStd_12)*1.1))
	{
	testStepPass("Pass","i_S4_SRR_RL_Obj_DistXStd_12 :%f",signalvalue1);
	}
	else
	{
	testStepFail("Fail","i_S4_SRR_RL_Obj_DistXStd_12 :%f",signalvalue1);
	}
}

testcase S4_SRR_RL_Obj_Mes_4_S4_SRR_RL_Obj_RelVelXStd_12()
{
	signalvalue1 = getSignal(S4_SRR_RL_Obj_RelVelXStd_12);
	write("S4_SRR_RL_Obj_RelVelXStd_12 :%f",signalvalue1);
	write("i_S4_SRR_RL_Obj_RelVelXStd_12 :%f",@ecu_Signals::i_S4_SRR_RL_Obj_RelVelXStd_12);

	testStep("get expect variable value: ","i_S4_SRR_RL_Obj_RelVelXStd_12 :%f",@ecu_Signals::i_S4_SRR_RL_Obj_RelVelXStd_12);

	if((abs(@ecu_Signals::i_S4_SRR_RL_Obj_RelVelXStd_12)*0.9<=abs(signalvalue1))&&(abs(signalvalue1)<=abs(@ecu_Signals::i_S4_SRR_RL_Obj_RelVelXStd_12)*1.1))
	{
	testStepPass("Pass","i_S4_SRR_RL_Obj_RelVelXStd_12 :%f",signalvalue1);
	}
	else
	{
	testStepFail("Fail","i_S4_SRR_RL_Obj_RelVelXStd_12 :%f",signalvalue1);
	}
}

testcase S4_SRR_RL_Obj_Mes_4_S4_SRR_RL_Obj_DistYStd_12()
{
	signalvalue1 = getSignal(S4_SRR_RL_Obj_DistYStd_12);
	write("S4_SRR_RL_Obj_DistYStd_12 :%f",signalvalue1);
	write("i_S4_SRR_RL_Obj_DistYStd_12 :%f",@ecu_Signals::i_S4_SRR_RL_Obj_DistYStd_12);

	testStep("get expect variable value: ","i_S4_SRR_RL_Obj_DistYStd_12 :%f",@ecu_Signals::i_S4_SRR_RL_Obj_DistYStd_12);

	if((abs(@ecu_Signals::i_S4_SRR_RL_Obj_DistYStd_12)*0.9<=abs(signalvalue1))&&(abs(signalvalue1)<=abs(@ecu_Signals::i_S4_SRR_RL_Obj_DistYStd_12)*1.1))
	{
	testStepPass("Pass","i_S4_SRR_RL_Obj_DistYStd_12 :%f",signalvalue1);
	}
	else
	{
	testStepFail("Fail","i_S4_SRR_RL_Obj_DistYStd_12 :%f",signalvalue1);
	}
}

testcase S4_SRR_RL_Obj_Mes_4_S4_SRR_RL_Obj_RelVelYStd_12()
{
	signalvalue1 = getSignal(S4_SRR_RL_Obj_RelVelYStd_12);
	write("S4_SRR_RL_Obj_RelVelYStd_12 :%f",signalvalue1);
	write("i_S4_SRR_RL_Obj_RelVelYStd_12 :%f",@ecu_Signals::i_S4_SRR_RL_Obj_RelVelYStd_12);

	testStep("get expect variable value: ","i_S4_SRR_RL_Obj_RelVelYStd_12 :%f",@ecu_Signals::i_S4_SRR_RL_Obj_RelVelYStd_12);

	if((abs(@ecu_Signals::i_S4_SRR_RL_Obj_RelVelYStd_12)*0.9<=abs(signalvalue1))&&(abs(signalvalue1)<=abs(@ecu_Signals::i_S4_SRR_RL_Obj_RelVelYStd_12)*1.1))
	{
	testStepPass("Pass","i_S4_SRR_RL_Obj_RelVelYStd_12 :%f",signalvalue1);
	}
	else
	{
	testStepFail("Fail","i_S4_SRR_RL_Obj_RelVelYStd_12 :%f",signalvalue1);
	}
}

testcase S4_SRR_RL_Obj_Mes_4_S4_SRR_RL_Obj_UpdateFlag_12()
{
	signalvalue1 = getSignal(S4_SRR_RL_Obj_UpdateFlag_12);
	write("S4_SRR_RL_Obj_UpdateFlag_12 :%f",signalvalue1);
	write("i_S4_SRR_RL_Obj_UpdateFlag_12 :%o",@ecu_Signals::i_S4_SRR_RL_Obj_UpdateFlag_12);

	testStep("get expect variable value: ","i_S4_SRR_RL_Obj_UpdateFlag_12 :%o",@ecu_Signals::i_S4_SRR_RL_Obj_UpdateFlag_12);

	if(signalvalue1==@ecu_Signals::i_S4_SRR_RL_Obj_UpdateFlag_12)
	{
	testStepPass("Pass","i_S4_SRR_RL_Obj_UpdateFlag_12 :%f",signalvalue1);
	}
	else
	{
	testStepFail("Fail","i_S4_SRR_RL_Obj_UpdateFlag_12 :%f",signalvalue1);
	}
}

testcase S4_SRR_RL_Obj_Mes_4_S4_SRR_RL_Obj_ExistProb_12()
{
	signalvalue1 = getSignal(S4_SRR_RL_Obj_ExistProb_12);
	write("S4_SRR_RL_Obj_ExistProb_12 :%f",signalvalue1);
	write("i_S4_SRR_RL_Obj_ExistProb_12 :%o",@ecu_Signals::i_S4_SRR_RL_Obj_ExistProb_12);

	testStep("get expect variable value: ","i_S4_SRR_RL_Obj_ExistProb_12 :%o",@ecu_Signals::i_S4_SRR_RL_Obj_ExistProb_12);

	if(signalvalue1==@ecu_Signals::i_S4_SRR_RL_Obj_ExistProb_12)
	{
	testStepPass("Pass","i_S4_SRR_RL_Obj_ExistProb_12 :%f",signalvalue1);
	}
	else
	{
	testStepFail("Fail","i_S4_SRR_RL_Obj_ExistProb_12 :%f",signalvalue1);
	}
}

testcase S4_SRR_RL_Obj_Mes_4_S4_SRR_RL_Obj_Type_12()
{
	signalvalue1 = getSignal(S4_SRR_RL_Obj_Type_12);
	write("S4_SRR_RL_Obj_Type_12 :%f",signalvalue1);
	write("i_S4_SRR_RL_Obj_Type_12 :%o",@ecu_Signals::i_S4_SRR_RL_Obj_Type_12);

	testStep("get expect variable value: ","i_S4_SRR_RL_Obj_Type_12 :%o",@ecu_Signals::i_S4_SRR_RL_Obj_Type_12);

	if(signalvalue1==@ecu_Signals::i_S4_SRR_RL_Obj_Type_12)
	{
	testStepPass("Pass","i_S4_SRR_RL_Obj_Type_12 :%f",signalvalue1);
	}
	else
	{
	testStepFail("Fail","i_S4_SRR_RL_Obj_Type_12 :%f",signalvalue1);
	}
}

testcase S4_SRR_RL_Obj_Mes_4_S4_SRR_RL_Obj_EDynProp_12()
{
	signalvalue1 = getSignal(S4_SRR_RL_Obj_EDynProp_12);
	write("S4_SRR_RL_Obj_EDynProp_12 :%f",signalvalue1);
	write("i_S4_SRR_RL_Obj_EDynProp_12 :%o",@ecu_Signals::i_S4_SRR_RL_Obj_EDynProp_12);

	testStep("get expect variable value: ","i_S4_SRR_RL_Obj_EDynProp_12 :%o",@ecu_Signals::i_S4_SRR_RL_Obj_EDynProp_12);

	if(signalvalue1==@ecu_Signals::i_S4_SRR_RL_Obj_EDynProp_12)
	{
	testStepPass("Pass","i_S4_SRR_RL_Obj_EDynProp_12 :%f",signalvalue1);
	}
	else
	{
	testStepFail("Fail","i_S4_SRR_RL_Obj_EDynProp_12 :%f",signalvalue1);
	}
}

testcase S4_SRR_RL_Obj_Mes_4_S4_SRR_RL_Obj_UiLifeCycles_12()
{
	signalvalue1 = getSignal(S4_SRR_RL_Obj_UiLifeCycles_12);
	write("S4_SRR_RL_Obj_UiLifeCycles_12 :%f",signalvalue1);
	write("i_S4_SRR_RL_Obj_UiLifeCycles_12 :%o",@ecu_Signals::i_S4_SRR_RL_Obj_UiLifeCycles_12);

	testStep("get expect variable value: ","i_S4_SRR_RL_Obj_UiLifeCycles_12 :%o",@ecu_Signals::i_S4_SRR_RL_Obj_UiLifeCycles_12);

	if(signalvalue1==@ecu_Signals::i_S4_SRR_RL_Obj_UiLifeCycles_12)
	{
	testStepPass("Pass","i_S4_SRR_RL_Obj_UiLifeCycles_12 :%f",signalvalue1);
	}
	else
	{
	testStepFail("Fail","i_S4_SRR_RL_Obj_UiLifeCycles_12 :%f",signalvalue1);
	}
}

testcase S4_SRR_RL_Obj_Mes_4_S4_SRR_RL_Obj_ID_13()
{
	signalvalue1 = getSignal(S4_SRR_RL_Obj_ID_13);
	write("S4_SRR_RL_Obj_ID_13 :%f",signalvalue1);
	write("i_S4_SRR_RL_Obj_ID_13 :%o",@ecu_Signals::i_S4_SRR_RL_Obj_ID_13);

	testStep("get expect variable value: ","i_S4_SRR_RL_Obj_ID_13 :%o",@ecu_Signals::i_S4_SRR_RL_Obj_ID_13);

	if(signalvalue1==@ecu_Signals::i_S4_SRR_RL_Obj_ID_13)
	{
	testStepPass("Pass","i_S4_SRR_RL_Obj_ID_13 :%f",signalvalue1);
	}
	else
	{
	testStepFail("Fail","i_S4_SRR_RL_Obj_ID_13 :%f",signalvalue1);
	}
}

testcase S4_SRR_RL_Obj_Mes_4_S4_SRR_RL_Obj_DistX_13()
{
	signalvalue1 = getSignal(S4_SRR_RL_Obj_DistX_13);
	write("S4_SRR_RL_Obj_DistX_13 :%f",signalvalue1);
	write("i_S4_SRR_RL_Obj_DistX_13 :%f",@ecu_Signals::i_S4_SRR_RL_Obj_DistX_13);

	testStep("get expect variable value: ","i_S4_SRR_RL_Obj_DistX_13 :%f",@ecu_Signals::i_S4_SRR_RL_Obj_DistX_13);

	if((abs(@ecu_Signals::i_S4_SRR_RL_Obj_DistX_13)*0.9<=abs(signalvalue1))&&(abs(signalvalue1)<=abs(@ecu_Signals::i_S4_SRR_RL_Obj_DistX_13)*1.1))
	{
	testStepPass("Pass","i_S4_SRR_RL_Obj_DistX_13 :%f",signalvalue1);
	}
	else
	{
	testStepFail("Fail","i_S4_SRR_RL_Obj_DistX_13 :%f",signalvalue1);
	}
}

testcase S4_SRR_RL_Obj_Mes_4_S4_SRR_RL_Obj_RelVelX_13()
{
	signalvalue1 = getSignal(S4_SRR_RL_Obj_RelVelX_13);
	write("S4_SRR_RL_Obj_RelVelX_13 :%f",signalvalue1);
	write("i_S4_SRR_RL_Obj_RelVelX_13 :%f",@ecu_Signals::i_S4_SRR_RL_Obj_RelVelX_13);

	testStep("get expect variable value: ","i_S4_SRR_RL_Obj_RelVelX_13 :%f",@ecu_Signals::i_S4_SRR_RL_Obj_RelVelX_13);

	if((abs(@ecu_Signals::i_S4_SRR_RL_Obj_RelVelX_13)*0.9<=abs(signalvalue1))&&(abs(signalvalue1)<=abs(@ecu_Signals::i_S4_SRR_RL_Obj_RelVelX_13)*1.1))
	{
	testStepPass("Pass","i_S4_SRR_RL_Obj_RelVelX_13 :%f",signalvalue1);
	}
	else
	{
	testStepFail("Fail","i_S4_SRR_RL_Obj_RelVelX_13 :%f",signalvalue1);
	}
}

testcase S4_SRR_RL_Obj_Mes_4_S4_SRR_RL_Obj_AccelX_13()
{
	signalvalue1 = getSignal(S4_SRR_RL_Obj_AccelX_13);
	write("S4_SRR_RL_Obj_AccelX_13 :%f",signalvalue1);
	write("i_S4_SRR_RL_Obj_AccelX_13 :%f",@ecu_Signals::i_S4_SRR_RL_Obj_AccelX_13);

	testStep("get expect variable value: ","i_S4_SRR_RL_Obj_AccelX_13 :%f",@ecu_Signals::i_S4_SRR_RL_Obj_AccelX_13);

	if((abs(@ecu_Signals::i_S4_SRR_RL_Obj_AccelX_13)*0.9<=abs(signalvalue1))&&(abs(signalvalue1)<=abs(@ecu_Signals::i_S4_SRR_RL_Obj_AccelX_13)*1.1))
	{
	testStepPass("Pass","i_S4_SRR_RL_Obj_AccelX_13 :%f",signalvalue1);
	}
	else
	{
	testStepFail("Fail","i_S4_SRR_RL_Obj_AccelX_13 :%f",signalvalue1);
	}
}

testcase S4_SRR_RL_Obj_Mes_4_S4_SRR_RL_Obj_DistY_13()
{
	signalvalue1 = getSignal(S4_SRR_RL_Obj_DistY_13);
	write("S4_SRR_RL_Obj_DistY_13 :%f",signalvalue1);
	write("i_S4_SRR_RL_Obj_DistY_13 :%f",@ecu_Signals::i_S4_SRR_RL_Obj_DistY_13);

	testStep("get expect variable value: ","i_S4_SRR_RL_Obj_DistY_13 :%f",@ecu_Signals::i_S4_SRR_RL_Obj_DistY_13);

	if((abs(@ecu_Signals::i_S4_SRR_RL_Obj_DistY_13)*0.9<=abs(signalvalue1))&&(abs(signalvalue1)<=abs(@ecu_Signals::i_S4_SRR_RL_Obj_DistY_13)*1.1))
	{
	testStepPass("Pass","i_S4_SRR_RL_Obj_DistY_13 :%f",signalvalue1);
	}
	else
	{
	testStepFail("Fail","i_S4_SRR_RL_Obj_DistY_13 :%f",signalvalue1);
	}
}

testcase S4_SRR_RL_Obj_Mes_4_S4_SRR_RL_Obj_RelVelY_13()
{
	signalvalue1 = getSignal(S4_SRR_RL_Obj_RelVelY_13);
	write("S4_SRR_RL_Obj_RelVelY_13 :%f",signalvalue1);
	write("i_S4_SRR_RL_Obj_RelVelY_13 :%f",@ecu_Signals::i_S4_SRR_RL_Obj_RelVelY_13);

	testStep("get expect variable value: ","i_S4_SRR_RL_Obj_RelVelY_13 :%f",@ecu_Signals::i_S4_SRR_RL_Obj_RelVelY_13);

	if((abs(@ecu_Signals::i_S4_SRR_RL_Obj_RelVelY_13)*0.9<=abs(signalvalue1))&&(abs(signalvalue1)<=abs(@ecu_Signals::i_S4_SRR_RL_Obj_RelVelY_13)*1.1))
	{
	testStepPass("Pass","i_S4_SRR_RL_Obj_RelVelY_13 :%f",signalvalue1);
	}
	else
	{
	testStepFail("Fail","i_S4_SRR_RL_Obj_RelVelY_13 :%f",signalvalue1);
	}
}

testcase S4_SRR_RL_Obj_Mes_4_S4_SRR_RL_Obj_AccelY_13()
{
	signalvalue1 = getSignal(S4_SRR_RL_Obj_AccelY_13);
	write("S4_SRR_RL_Obj_AccelY_13 :%f",signalvalue1);
	write("i_S4_SRR_RL_Obj_AccelY_13 :%f",@ecu_Signals::i_S4_SRR_RL_Obj_AccelY_13);

	testStep("get expect variable value: ","i_S4_SRR_RL_Obj_AccelY_13 :%f",@ecu_Signals::i_S4_SRR_RL_Obj_AccelY_13);

	if((abs(@ecu_Signals::i_S4_SRR_RL_Obj_AccelY_13)*0.9<=abs(signalvalue1))&&(abs(signalvalue1)<=abs(@ecu_Signals::i_S4_SRR_RL_Obj_AccelY_13)*1.1))
	{
	testStepPass("Pass","i_S4_SRR_RL_Obj_AccelY_13 :%f",signalvalue1);
	}
	else
	{
	testStepFail("Fail","i_S4_SRR_RL_Obj_AccelY_13 :%f",signalvalue1);
	}
}

testcase S4_SRR_RL_Obj_Mes_4_S4_SRR_RL_Obj_DistXStd_13()
{
	signalvalue1 = getSignal(S4_SRR_RL_Obj_DistXStd_13);
	write("S4_SRR_RL_Obj_DistXStd_13 :%f",signalvalue1);
	write("i_S4_SRR_RL_Obj_DistXStd_13 :%f",@ecu_Signals::i_S4_SRR_RL_Obj_DistXStd_13);

	testStep("get expect variable value: ","i_S4_SRR_RL_Obj_DistXStd_13 :%f",@ecu_Signals::i_S4_SRR_RL_Obj_DistXStd_13);

	if((abs(@ecu_Signals::i_S4_SRR_RL_Obj_DistXStd_13)*0.9<=abs(signalvalue1))&&(abs(signalvalue1)<=abs(@ecu_Signals::i_S4_SRR_RL_Obj_DistXStd_13)*1.1))
	{
	testStepPass("Pass","i_S4_SRR_RL_Obj_DistXStd_13 :%f",signalvalue1);
	}
	else
	{
	testStepFail("Fail","i_S4_SRR_RL_Obj_DistXStd_13 :%f",signalvalue1);
	}
}

testcase S4_SRR_RL_Obj_Mes_4_S4_SRR_RL_Obj_RelVelXStd_13()
{
	signalvalue1 = getSignal(S4_SRR_RL_Obj_RelVelXStd_13);
	write("S4_SRR_RL_Obj_RelVelXStd_13 :%f",signalvalue1);
	write("i_S4_SRR_RL_Obj_RelVelXStd_13 :%f",@ecu_Signals::i_S4_SRR_RL_Obj_RelVelXStd_13);

	testStep("get expect variable value: ","i_S4_SRR_RL_Obj_RelVelXStd_13 :%f",@ecu_Signals::i_S4_SRR_RL_Obj_RelVelXStd_13);

	if((abs(@ecu_Signals::i_S4_SRR_RL_Obj_RelVelXStd_13)*0.9<=abs(signalvalue1))&&(abs(signalvalue1)<=abs(@ecu_Signals::i_S4_SRR_RL_Obj_RelVelXStd_13)*1.1))
	{
	testStepPass("Pass","i_S4_SRR_RL_Obj_RelVelXStd_13 :%f",signalvalue1);
	}
	else
	{
	testStepFail("Fail","i_S4_SRR_RL_Obj_RelVelXStd_13 :%f",signalvalue1);
	}
}

testcase S4_SRR_RL_Obj_Mes_4_S4_SRR_RL_Obj_DistYStd_13()
{
	signalvalue1 = getSignal(S4_SRR_RL_Obj_DistYStd_13);
	write("S4_SRR_RL_Obj_DistYStd_13 :%f",signalvalue1);
	write("i_S4_SRR_RL_Obj_DistYStd_13 :%f",@ecu_Signals::i_S4_SRR_RL_Obj_DistYStd_13);

	testStep("get expect variable value: ","i_S4_SRR_RL_Obj_DistYStd_13 :%f",@ecu_Signals::i_S4_SRR_RL_Obj_DistYStd_13);

	if((abs(@ecu_Signals::i_S4_SRR_RL_Obj_DistYStd_13)*0.9<=abs(signalvalue1))&&(abs(signalvalue1)<=abs(@ecu_Signals::i_S4_SRR_RL_Obj_DistYStd_13)*1.1))
	{
	testStepPass("Pass","i_S4_SRR_RL_Obj_DistYStd_13 :%f",signalvalue1);
	}
	else
	{
	testStepFail("Fail","i_S4_SRR_RL_Obj_DistYStd_13 :%f",signalvalue1);
	}
}

testcase S4_SRR_RL_Obj_Mes_4_S4_SRR_RL_Obj_RelVelYStd_13()
{
	signalvalue1 = getSignal(S4_SRR_RL_Obj_RelVelYStd_13);
	write("S4_SRR_RL_Obj_RelVelYStd_13 :%f",signalvalue1);
	write("i_S4_SRR_RL_Obj_RelVelYStd_13 :%f",@ecu_Signals::i_S4_SRR_RL_Obj_RelVelYStd_13);

	testStep("get expect variable value: ","i_S4_SRR_RL_Obj_RelVelYStd_13 :%f",@ecu_Signals::i_S4_SRR_RL_Obj_RelVelYStd_13);

	if((abs(@ecu_Signals::i_S4_SRR_RL_Obj_RelVelYStd_13)*0.9<=abs(signalvalue1))&&(abs(signalvalue1)<=abs(@ecu_Signals::i_S4_SRR_RL_Obj_RelVelYStd_13)*1.1))
	{
	testStepPass("Pass","i_S4_SRR_RL_Obj_RelVelYStd_13 :%f",signalvalue1);
	}
	else
	{
	testStepFail("Fail","i_S4_SRR_RL_Obj_RelVelYStd_13 :%f",signalvalue1);
	}
}

testcase S4_SRR_RL_Obj_Mes_4_S4_SRR_RL_Obj_UpdateFlag_13()
{
	signalvalue1 = getSignal(S4_SRR_RL_Obj_UpdateFlag_13);
	write("S4_SRR_RL_Obj_UpdateFlag_13 :%f",signalvalue1);
	write("i_S4_SRR_RL_Obj_UpdateFlag_13 :%o",@ecu_Signals::i_S4_SRR_RL_Obj_UpdateFlag_13);

	testStep("get expect variable value: ","i_S4_SRR_RL_Obj_UpdateFlag_13 :%o",@ecu_Signals::i_S4_SRR_RL_Obj_UpdateFlag_13);

	if(signalvalue1==@ecu_Signals::i_S4_SRR_RL_Obj_UpdateFlag_13)
	{
	testStepPass("Pass","i_S4_SRR_RL_Obj_UpdateFlag_13 :%f",signalvalue1);
	}
	else
	{
	testStepFail("Fail","i_S4_SRR_RL_Obj_UpdateFlag_13 :%f",signalvalue1);
	}
}

testcase S4_SRR_RL_Obj_Mes_4_S4_SRR_RL_Obj_ExistProb_13()
{
	signalvalue1 = getSignal(S4_SRR_RL_Obj_ExistProb_13);
	write("S4_SRR_RL_Obj_ExistProb_13 :%f",signalvalue1);
	write("i_S4_SRR_RL_Obj_ExistProb_13 :%o",@ecu_Signals::i_S4_SRR_RL_Obj_ExistProb_13);

	testStep("get expect variable value: ","i_S4_SRR_RL_Obj_ExistProb_13 :%o",@ecu_Signals::i_S4_SRR_RL_Obj_ExistProb_13);

	if(signalvalue1==@ecu_Signals::i_S4_SRR_RL_Obj_ExistProb_13)
	{
	testStepPass("Pass","i_S4_SRR_RL_Obj_ExistProb_13 :%f",signalvalue1);
	}
	else
	{
	testStepFail("Fail","i_S4_SRR_RL_Obj_ExistProb_13 :%f",signalvalue1);
	}
}

testcase S4_SRR_RL_Obj_Mes_4_S4_SRR_RL_Obj_Type_13()
{
	signalvalue1 = getSignal(S4_SRR_RL_Obj_Type_13);
	write("S4_SRR_RL_Obj_Type_13 :%f",signalvalue1);
	write("i_S4_SRR_RL_Obj_Type_13 :%o",@ecu_Signals::i_S4_SRR_RL_Obj_Type_13);

	testStep("get expect variable value: ","i_S4_SRR_RL_Obj_Type_13 :%o",@ecu_Signals::i_S4_SRR_RL_Obj_Type_13);

	if(signalvalue1==@ecu_Signals::i_S4_SRR_RL_Obj_Type_13)
	{
	testStepPass("Pass","i_S4_SRR_RL_Obj_Type_13 :%f",signalvalue1);
	}
	else
	{
	testStepFail("Fail","i_S4_SRR_RL_Obj_Type_13 :%f",signalvalue1);
	}
}

testcase S4_SRR_RL_Obj_Mes_4_S4_SRR_RL_Obj_EDynProp_13()
{
	signalvalue1 = getSignal(S4_SRR_RL_Obj_EDynProp_13);
	write("S4_SRR_RL_Obj_EDynProp_13 :%f",signalvalue1);
	write("i_S4_SRR_RL_Obj_EDynProp_13 :%o",@ecu_Signals::i_S4_SRR_RL_Obj_EDynProp_13);

	testStep("get expect variable value: ","i_S4_SRR_RL_Obj_EDynProp_13 :%o",@ecu_Signals::i_S4_SRR_RL_Obj_EDynProp_13);

	if(signalvalue1==@ecu_Signals::i_S4_SRR_RL_Obj_EDynProp_13)
	{
	testStepPass("Pass","i_S4_SRR_RL_Obj_EDynProp_13 :%f",signalvalue1);
	}
	else
	{
	testStepFail("Fail","i_S4_SRR_RL_Obj_EDynProp_13 :%f",signalvalue1);
	}
}

testcase S4_SRR_RL_Obj_Mes_4_S4_SRR_RL_Obj_UiLifeCycles_13()
{
	signalvalue1 = getSignal(S4_SRR_RL_Obj_UiLifeCycles_13);
	write("S4_SRR_RL_Obj_UiLifeCycles_13 :%f",signalvalue1);
	write("i_S4_SRR_RL_Obj_UiLifeCycles_13 :%o",@ecu_Signals::i_S4_SRR_RL_Obj_UiLifeCycles_13);

	testStep("get expect variable value: ","i_S4_SRR_RL_Obj_UiLifeCycles_13 :%o",@ecu_Signals::i_S4_SRR_RL_Obj_UiLifeCycles_13);

	if(signalvalue1==@ecu_Signals::i_S4_SRR_RL_Obj_UiLifeCycles_13)
	{
	testStepPass("Pass","i_S4_SRR_RL_Obj_UiLifeCycles_13 :%f",signalvalue1);
	}
	else
	{
	testStepFail("Fail","i_S4_SRR_RL_Obj_UiLifeCycles_13 :%f",signalvalue1);
	}
}

testcase S4_SRR_RL_Obj_Mes_4_S4_SRR_RL_Obj_ID_14()
{
	signalvalue1 = getSignal(S4_SRR_RL_Obj_ID_14);
	write("S4_SRR_RL_Obj_ID_14 :%f",signalvalue1);
	write("i_S4_SRR_RL_Obj_ID_14 :%o",@ecu_Signals::i_S4_SRR_RL_Obj_ID_14);

	testStep("get expect variable value: ","i_S4_SRR_RL_Obj_ID_14 :%o",@ecu_Signals::i_S4_SRR_RL_Obj_ID_14);

	if(signalvalue1==@ecu_Signals::i_S4_SRR_RL_Obj_ID_14)
	{
	testStepPass("Pass","i_S4_SRR_RL_Obj_ID_14 :%f",signalvalue1);
	}
	else
	{
	testStepFail("Fail","i_S4_SRR_RL_Obj_ID_14 :%f",signalvalue1);
	}
}

testcase S4_SRR_RL_Obj_Mes_4_S4_SRR_RL_Obj_DistX_14()
{
	signalvalue1 = getSignal(S4_SRR_RL_Obj_DistX_14);
	write("S4_SRR_RL_Obj_DistX_14 :%f",signalvalue1);
	write("i_S4_SRR_RL_Obj_DistX_14 :%f",@ecu_Signals::i_S4_SRR_RL_Obj_DistX_14);

	testStep("get expect variable value: ","i_S4_SRR_RL_Obj_DistX_14 :%f",@ecu_Signals::i_S4_SRR_RL_Obj_DistX_14);

	if((abs(@ecu_Signals::i_S4_SRR_RL_Obj_DistX_14)*0.9<=abs(signalvalue1))&&(abs(signalvalue1)<=abs(@ecu_Signals::i_S4_SRR_RL_Obj_DistX_14)*1.1))
	{
	testStepPass("Pass","i_S4_SRR_RL_Obj_DistX_14 :%f",signalvalue1);
	}
	else
	{
	testStepFail("Fail","i_S4_SRR_RL_Obj_DistX_14 :%f",signalvalue1);
	}
}

testcase S4_SRR_RL_Obj_Mes_4_S4_SRR_RL_Obj_RelVelX_14()
{
	signalvalue1 = getSignal(S4_SRR_RL_Obj_RelVelX_14);
	write("S4_SRR_RL_Obj_RelVelX_14 :%f",signalvalue1);
	write("i_S4_SRR_RL_Obj_RelVelX_14 :%f",@ecu_Signals::i_S4_SRR_RL_Obj_RelVelX_14);

	testStep("get expect variable value: ","i_S4_SRR_RL_Obj_RelVelX_14 :%f",@ecu_Signals::i_S4_SRR_RL_Obj_RelVelX_14);

	if((abs(@ecu_Signals::i_S4_SRR_RL_Obj_RelVelX_14)*0.9<=abs(signalvalue1))&&(abs(signalvalue1)<=abs(@ecu_Signals::i_S4_SRR_RL_Obj_RelVelX_14)*1.1))
	{
	testStepPass("Pass","i_S4_SRR_RL_Obj_RelVelX_14 :%f",signalvalue1);
	}
	else
	{
	testStepFail("Fail","i_S4_SRR_RL_Obj_RelVelX_14 :%f",signalvalue1);
	}
}

testcase S4_SRR_RL_Obj_Mes_4_S4_SRR_RL_Obj_AccelX_14()
{
	signalvalue1 = getSignal(S4_SRR_RL_Obj_AccelX_14);
	write("S4_SRR_RL_Obj_AccelX_14 :%f",signalvalue1);
	write("i_S4_SRR_RL_Obj_AccelX_14 :%f",@ecu_Signals::i_S4_SRR_RL_Obj_AccelX_14);

	testStep("get expect variable value: ","i_S4_SRR_RL_Obj_AccelX_14 :%f",@ecu_Signals::i_S4_SRR_RL_Obj_AccelX_14);

	if((abs(@ecu_Signals::i_S4_SRR_RL_Obj_AccelX_14)*0.9<=abs(signalvalue1))&&(abs(signalvalue1)<=abs(@ecu_Signals::i_S4_SRR_RL_Obj_AccelX_14)*1.1))
	{
	testStepPass("Pass","i_S4_SRR_RL_Obj_AccelX_14 :%f",signalvalue1);
	}
	else
	{
	testStepFail("Fail","i_S4_SRR_RL_Obj_AccelX_14 :%f",signalvalue1);
	}
}

testcase S4_SRR_RL_Obj_Mes_4_S4_SRR_RL_Obj_DistY_14()
{
	signalvalue1 = getSignal(S4_SRR_RL_Obj_DistY_14);
	write("S4_SRR_RL_Obj_DistY_14 :%f",signalvalue1);
	write("i_S4_SRR_RL_Obj_DistY_14 :%f",@ecu_Signals::i_S4_SRR_RL_Obj_DistY_14);

	testStep("get expect variable value: ","i_S4_SRR_RL_Obj_DistY_14 :%f",@ecu_Signals::i_S4_SRR_RL_Obj_DistY_14);

	if((abs(@ecu_Signals::i_S4_SRR_RL_Obj_DistY_14)*0.9<=abs(signalvalue1))&&(abs(signalvalue1)<=abs(@ecu_Signals::i_S4_SRR_RL_Obj_DistY_14)*1.1))
	{
	testStepPass("Pass","i_S4_SRR_RL_Obj_DistY_14 :%f",signalvalue1);
	}
	else
	{
	testStepFail("Fail","i_S4_SRR_RL_Obj_DistY_14 :%f",signalvalue1);
	}
}

testcase S4_SRR_RL_Obj_Mes_4_S4_SRR_RL_Obj_RelVelY_14()
{
	signalvalue1 = getSignal(S4_SRR_RL_Obj_RelVelY_14);
	write("S4_SRR_RL_Obj_RelVelY_14 :%f",signalvalue1);
	write("i_S4_SRR_RL_Obj_RelVelY_14 :%f",@ecu_Signals::i_S4_SRR_RL_Obj_RelVelY_14);

	testStep("get expect variable value: ","i_S4_SRR_RL_Obj_RelVelY_14 :%f",@ecu_Signals::i_S4_SRR_RL_Obj_RelVelY_14);

	if((abs(@ecu_Signals::i_S4_SRR_RL_Obj_RelVelY_14)*0.9<=abs(signalvalue1))&&(abs(signalvalue1)<=abs(@ecu_Signals::i_S4_SRR_RL_Obj_RelVelY_14)*1.1))
	{
	testStepPass("Pass","i_S4_SRR_RL_Obj_RelVelY_14 :%f",signalvalue1);
	}
	else
	{
	testStepFail("Fail","i_S4_SRR_RL_Obj_RelVelY_14 :%f",signalvalue1);
	}
}

testcase S4_SRR_RL_Obj_Mes_4_S4_SRR_RL_Obj_AccelY_14()
{
	signalvalue1 = getSignal(S4_SRR_RL_Obj_AccelY_14);
	write("S4_SRR_RL_Obj_AccelY_14 :%f",signalvalue1);
	write("i_S4_SRR_RL_Obj_AccelY_14 :%f",@ecu_Signals::i_S4_SRR_RL_Obj_AccelY_14);

	testStep("get expect variable value: ","i_S4_SRR_RL_Obj_AccelY_14 :%f",@ecu_Signals::i_S4_SRR_RL_Obj_AccelY_14);

	if((abs(@ecu_Signals::i_S4_SRR_RL_Obj_AccelY_14)*0.9<=abs(signalvalue1))&&(abs(signalvalue1)<=abs(@ecu_Signals::i_S4_SRR_RL_Obj_AccelY_14)*1.1))
	{
	testStepPass("Pass","i_S4_SRR_RL_Obj_AccelY_14 :%f",signalvalue1);
	}
	else
	{
	testStepFail("Fail","i_S4_SRR_RL_Obj_AccelY_14 :%f",signalvalue1);
	}
}

testcase S4_SRR_RL_Obj_Mes_4_S4_SRR_RL_Obj_DistXStd_14()
{
	signalvalue1 = getSignal(S4_SRR_RL_Obj_DistXStd_14);
	write("S4_SRR_RL_Obj_DistXStd_14 :%f",signalvalue1);
	write("i_S4_SRR_RL_Obj_DistXStd_14 :%f",@ecu_Signals::i_S4_SRR_RL_Obj_DistXStd_14);

	testStep("get expect variable value: ","i_S4_SRR_RL_Obj_DistXStd_14 :%f",@ecu_Signals::i_S4_SRR_RL_Obj_DistXStd_14);

	if((abs(@ecu_Signals::i_S4_SRR_RL_Obj_DistXStd_14)*0.9<=abs(signalvalue1))&&(abs(signalvalue1)<=abs(@ecu_Signals::i_S4_SRR_RL_Obj_DistXStd_14)*1.1))
	{
	testStepPass("Pass","i_S4_SRR_RL_Obj_DistXStd_14 :%f",signalvalue1);
	}
	else
	{
	testStepFail("Fail","i_S4_SRR_RL_Obj_DistXStd_14 :%f",signalvalue1);
	}
}

testcase S4_SRR_RL_Obj_Mes_4_S4_SRR_RL_Obj_RelVelXStd_14()
{
	signalvalue1 = getSignal(S4_SRR_RL_Obj_RelVelXStd_14);
	write("S4_SRR_RL_Obj_RelVelXStd_14 :%f",signalvalue1);
	write("i_S4_SRR_RL_Obj_RelVelXStd_14 :%f",@ecu_Signals::i_S4_SRR_RL_Obj_RelVelXStd_14);

	testStep("get expect variable value: ","i_S4_SRR_RL_Obj_RelVelXStd_14 :%f",@ecu_Signals::i_S4_SRR_RL_Obj_RelVelXStd_14);

	if((abs(@ecu_Signals::i_S4_SRR_RL_Obj_RelVelXStd_14)*0.9<=abs(signalvalue1))&&(abs(signalvalue1)<=abs(@ecu_Signals::i_S4_SRR_RL_Obj_RelVelXStd_14)*1.1))
	{
	testStepPass("Pass","i_S4_SRR_RL_Obj_RelVelXStd_14 :%f",signalvalue1);
	}
	else
	{
	testStepFail("Fail","i_S4_SRR_RL_Obj_RelVelXStd_14 :%f",signalvalue1);
	}
}

testcase S4_SRR_RL_Obj_Mes_4_S4_SRR_RL_Obj_DistYStd_14()
{
	signalvalue1 = getSignal(S4_SRR_RL_Obj_DistYStd_14);
	write("S4_SRR_RL_Obj_DistYStd_14 :%f",signalvalue1);
	write("i_S4_SRR_RL_Obj_DistYStd_14 :%f",@ecu_Signals::i_S4_SRR_RL_Obj_DistYStd_14);

	testStep("get expect variable value: ","i_S4_SRR_RL_Obj_DistYStd_14 :%f",@ecu_Signals::i_S4_SRR_RL_Obj_DistYStd_14);

	if((abs(@ecu_Signals::i_S4_SRR_RL_Obj_DistYStd_14)*0.9<=abs(signalvalue1))&&(abs(signalvalue1)<=abs(@ecu_Signals::i_S4_SRR_RL_Obj_DistYStd_14)*1.1))
	{
	testStepPass("Pass","i_S4_SRR_RL_Obj_DistYStd_14 :%f",signalvalue1);
	}
	else
	{
	testStepFail("Fail","i_S4_SRR_RL_Obj_DistYStd_14 :%f",signalvalue1);
	}
}

testcase S4_SRR_RL_Obj_Mes_4_S4_SRR_RL_Obj_RelVelYStd_14()
{
	signalvalue1 = getSignal(S4_SRR_RL_Obj_RelVelYStd_14);
	write("S4_SRR_RL_Obj_RelVelYStd_14 :%f",signalvalue1);
	write("i_S4_SRR_RL_Obj_RelVelYStd_14 :%f",@ecu_Signals::i_S4_SRR_RL_Obj_RelVelYStd_14);

	testStep("get expect variable value: ","i_S4_SRR_RL_Obj_RelVelYStd_14 :%f",@ecu_Signals::i_S4_SRR_RL_Obj_RelVelYStd_14);

	if((abs(@ecu_Signals::i_S4_SRR_RL_Obj_RelVelYStd_14)*0.9<=abs(signalvalue1))&&(abs(signalvalue1)<=abs(@ecu_Signals::i_S4_SRR_RL_Obj_RelVelYStd_14)*1.1))
	{
	testStepPass("Pass","i_S4_SRR_RL_Obj_RelVelYStd_14 :%f",signalvalue1);
	}
	else
	{
	testStepFail("Fail","i_S4_SRR_RL_Obj_RelVelYStd_14 :%f",signalvalue1);
	}
}

testcase S4_SRR_RL_Obj_Mes_4_S4_SRR_RL_Obj_UpdateFlag_14()
{
	signalvalue1 = getSignal(S4_SRR_RL_Obj_UpdateFlag_14);
	write("S4_SRR_RL_Obj_UpdateFlag_14 :%f",signalvalue1);
	write("i_S4_SRR_RL_Obj_UpdateFlag_14 :%o",@ecu_Signals::i_S4_SRR_RL_Obj_UpdateFlag_14);

	testStep("get expect variable value: ","i_S4_SRR_RL_Obj_UpdateFlag_14 :%o",@ecu_Signals::i_S4_SRR_RL_Obj_UpdateFlag_14);

	if(signalvalue1==@ecu_Signals::i_S4_SRR_RL_Obj_UpdateFlag_14)
	{
	testStepPass("Pass","i_S4_SRR_RL_Obj_UpdateFlag_14 :%f",signalvalue1);
	}
	else
	{
	testStepFail("Fail","i_S4_SRR_RL_Obj_UpdateFlag_14 :%f",signalvalue1);
	}
}

testcase S4_SRR_RL_Obj_Mes_4_S4_SRR_RL_Obj_ExistProb_14()
{
	signalvalue1 = getSignal(S4_SRR_RL_Obj_ExistProb_14);
	write("S4_SRR_RL_Obj_ExistProb_14 :%f",signalvalue1);
	write("i_S4_SRR_RL_Obj_ExistProb_14 :%o",@ecu_Signals::i_S4_SRR_RL_Obj_ExistProb_14);

	testStep("get expect variable value: ","i_S4_SRR_RL_Obj_ExistProb_14 :%o",@ecu_Signals::i_S4_SRR_RL_Obj_ExistProb_14);

	if(signalvalue1==@ecu_Signals::i_S4_SRR_RL_Obj_ExistProb_14)
	{
	testStepPass("Pass","i_S4_SRR_RL_Obj_ExistProb_14 :%f",signalvalue1);
	}
	else
	{
	testStepFail("Fail","i_S4_SRR_RL_Obj_ExistProb_14 :%f",signalvalue1);
	}
}

testcase S4_SRR_RL_Obj_Mes_4_S4_SRR_RL_Obj_Type_14()
{
	signalvalue1 = getSignal(S4_SRR_RL_Obj_Type_14);
	write("S4_SRR_RL_Obj_Type_14 :%f",signalvalue1);
	write("i_S4_SRR_RL_Obj_Type_14 :%o",@ecu_Signals::i_S4_SRR_RL_Obj_Type_14);

	testStep("get expect variable value: ","i_S4_SRR_RL_Obj_Type_14 :%o",@ecu_Signals::i_S4_SRR_RL_Obj_Type_14);

	if(signalvalue1==@ecu_Signals::i_S4_SRR_RL_Obj_Type_14)
	{
	testStepPass("Pass","i_S4_SRR_RL_Obj_Type_14 :%f",signalvalue1);
	}
	else
	{
	testStepFail("Fail","i_S4_SRR_RL_Obj_Type_14 :%f",signalvalue1);
	}
}

testcase S4_SRR_RL_Obj_Mes_4_S4_SRR_RL_Obj_EDynProp_14()
{
	signalvalue1 = getSignal(S4_SRR_RL_Obj_EDynProp_14);
	write("S4_SRR_RL_Obj_EDynProp_14 :%f",signalvalue1);
	write("i_S4_SRR_RL_Obj_EDynProp_14 :%o",@ecu_Signals::i_S4_SRR_RL_Obj_EDynProp_14);

	testStep("get expect variable value: ","i_S4_SRR_RL_Obj_EDynProp_14 :%o",@ecu_Signals::i_S4_SRR_RL_Obj_EDynProp_14);

	if(signalvalue1==@ecu_Signals::i_S4_SRR_RL_Obj_EDynProp_14)
	{
	testStepPass("Pass","i_S4_SRR_RL_Obj_EDynProp_14 :%f",signalvalue1);
	}
	else
	{
	testStepFail("Fail","i_S4_SRR_RL_Obj_EDynProp_14 :%f",signalvalue1);
	}
}

testcase S4_SRR_RL_Obj_Mes_4_S4_SRR_RL_Obj_UiLifeCycles_14()
{
	signalvalue1 = getSignal(S4_SRR_RL_Obj_UiLifeCycles_14);
	write("S4_SRR_RL_Obj_UiLifeCycles_14 :%f",signalvalue1);
	write("i_S4_SRR_RL_Obj_UiLifeCycles_14 :%o",@ecu_Signals::i_S4_SRR_RL_Obj_UiLifeCycles_14);

	testStep("get expect variable value: ","i_S4_SRR_RL_Obj_UiLifeCycles_14 :%o",@ecu_Signals::i_S4_SRR_RL_Obj_UiLifeCycles_14);

	if(signalvalue1==@ecu_Signals::i_S4_SRR_RL_Obj_UiLifeCycles_14)
	{
	testStepPass("Pass","i_S4_SRR_RL_Obj_UiLifeCycles_14 :%f",signalvalue1);
	}
	else
	{
	testStepFail("Fail","i_S4_SRR_RL_Obj_UiLifeCycles_14 :%f",signalvalue1);
	}
}

testcase S4_SRR_RL_Obj_Mes_5_S4_SRR_RL_Obj_ID_15()
{
	signalvalue1 = getSignal(S4_SRR_RL_Obj_ID_15);
	write("S4_SRR_RL_Obj_ID_15 :%f",signalvalue1);
	write("i_S4_SRR_RL_Obj_ID_15 :%o",@ecu_Signals::i_S4_SRR_RL_Obj_ID_15);

	testStep("get expect variable value: ","i_S4_SRR_RL_Obj_ID_15 :%o",@ecu_Signals::i_S4_SRR_RL_Obj_ID_15);

	if(signalvalue1==@ecu_Signals::i_S4_SRR_RL_Obj_ID_15)
	{
	testStepPass("Pass","i_S4_SRR_RL_Obj_ID_15 :%f",signalvalue1);
	}
	else
	{
	testStepFail("Fail","i_S4_SRR_RL_Obj_ID_15 :%f",signalvalue1);
	}
}

testcase S4_SRR_RL_Obj_Mes_5_S4_SRR_RL_Obj_DistX_15()
{
	signalvalue1 = getSignal(S4_SRR_RL_Obj_DistX_15);
	write("S4_SRR_RL_Obj_DistX_15 :%f",signalvalue1);
	write("i_S4_SRR_RL_Obj_DistX_15 :%f",@ecu_Signals::i_S4_SRR_RL_Obj_DistX_15);

	testStep("get expect variable value: ","i_S4_SRR_RL_Obj_DistX_15 :%f",@ecu_Signals::i_S4_SRR_RL_Obj_DistX_15);

	if((abs(@ecu_Signals::i_S4_SRR_RL_Obj_DistX_15)*0.9<=abs(signalvalue1))&&(abs(signalvalue1)<=abs(@ecu_Signals::i_S4_SRR_RL_Obj_DistX_15)*1.1))
	{
	testStepPass("Pass","i_S4_SRR_RL_Obj_DistX_15 :%f",signalvalue1);
	}
	else
	{
	testStepFail("Fail","i_S4_SRR_RL_Obj_DistX_15 :%f",signalvalue1);
	}
}

testcase S4_SRR_RL_Obj_Mes_5_S4_SRR_RL_Obj_RelVelX_15()
{
	signalvalue1 = getSignal(S4_SRR_RL_Obj_RelVelX_15);
	write("S4_SRR_RL_Obj_RelVelX_15 :%f",signalvalue1);
	write("i_S4_SRR_RL_Obj_RelVelX_15 :%f",@ecu_Signals::i_S4_SRR_RL_Obj_RelVelX_15);

	testStep("get expect variable value: ","i_S4_SRR_RL_Obj_RelVelX_15 :%f",@ecu_Signals::i_S4_SRR_RL_Obj_RelVelX_15);

	if((abs(@ecu_Signals::i_S4_SRR_RL_Obj_RelVelX_15)*0.9<=abs(signalvalue1))&&(abs(signalvalue1)<=abs(@ecu_Signals::i_S4_SRR_RL_Obj_RelVelX_15)*1.1))
	{
	testStepPass("Pass","i_S4_SRR_RL_Obj_RelVelX_15 :%f",signalvalue1);
	}
	else
	{
	testStepFail("Fail","i_S4_SRR_RL_Obj_RelVelX_15 :%f",signalvalue1);
	}
}

testcase S4_SRR_RL_Obj_Mes_5_S4_SRR_RL_Obj_AccelX_15()
{
	signalvalue1 = getSignal(S4_SRR_RL_Obj_AccelX_15);
	write("S4_SRR_RL_Obj_AccelX_15 :%f",signalvalue1);
	write("i_S4_SRR_RL_Obj_AccelX_15 :%f",@ecu_Signals::i_S4_SRR_RL_Obj_AccelX_15);

	testStep("get expect variable value: ","i_S4_SRR_RL_Obj_AccelX_15 :%f",@ecu_Signals::i_S4_SRR_RL_Obj_AccelX_15);

	if((abs(@ecu_Signals::i_S4_SRR_RL_Obj_AccelX_15)*0.9<=abs(signalvalue1))&&(abs(signalvalue1)<=abs(@ecu_Signals::i_S4_SRR_RL_Obj_AccelX_15)*1.1))
	{
	testStepPass("Pass","i_S4_SRR_RL_Obj_AccelX_15 :%f",signalvalue1);
	}
	else
	{
	testStepFail("Fail","i_S4_SRR_RL_Obj_AccelX_15 :%f",signalvalue1);
	}
}

testcase S4_SRR_RL_Obj_Mes_5_S4_SRR_RL_Obj_DistY_15()
{
	signalvalue1 = getSignal(S4_SRR_RL_Obj_DistY_15);
	write("S4_SRR_RL_Obj_DistY_15 :%f",signalvalue1);
	write("i_S4_SRR_RL_Obj_DistY_15 :%f",@ecu_Signals::i_S4_SRR_RL_Obj_DistY_15);

	testStep("get expect variable value: ","i_S4_SRR_RL_Obj_DistY_15 :%f",@ecu_Signals::i_S4_SRR_RL_Obj_DistY_15);

	if((abs(@ecu_Signals::i_S4_SRR_RL_Obj_DistY_15)*0.9<=abs(signalvalue1))&&(abs(signalvalue1)<=abs(@ecu_Signals::i_S4_SRR_RL_Obj_DistY_15)*1.1))
	{
	testStepPass("Pass","i_S4_SRR_RL_Obj_DistY_15 :%f",signalvalue1);
	}
	else
	{
	testStepFail("Fail","i_S4_SRR_RL_Obj_DistY_15 :%f",signalvalue1);
	}
}

testcase S4_SRR_RL_Obj_Mes_5_S4_SRR_RL_Obj_RelVelY_15()
{
	signalvalue1 = getSignal(S4_SRR_RL_Obj_RelVelY_15);
	write("S4_SRR_RL_Obj_RelVelY_15 :%f",signalvalue1);
	write("i_S4_SRR_RL_Obj_RelVelY_15 :%f",@ecu_Signals::i_S4_SRR_RL_Obj_RelVelY_15);

	testStep("get expect variable value: ","i_S4_SRR_RL_Obj_RelVelY_15 :%f",@ecu_Signals::i_S4_SRR_RL_Obj_RelVelY_15);

	if((abs(@ecu_Signals::i_S4_SRR_RL_Obj_RelVelY_15)*0.9<=abs(signalvalue1))&&(abs(signalvalue1)<=abs(@ecu_Signals::i_S4_SRR_RL_Obj_RelVelY_15)*1.1))
	{
	testStepPass("Pass","i_S4_SRR_RL_Obj_RelVelY_15 :%f",signalvalue1);
	}
	else
	{
	testStepFail("Fail","i_S4_SRR_RL_Obj_RelVelY_15 :%f",signalvalue1);
	}
}

testcase S4_SRR_RL_Obj_Mes_5_S4_SRR_RL_Obj_AccelY_15()
{
	signalvalue1 = getSignal(S4_SRR_RL_Obj_AccelY_15);
	write("S4_SRR_RL_Obj_AccelY_15 :%f",signalvalue1);
	write("i_S4_SRR_RL_Obj_AccelY_15 :%f",@ecu_Signals::i_S4_SRR_RL_Obj_AccelY_15);

	testStep("get expect variable value: ","i_S4_SRR_RL_Obj_AccelY_15 :%f",@ecu_Signals::i_S4_SRR_RL_Obj_AccelY_15);

	if((abs(@ecu_Signals::i_S4_SRR_RL_Obj_AccelY_15)*0.9<=abs(signalvalue1))&&(abs(signalvalue1)<=abs(@ecu_Signals::i_S4_SRR_RL_Obj_AccelY_15)*1.1))
	{
	testStepPass("Pass","i_S4_SRR_RL_Obj_AccelY_15 :%f",signalvalue1);
	}
	else
	{
	testStepFail("Fail","i_S4_SRR_RL_Obj_AccelY_15 :%f",signalvalue1);
	}
}

testcase S4_SRR_RL_Obj_Mes_5_S4_SRR_RL_Obj_DistXStd_15()
{
	signalvalue1 = getSignal(S4_SRR_RL_Obj_DistXStd_15);
	write("S4_SRR_RL_Obj_DistXStd_15 :%f",signalvalue1);
	write("i_S4_SRR_RL_Obj_DistXStd_15 :%f",@ecu_Signals::i_S4_SRR_RL_Obj_DistXStd_15);

	testStep("get expect variable value: ","i_S4_SRR_RL_Obj_DistXStd_15 :%f",@ecu_Signals::i_S4_SRR_RL_Obj_DistXStd_15);

	if((abs(@ecu_Signals::i_S4_SRR_RL_Obj_DistXStd_15)*0.9<=abs(signalvalue1))&&(abs(signalvalue1)<=abs(@ecu_Signals::i_S4_SRR_RL_Obj_DistXStd_15)*1.1))
	{
	testStepPass("Pass","i_S4_SRR_RL_Obj_DistXStd_15 :%f",signalvalue1);
	}
	else
	{
	testStepFail("Fail","i_S4_SRR_RL_Obj_DistXStd_15 :%f",signalvalue1);
	}
}

testcase S4_SRR_RL_Obj_Mes_5_S4_SRR_RL_Obj_RelVelXStd_15()
{
	signalvalue1 = getSignal(S4_SRR_RL_Obj_RelVelXStd_15);
	write("S4_SRR_RL_Obj_RelVelXStd_15 :%f",signalvalue1);
	write("i_S4_SRR_RL_Obj_RelVelXStd_15 :%f",@ecu_Signals::i_S4_SRR_RL_Obj_RelVelXStd_15);

	testStep("get expect variable value: ","i_S4_SRR_RL_Obj_RelVelXStd_15 :%f",@ecu_Signals::i_S4_SRR_RL_Obj_RelVelXStd_15);

	if((abs(@ecu_Signals::i_S4_SRR_RL_Obj_RelVelXStd_15)*0.9<=abs(signalvalue1))&&(abs(signalvalue1)<=abs(@ecu_Signals::i_S4_SRR_RL_Obj_RelVelXStd_15)*1.1))
	{
	testStepPass("Pass","i_S4_SRR_RL_Obj_RelVelXStd_15 :%f",signalvalue1);
	}
	else
	{
	testStepFail("Fail","i_S4_SRR_RL_Obj_RelVelXStd_15 :%f",signalvalue1);
	}
}

testcase S4_SRR_RL_Obj_Mes_5_S4_SRR_RL_Obj_DistYStd_15()
{
	signalvalue1 = getSignal(S4_SRR_RL_Obj_DistYStd_15);
	write("S4_SRR_RL_Obj_DistYStd_15 :%f",signalvalue1);
	write("i_S4_SRR_RL_Obj_DistYStd_15 :%f",@ecu_Signals::i_S4_SRR_RL_Obj_DistYStd_15);

	testStep("get expect variable value: ","i_S4_SRR_RL_Obj_DistYStd_15 :%f",@ecu_Signals::i_S4_SRR_RL_Obj_DistYStd_15);

	if((abs(@ecu_Signals::i_S4_SRR_RL_Obj_DistYStd_15)*0.9<=abs(signalvalue1))&&(abs(signalvalue1)<=abs(@ecu_Signals::i_S4_SRR_RL_Obj_DistYStd_15)*1.1))
	{
	testStepPass("Pass","i_S4_SRR_RL_Obj_DistYStd_15 :%f",signalvalue1);
	}
	else
	{
	testStepFail("Fail","i_S4_SRR_RL_Obj_DistYStd_15 :%f",signalvalue1);
	}
}

testcase S4_SRR_RL_Obj_Mes_5_S4_SRR_RL_Obj_RelVelYStd_15()
{
	signalvalue1 = getSignal(S4_SRR_RL_Obj_RelVelYStd_15);
	write("S4_SRR_RL_Obj_RelVelYStd_15 :%f",signalvalue1);
	write("i_S4_SRR_RL_Obj_RelVelYStd_15 :%f",@ecu_Signals::i_S4_SRR_RL_Obj_RelVelYStd_15);

	testStep("get expect variable value: ","i_S4_SRR_RL_Obj_RelVelYStd_15 :%f",@ecu_Signals::i_S4_SRR_RL_Obj_RelVelYStd_15);

	if((abs(@ecu_Signals::i_S4_SRR_RL_Obj_RelVelYStd_15)*0.9<=abs(signalvalue1))&&(abs(signalvalue1)<=abs(@ecu_Signals::i_S4_SRR_RL_Obj_RelVelYStd_15)*1.1))
	{
	testStepPass("Pass","i_S4_SRR_RL_Obj_RelVelYStd_15 :%f",signalvalue1);
	}
	else
	{
	testStepFail("Fail","i_S4_SRR_RL_Obj_RelVelYStd_15 :%f",signalvalue1);
	}
}

testcase S4_SRR_RL_Obj_Mes_5_S4_SRR_RL_Obj_UpdateFlag_15()
{
	signalvalue1 = getSignal(S4_SRR_RL_Obj_UpdateFlag_15);
	write("S4_SRR_RL_Obj_UpdateFlag_15 :%f",signalvalue1);
	write("i_S4_SRR_RL_Obj_UpdateFlag_15 :%o",@ecu_Signals::i_S4_SRR_RL_Obj_UpdateFlag_15);

	testStep("get expect variable value: ","i_S4_SRR_RL_Obj_UpdateFlag_15 :%o",@ecu_Signals::i_S4_SRR_RL_Obj_UpdateFlag_15);

	if(signalvalue1==@ecu_Signals::i_S4_SRR_RL_Obj_UpdateFlag_15)
	{
	testStepPass("Pass","i_S4_SRR_RL_Obj_UpdateFlag_15 :%f",signalvalue1);
	}
	else
	{
	testStepFail("Fail","i_S4_SRR_RL_Obj_UpdateFlag_15 :%f",signalvalue1);
	}
}

testcase S4_SRR_RL_Obj_Mes_5_S4_SRR_RL_Obj_ExistProb_15()
{
	signalvalue1 = getSignal(S4_SRR_RL_Obj_ExistProb_15);
	write("S4_SRR_RL_Obj_ExistProb_15 :%f",signalvalue1);
	write("i_S4_SRR_RL_Obj_ExistProb_15 :%o",@ecu_Signals::i_S4_SRR_RL_Obj_ExistProb_15);

	testStep("get expect variable value: ","i_S4_SRR_RL_Obj_ExistProb_15 :%o",@ecu_Signals::i_S4_SRR_RL_Obj_ExistProb_15);

	if(signalvalue1==@ecu_Signals::i_S4_SRR_RL_Obj_ExistProb_15)
	{
	testStepPass("Pass","i_S4_SRR_RL_Obj_ExistProb_15 :%f",signalvalue1);
	}
	else
	{
	testStepFail("Fail","i_S4_SRR_RL_Obj_ExistProb_15 :%f",signalvalue1);
	}
}

testcase S4_SRR_RL_Obj_Mes_5_S4_SRR_RL_Obj_Type_15()
{
	signalvalue1 = getSignal(S4_SRR_RL_Obj_Type_15);
	write("S4_SRR_RL_Obj_Type_15 :%f",signalvalue1);
	write("i_S4_SRR_RL_Obj_Type_15 :%o",@ecu_Signals::i_S4_SRR_RL_Obj_Type_15);

	testStep("get expect variable value: ","i_S4_SRR_RL_Obj_Type_15 :%o",@ecu_Signals::i_S4_SRR_RL_Obj_Type_15);

	if(signalvalue1==@ecu_Signals::i_S4_SRR_RL_Obj_Type_15)
	{
	testStepPass("Pass","i_S4_SRR_RL_Obj_Type_15 :%f",signalvalue1);
	}
	else
	{
	testStepFail("Fail","i_S4_SRR_RL_Obj_Type_15 :%f",signalvalue1);
	}
}

testcase S4_SRR_RL_Obj_Mes_5_S4_SRR_RL_Obj_EDynProp_15()
{
	signalvalue1 = getSignal(S4_SRR_RL_Obj_EDynProp_15);
	write("S4_SRR_RL_Obj_EDynProp_15 :%f",signalvalue1);
	write("i_S4_SRR_RL_Obj_EDynProp_15 :%o",@ecu_Signals::i_S4_SRR_RL_Obj_EDynProp_15);

	testStep("get expect variable value: ","i_S4_SRR_RL_Obj_EDynProp_15 :%o",@ecu_Signals::i_S4_SRR_RL_Obj_EDynProp_15);

	if(signalvalue1==@ecu_Signals::i_S4_SRR_RL_Obj_EDynProp_15)
	{
	testStepPass("Pass","i_S4_SRR_RL_Obj_EDynProp_15 :%f",signalvalue1);
	}
	else
	{
	testStepFail("Fail","i_S4_SRR_RL_Obj_EDynProp_15 :%f",signalvalue1);
	}
}

testcase S4_SRR_RL_Obj_Mes_5_S4_SRR_RL_Obj_UiLifeCycles_15()
{
	signalvalue1 = getSignal(S4_SRR_RL_Obj_UiLifeCycles_15);
	write("S4_SRR_RL_Obj_UiLifeCycles_15 :%f",signalvalue1);
	write("i_S4_SRR_RL_Obj_UiLifeCycles_15 :%o",@ecu_Signals::i_S4_SRR_RL_Obj_UiLifeCycles_15);

	testStep("get expect variable value: ","i_S4_SRR_RL_Obj_UiLifeCycles_15 :%o",@ecu_Signals::i_S4_SRR_RL_Obj_UiLifeCycles_15);

	if(signalvalue1==@ecu_Signals::i_S4_SRR_RL_Obj_UiLifeCycles_15)
	{
	testStepPass("Pass","i_S4_SRR_RL_Obj_UiLifeCycles_15 :%f",signalvalue1);
	}
	else
	{
	testStepFail("Fail","i_S4_SRR_RL_Obj_UiLifeCycles_15 :%f",signalvalue1);
	}
}

testcase S4_SRR_RL_Obj_Mes_5_S4_SRR_RL_Obj_ID_16()
{
	signalvalue1 = getSignal(S4_SRR_RL_Obj_ID_16);
	write("S4_SRR_RL_Obj_ID_16 :%f",signalvalue1);
	write("i_S4_SRR_RL_Obj_ID_16 :%o",@ecu_Signals::i_S4_SRR_RL_Obj_ID_16);

	testStep("get expect variable value: ","i_S4_SRR_RL_Obj_ID_16 :%o",@ecu_Signals::i_S4_SRR_RL_Obj_ID_16);

	if(signalvalue1==@ecu_Signals::i_S4_SRR_RL_Obj_ID_16)
	{
	testStepPass("Pass","i_S4_SRR_RL_Obj_ID_16 :%f",signalvalue1);
	}
	else
	{
	testStepFail("Fail","i_S4_SRR_RL_Obj_ID_16 :%f",signalvalue1);
	}
}

testcase S4_SRR_RL_Obj_Mes_5_S4_SRR_RL_Obj_DistX_16()
{
	signalvalue1 = getSignal(S4_SRR_RL_Obj_DistX_16);
	write("S4_SRR_RL_Obj_DistX_16 :%f",signalvalue1);
	write("i_S4_SRR_RL_Obj_DistX_16 :%f",@ecu_Signals::i_S4_SRR_RL_Obj_DistX_16);

	testStep("get expect variable value: ","i_S4_SRR_RL_Obj_DistX_16 :%f",@ecu_Signals::i_S4_SRR_RL_Obj_DistX_16);

	if((abs(@ecu_Signals::i_S4_SRR_RL_Obj_DistX_16)*0.9<=abs(signalvalue1))&&(abs(signalvalue1)<=abs(@ecu_Signals::i_S4_SRR_RL_Obj_DistX_16)*1.1))
	{
	testStepPass("Pass","i_S4_SRR_RL_Obj_DistX_16 :%f",signalvalue1);
	}
	else
	{
	testStepFail("Fail","i_S4_SRR_RL_Obj_DistX_16 :%f",signalvalue1);
	}
}

testcase S4_SRR_RL_Obj_Mes_5_S4_SRR_RL_Obj_RelVelX_16()
{
	signalvalue1 = getSignal(S4_SRR_RL_Obj_RelVelX_16);
	write("S4_SRR_RL_Obj_RelVelX_16 :%f",signalvalue1);
	write("i_S4_SRR_RL_Obj_RelVelX_16 :%f",@ecu_Signals::i_S4_SRR_RL_Obj_RelVelX_16);

	testStep("get expect variable value: ","i_S4_SRR_RL_Obj_RelVelX_16 :%f",@ecu_Signals::i_S4_SRR_RL_Obj_RelVelX_16);

	if((abs(@ecu_Signals::i_S4_SRR_RL_Obj_RelVelX_16)*0.9<=abs(signalvalue1))&&(abs(signalvalue1)<=abs(@ecu_Signals::i_S4_SRR_RL_Obj_RelVelX_16)*1.1))
	{
	testStepPass("Pass","i_S4_SRR_RL_Obj_RelVelX_16 :%f",signalvalue1);
	}
	else
	{
	testStepFail("Fail","i_S4_SRR_RL_Obj_RelVelX_16 :%f",signalvalue1);
	}
}

testcase S4_SRR_RL_Obj_Mes_5_S4_SRR_RL_Obj_AccelX_16()
{
	signalvalue1 = getSignal(S4_SRR_RL_Obj_AccelX_16);
	write("S4_SRR_RL_Obj_AccelX_16 :%f",signalvalue1);
	write("i_S4_SRR_RL_Obj_AccelX_16 :%f",@ecu_Signals::i_S4_SRR_RL_Obj_AccelX_16);

	testStep("get expect variable value: ","i_S4_SRR_RL_Obj_AccelX_16 :%f",@ecu_Signals::i_S4_SRR_RL_Obj_AccelX_16);

	if((abs(@ecu_Signals::i_S4_SRR_RL_Obj_AccelX_16)*0.9<=abs(signalvalue1))&&(abs(signalvalue1)<=abs(@ecu_Signals::i_S4_SRR_RL_Obj_AccelX_16)*1.1))
	{
	testStepPass("Pass","i_S4_SRR_RL_Obj_AccelX_16 :%f",signalvalue1);
	}
	else
	{
	testStepFail("Fail","i_S4_SRR_RL_Obj_AccelX_16 :%f",signalvalue1);
	}
}

testcase S4_SRR_RL_Obj_Mes_5_S4_SRR_RL_Obj_DistY_16()
{
	signalvalue1 = getSignal(S4_SRR_RL_Obj_DistY_16);
	write("S4_SRR_RL_Obj_DistY_16 :%f",signalvalue1);
	write("i_S4_SRR_RL_Obj_DistY_16 :%f",@ecu_Signals::i_S4_SRR_RL_Obj_DistY_16);

	testStep("get expect variable value: ","i_S4_SRR_RL_Obj_DistY_16 :%f",@ecu_Signals::i_S4_SRR_RL_Obj_DistY_16);

	if((abs(@ecu_Signals::i_S4_SRR_RL_Obj_DistY_16)*0.9<=abs(signalvalue1))&&(abs(signalvalue1)<=abs(@ecu_Signals::i_S4_SRR_RL_Obj_DistY_16)*1.1))
	{
	testStepPass("Pass","i_S4_SRR_RL_Obj_DistY_16 :%f",signalvalue1);
	}
	else
	{
	testStepFail("Fail","i_S4_SRR_RL_Obj_DistY_16 :%f",signalvalue1);
	}
}

testcase S4_SRR_RL_Obj_Mes_5_S4_SRR_RL_Obj_RelVelY_16()
{
	signalvalue1 = getSignal(S4_SRR_RL_Obj_RelVelY_16);
	write("S4_SRR_RL_Obj_RelVelY_16 :%f",signalvalue1);
	write("i_S4_SRR_RL_Obj_RelVelY_16 :%f",@ecu_Signals::i_S4_SRR_RL_Obj_RelVelY_16);

	testStep("get expect variable value: ","i_S4_SRR_RL_Obj_RelVelY_16 :%f",@ecu_Signals::i_S4_SRR_RL_Obj_RelVelY_16);

	if((abs(@ecu_Signals::i_S4_SRR_RL_Obj_RelVelY_16)*0.9<=abs(signalvalue1))&&(abs(signalvalue1)<=abs(@ecu_Signals::i_S4_SRR_RL_Obj_RelVelY_16)*1.1))
	{
	testStepPass("Pass","i_S4_SRR_RL_Obj_RelVelY_16 :%f",signalvalue1);
	}
	else
	{
	testStepFail("Fail","i_S4_SRR_RL_Obj_RelVelY_16 :%f",signalvalue1);
	}
}

testcase S4_SRR_RL_Obj_Mes_5_S4_SRR_RL_Obj_AccelY_16()
{
	signalvalue1 = getSignal(S4_SRR_RL_Obj_AccelY_16);
	write("S4_SRR_RL_Obj_AccelY_16 :%f",signalvalue1);
	write("i_S4_SRR_RL_Obj_AccelY_16 :%f",@ecu_Signals::i_S4_SRR_RL_Obj_AccelY_16);

	testStep("get expect variable value: ","i_S4_SRR_RL_Obj_AccelY_16 :%f",@ecu_Signals::i_S4_SRR_RL_Obj_AccelY_16);

	if((abs(@ecu_Signals::i_S4_SRR_RL_Obj_AccelY_16)*0.9<=abs(signalvalue1))&&(abs(signalvalue1)<=abs(@ecu_Signals::i_S4_SRR_RL_Obj_AccelY_16)*1.1))
	{
	testStepPass("Pass","i_S4_SRR_RL_Obj_AccelY_16 :%f",signalvalue1);
	}
	else
	{
	testStepFail("Fail","i_S4_SRR_RL_Obj_AccelY_16 :%f",signalvalue1);
	}
}

testcase S4_SRR_RL_Obj_Mes_5_S4_SRR_RL_Obj_DistXStd_16()
{
	signalvalue1 = getSignal(S4_SRR_RL_Obj_DistXStd_16);
	write("S4_SRR_RL_Obj_DistXStd_16 :%f",signalvalue1);
	write("i_S4_SRR_RL_Obj_DistXStd_16 :%f",@ecu_Signals::i_S4_SRR_RL_Obj_DistXStd_16);

	testStep("get expect variable value: ","i_S4_SRR_RL_Obj_DistXStd_16 :%f",@ecu_Signals::i_S4_SRR_RL_Obj_DistXStd_16);

	if((abs(@ecu_Signals::i_S4_SRR_RL_Obj_DistXStd_16)*0.9<=abs(signalvalue1))&&(abs(signalvalue1)<=abs(@ecu_Signals::i_S4_SRR_RL_Obj_DistXStd_16)*1.1))
	{
	testStepPass("Pass","i_S4_SRR_RL_Obj_DistXStd_16 :%f",signalvalue1);
	}
	else
	{
	testStepFail("Fail","i_S4_SRR_RL_Obj_DistXStd_16 :%f",signalvalue1);
	}
}

testcase S4_SRR_RL_Obj_Mes_5_S4_SRR_RL_Obj_RelVelXStd_16()
{
	signalvalue1 = getSignal(S4_SRR_RL_Obj_RelVelXStd_16);
	write("S4_SRR_RL_Obj_RelVelXStd_16 :%f",signalvalue1);
	write("i_S4_SRR_RL_Obj_RelVelXStd_16 :%f",@ecu_Signals::i_S4_SRR_RL_Obj_RelVelXStd_16);

	testStep("get expect variable value: ","i_S4_SRR_RL_Obj_RelVelXStd_16 :%f",@ecu_Signals::i_S4_SRR_RL_Obj_RelVelXStd_16);

	if((abs(@ecu_Signals::i_S4_SRR_RL_Obj_RelVelXStd_16)*0.9<=abs(signalvalue1))&&(abs(signalvalue1)<=abs(@ecu_Signals::i_S4_SRR_RL_Obj_RelVelXStd_16)*1.1))
	{
	testStepPass("Pass","i_S4_SRR_RL_Obj_RelVelXStd_16 :%f",signalvalue1);
	}
	else
	{
	testStepFail("Fail","i_S4_SRR_RL_Obj_RelVelXStd_16 :%f",signalvalue1);
	}
}

testcase S4_SRR_RL_Obj_Mes_5_S4_SRR_RL_Obj_DistYStd_16()
{
	signalvalue1 = getSignal(S4_SRR_RL_Obj_DistYStd_16);
	write("S4_SRR_RL_Obj_DistYStd_16 :%f",signalvalue1);
	write("i_S4_SRR_RL_Obj_DistYStd_16 :%f",@ecu_Signals::i_S4_SRR_RL_Obj_DistYStd_16);

	testStep("get expect variable value: ","i_S4_SRR_RL_Obj_DistYStd_16 :%f",@ecu_Signals::i_S4_SRR_RL_Obj_DistYStd_16);

	if((abs(@ecu_Signals::i_S4_SRR_RL_Obj_DistYStd_16)*0.9<=abs(signalvalue1))&&(abs(signalvalue1)<=abs(@ecu_Signals::i_S4_SRR_RL_Obj_DistYStd_16)*1.1))
	{
	testStepPass("Pass","i_S4_SRR_RL_Obj_DistYStd_16 :%f",signalvalue1);
	}
	else
	{
	testStepFail("Fail","i_S4_SRR_RL_Obj_DistYStd_16 :%f",signalvalue1);
	}
}

testcase S4_SRR_RL_Obj_Mes_5_S4_SRR_RL_Obj_RelVelYStd_16()
{
	signalvalue1 = getSignal(S4_SRR_RL_Obj_RelVelYStd_16);
	write("S4_SRR_RL_Obj_RelVelYStd_16 :%f",signalvalue1);
	write("i_S4_SRR_RL_Obj_RelVelYStd_16 :%f",@ecu_Signals::i_S4_SRR_RL_Obj_RelVelYStd_16);

	testStep("get expect variable value: ","i_S4_SRR_RL_Obj_RelVelYStd_16 :%f",@ecu_Signals::i_S4_SRR_RL_Obj_RelVelYStd_16);

	if((abs(@ecu_Signals::i_S4_SRR_RL_Obj_RelVelYStd_16)*0.9<=abs(signalvalue1))&&(abs(signalvalue1)<=abs(@ecu_Signals::i_S4_SRR_RL_Obj_RelVelYStd_16)*1.1))
	{
	testStepPass("Pass","i_S4_SRR_RL_Obj_RelVelYStd_16 :%f",signalvalue1);
	}
	else
	{
	testStepFail("Fail","i_S4_SRR_RL_Obj_RelVelYStd_16 :%f",signalvalue1);
	}
}

testcase S4_SRR_RL_Obj_Mes_5_S4_SRR_RL_Obj_UpdateFlag_16()
{
	signalvalue1 = getSignal(S4_SRR_RL_Obj_UpdateFlag_16);
	write("S4_SRR_RL_Obj_UpdateFlag_16 :%f",signalvalue1);
	write("i_S4_SRR_RL_Obj_UpdateFlag_16 :%o",@ecu_Signals::i_S4_SRR_RL_Obj_UpdateFlag_16);

	testStep("get expect variable value: ","i_S4_SRR_RL_Obj_UpdateFlag_16 :%o",@ecu_Signals::i_S4_SRR_RL_Obj_UpdateFlag_16);

	if(signalvalue1==@ecu_Signals::i_S4_SRR_RL_Obj_UpdateFlag_16)
	{
	testStepPass("Pass","i_S4_SRR_RL_Obj_UpdateFlag_16 :%f",signalvalue1);
	}
	else
	{
	testStepFail("Fail","i_S4_SRR_RL_Obj_UpdateFlag_16 :%f",signalvalue1);
	}
}

testcase S4_SRR_RL_Obj_Mes_5_S4_SRR_RL_Obj_ExistProb_16()
{
	signalvalue1 = getSignal(S4_SRR_RL_Obj_ExistProb_16);
	write("S4_SRR_RL_Obj_ExistProb_16 :%f",signalvalue1);
	write("i_S4_SRR_RL_Obj_ExistProb_16 :%o",@ecu_Signals::i_S4_SRR_RL_Obj_ExistProb_16);

	testStep("get expect variable value: ","i_S4_SRR_RL_Obj_ExistProb_16 :%o",@ecu_Signals::i_S4_SRR_RL_Obj_ExistProb_16);

	if(signalvalue1==@ecu_Signals::i_S4_SRR_RL_Obj_ExistProb_16)
	{
	testStepPass("Pass","i_S4_SRR_RL_Obj_ExistProb_16 :%f",signalvalue1);
	}
	else
	{
	testStepFail("Fail","i_S4_SRR_RL_Obj_ExistProb_16 :%f",signalvalue1);
	}
}

testcase S4_SRR_RL_Obj_Mes_5_S4_SRR_RL_Obj_Type_16()
{
	signalvalue1 = getSignal(S4_SRR_RL_Obj_Type_16);
	write("S4_SRR_RL_Obj_Type_16 :%f",signalvalue1);
	write("i_S4_SRR_RL_Obj_Type_16 :%o",@ecu_Signals::i_S4_SRR_RL_Obj_Type_16);

	testStep("get expect variable value: ","i_S4_SRR_RL_Obj_Type_16 :%o",@ecu_Signals::i_S4_SRR_RL_Obj_Type_16);

	if(signalvalue1==@ecu_Signals::i_S4_SRR_RL_Obj_Type_16)
	{
	testStepPass("Pass","i_S4_SRR_RL_Obj_Type_16 :%f",signalvalue1);
	}
	else
	{
	testStepFail("Fail","i_S4_SRR_RL_Obj_Type_16 :%f",signalvalue1);
	}
}

testcase S4_SRR_RL_Obj_Mes_5_S4_SRR_RL_Obj_EDynProp_16()
{
	signalvalue1 = getSignal(S4_SRR_RL_Obj_EDynProp_16);
	write("S4_SRR_RL_Obj_EDynProp_16 :%f",signalvalue1);
	write("i_S4_SRR_RL_Obj_EDynProp_16 :%o",@ecu_Signals::i_S4_SRR_RL_Obj_EDynProp_16);

	testStep("get expect variable value: ","i_S4_SRR_RL_Obj_EDynProp_16 :%o",@ecu_Signals::i_S4_SRR_RL_Obj_EDynProp_16);

	if(signalvalue1==@ecu_Signals::i_S4_SRR_RL_Obj_EDynProp_16)
	{
	testStepPass("Pass","i_S4_SRR_RL_Obj_EDynProp_16 :%f",signalvalue1);
	}
	else
	{
	testStepFail("Fail","i_S4_SRR_RL_Obj_EDynProp_16 :%f",signalvalue1);
	}
}

testcase S4_SRR_RL_Obj_Mes_5_S4_SRR_RL_Obj_UiLifeCycles_16()
{
	signalvalue1 = getSignal(S4_SRR_RL_Obj_UiLifeCycles_16);
	write("S4_SRR_RL_Obj_UiLifeCycles_16 :%f",signalvalue1);
	write("i_S4_SRR_RL_Obj_UiLifeCycles_16 :%o",@ecu_Signals::i_S4_SRR_RL_Obj_UiLifeCycles_16);

	testStep("get expect variable value: ","i_S4_SRR_RL_Obj_UiLifeCycles_16 :%o",@ecu_Signals::i_S4_SRR_RL_Obj_UiLifeCycles_16);

	if(signalvalue1==@ecu_Signals::i_S4_SRR_RL_Obj_UiLifeCycles_16)
	{
	testStepPass("Pass","i_S4_SRR_RL_Obj_UiLifeCycles_16 :%f",signalvalue1);
	}
	else
	{
	testStepFail("Fail","i_S4_SRR_RL_Obj_UiLifeCycles_16 :%f",signalvalue1);
	}
}

testcase S4_SRR_RL_Obj_Mes_5_S4_SRR_RL_Obj_ID_17()
{
	signalvalue1 = getSignal(S4_SRR_RL_Obj_ID_17);
	write("S4_SRR_RL_Obj_ID_17 :%f",signalvalue1);
	write("i_S4_SRR_RL_Obj_ID_17 :%o",@ecu_Signals::i_S4_SRR_RL_Obj_ID_17);

	testStep("get expect variable value: ","i_S4_SRR_RL_Obj_ID_17 :%o",@ecu_Signals::i_S4_SRR_RL_Obj_ID_17);

	if(signalvalue1==@ecu_Signals::i_S4_SRR_RL_Obj_ID_17)
	{
	testStepPass("Pass","i_S4_SRR_RL_Obj_ID_17 :%f",signalvalue1);
	}
	else
	{
	testStepFail("Fail","i_S4_SRR_RL_Obj_ID_17 :%f",signalvalue1);
	}
}

testcase S4_SRR_RL_Obj_Mes_5_S4_SRR_RL_Obj_DistX_17()
{
	signalvalue1 = getSignal(S4_SRR_RL_Obj_DistX_17);
	write("S4_SRR_RL_Obj_DistX_17 :%f",signalvalue1);
	write("i_S4_SRR_RL_Obj_DistX_17 :%f",@ecu_Signals::i_S4_SRR_RL_Obj_DistX_17);

	testStep("get expect variable value: ","i_S4_SRR_RL_Obj_DistX_17 :%f",@ecu_Signals::i_S4_SRR_RL_Obj_DistX_17);

	if((abs(@ecu_Signals::i_S4_SRR_RL_Obj_DistX_17)*0.9<=abs(signalvalue1))&&(abs(signalvalue1)<=abs(@ecu_Signals::i_S4_SRR_RL_Obj_DistX_17)*1.1))
	{
	testStepPass("Pass","i_S4_SRR_RL_Obj_DistX_17 :%f",signalvalue1);
	}
	else
	{
	testStepFail("Fail","i_S4_SRR_RL_Obj_DistX_17 :%f",signalvalue1);
	}
}

testcase S4_SRR_RL_Obj_Mes_5_S4_SRR_RL_Obj_RelVelX_17()
{
	signalvalue1 = getSignal(S4_SRR_RL_Obj_RelVelX_17);
	write("S4_SRR_RL_Obj_RelVelX_17 :%f",signalvalue1);
	write("i_S4_SRR_RL_Obj_RelVelX_17 :%f",@ecu_Signals::i_S4_SRR_RL_Obj_RelVelX_17);

	testStep("get expect variable value: ","i_S4_SRR_RL_Obj_RelVelX_17 :%f",@ecu_Signals::i_S4_SRR_RL_Obj_RelVelX_17);

	if((abs(@ecu_Signals::i_S4_SRR_RL_Obj_RelVelX_17)*0.9<=abs(signalvalue1))&&(abs(signalvalue1)<=abs(@ecu_Signals::i_S4_SRR_RL_Obj_RelVelX_17)*1.1))
	{
	testStepPass("Pass","i_S4_SRR_RL_Obj_RelVelX_17 :%f",signalvalue1);
	}
	else
	{
	testStepFail("Fail","i_S4_SRR_RL_Obj_RelVelX_17 :%f",signalvalue1);
	}
}

testcase S4_SRR_RL_Obj_Mes_5_S4_SRR_RL_Obj_AccelX_17()
{
	signalvalue1 = getSignal(S4_SRR_RL_Obj_AccelX_17);
	write("S4_SRR_RL_Obj_AccelX_17 :%f",signalvalue1);
	write("i_S4_SRR_RL_Obj_AccelX_17 :%f",@ecu_Signals::i_S4_SRR_RL_Obj_AccelX_17);

	testStep("get expect variable value: ","i_S4_SRR_RL_Obj_AccelX_17 :%f",@ecu_Signals::i_S4_SRR_RL_Obj_AccelX_17);

	if((abs(@ecu_Signals::i_S4_SRR_RL_Obj_AccelX_17)*0.9<=abs(signalvalue1))&&(abs(signalvalue1)<=abs(@ecu_Signals::i_S4_SRR_RL_Obj_AccelX_17)*1.1))
	{
	testStepPass("Pass","i_S4_SRR_RL_Obj_AccelX_17 :%f",signalvalue1);
	}
	else
	{
	testStepFail("Fail","i_S4_SRR_RL_Obj_AccelX_17 :%f",signalvalue1);
	}
}

testcase S4_SRR_RL_Obj_Mes_5_S4_SRR_RL_Obj_DistY_17()
{
	signalvalue1 = getSignal(S4_SRR_RL_Obj_DistY_17);
	write("S4_SRR_RL_Obj_DistY_17 :%f",signalvalue1);
	write("i_S4_SRR_RL_Obj_DistY_17 :%f",@ecu_Signals::i_S4_SRR_RL_Obj_DistY_17);

	testStep("get expect variable value: ","i_S4_SRR_RL_Obj_DistY_17 :%f",@ecu_Signals::i_S4_SRR_RL_Obj_DistY_17);

	if((abs(@ecu_Signals::i_S4_SRR_RL_Obj_DistY_17)*0.9<=abs(signalvalue1))&&(abs(signalvalue1)<=abs(@ecu_Signals::i_S4_SRR_RL_Obj_DistY_17)*1.1))
	{
	testStepPass("Pass","i_S4_SRR_RL_Obj_DistY_17 :%f",signalvalue1);
	}
	else
	{
	testStepFail("Fail","i_S4_SRR_RL_Obj_DistY_17 :%f",signalvalue1);
	}
}

testcase S4_SRR_RL_Obj_Mes_5_S4_SRR_RL_Obj_RelVelY_17()
{
	signalvalue1 = getSignal(S4_SRR_RL_Obj_RelVelY_17);
	write("S4_SRR_RL_Obj_RelVelY_17 :%f",signalvalue1);
	write("i_S4_SRR_RL_Obj_RelVelY_17 :%f",@ecu_Signals::i_S4_SRR_RL_Obj_RelVelY_17);

	testStep("get expect variable value: ","i_S4_SRR_RL_Obj_RelVelY_17 :%f",@ecu_Signals::i_S4_SRR_RL_Obj_RelVelY_17);

	if((abs(@ecu_Signals::i_S4_SRR_RL_Obj_RelVelY_17)*0.9<=abs(signalvalue1))&&(abs(signalvalue1)<=abs(@ecu_Signals::i_S4_SRR_RL_Obj_RelVelY_17)*1.1))
	{
	testStepPass("Pass","i_S4_SRR_RL_Obj_RelVelY_17 :%f",signalvalue1);
	}
	else
	{
	testStepFail("Fail","i_S4_SRR_RL_Obj_RelVelY_17 :%f",signalvalue1);
	}
}

testcase S4_SRR_RL_Obj_Mes_5_S4_SRR_RL_Obj_AccelY_17()
{
	signalvalue1 = getSignal(S4_SRR_RL_Obj_AccelY_17);
	write("S4_SRR_RL_Obj_AccelY_17 :%f",signalvalue1);
	write("i_S4_SRR_RL_Obj_AccelY_17 :%f",@ecu_Signals::i_S4_SRR_RL_Obj_AccelY_17);

	testStep("get expect variable value: ","i_S4_SRR_RL_Obj_AccelY_17 :%f",@ecu_Signals::i_S4_SRR_RL_Obj_AccelY_17);

	if((abs(@ecu_Signals::i_S4_SRR_RL_Obj_AccelY_17)*0.9<=abs(signalvalue1))&&(abs(signalvalue1)<=abs(@ecu_Signals::i_S4_SRR_RL_Obj_AccelY_17)*1.1))
	{
	testStepPass("Pass","i_S4_SRR_RL_Obj_AccelY_17 :%f",signalvalue1);
	}
	else
	{
	testStepFail("Fail","i_S4_SRR_RL_Obj_AccelY_17 :%f",signalvalue1);
	}
}

testcase S4_SRR_RL_Obj_Mes_5_S4_SRR_RL_Obj_DistXStd_17()
{
	signalvalue1 = getSignal(S4_SRR_RL_Obj_DistXStd_17);
	write("S4_SRR_RL_Obj_DistXStd_17 :%f",signalvalue1);
	write("i_S4_SRR_RL_Obj_DistXStd_17 :%f",@ecu_Signals::i_S4_SRR_RL_Obj_DistXStd_17);

	testStep("get expect variable value: ","i_S4_SRR_RL_Obj_DistXStd_17 :%f",@ecu_Signals::i_S4_SRR_RL_Obj_DistXStd_17);

	if((abs(@ecu_Signals::i_S4_SRR_RL_Obj_DistXStd_17)*0.9<=abs(signalvalue1))&&(abs(signalvalue1)<=abs(@ecu_Signals::i_S4_SRR_RL_Obj_DistXStd_17)*1.1))
	{
	testStepPass("Pass","i_S4_SRR_RL_Obj_DistXStd_17 :%f",signalvalue1);
	}
	else
	{
	testStepFail("Fail","i_S4_SRR_RL_Obj_DistXStd_17 :%f",signalvalue1);
	}
}

testcase S4_SRR_RL_Obj_Mes_5_S4_SRR_RL_Obj_RelVelXStd_17()
{
	signalvalue1 = getSignal(S4_SRR_RL_Obj_RelVelXStd_17);
	write("S4_SRR_RL_Obj_RelVelXStd_17 :%f",signalvalue1);
	write("i_S4_SRR_RL_Obj_RelVelXStd_17 :%f",@ecu_Signals::i_S4_SRR_RL_Obj_RelVelXStd_17);

	testStep("get expect variable value: ","i_S4_SRR_RL_Obj_RelVelXStd_17 :%f",@ecu_Signals::i_S4_SRR_RL_Obj_RelVelXStd_17);

	if((abs(@ecu_Signals::i_S4_SRR_RL_Obj_RelVelXStd_17)*0.9<=abs(signalvalue1))&&(abs(signalvalue1)<=abs(@ecu_Signals::i_S4_SRR_RL_Obj_RelVelXStd_17)*1.1))
	{
	testStepPass("Pass","i_S4_SRR_RL_Obj_RelVelXStd_17 :%f",signalvalue1);
	}
	else
	{
	testStepFail("Fail","i_S4_SRR_RL_Obj_RelVelXStd_17 :%f",signalvalue1);
	}
}

testcase S4_SRR_RL_Obj_Mes_5_S4_SRR_RL_Obj_DistYStd_17()
{
	signalvalue1 = getSignal(S4_SRR_RL_Obj_DistYStd_17);
	write("S4_SRR_RL_Obj_DistYStd_17 :%f",signalvalue1);
	write("i_S4_SRR_RL_Obj_DistYStd_17 :%f",@ecu_Signals::i_S4_SRR_RL_Obj_DistYStd_17);

	testStep("get expect variable value: ","i_S4_SRR_RL_Obj_DistYStd_17 :%f",@ecu_Signals::i_S4_SRR_RL_Obj_DistYStd_17);

	if((abs(@ecu_Signals::i_S4_SRR_RL_Obj_DistYStd_17)*0.9<=abs(signalvalue1))&&(abs(signalvalue1)<=abs(@ecu_Signals::i_S4_SRR_RL_Obj_DistYStd_17)*1.1))
	{
	testStepPass("Pass","i_S4_SRR_RL_Obj_DistYStd_17 :%f",signalvalue1);
	}
	else
	{
	testStepFail("Fail","i_S4_SRR_RL_Obj_DistYStd_17 :%f",signalvalue1);
	}
}

testcase S4_SRR_RL_Obj_Mes_5_S4_SRR_RL_Obj_RelVelYStd_17()
{
	signalvalue1 = getSignal(S4_SRR_RL_Obj_RelVelYStd_17);
	write("S4_SRR_RL_Obj_RelVelYStd_17 :%f",signalvalue1);
	write("i_S4_SRR_RL_Obj_RelVelYStd_17 :%f",@ecu_Signals::i_S4_SRR_RL_Obj_RelVelYStd_17);

	testStep("get expect variable value: ","i_S4_SRR_RL_Obj_RelVelYStd_17 :%f",@ecu_Signals::i_S4_SRR_RL_Obj_RelVelYStd_17);

	if((abs(@ecu_Signals::i_S4_SRR_RL_Obj_RelVelYStd_17)*0.9<=abs(signalvalue1))&&(abs(signalvalue1)<=abs(@ecu_Signals::i_S4_SRR_RL_Obj_RelVelYStd_17)*1.1))
	{
	testStepPass("Pass","i_S4_SRR_RL_Obj_RelVelYStd_17 :%f",signalvalue1);
	}
	else
	{
	testStepFail("Fail","i_S4_SRR_RL_Obj_RelVelYStd_17 :%f",signalvalue1);
	}
}

testcase S4_SRR_RL_Obj_Mes_5_S4_SRR_RL_Obj_UpdateFlag_17()
{
	signalvalue1 = getSignal(S4_SRR_RL_Obj_UpdateFlag_17);
	write("S4_SRR_RL_Obj_UpdateFlag_17 :%f",signalvalue1);
	write("i_S4_SRR_RL_Obj_UpdateFlag_17 :%o",@ecu_Signals::i_S4_SRR_RL_Obj_UpdateFlag_17);

	testStep("get expect variable value: ","i_S4_SRR_RL_Obj_UpdateFlag_17 :%o",@ecu_Signals::i_S4_SRR_RL_Obj_UpdateFlag_17);

	if(signalvalue1==@ecu_Signals::i_S4_SRR_RL_Obj_UpdateFlag_17)
	{
	testStepPass("Pass","i_S4_SRR_RL_Obj_UpdateFlag_17 :%f",signalvalue1);
	}
	else
	{
	testStepFail("Fail","i_S4_SRR_RL_Obj_UpdateFlag_17 :%f",signalvalue1);
	}
}

testcase S4_SRR_RL_Obj_Mes_5_S4_SRR_RL_Obj_ExistProb_17()
{
	signalvalue1 = getSignal(S4_SRR_RL_Obj_ExistProb_17);
	write("S4_SRR_RL_Obj_ExistProb_17 :%f",signalvalue1);
	write("i_S4_SRR_RL_Obj_ExistProb_17 :%o",@ecu_Signals::i_S4_SRR_RL_Obj_ExistProb_17);

	testStep("get expect variable value: ","i_S4_SRR_RL_Obj_ExistProb_17 :%o",@ecu_Signals::i_S4_SRR_RL_Obj_ExistProb_17);

	if(signalvalue1==@ecu_Signals::i_S4_SRR_RL_Obj_ExistProb_17)
	{
	testStepPass("Pass","i_S4_SRR_RL_Obj_ExistProb_17 :%f",signalvalue1);
	}
	else
	{
	testStepFail("Fail","i_S4_SRR_RL_Obj_ExistProb_17 :%f",signalvalue1);
	}
}

testcase S4_SRR_RL_Obj_Mes_5_S4_SRR_RL_Obj_Type_17()
{
	signalvalue1 = getSignal(S4_SRR_RL_Obj_Type_17);
	write("S4_SRR_RL_Obj_Type_17 :%f",signalvalue1);
	write("i_S4_SRR_RL_Obj_Type_17 :%o",@ecu_Signals::i_S4_SRR_RL_Obj_Type_17);

	testStep("get expect variable value: ","i_S4_SRR_RL_Obj_Type_17 :%o",@ecu_Signals::i_S4_SRR_RL_Obj_Type_17);

	if(signalvalue1==@ecu_Signals::i_S4_SRR_RL_Obj_Type_17)
	{
	testStepPass("Pass","i_S4_SRR_RL_Obj_Type_17 :%f",signalvalue1);
	}
	else
	{
	testStepFail("Fail","i_S4_SRR_RL_Obj_Type_17 :%f",signalvalue1);
	}
}

testcase S4_SRR_RL_Obj_Mes_5_S4_SRR_RL_Obj_EDynProp_17()
{
	signalvalue1 = getSignal(S4_SRR_RL_Obj_EDynProp_17);
	write("S4_SRR_RL_Obj_EDynProp_17 :%f",signalvalue1);
	write("i_S4_SRR_RL_Obj_EDynProp_17 :%o",@ecu_Signals::i_S4_SRR_RL_Obj_EDynProp_17);

	testStep("get expect variable value: ","i_S4_SRR_RL_Obj_EDynProp_17 :%o",@ecu_Signals::i_S4_SRR_RL_Obj_EDynProp_17);

	if(signalvalue1==@ecu_Signals::i_S4_SRR_RL_Obj_EDynProp_17)
	{
	testStepPass("Pass","i_S4_SRR_RL_Obj_EDynProp_17 :%f",signalvalue1);
	}
	else
	{
	testStepFail("Fail","i_S4_SRR_RL_Obj_EDynProp_17 :%f",signalvalue1);
	}
}

testcase S4_SRR_RL_Obj_Mes_5_S4_SRR_RL_Obj_UiLifeCycles_17()
{
	signalvalue1 = getSignal(S4_SRR_RL_Obj_UiLifeCycles_17);
	write("S4_SRR_RL_Obj_UiLifeCycles_17 :%f",signalvalue1);
	write("i_S4_SRR_RL_Obj_UiLifeCycles_17 :%o",@ecu_Signals::i_S4_SRR_RL_Obj_UiLifeCycles_17);

	testStep("get expect variable value: ","i_S4_SRR_RL_Obj_UiLifeCycles_17 :%o",@ecu_Signals::i_S4_SRR_RL_Obj_UiLifeCycles_17);

	if(signalvalue1==@ecu_Signals::i_S4_SRR_RL_Obj_UiLifeCycles_17)
	{
	testStepPass("Pass","i_S4_SRR_RL_Obj_UiLifeCycles_17 :%f",signalvalue1);
	}
	else
	{
	testStepFail("Fail","i_S4_SRR_RL_Obj_UiLifeCycles_17 :%f",signalvalue1);
	}
}

testcase S4_SRR_RL_Obj_Mes_6_S4_SRR_RL_Obj_ID_18()
{
	signalvalue1 = getSignal(S4_SRR_RL_Obj_ID_18);
	write("S4_SRR_RL_Obj_ID_18 :%f",signalvalue1);
	write("i_S4_SRR_RL_Obj_ID_18 :%o",@ecu_Signals::i_S4_SRR_RL_Obj_ID_18);

	testStep("get expect variable value: ","i_S4_SRR_RL_Obj_ID_18 :%o",@ecu_Signals::i_S4_SRR_RL_Obj_ID_18);

	if(signalvalue1==@ecu_Signals::i_S4_SRR_RL_Obj_ID_18)
	{
	testStepPass("Pass","i_S4_SRR_RL_Obj_ID_18 :%f",signalvalue1);
	}
	else
	{
	testStepFail("Fail","i_S4_SRR_RL_Obj_ID_18 :%f",signalvalue1);
	}
}

testcase S4_SRR_RL_Obj_Mes_6_S4_SRR_RL_Obj_DistX_18()
{
	signalvalue1 = getSignal(S4_SRR_RL_Obj_DistX_18);
	write("S4_SRR_RL_Obj_DistX_18 :%f",signalvalue1);
	write("i_S4_SRR_RL_Obj_DistX_18 :%f",@ecu_Signals::i_S4_SRR_RL_Obj_DistX_18);

	testStep("get expect variable value: ","i_S4_SRR_RL_Obj_DistX_18 :%f",@ecu_Signals::i_S4_SRR_RL_Obj_DistX_18);

	if((abs(@ecu_Signals::i_S4_SRR_RL_Obj_DistX_18)*0.9<=abs(signalvalue1))&&(abs(signalvalue1)<=abs(@ecu_Signals::i_S4_SRR_RL_Obj_DistX_18)*1.1))
	{
	testStepPass("Pass","i_S4_SRR_RL_Obj_DistX_18 :%f",signalvalue1);
	}
	else
	{
	testStepFail("Fail","i_S4_SRR_RL_Obj_DistX_18 :%f",signalvalue1);
	}
}

testcase S4_SRR_RL_Obj_Mes_6_S4_SRR_RL_Obj_RelVelX_18()
{
	signalvalue1 = getSignal(S4_SRR_RL_Obj_RelVelX_18);
	write("S4_SRR_RL_Obj_RelVelX_18 :%f",signalvalue1);
	write("i_S4_SRR_RL_Obj_RelVelX_18 :%f",@ecu_Signals::i_S4_SRR_RL_Obj_RelVelX_18);

	testStep("get expect variable value: ","i_S4_SRR_RL_Obj_RelVelX_18 :%f",@ecu_Signals::i_S4_SRR_RL_Obj_RelVelX_18);

	if((abs(@ecu_Signals::i_S4_SRR_RL_Obj_RelVelX_18)*0.9<=abs(signalvalue1))&&(abs(signalvalue1)<=abs(@ecu_Signals::i_S4_SRR_RL_Obj_RelVelX_18)*1.1))
	{
	testStepPass("Pass","i_S4_SRR_RL_Obj_RelVelX_18 :%f",signalvalue1);
	}
	else
	{
	testStepFail("Fail","i_S4_SRR_RL_Obj_RelVelX_18 :%f",signalvalue1);
	}
}

testcase S4_SRR_RL_Obj_Mes_6_S4_SRR_RL_Obj_AccelX_18()
{
	signalvalue1 = getSignal(S4_SRR_RL_Obj_AccelX_18);
	write("S4_SRR_RL_Obj_AccelX_18 :%f",signalvalue1);
	write("i_S4_SRR_RL_Obj_AccelX_18 :%f",@ecu_Signals::i_S4_SRR_RL_Obj_AccelX_18);

	testStep("get expect variable value: ","i_S4_SRR_RL_Obj_AccelX_18 :%f",@ecu_Signals::i_S4_SRR_RL_Obj_AccelX_18);

	if((abs(@ecu_Signals::i_S4_SRR_RL_Obj_AccelX_18)*0.9<=abs(signalvalue1))&&(abs(signalvalue1)<=abs(@ecu_Signals::i_S4_SRR_RL_Obj_AccelX_18)*1.1))
	{
	testStepPass("Pass","i_S4_SRR_RL_Obj_AccelX_18 :%f",signalvalue1);
	}
	else
	{
	testStepFail("Fail","i_S4_SRR_RL_Obj_AccelX_18 :%f",signalvalue1);
	}
}

testcase S4_SRR_RL_Obj_Mes_6_S4_SRR_RL_Obj_DistY_18()
{
	signalvalue1 = getSignal(S4_SRR_RL_Obj_DistY_18);
	write("S4_SRR_RL_Obj_DistY_18 :%f",signalvalue1);
	write("i_S4_SRR_RL_Obj_DistY_18 :%f",@ecu_Signals::i_S4_SRR_RL_Obj_DistY_18);

	testStep("get expect variable value: ","i_S4_SRR_RL_Obj_DistY_18 :%f",@ecu_Signals::i_S4_SRR_RL_Obj_DistY_18);

	if((abs(@ecu_Signals::i_S4_SRR_RL_Obj_DistY_18)*0.9<=abs(signalvalue1))&&(abs(signalvalue1)<=abs(@ecu_Signals::i_S4_SRR_RL_Obj_DistY_18)*1.1))
	{
	testStepPass("Pass","i_S4_SRR_RL_Obj_DistY_18 :%f",signalvalue1);
	}
	else
	{
	testStepFail("Fail","i_S4_SRR_RL_Obj_DistY_18 :%f",signalvalue1);
	}
}

testcase S4_SRR_RL_Obj_Mes_6_S4_SRR_RL_Obj_RelVelY_18()
{
	signalvalue1 = getSignal(S4_SRR_RL_Obj_RelVelY_18);
	write("S4_SRR_RL_Obj_RelVelY_18 :%f",signalvalue1);
	write("i_S4_SRR_RL_Obj_RelVelY_18 :%f",@ecu_Signals::i_S4_SRR_RL_Obj_RelVelY_18);

	testStep("get expect variable value: ","i_S4_SRR_RL_Obj_RelVelY_18 :%f",@ecu_Signals::i_S4_SRR_RL_Obj_RelVelY_18);

	if((abs(@ecu_Signals::i_S4_SRR_RL_Obj_RelVelY_18)*0.9<=abs(signalvalue1))&&(abs(signalvalue1)<=abs(@ecu_Signals::i_S4_SRR_RL_Obj_RelVelY_18)*1.1))
	{
	testStepPass("Pass","i_S4_SRR_RL_Obj_RelVelY_18 :%f",signalvalue1);
	}
	else
	{
	testStepFail("Fail","i_S4_SRR_RL_Obj_RelVelY_18 :%f",signalvalue1);
	}
}

testcase S4_SRR_RL_Obj_Mes_6_S4_SRR_RL_Obj_AccelY_18()
{
	signalvalue1 = getSignal(S4_SRR_RL_Obj_AccelY_18);
	write("S4_SRR_RL_Obj_AccelY_18 :%f",signalvalue1);
	write("i_S4_SRR_RL_Obj_AccelY_18 :%f",@ecu_Signals::i_S4_SRR_RL_Obj_AccelY_18);

	testStep("get expect variable value: ","i_S4_SRR_RL_Obj_AccelY_18 :%f",@ecu_Signals::i_S4_SRR_RL_Obj_AccelY_18);

	if((abs(@ecu_Signals::i_S4_SRR_RL_Obj_AccelY_18)*0.9<=abs(signalvalue1))&&(abs(signalvalue1)<=abs(@ecu_Signals::i_S4_SRR_RL_Obj_AccelY_18)*1.1))
	{
	testStepPass("Pass","i_S4_SRR_RL_Obj_AccelY_18 :%f",signalvalue1);
	}
	else
	{
	testStepFail("Fail","i_S4_SRR_RL_Obj_AccelY_18 :%f",signalvalue1);
	}
}

testcase S4_SRR_RL_Obj_Mes_6_S4_SRR_RL_Obj_DistXStd_18()
{
	signalvalue1 = getSignal(S4_SRR_RL_Obj_DistXStd_18);
	write("S4_SRR_RL_Obj_DistXStd_18 :%f",signalvalue1);
	write("i_S4_SRR_RL_Obj_DistXStd_18 :%f",@ecu_Signals::i_S4_SRR_RL_Obj_DistXStd_18);

	testStep("get expect variable value: ","i_S4_SRR_RL_Obj_DistXStd_18 :%f",@ecu_Signals::i_S4_SRR_RL_Obj_DistXStd_18);

	if((abs(@ecu_Signals::i_S4_SRR_RL_Obj_DistXStd_18)*0.9<=abs(signalvalue1))&&(abs(signalvalue1)<=abs(@ecu_Signals::i_S4_SRR_RL_Obj_DistXStd_18)*1.1))
	{
	testStepPass("Pass","i_S4_SRR_RL_Obj_DistXStd_18 :%f",signalvalue1);
	}
	else
	{
	testStepFail("Fail","i_S4_SRR_RL_Obj_DistXStd_18 :%f",signalvalue1);
	}
}

testcase S4_SRR_RL_Obj_Mes_6_S4_SRR_RL_Obj_RelVelXStd_18()
{
	signalvalue1 = getSignal(S4_SRR_RL_Obj_RelVelXStd_18);
	write("S4_SRR_RL_Obj_RelVelXStd_18 :%f",signalvalue1);
	write("i_S4_SRR_RL_Obj_RelVelXStd_18 :%f",@ecu_Signals::i_S4_SRR_RL_Obj_RelVelXStd_18);

	testStep("get expect variable value: ","i_S4_SRR_RL_Obj_RelVelXStd_18 :%f",@ecu_Signals::i_S4_SRR_RL_Obj_RelVelXStd_18);

	if((abs(@ecu_Signals::i_S4_SRR_RL_Obj_RelVelXStd_18)*0.9<=abs(signalvalue1))&&(abs(signalvalue1)<=abs(@ecu_Signals::i_S4_SRR_RL_Obj_RelVelXStd_18)*1.1))
	{
	testStepPass("Pass","i_S4_SRR_RL_Obj_RelVelXStd_18 :%f",signalvalue1);
	}
	else
	{
	testStepFail("Fail","i_S4_SRR_RL_Obj_RelVelXStd_18 :%f",signalvalue1);
	}
}

testcase S4_SRR_RL_Obj_Mes_6_S4_SRR_RL_Obj_DistYStd_18()
{
	signalvalue1 = getSignal(S4_SRR_RL_Obj_DistYStd_18);
	write("S4_SRR_RL_Obj_DistYStd_18 :%f",signalvalue1);
	write("i_S4_SRR_RL_Obj_DistYStd_18 :%f",@ecu_Signals::i_S4_SRR_RL_Obj_DistYStd_18);

	testStep("get expect variable value: ","i_S4_SRR_RL_Obj_DistYStd_18 :%f",@ecu_Signals::i_S4_SRR_RL_Obj_DistYStd_18);

	if((abs(@ecu_Signals::i_S4_SRR_RL_Obj_DistYStd_18)*0.9<=abs(signalvalue1))&&(abs(signalvalue1)<=abs(@ecu_Signals::i_S4_SRR_RL_Obj_DistYStd_18)*1.1))
	{
	testStepPass("Pass","i_S4_SRR_RL_Obj_DistYStd_18 :%f",signalvalue1);
	}
	else
	{
	testStepFail("Fail","i_S4_SRR_RL_Obj_DistYStd_18 :%f",signalvalue1);
	}
}

testcase S4_SRR_RL_Obj_Mes_6_S4_SRR_RL_Obj_RelVelYStd_18()
{
	signalvalue1 = getSignal(S4_SRR_RL_Obj_RelVelYStd_18);
	write("S4_SRR_RL_Obj_RelVelYStd_18 :%f",signalvalue1);
	write("i_S4_SRR_RL_Obj_RelVelYStd_18 :%f",@ecu_Signals::i_S4_SRR_RL_Obj_RelVelYStd_18);

	testStep("get expect variable value: ","i_S4_SRR_RL_Obj_RelVelYStd_18 :%f",@ecu_Signals::i_S4_SRR_RL_Obj_RelVelYStd_18);

	if((abs(@ecu_Signals::i_S4_SRR_RL_Obj_RelVelYStd_18)*0.9<=abs(signalvalue1))&&(abs(signalvalue1)<=abs(@ecu_Signals::i_S4_SRR_RL_Obj_RelVelYStd_18)*1.1))
	{
	testStepPass("Pass","i_S4_SRR_RL_Obj_RelVelYStd_18 :%f",signalvalue1);
	}
	else
	{
	testStepFail("Fail","i_S4_SRR_RL_Obj_RelVelYStd_18 :%f",signalvalue1);
	}
}

testcase S4_SRR_RL_Obj_Mes_6_S4_SRR_RL_Obj_UpdateFlag_18()
{
	signalvalue1 = getSignal(S4_SRR_RL_Obj_UpdateFlag_18);
	write("S4_SRR_RL_Obj_UpdateFlag_18 :%f",signalvalue1);
	write("i_S4_SRR_RL_Obj_UpdateFlag_18 :%o",@ecu_Signals::i_S4_SRR_RL_Obj_UpdateFlag_18);

	testStep("get expect variable value: ","i_S4_SRR_RL_Obj_UpdateFlag_18 :%o",@ecu_Signals::i_S4_SRR_RL_Obj_UpdateFlag_18);

	if(signalvalue1==@ecu_Signals::i_S4_SRR_RL_Obj_UpdateFlag_18)
	{
	testStepPass("Pass","i_S4_SRR_RL_Obj_UpdateFlag_18 :%f",signalvalue1);
	}
	else
	{
	testStepFail("Fail","i_S4_SRR_RL_Obj_UpdateFlag_18 :%f",signalvalue1);
	}
}

testcase S4_SRR_RL_Obj_Mes_6_S4_SRR_RL_Obj_ExistProb_18()
{
	signalvalue1 = getSignal(S4_SRR_RL_Obj_ExistProb_18);
	write("S4_SRR_RL_Obj_ExistProb_18 :%f",signalvalue1);
	write("i_S4_SRR_RL_Obj_ExistProb_18 :%o",@ecu_Signals::i_S4_SRR_RL_Obj_ExistProb_18);

	testStep("get expect variable value: ","i_S4_SRR_RL_Obj_ExistProb_18 :%o",@ecu_Signals::i_S4_SRR_RL_Obj_ExistProb_18);

	if(signalvalue1==@ecu_Signals::i_S4_SRR_RL_Obj_ExistProb_18)
	{
	testStepPass("Pass","i_S4_SRR_RL_Obj_ExistProb_18 :%f",signalvalue1);
	}
	else
	{
	testStepFail("Fail","i_S4_SRR_RL_Obj_ExistProb_18 :%f",signalvalue1);
	}
}

testcase S4_SRR_RL_Obj_Mes_6_S4_SRR_RL_Obj_Type_18()
{
	signalvalue1 = getSignal(S4_SRR_RL_Obj_Type_18);
	write("S4_SRR_RL_Obj_Type_18 :%f",signalvalue1);
	write("i_S4_SRR_RL_Obj_Type_18 :%o",@ecu_Signals::i_S4_SRR_RL_Obj_Type_18);

	testStep("get expect variable value: ","i_S4_SRR_RL_Obj_Type_18 :%o",@ecu_Signals::i_S4_SRR_RL_Obj_Type_18);

	if(signalvalue1==@ecu_Signals::i_S4_SRR_RL_Obj_Type_18)
	{
	testStepPass("Pass","i_S4_SRR_RL_Obj_Type_18 :%f",signalvalue1);
	}
	else
	{
	testStepFail("Fail","i_S4_SRR_RL_Obj_Type_18 :%f",signalvalue1);
	}
}

testcase S4_SRR_RL_Obj_Mes_6_S4_SRR_RL_Obj_EDynProp_18()
{
	signalvalue1 = getSignal(S4_SRR_RL_Obj_EDynProp_18);
	write("S4_SRR_RL_Obj_EDynProp_18 :%f",signalvalue1);
	write("i_S4_SRR_RL_Obj_EDynProp_18 :%o",@ecu_Signals::i_S4_SRR_RL_Obj_EDynProp_18);

	testStep("get expect variable value: ","i_S4_SRR_RL_Obj_EDynProp_18 :%o",@ecu_Signals::i_S4_SRR_RL_Obj_EDynProp_18);

	if(signalvalue1==@ecu_Signals::i_S4_SRR_RL_Obj_EDynProp_18)
	{
	testStepPass("Pass","i_S4_SRR_RL_Obj_EDynProp_18 :%f",signalvalue1);
	}
	else
	{
	testStepFail("Fail","i_S4_SRR_RL_Obj_EDynProp_18 :%f",signalvalue1);
	}
}

testcase S4_SRR_RL_Obj_Mes_6_S4_SRR_RL_Obj_UiLifeCycles_18()
{
	signalvalue1 = getSignal(S4_SRR_RL_Obj_UiLifeCycles_18);
	write("S4_SRR_RL_Obj_UiLifeCycles_18 :%f",signalvalue1);
	write("i_S4_SRR_RL_Obj_UiLifeCycles_18 :%o",@ecu_Signals::i_S4_SRR_RL_Obj_UiLifeCycles_18);

	testStep("get expect variable value: ","i_S4_SRR_RL_Obj_UiLifeCycles_18 :%o",@ecu_Signals::i_S4_SRR_RL_Obj_UiLifeCycles_18);

	if(signalvalue1==@ecu_Signals::i_S4_SRR_RL_Obj_UiLifeCycles_18)
	{
	testStepPass("Pass","i_S4_SRR_RL_Obj_UiLifeCycles_18 :%f",signalvalue1);
	}
	else
	{
	testStepFail("Fail","i_S4_SRR_RL_Obj_UiLifeCycles_18 :%f",signalvalue1);
	}
}

testcase S4_SRR_RL_Obj_Mes_6_S4_SRR_RL_Obj_ID_19()
{
	signalvalue1 = getSignal(S4_SRR_RL_Obj_ID_19);
	write("S4_SRR_RL_Obj_ID_19 :%f",signalvalue1);
	write("i_S4_SRR_RL_Obj_ID_19 :%o",@ecu_Signals::i_S4_SRR_RL_Obj_ID_19);

	testStep("get expect variable value: ","i_S4_SRR_RL_Obj_ID_19 :%o",@ecu_Signals::i_S4_SRR_RL_Obj_ID_19);

	if(signalvalue1==@ecu_Signals::i_S4_SRR_RL_Obj_ID_19)
	{
	testStepPass("Pass","i_S4_SRR_RL_Obj_ID_19 :%f",signalvalue1);
	}
	else
	{
	testStepFail("Fail","i_S4_SRR_RL_Obj_ID_19 :%f",signalvalue1);
	}
}

testcase S4_SRR_RL_Obj_Mes_6_S4_SRR_RL_Obj_DistX_19()
{
	signalvalue1 = getSignal(S4_SRR_RL_Obj_DistX_19);
	write("S4_SRR_RL_Obj_DistX_19 :%f",signalvalue1);
	write("i_S4_SRR_RL_Obj_DistX_19 :%f",@ecu_Signals::i_S4_SRR_RL_Obj_DistX_19);

	testStep("get expect variable value: ","i_S4_SRR_RL_Obj_DistX_19 :%f",@ecu_Signals::i_S4_SRR_RL_Obj_DistX_19);

	if((abs(@ecu_Signals::i_S4_SRR_RL_Obj_DistX_19)*0.9<=abs(signalvalue1))&&(abs(signalvalue1)<=abs(@ecu_Signals::i_S4_SRR_RL_Obj_DistX_19)*1.1))
	{
	testStepPass("Pass","i_S4_SRR_RL_Obj_DistX_19 :%f",signalvalue1);
	}
	else
	{
	testStepFail("Fail","i_S4_SRR_RL_Obj_DistX_19 :%f",signalvalue1);
	}
}

testcase S4_SRR_RL_Obj_Mes_6_S4_SRR_RL_Obj_RelVelX_19()
{
	signalvalue1 = getSignal(S4_SRR_RL_Obj_RelVelX_19);
	write("S4_SRR_RL_Obj_RelVelX_19 :%f",signalvalue1);
	write("i_S4_SRR_RL_Obj_RelVelX_19 :%f",@ecu_Signals::i_S4_SRR_RL_Obj_RelVelX_19);

	testStep("get expect variable value: ","i_S4_SRR_RL_Obj_RelVelX_19 :%f",@ecu_Signals::i_S4_SRR_RL_Obj_RelVelX_19);

	if((abs(@ecu_Signals::i_S4_SRR_RL_Obj_RelVelX_19)*0.9<=abs(signalvalue1))&&(abs(signalvalue1)<=abs(@ecu_Signals::i_S4_SRR_RL_Obj_RelVelX_19)*1.1))
	{
	testStepPass("Pass","i_S4_SRR_RL_Obj_RelVelX_19 :%f",signalvalue1);
	}
	else
	{
	testStepFail("Fail","i_S4_SRR_RL_Obj_RelVelX_19 :%f",signalvalue1);
	}
}

testcase S4_SRR_RL_Obj_Mes_6_S4_SRR_RL_Obj_AccelX_19()
{
	signalvalue1 = getSignal(S4_SRR_RL_Obj_AccelX_19);
	write("S4_SRR_RL_Obj_AccelX_19 :%f",signalvalue1);
	write("i_S4_SRR_RL_Obj_AccelX_19 :%f",@ecu_Signals::i_S4_SRR_RL_Obj_AccelX_19);

	testStep("get expect variable value: ","i_S4_SRR_RL_Obj_AccelX_19 :%f",@ecu_Signals::i_S4_SRR_RL_Obj_AccelX_19);

	if((abs(@ecu_Signals::i_S4_SRR_RL_Obj_AccelX_19)*0.9<=abs(signalvalue1))&&(abs(signalvalue1)<=abs(@ecu_Signals::i_S4_SRR_RL_Obj_AccelX_19)*1.1))
	{
	testStepPass("Pass","i_S4_SRR_RL_Obj_AccelX_19 :%f",signalvalue1);
	}
	else
	{
	testStepFail("Fail","i_S4_SRR_RL_Obj_AccelX_19 :%f",signalvalue1);
	}
}

testcase S4_SRR_RL_Obj_Mes_6_S4_SRR_RL_Obj_DistY_19()
{
	signalvalue1 = getSignal(S4_SRR_RL_Obj_DistY_19);
	write("S4_SRR_RL_Obj_DistY_19 :%f",signalvalue1);
	write("i_S4_SRR_RL_Obj_DistY_19 :%f",@ecu_Signals::i_S4_SRR_RL_Obj_DistY_19);

	testStep("get expect variable value: ","i_S4_SRR_RL_Obj_DistY_19 :%f",@ecu_Signals::i_S4_SRR_RL_Obj_DistY_19);

	if((abs(@ecu_Signals::i_S4_SRR_RL_Obj_DistY_19)*0.9<=abs(signalvalue1))&&(abs(signalvalue1)<=abs(@ecu_Signals::i_S4_SRR_RL_Obj_DistY_19)*1.1))
	{
	testStepPass("Pass","i_S4_SRR_RL_Obj_DistY_19 :%f",signalvalue1);
	}
	else
	{
	testStepFail("Fail","i_S4_SRR_RL_Obj_DistY_19 :%f",signalvalue1);
	}
}

testcase S4_SRR_RL_Obj_Mes_6_S4_SRR_RL_Obj_RelVelY_19()
{
	signalvalue1 = getSignal(S4_SRR_RL_Obj_RelVelY_19);
	write("S4_SRR_RL_Obj_RelVelY_19 :%f",signalvalue1);
	write("i_S4_SRR_RL_Obj_RelVelY_19 :%f",@ecu_Signals::i_S4_SRR_RL_Obj_RelVelY_19);

	testStep("get expect variable value: ","i_S4_SRR_RL_Obj_RelVelY_19 :%f",@ecu_Signals::i_S4_SRR_RL_Obj_RelVelY_19);

	if((abs(@ecu_Signals::i_S4_SRR_RL_Obj_RelVelY_19)*0.9<=abs(signalvalue1))&&(abs(signalvalue1)<=abs(@ecu_Signals::i_S4_SRR_RL_Obj_RelVelY_19)*1.1))
	{
	testStepPass("Pass","i_S4_SRR_RL_Obj_RelVelY_19 :%f",signalvalue1);
	}
	else
	{
	testStepFail("Fail","i_S4_SRR_RL_Obj_RelVelY_19 :%f",signalvalue1);
	}
}

testcase S4_SRR_RL_Obj_Mes_6_S4_SRR_RL_Obj_AccelY_19()
{
	signalvalue1 = getSignal(S4_SRR_RL_Obj_AccelY_19);
	write("S4_SRR_RL_Obj_AccelY_19 :%f",signalvalue1);
	write("i_S4_SRR_RL_Obj_AccelY_19 :%f",@ecu_Signals::i_S4_SRR_RL_Obj_AccelY_19);

	testStep("get expect variable value: ","i_S4_SRR_RL_Obj_AccelY_19 :%f",@ecu_Signals::i_S4_SRR_RL_Obj_AccelY_19);

	if((abs(@ecu_Signals::i_S4_SRR_RL_Obj_AccelY_19)*0.9<=abs(signalvalue1))&&(abs(signalvalue1)<=abs(@ecu_Signals::i_S4_SRR_RL_Obj_AccelY_19)*1.1))
	{
	testStepPass("Pass","i_S4_SRR_RL_Obj_AccelY_19 :%f",signalvalue1);
	}
	else
	{
	testStepFail("Fail","i_S4_SRR_RL_Obj_AccelY_19 :%f",signalvalue1);
	}
}

testcase S4_SRR_RL_Obj_Mes_6_S4_SRR_RL_Obj_DistXStd_19()
{
	signalvalue1 = getSignal(S4_SRR_RL_Obj_DistXStd_19);
	write("S4_SRR_RL_Obj_DistXStd_19 :%f",signalvalue1);
	write("i_S4_SRR_RL_Obj_DistXStd_19 :%f",@ecu_Signals::i_S4_SRR_RL_Obj_DistXStd_19);

	testStep("get expect variable value: ","i_S4_SRR_RL_Obj_DistXStd_19 :%f",@ecu_Signals::i_S4_SRR_RL_Obj_DistXStd_19);

	if((abs(@ecu_Signals::i_S4_SRR_RL_Obj_DistXStd_19)*0.9<=abs(signalvalue1))&&(abs(signalvalue1)<=abs(@ecu_Signals::i_S4_SRR_RL_Obj_DistXStd_19)*1.1))
	{
	testStepPass("Pass","i_S4_SRR_RL_Obj_DistXStd_19 :%f",signalvalue1);
	}
	else
	{
	testStepFail("Fail","i_S4_SRR_RL_Obj_DistXStd_19 :%f",signalvalue1);
	}
}

testcase S4_SRR_RL_Obj_Mes_6_S4_SRR_RL_Obj_RelVelXStd_19()
{
	signalvalue1 = getSignal(S4_SRR_RL_Obj_RelVelXStd_19);
	write("S4_SRR_RL_Obj_RelVelXStd_19 :%f",signalvalue1);
	write("i_S4_SRR_RL_Obj_RelVelXStd_19 :%f",@ecu_Signals::i_S4_SRR_RL_Obj_RelVelXStd_19);

	testStep("get expect variable value: ","i_S4_SRR_RL_Obj_RelVelXStd_19 :%f",@ecu_Signals::i_S4_SRR_RL_Obj_RelVelXStd_19);

	if((abs(@ecu_Signals::i_S4_SRR_RL_Obj_RelVelXStd_19)*0.9<=abs(signalvalue1))&&(abs(signalvalue1)<=abs(@ecu_Signals::i_S4_SRR_RL_Obj_RelVelXStd_19)*1.1))
	{
	testStepPass("Pass","i_S4_SRR_RL_Obj_RelVelXStd_19 :%f",signalvalue1);
	}
	else
	{
	testStepFail("Fail","i_S4_SRR_RL_Obj_RelVelXStd_19 :%f",signalvalue1);
	}
}

testcase S4_SRR_RL_Obj_Mes_6_S4_SRR_RL_Obj_DistYStd_19()
{
	signalvalue1 = getSignal(S4_SRR_RL_Obj_DistYStd_19);
	write("S4_SRR_RL_Obj_DistYStd_19 :%f",signalvalue1);
	write("i_S4_SRR_RL_Obj_DistYStd_19 :%f",@ecu_Signals::i_S4_SRR_RL_Obj_DistYStd_19);

	testStep("get expect variable value: ","i_S4_SRR_RL_Obj_DistYStd_19 :%f",@ecu_Signals::i_S4_SRR_RL_Obj_DistYStd_19);

	if((abs(@ecu_Signals::i_S4_SRR_RL_Obj_DistYStd_19)*0.9<=abs(signalvalue1))&&(abs(signalvalue1)<=abs(@ecu_Signals::i_S4_SRR_RL_Obj_DistYStd_19)*1.1))
	{
	testStepPass("Pass","i_S4_SRR_RL_Obj_DistYStd_19 :%f",signalvalue1);
	}
	else
	{
	testStepFail("Fail","i_S4_SRR_RL_Obj_DistYStd_19 :%f",signalvalue1);
	}
}

testcase S4_SRR_RL_Obj_Mes_6_S4_SRR_RL_Obj_RelVelYStd_19()
{
	signalvalue1 = getSignal(S4_SRR_RL_Obj_RelVelYStd_19);
	write("S4_SRR_RL_Obj_RelVelYStd_19 :%f",signalvalue1);
	write("i_S4_SRR_RL_Obj_RelVelYStd_19 :%f",@ecu_Signals::i_S4_SRR_RL_Obj_RelVelYStd_19);

	testStep("get expect variable value: ","i_S4_SRR_RL_Obj_RelVelYStd_19 :%f",@ecu_Signals::i_S4_SRR_RL_Obj_RelVelYStd_19);

	if((abs(@ecu_Signals::i_S4_SRR_RL_Obj_RelVelYStd_19)*0.9<=abs(signalvalue1))&&(abs(signalvalue1)<=abs(@ecu_Signals::i_S4_SRR_RL_Obj_RelVelYStd_19)*1.1))
	{
	testStepPass("Pass","i_S4_SRR_RL_Obj_RelVelYStd_19 :%f",signalvalue1);
	}
	else
	{
	testStepFail("Fail","i_S4_SRR_RL_Obj_RelVelYStd_19 :%f",signalvalue1);
	}
}

testcase S4_SRR_RL_Obj_Mes_6_S4_SRR_RL_Obj_UpdateFlag_19()
{
	signalvalue1 = getSignal(S4_SRR_RL_Obj_UpdateFlag_19);
	write("S4_SRR_RL_Obj_UpdateFlag_19 :%f",signalvalue1);
	write("i_S4_SRR_RL_Obj_UpdateFlag_19 :%o",@ecu_Signals::i_S4_SRR_RL_Obj_UpdateFlag_19);

	testStep("get expect variable value: ","i_S4_SRR_RL_Obj_UpdateFlag_19 :%o",@ecu_Signals::i_S4_SRR_RL_Obj_UpdateFlag_19);

	if(signalvalue1==@ecu_Signals::i_S4_SRR_RL_Obj_UpdateFlag_19)
	{
	testStepPass("Pass","i_S4_SRR_RL_Obj_UpdateFlag_19 :%f",signalvalue1);
	}
	else
	{
	testStepFail("Fail","i_S4_SRR_RL_Obj_UpdateFlag_19 :%f",signalvalue1);
	}
}

testcase S4_SRR_RL_Obj_Mes_6_S4_SRR_RL_Obj_ExistProb_19()
{
	signalvalue1 = getSignal(S4_SRR_RL_Obj_ExistProb_19);
	write("S4_SRR_RL_Obj_ExistProb_19 :%f",signalvalue1);
	write("i_S4_SRR_RL_Obj_ExistProb_19 :%o",@ecu_Signals::i_S4_SRR_RL_Obj_ExistProb_19);

	testStep("get expect variable value: ","i_S4_SRR_RL_Obj_ExistProb_19 :%o",@ecu_Signals::i_S4_SRR_RL_Obj_ExistProb_19);

	if(signalvalue1==@ecu_Signals::i_S4_SRR_RL_Obj_ExistProb_19)
	{
	testStepPass("Pass","i_S4_SRR_RL_Obj_ExistProb_19 :%f",signalvalue1);
	}
	else
	{
	testStepFail("Fail","i_S4_SRR_RL_Obj_ExistProb_19 :%f",signalvalue1);
	}
}

testcase S4_SRR_RL_Obj_Mes_6_S4_SRR_RL_Obj_Type_19()
{
	signalvalue1 = getSignal(S4_SRR_RL_Obj_Type_19);
	write("S4_SRR_RL_Obj_Type_19 :%f",signalvalue1);
	write("i_S4_SRR_RL_Obj_Type_19 :%o",@ecu_Signals::i_S4_SRR_RL_Obj_Type_19);

	testStep("get expect variable value: ","i_S4_SRR_RL_Obj_Type_19 :%o",@ecu_Signals::i_S4_SRR_RL_Obj_Type_19);

	if(signalvalue1==@ecu_Signals::i_S4_SRR_RL_Obj_Type_19)
	{
	testStepPass("Pass","i_S4_SRR_RL_Obj_Type_19 :%f",signalvalue1);
	}
	else
	{
	testStepFail("Fail","i_S4_SRR_RL_Obj_Type_19 :%f",signalvalue1);
	}
}

testcase S4_SRR_RL_Obj_Mes_6_S4_SRR_RL_Obj_EDynProp_19()
{
	signalvalue1 = getSignal(S4_SRR_RL_Obj_EDynProp_19);
	write("S4_SRR_RL_Obj_EDynProp_19 :%f",signalvalue1);
	write("i_S4_SRR_RL_Obj_EDynProp_19 :%o",@ecu_Signals::i_S4_SRR_RL_Obj_EDynProp_19);

	testStep("get expect variable value: ","i_S4_SRR_RL_Obj_EDynProp_19 :%o",@ecu_Signals::i_S4_SRR_RL_Obj_EDynProp_19);

	if(signalvalue1==@ecu_Signals::i_S4_SRR_RL_Obj_EDynProp_19)
	{
	testStepPass("Pass","i_S4_SRR_RL_Obj_EDynProp_19 :%f",signalvalue1);
	}
	else
	{
	testStepFail("Fail","i_S4_SRR_RL_Obj_EDynProp_19 :%f",signalvalue1);
	}
}

testcase S4_SRR_RL_Obj_Mes_6_S4_SRR_RL_Obj_UiLifeCycles_19()
{
	signalvalue1 = getSignal(S4_SRR_RL_Obj_UiLifeCycles_19);
	write("S4_SRR_RL_Obj_UiLifeCycles_19 :%f",signalvalue1);
	write("i_S4_SRR_RL_Obj_UiLifeCycles_19 :%o",@ecu_Signals::i_S4_SRR_RL_Obj_UiLifeCycles_19);

	testStep("get expect variable value: ","i_S4_SRR_RL_Obj_UiLifeCycles_19 :%o",@ecu_Signals::i_S4_SRR_RL_Obj_UiLifeCycles_19);

	if(signalvalue1==@ecu_Signals::i_S4_SRR_RL_Obj_UiLifeCycles_19)
	{
	testStepPass("Pass","i_S4_SRR_RL_Obj_UiLifeCycles_19 :%f",signalvalue1);
	}
	else
	{
	testStepFail("Fail","i_S4_SRR_RL_Obj_UiLifeCycles_19 :%f",signalvalue1);
	}
}

testcase S4_SRR_RL_Obj_Mes_6_S4_SRR_RL_Obj_ID_20()
{
	signalvalue1 = getSignal(S4_SRR_RL_Obj_ID_20);
	write("S4_SRR_RL_Obj_ID_20 :%f",signalvalue1);
	write("i_S4_SRR_RL_Obj_ID_20 :%o",@ecu_Signals::i_S4_SRR_RL_Obj_ID_20);

	testStep("get expect variable value: ","i_S4_SRR_RL_Obj_ID_20 :%o",@ecu_Signals::i_S4_SRR_RL_Obj_ID_20);

	if(signalvalue1==@ecu_Signals::i_S4_SRR_RL_Obj_ID_20)
	{
	testStepPass("Pass","i_S4_SRR_RL_Obj_ID_20 :%f",signalvalue1);
	}
	else
	{
	testStepFail("Fail","i_S4_SRR_RL_Obj_ID_20 :%f",signalvalue1);
	}
}

testcase S4_SRR_RL_Obj_Mes_6_S4_SRR_RL_Obj_DistX_20()
{
	signalvalue1 = getSignal(S4_SRR_RL_Obj_DistX_20);
	write("S4_SRR_RL_Obj_DistX_20 :%f",signalvalue1);
	write("i_S4_SRR_RL_Obj_DistX_20 :%f",@ecu_Signals::i_S4_SRR_RL_Obj_DistX_20);

	testStep("get expect variable value: ","i_S4_SRR_RL_Obj_DistX_20 :%f",@ecu_Signals::i_S4_SRR_RL_Obj_DistX_20);

	if((abs(@ecu_Signals::i_S4_SRR_RL_Obj_DistX_20)*0.9<=abs(signalvalue1))&&(abs(signalvalue1)<=abs(@ecu_Signals::i_S4_SRR_RL_Obj_DistX_20)*1.1))
	{
	testStepPass("Pass","i_S4_SRR_RL_Obj_DistX_20 :%f",signalvalue1);
	}
	else
	{
	testStepFail("Fail","i_S4_SRR_RL_Obj_DistX_20 :%f",signalvalue1);
	}
}

testcase S4_SRR_RL_Obj_Mes_6_S4_SRR_RL_Obj_RelVelX_20()
{
	signalvalue1 = getSignal(S4_SRR_RL_Obj_RelVelX_20);
	write("S4_SRR_RL_Obj_RelVelX_20 :%f",signalvalue1);
	write("i_S4_SRR_RL_Obj_RelVelX_20 :%f",@ecu_Signals::i_S4_SRR_RL_Obj_RelVelX_20);

	testStep("get expect variable value: ","i_S4_SRR_RL_Obj_RelVelX_20 :%f",@ecu_Signals::i_S4_SRR_RL_Obj_RelVelX_20);

	if((abs(@ecu_Signals::i_S4_SRR_RL_Obj_RelVelX_20)*0.9<=abs(signalvalue1))&&(abs(signalvalue1)<=abs(@ecu_Signals::i_S4_SRR_RL_Obj_RelVelX_20)*1.1))
	{
	testStepPass("Pass","i_S4_SRR_RL_Obj_RelVelX_20 :%f",signalvalue1);
	}
	else
	{
	testStepFail("Fail","i_S4_SRR_RL_Obj_RelVelX_20 :%f",signalvalue1);
	}
}

testcase S4_SRR_RL_Obj_Mes_6_S4_SRR_RL_Obj_AccelX_20()
{
	signalvalue1 = getSignal(S4_SRR_RL_Obj_AccelX_20);
	write("S4_SRR_RL_Obj_AccelX_20 :%f",signalvalue1);
	write("i_S4_SRR_RL_Obj_AccelX_20 :%f",@ecu_Signals::i_S4_SRR_RL_Obj_AccelX_20);

	testStep("get expect variable value: ","i_S4_SRR_RL_Obj_AccelX_20 :%f",@ecu_Signals::i_S4_SRR_RL_Obj_AccelX_20);

	if((abs(@ecu_Signals::i_S4_SRR_RL_Obj_AccelX_20)*0.9<=abs(signalvalue1))&&(abs(signalvalue1)<=abs(@ecu_Signals::i_S4_SRR_RL_Obj_AccelX_20)*1.1))
	{
	testStepPass("Pass","i_S4_SRR_RL_Obj_AccelX_20 :%f",signalvalue1);
	}
	else
	{
	testStepFail("Fail","i_S4_SRR_RL_Obj_AccelX_20 :%f",signalvalue1);
	}
}

testcase S4_SRR_RL_Obj_Mes_6_S4_SRR_RL_Obj_DistY_20()
{
	signalvalue1 = getSignal(S4_SRR_RL_Obj_DistY_20);
	write("S4_SRR_RL_Obj_DistY_20 :%f",signalvalue1);
	write("i_S4_SRR_RL_Obj_DistY_20 :%f",@ecu_Signals::i_S4_SRR_RL_Obj_DistY_20);

	testStep("get expect variable value: ","i_S4_SRR_RL_Obj_DistY_20 :%f",@ecu_Signals::i_S4_SRR_RL_Obj_DistY_20);

	if((abs(@ecu_Signals::i_S4_SRR_RL_Obj_DistY_20)*0.9<=abs(signalvalue1))&&(abs(signalvalue1)<=abs(@ecu_Signals::i_S4_SRR_RL_Obj_DistY_20)*1.1))
	{
	testStepPass("Pass","i_S4_SRR_RL_Obj_DistY_20 :%f",signalvalue1);
	}
	else
	{
	testStepFail("Fail","i_S4_SRR_RL_Obj_DistY_20 :%f",signalvalue1);
	}
}

testcase S4_SRR_RL_Obj_Mes_6_S4_SRR_RL_Obj_RelVelY_20()
{
	signalvalue1 = getSignal(S4_SRR_RL_Obj_RelVelY_20);
	write("S4_SRR_RL_Obj_RelVelY_20 :%f",signalvalue1);
	write("i_S4_SRR_RL_Obj_RelVelY_20 :%f",@ecu_Signals::i_S4_SRR_RL_Obj_RelVelY_20);

	testStep("get expect variable value: ","i_S4_SRR_RL_Obj_RelVelY_20 :%f",@ecu_Signals::i_S4_SRR_RL_Obj_RelVelY_20);

	if((abs(@ecu_Signals::i_S4_SRR_RL_Obj_RelVelY_20)*0.9<=abs(signalvalue1))&&(abs(signalvalue1)<=abs(@ecu_Signals::i_S4_SRR_RL_Obj_RelVelY_20)*1.1))
	{
	testStepPass("Pass","i_S4_SRR_RL_Obj_RelVelY_20 :%f",signalvalue1);
	}
	else
	{
	testStepFail("Fail","i_S4_SRR_RL_Obj_RelVelY_20 :%f",signalvalue1);
	}
}

testcase S4_SRR_RL_Obj_Mes_6_S4_SRR_RL_Obj_AccelY_20()
{
	signalvalue1 = getSignal(S4_SRR_RL_Obj_AccelY_20);
	write("S4_SRR_RL_Obj_AccelY_20 :%f",signalvalue1);
	write("i_S4_SRR_RL_Obj_AccelY_20 :%f",@ecu_Signals::i_S4_SRR_RL_Obj_AccelY_20);

	testStep("get expect variable value: ","i_S4_SRR_RL_Obj_AccelY_20 :%f",@ecu_Signals::i_S4_SRR_RL_Obj_AccelY_20);

	if((abs(@ecu_Signals::i_S4_SRR_RL_Obj_AccelY_20)*0.9<=abs(signalvalue1))&&(abs(signalvalue1)<=abs(@ecu_Signals::i_S4_SRR_RL_Obj_AccelY_20)*1.1))
	{
	testStepPass("Pass","i_S4_SRR_RL_Obj_AccelY_20 :%f",signalvalue1);
	}
	else
	{
	testStepFail("Fail","i_S4_SRR_RL_Obj_AccelY_20 :%f",signalvalue1);
	}
}

testcase S4_SRR_RL_Obj_Mes_6_S4_SRR_RL_Obj_DistXStd_20()
{
	signalvalue1 = getSignal(S4_SRR_RL_Obj_DistXStd_20);
	write("S4_SRR_RL_Obj_DistXStd_20 :%f",signalvalue1);
	write("i_S4_SRR_RL_Obj_DistXStd_20 :%f",@ecu_Signals::i_S4_SRR_RL_Obj_DistXStd_20);

	testStep("get expect variable value: ","i_S4_SRR_RL_Obj_DistXStd_20 :%f",@ecu_Signals::i_S4_SRR_RL_Obj_DistXStd_20);

	if((abs(@ecu_Signals::i_S4_SRR_RL_Obj_DistXStd_20)*0.9<=abs(signalvalue1))&&(abs(signalvalue1)<=abs(@ecu_Signals::i_S4_SRR_RL_Obj_DistXStd_20)*1.1))
	{
	testStepPass("Pass","i_S4_SRR_RL_Obj_DistXStd_20 :%f",signalvalue1);
	}
	else
	{
	testStepFail("Fail","i_S4_SRR_RL_Obj_DistXStd_20 :%f",signalvalue1);
	}
}

testcase S4_SRR_RL_Obj_Mes_6_S4_SRR_RL_Obj_RelVelXStd_20()
{
	signalvalue1 = getSignal(S4_SRR_RL_Obj_RelVelXStd_20);
	write("S4_SRR_RL_Obj_RelVelXStd_20 :%f",signalvalue1);
	write("i_S4_SRR_RL_Obj_RelVelXStd_20 :%f",@ecu_Signals::i_S4_SRR_RL_Obj_RelVelXStd_20);

	testStep("get expect variable value: ","i_S4_SRR_RL_Obj_RelVelXStd_20 :%f",@ecu_Signals::i_S4_SRR_RL_Obj_RelVelXStd_20);

	if((abs(@ecu_Signals::i_S4_SRR_RL_Obj_RelVelXStd_20)*0.9<=abs(signalvalue1))&&(abs(signalvalue1)<=abs(@ecu_Signals::i_S4_SRR_RL_Obj_RelVelXStd_20)*1.1))
	{
	testStepPass("Pass","i_S4_SRR_RL_Obj_RelVelXStd_20 :%f",signalvalue1);
	}
	else
	{
	testStepFail("Fail","i_S4_SRR_RL_Obj_RelVelXStd_20 :%f",signalvalue1);
	}
}

testcase S4_SRR_RL_Obj_Mes_6_S4_SRR_RL_Obj_DistYStd_20()
{
	signalvalue1 = getSignal(S4_SRR_RL_Obj_DistYStd_20);
	write("S4_SRR_RL_Obj_DistYStd_20 :%f",signalvalue1);
	write("i_S4_SRR_RL_Obj_DistYStd_20 :%f",@ecu_Signals::i_S4_SRR_RL_Obj_DistYStd_20);

	testStep("get expect variable value: ","i_S4_SRR_RL_Obj_DistYStd_20 :%f",@ecu_Signals::i_S4_SRR_RL_Obj_DistYStd_20);

	if((abs(@ecu_Signals::i_S4_SRR_RL_Obj_DistYStd_20)*0.9<=abs(signalvalue1))&&(abs(signalvalue1)<=abs(@ecu_Signals::i_S4_SRR_RL_Obj_DistYStd_20)*1.1))
	{
	testStepPass("Pass","i_S4_SRR_RL_Obj_DistYStd_20 :%f",signalvalue1);
	}
	else
	{
	testStepFail("Fail","i_S4_SRR_RL_Obj_DistYStd_20 :%f",signalvalue1);
	}
}

testcase S4_SRR_RL_Obj_Mes_6_S4_SRR_RL_Obj_RelVelYStd_20()
{
	signalvalue1 = getSignal(S4_SRR_RL_Obj_RelVelYStd_20);
	write("S4_SRR_RL_Obj_RelVelYStd_20 :%f",signalvalue1);
	write("i_S4_SRR_RL_Obj_RelVelYStd_20 :%f",@ecu_Signals::i_S4_SRR_RL_Obj_RelVelYStd_20);

	testStep("get expect variable value: ","i_S4_SRR_RL_Obj_RelVelYStd_20 :%f",@ecu_Signals::i_S4_SRR_RL_Obj_RelVelYStd_20);

	if((abs(@ecu_Signals::i_S4_SRR_RL_Obj_RelVelYStd_20)*0.9<=abs(signalvalue1))&&(abs(signalvalue1)<=abs(@ecu_Signals::i_S4_SRR_RL_Obj_RelVelYStd_20)*1.1))
	{
	testStepPass("Pass","i_S4_SRR_RL_Obj_RelVelYStd_20 :%f",signalvalue1);
	}
	else
	{
	testStepFail("Fail","i_S4_SRR_RL_Obj_RelVelYStd_20 :%f",signalvalue1);
	}
}

testcase S4_SRR_RL_Obj_Mes_6_S4_SRR_RL_Obj_UpdateFlag_20()
{
	signalvalue1 = getSignal(S4_SRR_RL_Obj_UpdateFlag_20);
	write("S4_SRR_RL_Obj_UpdateFlag_20 :%f",signalvalue1);
	write("i_S4_SRR_RL_Obj_UpdateFlag_20 :%o",@ecu_Signals::i_S4_SRR_RL_Obj_UpdateFlag_20);

	testStep("get expect variable value: ","i_S4_SRR_RL_Obj_UpdateFlag_20 :%o",@ecu_Signals::i_S4_SRR_RL_Obj_UpdateFlag_20);

	if(signalvalue1==@ecu_Signals::i_S4_SRR_RL_Obj_UpdateFlag_20)
	{
	testStepPass("Pass","i_S4_SRR_RL_Obj_UpdateFlag_20 :%f",signalvalue1);
	}
	else
	{
	testStepFail("Fail","i_S4_SRR_RL_Obj_UpdateFlag_20 :%f",signalvalue1);
	}
}

testcase S4_SRR_RL_Obj_Mes_6_S4_SRR_RL_Obj_ExistProb_20()
{
	signalvalue1 = getSignal(S4_SRR_RL_Obj_ExistProb_20);
	write("S4_SRR_RL_Obj_ExistProb_20 :%f",signalvalue1);
	write("i_S4_SRR_RL_Obj_ExistProb_20 :%o",@ecu_Signals::i_S4_SRR_RL_Obj_ExistProb_20);

	testStep("get expect variable value: ","i_S4_SRR_RL_Obj_ExistProb_20 :%o",@ecu_Signals::i_S4_SRR_RL_Obj_ExistProb_20);

	if(signalvalue1==@ecu_Signals::i_S4_SRR_RL_Obj_ExistProb_20)
	{
	testStepPass("Pass","i_S4_SRR_RL_Obj_ExistProb_20 :%f",signalvalue1);
	}
	else
	{
	testStepFail("Fail","i_S4_SRR_RL_Obj_ExistProb_20 :%f",signalvalue1);
	}
}

testcase S4_SRR_RL_Obj_Mes_6_S4_SRR_RL_Obj_Type_20()
{
	signalvalue1 = getSignal(S4_SRR_RL_Obj_Type_20);
	write("S4_SRR_RL_Obj_Type_20 :%f",signalvalue1);
	write("i_S4_SRR_RL_Obj_Type_20 :%o",@ecu_Signals::i_S4_SRR_RL_Obj_Type_20);

	testStep("get expect variable value: ","i_S4_SRR_RL_Obj_Type_20 :%o",@ecu_Signals::i_S4_SRR_RL_Obj_Type_20);

	if(signalvalue1==@ecu_Signals::i_S4_SRR_RL_Obj_Type_20)
	{
	testStepPass("Pass","i_S4_SRR_RL_Obj_Type_20 :%f",signalvalue1);
	}
	else
	{
	testStepFail("Fail","i_S4_SRR_RL_Obj_Type_20 :%f",signalvalue1);
	}
}

testcase S4_SRR_RL_Obj_Mes_6_S4_SRR_RL_Obj_EDynProp_20()
{
	signalvalue1 = getSignal(S4_SRR_RL_Obj_EDynProp_20);
	write("S4_SRR_RL_Obj_EDynProp_20 :%f",signalvalue1);
	write("i_S4_SRR_RL_Obj_EDynProp_20 :%o",@ecu_Signals::i_S4_SRR_RL_Obj_EDynProp_20);

	testStep("get expect variable value: ","i_S4_SRR_RL_Obj_EDynProp_20 :%o",@ecu_Signals::i_S4_SRR_RL_Obj_EDynProp_20);

	if(signalvalue1==@ecu_Signals::i_S4_SRR_RL_Obj_EDynProp_20)
	{
	testStepPass("Pass","i_S4_SRR_RL_Obj_EDynProp_20 :%f",signalvalue1);
	}
	else
	{
	testStepFail("Fail","i_S4_SRR_RL_Obj_EDynProp_20 :%f",signalvalue1);
	}
}

testcase S4_SRR_RL_Obj_Mes_6_S4_SRR_RL_Obj_UiLifeCycles_20()
{
	signalvalue1 = getSignal(S4_SRR_RL_Obj_UiLifeCycles_20);
	write("S4_SRR_RL_Obj_UiLifeCycles_20 :%f",signalvalue1);
	write("i_S4_SRR_RL_Obj_UiLifeCycles_20 :%o",@ecu_Signals::i_S4_SRR_RL_Obj_UiLifeCycles_20);

	testStep("get expect variable value: ","i_S4_SRR_RL_Obj_UiLifeCycles_20 :%o",@ecu_Signals::i_S4_SRR_RL_Obj_UiLifeCycles_20);

	if(signalvalue1==@ecu_Signals::i_S4_SRR_RL_Obj_UiLifeCycles_20)
	{
	testStepPass("Pass","i_S4_SRR_RL_Obj_UiLifeCycles_20 :%f",signalvalue1);
	}
	else
	{
	testStepFail("Fail","i_S4_SRR_RL_Obj_UiLifeCycles_20 :%f",signalvalue1);
	}
}

testcase S4_SRR_RL_Obj_Mes_7_S4_SRR_RL_Obj_ID_21()
{
	signalvalue1 = getSignal(S4_SRR_RL_Obj_ID_21);
	write("S4_SRR_RL_Obj_ID_21 :%f",signalvalue1);
	write("i_S4_SRR_RL_Obj_ID_21 :%o",@ecu_Signals::i_S4_SRR_RL_Obj_ID_21);

	testStep("get expect variable value: ","i_S4_SRR_RL_Obj_ID_21 :%o",@ecu_Signals::i_S4_SRR_RL_Obj_ID_21);

	if(signalvalue1==@ecu_Signals::i_S4_SRR_RL_Obj_ID_21)
	{
	testStepPass("Pass","i_S4_SRR_RL_Obj_ID_21 :%f",signalvalue1);
	}
	else
	{
	testStepFail("Fail","i_S4_SRR_RL_Obj_ID_21 :%f",signalvalue1);
	}
}

testcase S4_SRR_RL_Obj_Mes_7_S4_SRR_RL_Obj_DistX_21()
{
	signalvalue1 = getSignal(S4_SRR_RL_Obj_DistX_21);
	write("S4_SRR_RL_Obj_DistX_21 :%f",signalvalue1);
	write("i_S4_SRR_RL_Obj_DistX_21 :%f",@ecu_Signals::i_S4_SRR_RL_Obj_DistX_21);

	testStep("get expect variable value: ","i_S4_SRR_RL_Obj_DistX_21 :%f",@ecu_Signals::i_S4_SRR_RL_Obj_DistX_21);

	if((abs(@ecu_Signals::i_S4_SRR_RL_Obj_DistX_21)*0.9<=abs(signalvalue1))&&(abs(signalvalue1)<=abs(@ecu_Signals::i_S4_SRR_RL_Obj_DistX_21)*1.1))
	{
	testStepPass("Pass","i_S4_SRR_RL_Obj_DistX_21 :%f",signalvalue1);
	}
	else
	{
	testStepFail("Fail","i_S4_SRR_RL_Obj_DistX_21 :%f",signalvalue1);
	}
}

testcase S4_SRR_RL_Obj_Mes_7_S4_SRR_RL_Obj_RelVelX_21()
{
	signalvalue1 = getSignal(S4_SRR_RL_Obj_RelVelX_21);
	write("S4_SRR_RL_Obj_RelVelX_21 :%f",signalvalue1);
	write("i_S4_SRR_RL_Obj_RelVelX_21 :%f",@ecu_Signals::i_S4_SRR_RL_Obj_RelVelX_21);

	testStep("get expect variable value: ","i_S4_SRR_RL_Obj_RelVelX_21 :%f",@ecu_Signals::i_S4_SRR_RL_Obj_RelVelX_21);

	if((abs(@ecu_Signals::i_S4_SRR_RL_Obj_RelVelX_21)*0.9<=abs(signalvalue1))&&(abs(signalvalue1)<=abs(@ecu_Signals::i_S4_SRR_RL_Obj_RelVelX_21)*1.1))
	{
	testStepPass("Pass","i_S4_SRR_RL_Obj_RelVelX_21 :%f",signalvalue1);
	}
	else
	{
	testStepFail("Fail","i_S4_SRR_RL_Obj_RelVelX_21 :%f",signalvalue1);
	}
}

testcase S4_SRR_RL_Obj_Mes_7_S4_SRR_RL_Obj_AccelX_21()
{
	signalvalue1 = getSignal(S4_SRR_RL_Obj_AccelX_21);
	write("S4_SRR_RL_Obj_AccelX_21 :%f",signalvalue1);
	write("i_S4_SRR_RL_Obj_AccelX_21 :%f",@ecu_Signals::i_S4_SRR_RL_Obj_AccelX_21);

	testStep("get expect variable value: ","i_S4_SRR_RL_Obj_AccelX_21 :%f",@ecu_Signals::i_S4_SRR_RL_Obj_AccelX_21);

	if((abs(@ecu_Signals::i_S4_SRR_RL_Obj_AccelX_21)*0.9<=abs(signalvalue1))&&(abs(signalvalue1)<=abs(@ecu_Signals::i_S4_SRR_RL_Obj_AccelX_21)*1.1))
	{
	testStepPass("Pass","i_S4_SRR_RL_Obj_AccelX_21 :%f",signalvalue1);
	}
	else
	{
	testStepFail("Fail","i_S4_SRR_RL_Obj_AccelX_21 :%f",signalvalue1);
	}
}

testcase S4_SRR_RL_Obj_Mes_7_S4_SRR_RL_Obj_DistY_21()
{
	signalvalue1 = getSignal(S4_SRR_RL_Obj_DistY_21);
	write("S4_SRR_RL_Obj_DistY_21 :%f",signalvalue1);
	write("i_S4_SRR_RL_Obj_DistY_21 :%f",@ecu_Signals::i_S4_SRR_RL_Obj_DistY_21);

	testStep("get expect variable value: ","i_S4_SRR_RL_Obj_DistY_21 :%f",@ecu_Signals::i_S4_SRR_RL_Obj_DistY_21);

	if((abs(@ecu_Signals::i_S4_SRR_RL_Obj_DistY_21)*0.9<=abs(signalvalue1))&&(abs(signalvalue1)<=abs(@ecu_Signals::i_S4_SRR_RL_Obj_DistY_21)*1.1))
	{
	testStepPass("Pass","i_S4_SRR_RL_Obj_DistY_21 :%f",signalvalue1);
	}
	else
	{
	testStepFail("Fail","i_S4_SRR_RL_Obj_DistY_21 :%f",signalvalue1);
	}
}

testcase S4_SRR_RL_Obj_Mes_7_S4_SRR_RL_Obj_RelVelY_21()
{
	signalvalue1 = getSignal(S4_SRR_RL_Obj_RelVelY_21);
	write("S4_SRR_RL_Obj_RelVelY_21 :%f",signalvalue1);
	write("i_S4_SRR_RL_Obj_RelVelY_21 :%f",@ecu_Signals::i_S4_SRR_RL_Obj_RelVelY_21);

	testStep("get expect variable value: ","i_S4_SRR_RL_Obj_RelVelY_21 :%f",@ecu_Signals::i_S4_SRR_RL_Obj_RelVelY_21);

	if((abs(@ecu_Signals::i_S4_SRR_RL_Obj_RelVelY_21)*0.9<=abs(signalvalue1))&&(abs(signalvalue1)<=abs(@ecu_Signals::i_S4_SRR_RL_Obj_RelVelY_21)*1.1))
	{
	testStepPass("Pass","i_S4_SRR_RL_Obj_RelVelY_21 :%f",signalvalue1);
	}
	else
	{
	testStepFail("Fail","i_S4_SRR_RL_Obj_RelVelY_21 :%f",signalvalue1);
	}
}

testcase S4_SRR_RL_Obj_Mes_7_S4_SRR_RL_Obj_AccelY_21()
{
	signalvalue1 = getSignal(S4_SRR_RL_Obj_AccelY_21);
	write("S4_SRR_RL_Obj_AccelY_21 :%f",signalvalue1);
	write("i_S4_SRR_RL_Obj_AccelY_21 :%f",@ecu_Signals::i_S4_SRR_RL_Obj_AccelY_21);

	testStep("get expect variable value: ","i_S4_SRR_RL_Obj_AccelY_21 :%f",@ecu_Signals::i_S4_SRR_RL_Obj_AccelY_21);

	if((abs(@ecu_Signals::i_S4_SRR_RL_Obj_AccelY_21)*0.9<=abs(signalvalue1))&&(abs(signalvalue1)<=abs(@ecu_Signals::i_S4_SRR_RL_Obj_AccelY_21)*1.1))
	{
	testStepPass("Pass","i_S4_SRR_RL_Obj_AccelY_21 :%f",signalvalue1);
	}
	else
	{
	testStepFail("Fail","i_S4_SRR_RL_Obj_AccelY_21 :%f",signalvalue1);
	}
}

testcase S4_SRR_RL_Obj_Mes_7_S4_SRR_RL_Obj_DistXStd_21()
{
	signalvalue1 = getSignal(S4_SRR_RL_Obj_DistXStd_21);
	write("S4_SRR_RL_Obj_DistXStd_21 :%f",signalvalue1);
	write("i_S4_SRR_RL_Obj_DistXStd_21 :%f",@ecu_Signals::i_S4_SRR_RL_Obj_DistXStd_21);

	testStep("get expect variable value: ","i_S4_SRR_RL_Obj_DistXStd_21 :%f",@ecu_Signals::i_S4_SRR_RL_Obj_DistXStd_21);

	if((abs(@ecu_Signals::i_S4_SRR_RL_Obj_DistXStd_21)*0.9<=abs(signalvalue1))&&(abs(signalvalue1)<=abs(@ecu_Signals::i_S4_SRR_RL_Obj_DistXStd_21)*1.1))
	{
	testStepPass("Pass","i_S4_SRR_RL_Obj_DistXStd_21 :%f",signalvalue1);
	}
	else
	{
	testStepFail("Fail","i_S4_SRR_RL_Obj_DistXStd_21 :%f",signalvalue1);
	}
}

testcase S4_SRR_RL_Obj_Mes_7_S4_SRR_RL_Obj_RelVelXStd_21()
{
	signalvalue1 = getSignal(S4_SRR_RL_Obj_RelVelXStd_21);
	write("S4_SRR_RL_Obj_RelVelXStd_21 :%f",signalvalue1);
	write("i_S4_SRR_RL_Obj_RelVelXStd_21 :%f",@ecu_Signals::i_S4_SRR_RL_Obj_RelVelXStd_21);

	testStep("get expect variable value: ","i_S4_SRR_RL_Obj_RelVelXStd_21 :%f",@ecu_Signals::i_S4_SRR_RL_Obj_RelVelXStd_21);

	if((abs(@ecu_Signals::i_S4_SRR_RL_Obj_RelVelXStd_21)*0.9<=abs(signalvalue1))&&(abs(signalvalue1)<=abs(@ecu_Signals::i_S4_SRR_RL_Obj_RelVelXStd_21)*1.1))
	{
	testStepPass("Pass","i_S4_SRR_RL_Obj_RelVelXStd_21 :%f",signalvalue1);
	}
	else
	{
	testStepFail("Fail","i_S4_SRR_RL_Obj_RelVelXStd_21 :%f",signalvalue1);
	}
}

testcase S4_SRR_RL_Obj_Mes_7_S4_SRR_RL_Obj_DistYStd_21()
{
	signalvalue1 = getSignal(S4_SRR_RL_Obj_DistYStd_21);
	write("S4_SRR_RL_Obj_DistYStd_21 :%f",signalvalue1);
	write("i_S4_SRR_RL_Obj_DistYStd_21 :%f",@ecu_Signals::i_S4_SRR_RL_Obj_DistYStd_21);

	testStep("get expect variable value: ","i_S4_SRR_RL_Obj_DistYStd_21 :%f",@ecu_Signals::i_S4_SRR_RL_Obj_DistYStd_21);

	if((abs(@ecu_Signals::i_S4_SRR_RL_Obj_DistYStd_21)*0.9<=abs(signalvalue1))&&(abs(signalvalue1)<=abs(@ecu_Signals::i_S4_SRR_RL_Obj_DistYStd_21)*1.1))
	{
	testStepPass("Pass","i_S4_SRR_RL_Obj_DistYStd_21 :%f",signalvalue1);
	}
	else
	{
	testStepFail("Fail","i_S4_SRR_RL_Obj_DistYStd_21 :%f",signalvalue1);
	}
}

testcase S4_SRR_RL_Obj_Mes_7_S4_SRR_RL_Obj_RelVelYStd_21()
{
	signalvalue1 = getSignal(S4_SRR_RL_Obj_RelVelYStd_21);
	write("S4_SRR_RL_Obj_RelVelYStd_21 :%f",signalvalue1);
	write("i_S4_SRR_RL_Obj_RelVelYStd_21 :%f",@ecu_Signals::i_S4_SRR_RL_Obj_RelVelYStd_21);

	testStep("get expect variable value: ","i_S4_SRR_RL_Obj_RelVelYStd_21 :%f",@ecu_Signals::i_S4_SRR_RL_Obj_RelVelYStd_21);

	if((abs(@ecu_Signals::i_S4_SRR_RL_Obj_RelVelYStd_21)*0.9<=abs(signalvalue1))&&(abs(signalvalue1)<=abs(@ecu_Signals::i_S4_SRR_RL_Obj_RelVelYStd_21)*1.1))
	{
	testStepPass("Pass","i_S4_SRR_RL_Obj_RelVelYStd_21 :%f",signalvalue1);
	}
	else
	{
	testStepFail("Fail","i_S4_SRR_RL_Obj_RelVelYStd_21 :%f",signalvalue1);
	}
}

testcase S4_SRR_RL_Obj_Mes_7_S4_SRR_RL_Obj_UpdateFlag_21()
{
	signalvalue1 = getSignal(S4_SRR_RL_Obj_UpdateFlag_21);
	write("S4_SRR_RL_Obj_UpdateFlag_21 :%f",signalvalue1);
	write("i_S4_SRR_RL_Obj_UpdateFlag_21 :%o",@ecu_Signals::i_S4_SRR_RL_Obj_UpdateFlag_21);

	testStep("get expect variable value: ","i_S4_SRR_RL_Obj_UpdateFlag_21 :%o",@ecu_Signals::i_S4_SRR_RL_Obj_UpdateFlag_21);

	if(signalvalue1==@ecu_Signals::i_S4_SRR_RL_Obj_UpdateFlag_21)
	{
	testStepPass("Pass","i_S4_SRR_RL_Obj_UpdateFlag_21 :%f",signalvalue1);
	}
	else
	{
	testStepFail("Fail","i_S4_SRR_RL_Obj_UpdateFlag_21 :%f",signalvalue1);
	}
}

testcase S4_SRR_RL_Obj_Mes_7_S4_SRR_RL_Obj_ExistProb_21()
{
	signalvalue1 = getSignal(S4_SRR_RL_Obj_ExistProb_21);
	write("S4_SRR_RL_Obj_ExistProb_21 :%f",signalvalue1);
	write("i_S4_SRR_RL_Obj_ExistProb_21 :%o",@ecu_Signals::i_S4_SRR_RL_Obj_ExistProb_21);

	testStep("get expect variable value: ","i_S4_SRR_RL_Obj_ExistProb_21 :%o",@ecu_Signals::i_S4_SRR_RL_Obj_ExistProb_21);

	if(signalvalue1==@ecu_Signals::i_S4_SRR_RL_Obj_ExistProb_21)
	{
	testStepPass("Pass","i_S4_SRR_RL_Obj_ExistProb_21 :%f",signalvalue1);
	}
	else
	{
	testStepFail("Fail","i_S4_SRR_RL_Obj_ExistProb_21 :%f",signalvalue1);
	}
}

testcase S4_SRR_RL_Obj_Mes_7_S4_SRR_RL_Obj_Type_21()
{
	signalvalue1 = getSignal(S4_SRR_RL_Obj_Type_21);
	write("S4_SRR_RL_Obj_Type_21 :%f",signalvalue1);
	write("i_S4_SRR_RL_Obj_Type_21 :%o",@ecu_Signals::i_S4_SRR_RL_Obj_Type_21);

	testStep("get expect variable value: ","i_S4_SRR_RL_Obj_Type_21 :%o",@ecu_Signals::i_S4_SRR_RL_Obj_Type_21);

	if(signalvalue1==@ecu_Signals::i_S4_SRR_RL_Obj_Type_21)
	{
	testStepPass("Pass","i_S4_SRR_RL_Obj_Type_21 :%f",signalvalue1);
	}
	else
	{
	testStepFail("Fail","i_S4_SRR_RL_Obj_Type_21 :%f",signalvalue1);
	}
}

testcase S4_SRR_RL_Obj_Mes_7_S4_SRR_RL_Obj_EDynProp_21()
{
	signalvalue1 = getSignal(S4_SRR_RL_Obj_EDynProp_21);
	write("S4_SRR_RL_Obj_EDynProp_21 :%f",signalvalue1);
	write("i_S4_SRR_RL_Obj_EDynProp_21 :%o",@ecu_Signals::i_S4_SRR_RL_Obj_EDynProp_21);

	testStep("get expect variable value: ","i_S4_SRR_RL_Obj_EDynProp_21 :%o",@ecu_Signals::i_S4_SRR_RL_Obj_EDynProp_21);

	if(signalvalue1==@ecu_Signals::i_S4_SRR_RL_Obj_EDynProp_21)
	{
	testStepPass("Pass","i_S4_SRR_RL_Obj_EDynProp_21 :%f",signalvalue1);
	}
	else
	{
	testStepFail("Fail","i_S4_SRR_RL_Obj_EDynProp_21 :%f",signalvalue1);
	}
}

testcase S4_SRR_RL_Obj_Mes_7_S4_SRR_RL_Obj_UiLifeCycles_21()
{
	signalvalue1 = getSignal(S4_SRR_RL_Obj_UiLifeCycles_21);
	write("S4_SRR_RL_Obj_UiLifeCycles_21 :%f",signalvalue1);
	write("i_S4_SRR_RL_Obj_UiLifeCycles_21 :%o",@ecu_Signals::i_S4_SRR_RL_Obj_UiLifeCycles_21);

	testStep("get expect variable value: ","i_S4_SRR_RL_Obj_UiLifeCycles_21 :%o",@ecu_Signals::i_S4_SRR_RL_Obj_UiLifeCycles_21);

	if(signalvalue1==@ecu_Signals::i_S4_SRR_RL_Obj_UiLifeCycles_21)
	{
	testStepPass("Pass","i_S4_SRR_RL_Obj_UiLifeCycles_21 :%f",signalvalue1);
	}
	else
	{
	testStepFail("Fail","i_S4_SRR_RL_Obj_UiLifeCycles_21 :%f",signalvalue1);
	}
}

testcase S4_SRR_RL_Obj_Mes_7_S4_SRR_RL_Obj_ID_22()
{
	signalvalue1 = getSignal(S4_SRR_RL_Obj_ID_22);
	write("S4_SRR_RL_Obj_ID_22 :%f",signalvalue1);
	write("i_S4_SRR_RL_Obj_ID_22 :%o",@ecu_Signals::i_S4_SRR_RL_Obj_ID_22);

	testStep("get expect variable value: ","i_S4_SRR_RL_Obj_ID_22 :%o",@ecu_Signals::i_S4_SRR_RL_Obj_ID_22);

	if(signalvalue1==@ecu_Signals::i_S4_SRR_RL_Obj_ID_22)
	{
	testStepPass("Pass","i_S4_SRR_RL_Obj_ID_22 :%f",signalvalue1);
	}
	else
	{
	testStepFail("Fail","i_S4_SRR_RL_Obj_ID_22 :%f",signalvalue1);
	}
}

testcase S4_SRR_RL_Obj_Mes_7_S4_SRR_RL_Obj_DistX_22()
{
	signalvalue1 = getSignal(S4_SRR_RL_Obj_DistX_22);
	write("S4_SRR_RL_Obj_DistX_22 :%f",signalvalue1);
	write("i_S4_SRR_RL_Obj_DistX_22 :%f",@ecu_Signals::i_S4_SRR_RL_Obj_DistX_22);

	testStep("get expect variable value: ","i_S4_SRR_RL_Obj_DistX_22 :%f",@ecu_Signals::i_S4_SRR_RL_Obj_DistX_22);

	if((abs(@ecu_Signals::i_S4_SRR_RL_Obj_DistX_22)*0.9<=abs(signalvalue1))&&(abs(signalvalue1)<=abs(@ecu_Signals::i_S4_SRR_RL_Obj_DistX_22)*1.1))
	{
	testStepPass("Pass","i_S4_SRR_RL_Obj_DistX_22 :%f",signalvalue1);
	}
	else
	{
	testStepFail("Fail","i_S4_SRR_RL_Obj_DistX_22 :%f",signalvalue1);
	}
}

testcase S4_SRR_RL_Obj_Mes_7_S4_SRR_RL_Obj_RelVelX_22()
{
	signalvalue1 = getSignal(S4_SRR_RL_Obj_RelVelX_22);
	write("S4_SRR_RL_Obj_RelVelX_22 :%f",signalvalue1);
	write("i_S4_SRR_RL_Obj_RelVelX_22 :%f",@ecu_Signals::i_S4_SRR_RL_Obj_RelVelX_22);

	testStep("get expect variable value: ","i_S4_SRR_RL_Obj_RelVelX_22 :%f",@ecu_Signals::i_S4_SRR_RL_Obj_RelVelX_22);

	if((abs(@ecu_Signals::i_S4_SRR_RL_Obj_RelVelX_22)*0.9<=abs(signalvalue1))&&(abs(signalvalue1)<=abs(@ecu_Signals::i_S4_SRR_RL_Obj_RelVelX_22)*1.1))
	{
	testStepPass("Pass","i_S4_SRR_RL_Obj_RelVelX_22 :%f",signalvalue1);
	}
	else
	{
	testStepFail("Fail","i_S4_SRR_RL_Obj_RelVelX_22 :%f",signalvalue1);
	}
}

testcase S4_SRR_RL_Obj_Mes_7_S4_SRR_RL_Obj_AccelX_22()
{
	signalvalue1 = getSignal(S4_SRR_RL_Obj_AccelX_22);
	write("S4_SRR_RL_Obj_AccelX_22 :%f",signalvalue1);
	write("i_S4_SRR_RL_Obj_AccelX_22 :%f",@ecu_Signals::i_S4_SRR_RL_Obj_AccelX_22);

	testStep("get expect variable value: ","i_S4_SRR_RL_Obj_AccelX_22 :%f",@ecu_Signals::i_S4_SRR_RL_Obj_AccelX_22);

	if((abs(@ecu_Signals::i_S4_SRR_RL_Obj_AccelX_22)*0.9<=abs(signalvalue1))&&(abs(signalvalue1)<=abs(@ecu_Signals::i_S4_SRR_RL_Obj_AccelX_22)*1.1))
	{
	testStepPass("Pass","i_S4_SRR_RL_Obj_AccelX_22 :%f",signalvalue1);
	}
	else
	{
	testStepFail("Fail","i_S4_SRR_RL_Obj_AccelX_22 :%f",signalvalue1);
	}
}

testcase S4_SRR_RL_Obj_Mes_7_S4_SRR_RL_Obj_DistY_22()
{
	signalvalue1 = getSignal(S4_SRR_RL_Obj_DistY_22);
	write("S4_SRR_RL_Obj_DistY_22 :%f",signalvalue1);
	write("i_S4_SRR_RL_Obj_DistY_22 :%f",@ecu_Signals::i_S4_SRR_RL_Obj_DistY_22);

	testStep("get expect variable value: ","i_S4_SRR_RL_Obj_DistY_22 :%f",@ecu_Signals::i_S4_SRR_RL_Obj_DistY_22);

	if((abs(@ecu_Signals::i_S4_SRR_RL_Obj_DistY_22)*0.9<=abs(signalvalue1))&&(abs(signalvalue1)<=abs(@ecu_Signals::i_S4_SRR_RL_Obj_DistY_22)*1.1))
	{
	testStepPass("Pass","i_S4_SRR_RL_Obj_DistY_22 :%f",signalvalue1);
	}
	else
	{
	testStepFail("Fail","i_S4_SRR_RL_Obj_DistY_22 :%f",signalvalue1);
	}
}

testcase S4_SRR_RL_Obj_Mes_7_S4_SRR_RL_Obj_RelVelY_22()
{
	signalvalue1 = getSignal(S4_SRR_RL_Obj_RelVelY_22);
	write("S4_SRR_RL_Obj_RelVelY_22 :%f",signalvalue1);
	write("i_S4_SRR_RL_Obj_RelVelY_22 :%f",@ecu_Signals::i_S4_SRR_RL_Obj_RelVelY_22);

	testStep("get expect variable value: ","i_S4_SRR_RL_Obj_RelVelY_22 :%f",@ecu_Signals::i_S4_SRR_RL_Obj_RelVelY_22);

	if((abs(@ecu_Signals::i_S4_SRR_RL_Obj_RelVelY_22)*0.9<=abs(signalvalue1))&&(abs(signalvalue1)<=abs(@ecu_Signals::i_S4_SRR_RL_Obj_RelVelY_22)*1.1))
	{
	testStepPass("Pass","i_S4_SRR_RL_Obj_RelVelY_22 :%f",signalvalue1);
	}
	else
	{
	testStepFail("Fail","i_S4_SRR_RL_Obj_RelVelY_22 :%f",signalvalue1);
	}
}

testcase S4_SRR_RL_Obj_Mes_7_S4_SRR_RL_Obj_AccelY_22()
{
	signalvalue1 = getSignal(S4_SRR_RL_Obj_AccelY_22);
	write("S4_SRR_RL_Obj_AccelY_22 :%f",signalvalue1);
	write("i_S4_SRR_RL_Obj_AccelY_22 :%f",@ecu_Signals::i_S4_SRR_RL_Obj_AccelY_22);

	testStep("get expect variable value: ","i_S4_SRR_RL_Obj_AccelY_22 :%f",@ecu_Signals::i_S4_SRR_RL_Obj_AccelY_22);

	if((abs(@ecu_Signals::i_S4_SRR_RL_Obj_AccelY_22)*0.9<=abs(signalvalue1))&&(abs(signalvalue1)<=abs(@ecu_Signals::i_S4_SRR_RL_Obj_AccelY_22)*1.1))
	{
	testStepPass("Pass","i_S4_SRR_RL_Obj_AccelY_22 :%f",signalvalue1);
	}
	else
	{
	testStepFail("Fail","i_S4_SRR_RL_Obj_AccelY_22 :%f",signalvalue1);
	}
}

testcase S4_SRR_RL_Obj_Mes_7_S4_SRR_RL_Obj_DistXStd_22()
{
	signalvalue1 = getSignal(S4_SRR_RL_Obj_DistXStd_22);
	write("S4_SRR_RL_Obj_DistXStd_22 :%f",signalvalue1);
	write("i_S4_SRR_RL_Obj_DistXStd_22 :%f",@ecu_Signals::i_S4_SRR_RL_Obj_DistXStd_22);

	testStep("get expect variable value: ","i_S4_SRR_RL_Obj_DistXStd_22 :%f",@ecu_Signals::i_S4_SRR_RL_Obj_DistXStd_22);

	if((abs(@ecu_Signals::i_S4_SRR_RL_Obj_DistXStd_22)*0.9<=abs(signalvalue1))&&(abs(signalvalue1)<=abs(@ecu_Signals::i_S4_SRR_RL_Obj_DistXStd_22)*1.1))
	{
	testStepPass("Pass","i_S4_SRR_RL_Obj_DistXStd_22 :%f",signalvalue1);
	}
	else
	{
	testStepFail("Fail","i_S4_SRR_RL_Obj_DistXStd_22 :%f",signalvalue1);
	}
}

testcase S4_SRR_RL_Obj_Mes_7_S4_SRR_RL_Obj_RelVelXStd_22()
{
	signalvalue1 = getSignal(S4_SRR_RL_Obj_RelVelXStd_22);
	write("S4_SRR_RL_Obj_RelVelXStd_22 :%f",signalvalue1);
	write("i_S4_SRR_RL_Obj_RelVelXStd_22 :%f",@ecu_Signals::i_S4_SRR_RL_Obj_RelVelXStd_22);

	testStep("get expect variable value: ","i_S4_SRR_RL_Obj_RelVelXStd_22 :%f",@ecu_Signals::i_S4_SRR_RL_Obj_RelVelXStd_22);

	if((abs(@ecu_Signals::i_S4_SRR_RL_Obj_RelVelXStd_22)*0.9<=abs(signalvalue1))&&(abs(signalvalue1)<=abs(@ecu_Signals::i_S4_SRR_RL_Obj_RelVelXStd_22)*1.1))
	{
	testStepPass("Pass","i_S4_SRR_RL_Obj_RelVelXStd_22 :%f",signalvalue1);
	}
	else
	{
	testStepFail("Fail","i_S4_SRR_RL_Obj_RelVelXStd_22 :%f",signalvalue1);
	}
}

testcase S4_SRR_RL_Obj_Mes_7_S4_SRR_RL_Obj_DistYStd_22()
{
	signalvalue1 = getSignal(S4_SRR_RL_Obj_DistYStd_22);
	write("S4_SRR_RL_Obj_DistYStd_22 :%f",signalvalue1);
	write("i_S4_SRR_RL_Obj_DistYStd_22 :%f",@ecu_Signals::i_S4_SRR_RL_Obj_DistYStd_22);

	testStep("get expect variable value: ","i_S4_SRR_RL_Obj_DistYStd_22 :%f",@ecu_Signals::i_S4_SRR_RL_Obj_DistYStd_22);

	if((abs(@ecu_Signals::i_S4_SRR_RL_Obj_DistYStd_22)*0.9<=abs(signalvalue1))&&(abs(signalvalue1)<=abs(@ecu_Signals::i_S4_SRR_RL_Obj_DistYStd_22)*1.1))
	{
	testStepPass("Pass","i_S4_SRR_RL_Obj_DistYStd_22 :%f",signalvalue1);
	}
	else
	{
	testStepFail("Fail","i_S4_SRR_RL_Obj_DistYStd_22 :%f",signalvalue1);
	}
}

testcase S4_SRR_RL_Obj_Mes_7_S4_SRR_RL_Obj_RelVelYStd_22()
{
	signalvalue1 = getSignal(S4_SRR_RL_Obj_RelVelYStd_22);
	write("S4_SRR_RL_Obj_RelVelYStd_22 :%f",signalvalue1);
	write("i_S4_SRR_RL_Obj_RelVelYStd_22 :%f",@ecu_Signals::i_S4_SRR_RL_Obj_RelVelYStd_22);

	testStep("get expect variable value: ","i_S4_SRR_RL_Obj_RelVelYStd_22 :%f",@ecu_Signals::i_S4_SRR_RL_Obj_RelVelYStd_22);

	if((abs(@ecu_Signals::i_S4_SRR_RL_Obj_RelVelYStd_22)*0.9<=abs(signalvalue1))&&(abs(signalvalue1)<=abs(@ecu_Signals::i_S4_SRR_RL_Obj_RelVelYStd_22)*1.1))
	{
	testStepPass("Pass","i_S4_SRR_RL_Obj_RelVelYStd_22 :%f",signalvalue1);
	}
	else
	{
	testStepFail("Fail","i_S4_SRR_RL_Obj_RelVelYStd_22 :%f",signalvalue1);
	}
}

testcase S4_SRR_RL_Obj_Mes_7_S4_SRR_RL_Obj_UpdateFlag_22()
{
	signalvalue1 = getSignal(S4_SRR_RL_Obj_UpdateFlag_22);
	write("S4_SRR_RL_Obj_UpdateFlag_22 :%f",signalvalue1);
	write("i_S4_SRR_RL_Obj_UpdateFlag_22 :%o",@ecu_Signals::i_S4_SRR_RL_Obj_UpdateFlag_22);

	testStep("get expect variable value: ","i_S4_SRR_RL_Obj_UpdateFlag_22 :%o",@ecu_Signals::i_S4_SRR_RL_Obj_UpdateFlag_22);

	if(signalvalue1==@ecu_Signals::i_S4_SRR_RL_Obj_UpdateFlag_22)
	{
	testStepPass("Pass","i_S4_SRR_RL_Obj_UpdateFlag_22 :%f",signalvalue1);
	}
	else
	{
	testStepFail("Fail","i_S4_SRR_RL_Obj_UpdateFlag_22 :%f",signalvalue1);
	}
}

testcase S4_SRR_RL_Obj_Mes_7_S4_SRR_RL_Obj_ExistProb_22()
{
	signalvalue1 = getSignal(S4_SRR_RL_Obj_ExistProb_22);
	write("S4_SRR_RL_Obj_ExistProb_22 :%f",signalvalue1);
	write("i_S4_SRR_RL_Obj_ExistProb_22 :%o",@ecu_Signals::i_S4_SRR_RL_Obj_ExistProb_22);

	testStep("get expect variable value: ","i_S4_SRR_RL_Obj_ExistProb_22 :%o",@ecu_Signals::i_S4_SRR_RL_Obj_ExistProb_22);

	if(signalvalue1==@ecu_Signals::i_S4_SRR_RL_Obj_ExistProb_22)
	{
	testStepPass("Pass","i_S4_SRR_RL_Obj_ExistProb_22 :%f",signalvalue1);
	}
	else
	{
	testStepFail("Fail","i_S4_SRR_RL_Obj_ExistProb_22 :%f",signalvalue1);
	}
}

testcase S4_SRR_RL_Obj_Mes_7_S4_SRR_RL_Obj_Type_22()
{
	signalvalue1 = getSignal(S4_SRR_RL_Obj_Type_22);
	write("S4_SRR_RL_Obj_Type_22 :%f",signalvalue1);
	write("i_S4_SRR_RL_Obj_Type_22 :%o",@ecu_Signals::i_S4_SRR_RL_Obj_Type_22);

	testStep("get expect variable value: ","i_S4_SRR_RL_Obj_Type_22 :%o",@ecu_Signals::i_S4_SRR_RL_Obj_Type_22);

	if(signalvalue1==@ecu_Signals::i_S4_SRR_RL_Obj_Type_22)
	{
	testStepPass("Pass","i_S4_SRR_RL_Obj_Type_22 :%f",signalvalue1);
	}
	else
	{
	testStepFail("Fail","i_S4_SRR_RL_Obj_Type_22 :%f",signalvalue1);
	}
}

testcase S4_SRR_RL_Obj_Mes_7_S4_SRR_RL_Obj_EDynProp_22()
{
	signalvalue1 = getSignal(S4_SRR_RL_Obj_EDynProp_22);
	write("S4_SRR_RL_Obj_EDynProp_22 :%f",signalvalue1);
	write("i_S4_SRR_RL_Obj_EDynProp_22 :%o",@ecu_Signals::i_S4_SRR_RL_Obj_EDynProp_22);

	testStep("get expect variable value: ","i_S4_SRR_RL_Obj_EDynProp_22 :%o",@ecu_Signals::i_S4_SRR_RL_Obj_EDynProp_22);

	if(signalvalue1==@ecu_Signals::i_S4_SRR_RL_Obj_EDynProp_22)
	{
	testStepPass("Pass","i_S4_SRR_RL_Obj_EDynProp_22 :%f",signalvalue1);
	}
	else
	{
	testStepFail("Fail","i_S4_SRR_RL_Obj_EDynProp_22 :%f",signalvalue1);
	}
}

testcase S4_SRR_RL_Obj_Mes_7_S4_SRR_RL_Obj_UiLifeCycles_22()
{
	signalvalue1 = getSignal(S4_SRR_RL_Obj_UiLifeCycles_22);
	write("S4_SRR_RL_Obj_UiLifeCycles_22 :%f",signalvalue1);
	write("i_S4_SRR_RL_Obj_UiLifeCycles_22 :%o",@ecu_Signals::i_S4_SRR_RL_Obj_UiLifeCycles_22);

	testStep("get expect variable value: ","i_S4_SRR_RL_Obj_UiLifeCycles_22 :%o",@ecu_Signals::i_S4_SRR_RL_Obj_UiLifeCycles_22);

	if(signalvalue1==@ecu_Signals::i_S4_SRR_RL_Obj_UiLifeCycles_22)
	{
	testStepPass("Pass","i_S4_SRR_RL_Obj_UiLifeCycles_22 :%f",signalvalue1);
	}
	else
	{
	testStepFail("Fail","i_S4_SRR_RL_Obj_UiLifeCycles_22 :%f",signalvalue1);
	}
}

testcase S4_SRR_RL_Obj_Mes_7_S4_SRR_RL_Obj_ID_23()
{
	signalvalue1 = getSignal(S4_SRR_RL_Obj_ID_23);
	write("S4_SRR_RL_Obj_ID_23 :%f",signalvalue1);
	write("i_S4_SRR_RL_Obj_ID_23 :%o",@ecu_Signals::i_S4_SRR_RL_Obj_ID_23);

	testStep("get expect variable value: ","i_S4_SRR_RL_Obj_ID_23 :%o",@ecu_Signals::i_S4_SRR_RL_Obj_ID_23);

	if(signalvalue1==@ecu_Signals::i_S4_SRR_RL_Obj_ID_23)
	{
	testStepPass("Pass","i_S4_SRR_RL_Obj_ID_23 :%f",signalvalue1);
	}
	else
	{
	testStepFail("Fail","i_S4_SRR_RL_Obj_ID_23 :%f",signalvalue1);
	}
}

testcase S4_SRR_RL_Obj_Mes_7_S4_SRR_RL_Obj_DistX_23()
{
	signalvalue1 = getSignal(S4_SRR_RL_Obj_DistX_23);
	write("S4_SRR_RL_Obj_DistX_23 :%f",signalvalue1);
	write("i_S4_SRR_RL_Obj_DistX_23 :%f",@ecu_Signals::i_S4_SRR_RL_Obj_DistX_23);

	testStep("get expect variable value: ","i_S4_SRR_RL_Obj_DistX_23 :%f",@ecu_Signals::i_S4_SRR_RL_Obj_DistX_23);

	if((abs(@ecu_Signals::i_S4_SRR_RL_Obj_DistX_23)*0.9<=abs(signalvalue1))&&(abs(signalvalue1)<=abs(@ecu_Signals::i_S4_SRR_RL_Obj_DistX_23)*1.1))
	{
	testStepPass("Pass","i_S4_SRR_RL_Obj_DistX_23 :%f",signalvalue1);
	}
	else
	{
	testStepFail("Fail","i_S4_SRR_RL_Obj_DistX_23 :%f",signalvalue1);
	}
}

testcase S4_SRR_RL_Obj_Mes_7_S4_SRR_RL_Obj_RelVelX_23()
{
	signalvalue1 = getSignal(S4_SRR_RL_Obj_RelVelX_23);
	write("S4_SRR_RL_Obj_RelVelX_23 :%f",signalvalue1);
	write("i_S4_SRR_RL_Obj_RelVelX_23 :%f",@ecu_Signals::i_S4_SRR_RL_Obj_RelVelX_23);

	testStep("get expect variable value: ","i_S4_SRR_RL_Obj_RelVelX_23 :%f",@ecu_Signals::i_S4_SRR_RL_Obj_RelVelX_23);

	if((abs(@ecu_Signals::i_S4_SRR_RL_Obj_RelVelX_23)*0.9<=abs(signalvalue1))&&(abs(signalvalue1)<=abs(@ecu_Signals::i_S4_SRR_RL_Obj_RelVelX_23)*1.1))
	{
	testStepPass("Pass","i_S4_SRR_RL_Obj_RelVelX_23 :%f",signalvalue1);
	}
	else
	{
	testStepFail("Fail","i_S4_SRR_RL_Obj_RelVelX_23 :%f",signalvalue1);
	}
}

testcase S4_SRR_RL_Obj_Mes_7_S4_SRR_RL_Obj_AccelX_23()
{
	signalvalue1 = getSignal(S4_SRR_RL_Obj_AccelX_23);
	write("S4_SRR_RL_Obj_AccelX_23 :%f",signalvalue1);
	write("i_S4_SRR_RL_Obj_AccelX_23 :%f",@ecu_Signals::i_S4_SRR_RL_Obj_AccelX_23);

	testStep("get expect variable value: ","i_S4_SRR_RL_Obj_AccelX_23 :%f",@ecu_Signals::i_S4_SRR_RL_Obj_AccelX_23);

	if((abs(@ecu_Signals::i_S4_SRR_RL_Obj_AccelX_23)*0.9<=abs(signalvalue1))&&(abs(signalvalue1)<=abs(@ecu_Signals::i_S4_SRR_RL_Obj_AccelX_23)*1.1))
	{
	testStepPass("Pass","i_S4_SRR_RL_Obj_AccelX_23 :%f",signalvalue1);
	}
	else
	{
	testStepFail("Fail","i_S4_SRR_RL_Obj_AccelX_23 :%f",signalvalue1);
	}
}

testcase S4_SRR_RL_Obj_Mes_7_S4_SRR_RL_Obj_DistY_23()
{
	signalvalue1 = getSignal(S4_SRR_RL_Obj_DistY_23);
	write("S4_SRR_RL_Obj_DistY_23 :%f",signalvalue1);
	write("i_S4_SRR_RL_Obj_DistY_23 :%f",@ecu_Signals::i_S4_SRR_RL_Obj_DistY_23);

	testStep("get expect variable value: ","i_S4_SRR_RL_Obj_DistY_23 :%f",@ecu_Signals::i_S4_SRR_RL_Obj_DistY_23);

	if((abs(@ecu_Signals::i_S4_SRR_RL_Obj_DistY_23)*0.9<=abs(signalvalue1))&&(abs(signalvalue1)<=abs(@ecu_Signals::i_S4_SRR_RL_Obj_DistY_23)*1.1))
	{
	testStepPass("Pass","i_S4_SRR_RL_Obj_DistY_23 :%f",signalvalue1);
	}
	else
	{
	testStepFail("Fail","i_S4_SRR_RL_Obj_DistY_23 :%f",signalvalue1);
	}
}

testcase S4_SRR_RL_Obj_Mes_7_S4_SRR_RL_Obj_RelVelY_23()
{
	signalvalue1 = getSignal(S4_SRR_RL_Obj_RelVelY_23);
	write("S4_SRR_RL_Obj_RelVelY_23 :%f",signalvalue1);
	write("i_S4_SRR_RL_Obj_RelVelY_23 :%f",@ecu_Signals::i_S4_SRR_RL_Obj_RelVelY_23);

	testStep("get expect variable value: ","i_S4_SRR_RL_Obj_RelVelY_23 :%f",@ecu_Signals::i_S4_SRR_RL_Obj_RelVelY_23);

	if((abs(@ecu_Signals::i_S4_SRR_RL_Obj_RelVelY_23)*0.9<=abs(signalvalue1))&&(abs(signalvalue1)<=abs(@ecu_Signals::i_S4_SRR_RL_Obj_RelVelY_23)*1.1))
	{
	testStepPass("Pass","i_S4_SRR_RL_Obj_RelVelY_23 :%f",signalvalue1);
	}
	else
	{
	testStepFail("Fail","i_S4_SRR_RL_Obj_RelVelY_23 :%f",signalvalue1);
	}
}

testcase S4_SRR_RL_Obj_Mes_7_S4_SRR_RL_Obj_AccelY_23()
{
	signalvalue1 = getSignal(S4_SRR_RL_Obj_AccelY_23);
	write("S4_SRR_RL_Obj_AccelY_23 :%f",signalvalue1);
	write("i_S4_SRR_RL_Obj_AccelY_23 :%f",@ecu_Signals::i_S4_SRR_RL_Obj_AccelY_23);

	testStep("get expect variable value: ","i_S4_SRR_RL_Obj_AccelY_23 :%f",@ecu_Signals::i_S4_SRR_RL_Obj_AccelY_23);

	if((abs(@ecu_Signals::i_S4_SRR_RL_Obj_AccelY_23)*0.9<=abs(signalvalue1))&&(abs(signalvalue1)<=abs(@ecu_Signals::i_S4_SRR_RL_Obj_AccelY_23)*1.1))
	{
	testStepPass("Pass","i_S4_SRR_RL_Obj_AccelY_23 :%f",signalvalue1);
	}
	else
	{
	testStepFail("Fail","i_S4_SRR_RL_Obj_AccelY_23 :%f",signalvalue1);
	}
}

testcase S4_SRR_RL_Obj_Mes_7_S4_SRR_RL_Obj_DistXStd_23()
{
	signalvalue1 = getSignal(S4_SRR_RL_Obj_DistXStd_23);
	write("S4_SRR_RL_Obj_DistXStd_23 :%f",signalvalue1);
	write("i_S4_SRR_RL_Obj_DistXStd_23 :%f",@ecu_Signals::i_S4_SRR_RL_Obj_DistXStd_23);

	testStep("get expect variable value: ","i_S4_SRR_RL_Obj_DistXStd_23 :%f",@ecu_Signals::i_S4_SRR_RL_Obj_DistXStd_23);

	if((abs(@ecu_Signals::i_S4_SRR_RL_Obj_DistXStd_23)*0.9<=abs(signalvalue1))&&(abs(signalvalue1)<=abs(@ecu_Signals::i_S4_SRR_RL_Obj_DistXStd_23)*1.1))
	{
	testStepPass("Pass","i_S4_SRR_RL_Obj_DistXStd_23 :%f",signalvalue1);
	}
	else
	{
	testStepFail("Fail","i_S4_SRR_RL_Obj_DistXStd_23 :%f",signalvalue1);
	}
}

testcase S4_SRR_RL_Obj_Mes_7_S4_SRR_RL_Obj_RelVelXStd_23()
{
	signalvalue1 = getSignal(S4_SRR_RL_Obj_RelVelXStd_23);
	write("S4_SRR_RL_Obj_RelVelXStd_23 :%f",signalvalue1);
	write("i_S4_SRR_RL_Obj_RelVelXStd_23 :%f",@ecu_Signals::i_S4_SRR_RL_Obj_RelVelXStd_23);

	testStep("get expect variable value: ","i_S4_SRR_RL_Obj_RelVelXStd_23 :%f",@ecu_Signals::i_S4_SRR_RL_Obj_RelVelXStd_23);

	if((abs(@ecu_Signals::i_S4_SRR_RL_Obj_RelVelXStd_23)*0.9<=abs(signalvalue1))&&(abs(signalvalue1)<=abs(@ecu_Signals::i_S4_SRR_RL_Obj_RelVelXStd_23)*1.1))
	{
	testStepPass("Pass","i_S4_SRR_RL_Obj_RelVelXStd_23 :%f",signalvalue1);
	}
	else
	{
	testStepFail("Fail","i_S4_SRR_RL_Obj_RelVelXStd_23 :%f",signalvalue1);
	}
}

testcase S4_SRR_RL_Obj_Mes_7_S4_SRR_RL_Obj_DistYStd_23()
{
	signalvalue1 = getSignal(S4_SRR_RL_Obj_DistYStd_23);
	write("S4_SRR_RL_Obj_DistYStd_23 :%f",signalvalue1);
	write("i_S4_SRR_RL_Obj_DistYStd_23 :%f",@ecu_Signals::i_S4_SRR_RL_Obj_DistYStd_23);

	testStep("get expect variable value: ","i_S4_SRR_RL_Obj_DistYStd_23 :%f",@ecu_Signals::i_S4_SRR_RL_Obj_DistYStd_23);

	if((abs(@ecu_Signals::i_S4_SRR_RL_Obj_DistYStd_23)*0.9<=abs(signalvalue1))&&(abs(signalvalue1)<=abs(@ecu_Signals::i_S4_SRR_RL_Obj_DistYStd_23)*1.1))
	{
	testStepPass("Pass","i_S4_SRR_RL_Obj_DistYStd_23 :%f",signalvalue1);
	}
	else
	{
	testStepFail("Fail","i_S4_SRR_RL_Obj_DistYStd_23 :%f",signalvalue1);
	}
}

testcase S4_SRR_RL_Obj_Mes_7_S4_SRR_RL_Obj_RelVelYStd_23()
{
	signalvalue1 = getSignal(S4_SRR_RL_Obj_RelVelYStd_23);
	write("S4_SRR_RL_Obj_RelVelYStd_23 :%f",signalvalue1);
	write("i_S4_SRR_RL_Obj_RelVelYStd_23 :%f",@ecu_Signals::i_S4_SRR_RL_Obj_RelVelYStd_23);

	testStep("get expect variable value: ","i_S4_SRR_RL_Obj_RelVelYStd_23 :%f",@ecu_Signals::i_S4_SRR_RL_Obj_RelVelYStd_23);

	if((abs(@ecu_Signals::i_S4_SRR_RL_Obj_RelVelYStd_23)*0.9<=abs(signalvalue1))&&(abs(signalvalue1)<=abs(@ecu_Signals::i_S4_SRR_RL_Obj_RelVelYStd_23)*1.1))
	{
	testStepPass("Pass","i_S4_SRR_RL_Obj_RelVelYStd_23 :%f",signalvalue1);
	}
	else
	{
	testStepFail("Fail","i_S4_SRR_RL_Obj_RelVelYStd_23 :%f",signalvalue1);
	}
}

testcase S4_SRR_RL_Obj_Mes_7_S4_SRR_RL_Obj_UpdateFlag_23()
{
	signalvalue1 = getSignal(S4_SRR_RL_Obj_UpdateFlag_23);
	write("S4_SRR_RL_Obj_UpdateFlag_23 :%f",signalvalue1);
	write("i_S4_SRR_RL_Obj_UpdateFlag_23 :%o",@ecu_Signals::i_S4_SRR_RL_Obj_UpdateFlag_23);

	testStep("get expect variable value: ","i_S4_SRR_RL_Obj_UpdateFlag_23 :%o",@ecu_Signals::i_S4_SRR_RL_Obj_UpdateFlag_23);

	if(signalvalue1==@ecu_Signals::i_S4_SRR_RL_Obj_UpdateFlag_23)
	{
	testStepPass("Pass","i_S4_SRR_RL_Obj_UpdateFlag_23 :%f",signalvalue1);
	}
	else
	{
	testStepFail("Fail","i_S4_SRR_RL_Obj_UpdateFlag_23 :%f",signalvalue1);
	}
}

testcase S4_SRR_RL_Obj_Mes_7_S4_SRR_RL_Obj_ExistProb_23()
{
	signalvalue1 = getSignal(S4_SRR_RL_Obj_ExistProb_23);
	write("S4_SRR_RL_Obj_ExistProb_23 :%f",signalvalue1);
	write("i_S4_SRR_RL_Obj_ExistProb_23 :%o",@ecu_Signals::i_S4_SRR_RL_Obj_ExistProb_23);

	testStep("get expect variable value: ","i_S4_SRR_RL_Obj_ExistProb_23 :%o",@ecu_Signals::i_S4_SRR_RL_Obj_ExistProb_23);

	if(signalvalue1==@ecu_Signals::i_S4_SRR_RL_Obj_ExistProb_23)
	{
	testStepPass("Pass","i_S4_SRR_RL_Obj_ExistProb_23 :%f",signalvalue1);
	}
	else
	{
	testStepFail("Fail","i_S4_SRR_RL_Obj_ExistProb_23 :%f",signalvalue1);
	}
}

testcase S4_SRR_RL_Obj_Mes_7_S4_SRR_RL_Obj_Type_23()
{
	signalvalue1 = getSignal(S4_SRR_RL_Obj_Type_23);
	write("S4_SRR_RL_Obj_Type_23 :%f",signalvalue1);
	write("i_S4_SRR_RL_Obj_Type_23 :%o",@ecu_Signals::i_S4_SRR_RL_Obj_Type_23);

	testStep("get expect variable value: ","i_S4_SRR_RL_Obj_Type_23 :%o",@ecu_Signals::i_S4_SRR_RL_Obj_Type_23);

	if(signalvalue1==@ecu_Signals::i_S4_SRR_RL_Obj_Type_23)
	{
	testStepPass("Pass","i_S4_SRR_RL_Obj_Type_23 :%f",signalvalue1);
	}
	else
	{
	testStepFail("Fail","i_S4_SRR_RL_Obj_Type_23 :%f",signalvalue1);
	}
}

testcase S4_SRR_RL_Obj_Mes_7_S4_SRR_RL_Obj_EDynProp_23()
{
	signalvalue1 = getSignal(S4_SRR_RL_Obj_EDynProp_23);
	write("S4_SRR_RL_Obj_EDynProp_23 :%f",signalvalue1);
	write("i_S4_SRR_RL_Obj_EDynProp_23 :%o",@ecu_Signals::i_S4_SRR_RL_Obj_EDynProp_23);

	testStep("get expect variable value: ","i_S4_SRR_RL_Obj_EDynProp_23 :%o",@ecu_Signals::i_S4_SRR_RL_Obj_EDynProp_23);

	if(signalvalue1==@ecu_Signals::i_S4_SRR_RL_Obj_EDynProp_23)
	{
	testStepPass("Pass","i_S4_SRR_RL_Obj_EDynProp_23 :%f",signalvalue1);
	}
	else
	{
	testStepFail("Fail","i_S4_SRR_RL_Obj_EDynProp_23 :%f",signalvalue1);
	}
}

testcase S4_SRR_RL_Obj_Mes_7_S4_SRR_RL_Obj_UiLifeCycles_23()
{
	signalvalue1 = getSignal(S4_SRR_RL_Obj_UiLifeCycles_23);
	write("S4_SRR_RL_Obj_UiLifeCycles_23 :%f",signalvalue1);
	write("i_S4_SRR_RL_Obj_UiLifeCycles_23 :%o",@ecu_Signals::i_S4_SRR_RL_Obj_UiLifeCycles_23);

	testStep("get expect variable value: ","i_S4_SRR_RL_Obj_UiLifeCycles_23 :%o",@ecu_Signals::i_S4_SRR_RL_Obj_UiLifeCycles_23);

	if(signalvalue1==@ecu_Signals::i_S4_SRR_RL_Obj_UiLifeCycles_23)
	{
	testStepPass("Pass","i_S4_SRR_RL_Obj_UiLifeCycles_23 :%f",signalvalue1);
	}
	else
	{
	testStepFail("Fail","i_S4_SRR_RL_Obj_UiLifeCycles_23 :%f",signalvalue1);
	}
}

testcase S4_SRR_RL_Obj_Mes_8_S4_SRR_RL_Obj_ID_24()
{
	signalvalue1 = getSignal(S4_SRR_RL_Obj_ID_24);
	write("S4_SRR_RL_Obj_ID_24 :%f",signalvalue1);
	write("i_S4_SRR_RL_Obj_ID_24 :%o",@ecu_Signals::i_S4_SRR_RL_Obj_ID_24);

	testStep("get expect variable value: ","i_S4_SRR_RL_Obj_ID_24 :%o",@ecu_Signals::i_S4_SRR_RL_Obj_ID_24);

	if(signalvalue1==@ecu_Signals::i_S4_SRR_RL_Obj_ID_24)
	{
	testStepPass("Pass","i_S4_SRR_RL_Obj_ID_24 :%f",signalvalue1);
	}
	else
	{
	testStepFail("Fail","i_S4_SRR_RL_Obj_ID_24 :%f",signalvalue1);
	}
}

testcase S4_SRR_RL_Obj_Mes_8_S4_SRR_RL_Obj_DistX_24()
{
	signalvalue1 = getSignal(S4_SRR_RL_Obj_DistX_24);
	write("S4_SRR_RL_Obj_DistX_24 :%f",signalvalue1);
	write("i_S4_SRR_RL_Obj_DistX_24 :%f",@ecu_Signals::i_S4_SRR_RL_Obj_DistX_24);

	testStep("get expect variable value: ","i_S4_SRR_RL_Obj_DistX_24 :%f",@ecu_Signals::i_S4_SRR_RL_Obj_DistX_24);

	if((abs(@ecu_Signals::i_S4_SRR_RL_Obj_DistX_24)*0.9<=abs(signalvalue1))&&(abs(signalvalue1)<=abs(@ecu_Signals::i_S4_SRR_RL_Obj_DistX_24)*1.1))
	{
	testStepPass("Pass","i_S4_SRR_RL_Obj_DistX_24 :%f",signalvalue1);
	}
	else
	{
	testStepFail("Fail","i_S4_SRR_RL_Obj_DistX_24 :%f",signalvalue1);
	}
}

testcase S4_SRR_RL_Obj_Mes_8_S4_SRR_RL_Obj_RelVelX_24()
{
	signalvalue1 = getSignal(S4_SRR_RL_Obj_RelVelX_24);
	write("S4_SRR_RL_Obj_RelVelX_24 :%f",signalvalue1);
	write("i_S4_SRR_RL_Obj_RelVelX_24 :%f",@ecu_Signals::i_S4_SRR_RL_Obj_RelVelX_24);

	testStep("get expect variable value: ","i_S4_SRR_RL_Obj_RelVelX_24 :%f",@ecu_Signals::i_S4_SRR_RL_Obj_RelVelX_24);

	if((abs(@ecu_Signals::i_S4_SRR_RL_Obj_RelVelX_24)*0.9<=abs(signalvalue1))&&(abs(signalvalue1)<=abs(@ecu_Signals::i_S4_SRR_RL_Obj_RelVelX_24)*1.1))
	{
	testStepPass("Pass","i_S4_SRR_RL_Obj_RelVelX_24 :%f",signalvalue1);
	}
	else
	{
	testStepFail("Fail","i_S4_SRR_RL_Obj_RelVelX_24 :%f",signalvalue1);
	}
}

testcase S4_SRR_RL_Obj_Mes_8_S4_SRR_RL_Obj_AccelX_24()
{
	signalvalue1 = getSignal(S4_SRR_RL_Obj_AccelX_24);
	write("S4_SRR_RL_Obj_AccelX_24 :%f",signalvalue1);
	write("i_S4_SRR_RL_Obj_AccelX_24 :%f",@ecu_Signals::i_S4_SRR_RL_Obj_AccelX_24);

	testStep("get expect variable value: ","i_S4_SRR_RL_Obj_AccelX_24 :%f",@ecu_Signals::i_S4_SRR_RL_Obj_AccelX_24);

	if((abs(@ecu_Signals::i_S4_SRR_RL_Obj_AccelX_24)*0.9<=abs(signalvalue1))&&(abs(signalvalue1)<=abs(@ecu_Signals::i_S4_SRR_RL_Obj_AccelX_24)*1.1))
	{
	testStepPass("Pass","i_S4_SRR_RL_Obj_AccelX_24 :%f",signalvalue1);
	}
	else
	{
	testStepFail("Fail","i_S4_SRR_RL_Obj_AccelX_24 :%f",signalvalue1);
	}
}

testcase S4_SRR_RL_Obj_Mes_8_S4_SRR_RL_Obj_DistY_24()
{
	signalvalue1 = getSignal(S4_SRR_RL_Obj_DistY_24);
	write("S4_SRR_RL_Obj_DistY_24 :%f",signalvalue1);
	write("i_S4_SRR_RL_Obj_DistY_24 :%f",@ecu_Signals::i_S4_SRR_RL_Obj_DistY_24);

	testStep("get expect variable value: ","i_S4_SRR_RL_Obj_DistY_24 :%f",@ecu_Signals::i_S4_SRR_RL_Obj_DistY_24);

	if((abs(@ecu_Signals::i_S4_SRR_RL_Obj_DistY_24)*0.9<=abs(signalvalue1))&&(abs(signalvalue1)<=abs(@ecu_Signals::i_S4_SRR_RL_Obj_DistY_24)*1.1))
	{
	testStepPass("Pass","i_S4_SRR_RL_Obj_DistY_24 :%f",signalvalue1);
	}
	else
	{
	testStepFail("Fail","i_S4_SRR_RL_Obj_DistY_24 :%f",signalvalue1);
	}
}

testcase S4_SRR_RL_Obj_Mes_8_S4_SRR_RL_Obj_RelVelY_24()
{
	signalvalue1 = getSignal(S4_SRR_RL_Obj_RelVelY_24);
	write("S4_SRR_RL_Obj_RelVelY_24 :%f",signalvalue1);
	write("i_S4_SRR_RL_Obj_RelVelY_24 :%f",@ecu_Signals::i_S4_SRR_RL_Obj_RelVelY_24);

	testStep("get expect variable value: ","i_S4_SRR_RL_Obj_RelVelY_24 :%f",@ecu_Signals::i_S4_SRR_RL_Obj_RelVelY_24);

	if((abs(@ecu_Signals::i_S4_SRR_RL_Obj_RelVelY_24)*0.9<=abs(signalvalue1))&&(abs(signalvalue1)<=abs(@ecu_Signals::i_S4_SRR_RL_Obj_RelVelY_24)*1.1))
	{
	testStepPass("Pass","i_S4_SRR_RL_Obj_RelVelY_24 :%f",signalvalue1);
	}
	else
	{
	testStepFail("Fail","i_S4_SRR_RL_Obj_RelVelY_24 :%f",signalvalue1);
	}
}

testcase S4_SRR_RL_Obj_Mes_8_S4_SRR_RL_Obj_AccelY_24()
{
	signalvalue1 = getSignal(S4_SRR_RL_Obj_AccelY_24);
	write("S4_SRR_RL_Obj_AccelY_24 :%f",signalvalue1);
	write("i_S4_SRR_RL_Obj_AccelY_24 :%f",@ecu_Signals::i_S4_SRR_RL_Obj_AccelY_24);

	testStep("get expect variable value: ","i_S4_SRR_RL_Obj_AccelY_24 :%f",@ecu_Signals::i_S4_SRR_RL_Obj_AccelY_24);

	if((abs(@ecu_Signals::i_S4_SRR_RL_Obj_AccelY_24)*0.9<=abs(signalvalue1))&&(abs(signalvalue1)<=abs(@ecu_Signals::i_S4_SRR_RL_Obj_AccelY_24)*1.1))
	{
	testStepPass("Pass","i_S4_SRR_RL_Obj_AccelY_24 :%f",signalvalue1);
	}
	else
	{
	testStepFail("Fail","i_S4_SRR_RL_Obj_AccelY_24 :%f",signalvalue1);
	}
}

testcase S4_SRR_RL_Obj_Mes_8_S4_SRR_RL_Obj_DistXStd_24()
{
	signalvalue1 = getSignal(S4_SRR_RL_Obj_DistXStd_24);
	write("S4_SRR_RL_Obj_DistXStd_24 :%f",signalvalue1);
	write("i_S4_SRR_RL_Obj_DistXStd_24 :%f",@ecu_Signals::i_S4_SRR_RL_Obj_DistXStd_24);

	testStep("get expect variable value: ","i_S4_SRR_RL_Obj_DistXStd_24 :%f",@ecu_Signals::i_S4_SRR_RL_Obj_DistXStd_24);

	if((abs(@ecu_Signals::i_S4_SRR_RL_Obj_DistXStd_24)*0.9<=abs(signalvalue1))&&(abs(signalvalue1)<=abs(@ecu_Signals::i_S4_SRR_RL_Obj_DistXStd_24)*1.1))
	{
	testStepPass("Pass","i_S4_SRR_RL_Obj_DistXStd_24 :%f",signalvalue1);
	}
	else
	{
	testStepFail("Fail","i_S4_SRR_RL_Obj_DistXStd_24 :%f",signalvalue1);
	}
}

testcase S4_SRR_RL_Obj_Mes_8_S4_SRR_RL_Obj_RelVelXStd_24()
{
	signalvalue1 = getSignal(S4_SRR_RL_Obj_RelVelXStd_24);
	write("S4_SRR_RL_Obj_RelVelXStd_24 :%f",signalvalue1);
	write("i_S4_SRR_RL_Obj_RelVelXStd_24 :%f",@ecu_Signals::i_S4_SRR_RL_Obj_RelVelXStd_24);

	testStep("get expect variable value: ","i_S4_SRR_RL_Obj_RelVelXStd_24 :%f",@ecu_Signals::i_S4_SRR_RL_Obj_RelVelXStd_24);

	if((abs(@ecu_Signals::i_S4_SRR_RL_Obj_RelVelXStd_24)*0.9<=abs(signalvalue1))&&(abs(signalvalue1)<=abs(@ecu_Signals::i_S4_SRR_RL_Obj_RelVelXStd_24)*1.1))
	{
	testStepPass("Pass","i_S4_SRR_RL_Obj_RelVelXStd_24 :%f",signalvalue1);
	}
	else
	{
	testStepFail("Fail","i_S4_SRR_RL_Obj_RelVelXStd_24 :%f",signalvalue1);
	}
}

testcase S4_SRR_RL_Obj_Mes_8_S4_SRR_RL_Obj_DistYStd_24()
{
	signalvalue1 = getSignal(S4_SRR_RL_Obj_DistYStd_24);
	write("S4_SRR_RL_Obj_DistYStd_24 :%f",signalvalue1);
	write("i_S4_SRR_RL_Obj_DistYStd_24 :%f",@ecu_Signals::i_S4_SRR_RL_Obj_DistYStd_24);

	testStep("get expect variable value: ","i_S4_SRR_RL_Obj_DistYStd_24 :%f",@ecu_Signals::i_S4_SRR_RL_Obj_DistYStd_24);

	if((abs(@ecu_Signals::i_S4_SRR_RL_Obj_DistYStd_24)*0.9<=abs(signalvalue1))&&(abs(signalvalue1)<=abs(@ecu_Signals::i_S4_SRR_RL_Obj_DistYStd_24)*1.1))
	{
	testStepPass("Pass","i_S4_SRR_RL_Obj_DistYStd_24 :%f",signalvalue1);
	}
	else
	{
	testStepFail("Fail","i_S4_SRR_RL_Obj_DistYStd_24 :%f",signalvalue1);
	}
}

testcase S4_SRR_RL_Obj_Mes_8_S4_SRR_RL_Obj_RelVelYStd_24()
{
	signalvalue1 = getSignal(S4_SRR_RL_Obj_RelVelYStd_24);
	write("S4_SRR_RL_Obj_RelVelYStd_24 :%f",signalvalue1);
	write("i_S4_SRR_RL_Obj_RelVelYStd_24 :%f",@ecu_Signals::i_S4_SRR_RL_Obj_RelVelYStd_24);

	testStep("get expect variable value: ","i_S4_SRR_RL_Obj_RelVelYStd_24 :%f",@ecu_Signals::i_S4_SRR_RL_Obj_RelVelYStd_24);

	if((abs(@ecu_Signals::i_S4_SRR_RL_Obj_RelVelYStd_24)*0.9<=abs(signalvalue1))&&(abs(signalvalue1)<=abs(@ecu_Signals::i_S4_SRR_RL_Obj_RelVelYStd_24)*1.1))
	{
	testStepPass("Pass","i_S4_SRR_RL_Obj_RelVelYStd_24 :%f",signalvalue1);
	}
	else
	{
	testStepFail("Fail","i_S4_SRR_RL_Obj_RelVelYStd_24 :%f",signalvalue1);
	}
}

testcase S4_SRR_RL_Obj_Mes_8_S4_SRR_RL_Obj_UpdateFlag_24()
{
	signalvalue1 = getSignal(S4_SRR_RL_Obj_UpdateFlag_24);
	write("S4_SRR_RL_Obj_UpdateFlag_24 :%f",signalvalue1);
	write("i_S4_SRR_RL_Obj_UpdateFlag_24 :%o",@ecu_Signals::i_S4_SRR_RL_Obj_UpdateFlag_24);

	testStep("get expect variable value: ","i_S4_SRR_RL_Obj_UpdateFlag_24 :%o",@ecu_Signals::i_S4_SRR_RL_Obj_UpdateFlag_24);

	if(signalvalue1==@ecu_Signals::i_S4_SRR_RL_Obj_UpdateFlag_24)
	{
	testStepPass("Pass","i_S4_SRR_RL_Obj_UpdateFlag_24 :%f",signalvalue1);
	}
	else
	{
	testStepFail("Fail","i_S4_SRR_RL_Obj_UpdateFlag_24 :%f",signalvalue1);
	}
}

testcase S4_SRR_RL_Obj_Mes_8_S4_SRR_RL_Obj_ExistProb_24()
{
	signalvalue1 = getSignal(S4_SRR_RL_Obj_ExistProb_24);
	write("S4_SRR_RL_Obj_ExistProb_24 :%f",signalvalue1);
	write("i_S4_SRR_RL_Obj_ExistProb_24 :%o",@ecu_Signals::i_S4_SRR_RL_Obj_ExistProb_24);

	testStep("get expect variable value: ","i_S4_SRR_RL_Obj_ExistProb_24 :%o",@ecu_Signals::i_S4_SRR_RL_Obj_ExistProb_24);

	if(signalvalue1==@ecu_Signals::i_S4_SRR_RL_Obj_ExistProb_24)
	{
	testStepPass("Pass","i_S4_SRR_RL_Obj_ExistProb_24 :%f",signalvalue1);
	}
	else
	{
	testStepFail("Fail","i_S4_SRR_RL_Obj_ExistProb_24 :%f",signalvalue1);
	}
}

testcase S4_SRR_RL_Obj_Mes_8_S4_SRR_RL_Obj_Type_24()
{
	signalvalue1 = getSignal(S4_SRR_RL_Obj_Type_24);
	write("S4_SRR_RL_Obj_Type_24 :%f",signalvalue1);
	write("i_S4_SRR_RL_Obj_Type_24 :%o",@ecu_Signals::i_S4_SRR_RL_Obj_Type_24);

	testStep("get expect variable value: ","i_S4_SRR_RL_Obj_Type_24 :%o",@ecu_Signals::i_S4_SRR_RL_Obj_Type_24);

	if(signalvalue1==@ecu_Signals::i_S4_SRR_RL_Obj_Type_24)
	{
	testStepPass("Pass","i_S4_SRR_RL_Obj_Type_24 :%f",signalvalue1);
	}
	else
	{
	testStepFail("Fail","i_S4_SRR_RL_Obj_Type_24 :%f",signalvalue1);
	}
}

testcase S4_SRR_RL_Obj_Mes_8_S4_SRR_RL_Obj_EDynProp_24()
{
	signalvalue1 = getSignal(S4_SRR_RL_Obj_EDynProp_24);
	write("S4_SRR_RL_Obj_EDynProp_24 :%f",signalvalue1);
	write("i_S4_SRR_RL_Obj_EDynProp_24 :%o",@ecu_Signals::i_S4_SRR_RL_Obj_EDynProp_24);

	testStep("get expect variable value: ","i_S4_SRR_RL_Obj_EDynProp_24 :%o",@ecu_Signals::i_S4_SRR_RL_Obj_EDynProp_24);

	if(signalvalue1==@ecu_Signals::i_S4_SRR_RL_Obj_EDynProp_24)
	{
	testStepPass("Pass","i_S4_SRR_RL_Obj_EDynProp_24 :%f",signalvalue1);
	}
	else
	{
	testStepFail("Fail","i_S4_SRR_RL_Obj_EDynProp_24 :%f",signalvalue1);
	}
}

testcase S4_SRR_RL_Obj_Mes_8_S4_SRR_RL_Obj_UiLifeCycles_24()
{
	signalvalue1 = getSignal(S4_SRR_RL_Obj_UiLifeCycles_24);
	write("S4_SRR_RL_Obj_UiLifeCycles_24 :%f",signalvalue1);
	write("i_S4_SRR_RL_Obj_UiLifeCycles_24 :%o",@ecu_Signals::i_S4_SRR_RL_Obj_UiLifeCycles_24);

	testStep("get expect variable value: ","i_S4_SRR_RL_Obj_UiLifeCycles_24 :%o",@ecu_Signals::i_S4_SRR_RL_Obj_UiLifeCycles_24);

	if(signalvalue1==@ecu_Signals::i_S4_SRR_RL_Obj_UiLifeCycles_24)
	{
	testStepPass("Pass","i_S4_SRR_RL_Obj_UiLifeCycles_24 :%f",signalvalue1);
	}
	else
	{
	testStepFail("Fail","i_S4_SRR_RL_Obj_UiLifeCycles_24 :%f",signalvalue1);
	}
}

testcase S4_SRR_RL_Obj_Mes_8_S4_SRR_RL_Obj_ID_25()
{
	signalvalue1 = getSignal(S4_SRR_RL_Obj_ID_25);
	write("S4_SRR_RL_Obj_ID_25 :%f",signalvalue1);
	write("i_S4_SRR_RL_Obj_ID_25 :%o",@ecu_Signals::i_S4_SRR_RL_Obj_ID_25);

	testStep("get expect variable value: ","i_S4_SRR_RL_Obj_ID_25 :%o",@ecu_Signals::i_S4_SRR_RL_Obj_ID_25);

	if(signalvalue1==@ecu_Signals::i_S4_SRR_RL_Obj_ID_25)
	{
	testStepPass("Pass","i_S4_SRR_RL_Obj_ID_25 :%f",signalvalue1);
	}
	else
	{
	testStepFail("Fail","i_S4_SRR_RL_Obj_ID_25 :%f",signalvalue1);
	}
}

testcase S4_SRR_RL_Obj_Mes_8_S4_SRR_RL_Obj_DistX_25()
{
	signalvalue1 = getSignal(S4_SRR_RL_Obj_DistX_25);
	write("S4_SRR_RL_Obj_DistX_25 :%f",signalvalue1);
	write("i_S4_SRR_RL_Obj_DistX_25 :%f",@ecu_Signals::i_S4_SRR_RL_Obj_DistX_25);

	testStep("get expect variable value: ","i_S4_SRR_RL_Obj_DistX_25 :%f",@ecu_Signals::i_S4_SRR_RL_Obj_DistX_25);

	if((abs(@ecu_Signals::i_S4_SRR_RL_Obj_DistX_25)*0.9<=abs(signalvalue1))&&(abs(signalvalue1)<=abs(@ecu_Signals::i_S4_SRR_RL_Obj_DistX_25)*1.1))
	{
	testStepPass("Pass","i_S4_SRR_RL_Obj_DistX_25 :%f",signalvalue1);
	}
	else
	{
	testStepFail("Fail","i_S4_SRR_RL_Obj_DistX_25 :%f",signalvalue1);
	}
}

testcase S4_SRR_RL_Obj_Mes_8_S4_SRR_RL_Obj_RelVelX_25()
{
	signalvalue1 = getSignal(S4_SRR_RL_Obj_RelVelX_25);
	write("S4_SRR_RL_Obj_RelVelX_25 :%f",signalvalue1);
	write("i_S4_SRR_RL_Obj_RelVelX_25 :%f",@ecu_Signals::i_S4_SRR_RL_Obj_RelVelX_25);

	testStep("get expect variable value: ","i_S4_SRR_RL_Obj_RelVelX_25 :%f",@ecu_Signals::i_S4_SRR_RL_Obj_RelVelX_25);

	if((abs(@ecu_Signals::i_S4_SRR_RL_Obj_RelVelX_25)*0.9<=abs(signalvalue1))&&(abs(signalvalue1)<=abs(@ecu_Signals::i_S4_SRR_RL_Obj_RelVelX_25)*1.1))
	{
	testStepPass("Pass","i_S4_SRR_RL_Obj_RelVelX_25 :%f",signalvalue1);
	}
	else
	{
	testStepFail("Fail","i_S4_SRR_RL_Obj_RelVelX_25 :%f",signalvalue1);
	}
}

testcase S4_SRR_RL_Obj_Mes_8_S4_SRR_RL_Obj_AccelX_25()
{
	signalvalue1 = getSignal(S4_SRR_RL_Obj_AccelX_25);
	write("S4_SRR_RL_Obj_AccelX_25 :%f",signalvalue1);
	write("i_S4_SRR_RL_Obj_AccelX_25 :%f",@ecu_Signals::i_S4_SRR_RL_Obj_AccelX_25);

	testStep("get expect variable value: ","i_S4_SRR_RL_Obj_AccelX_25 :%f",@ecu_Signals::i_S4_SRR_RL_Obj_AccelX_25);

	if((abs(@ecu_Signals::i_S4_SRR_RL_Obj_AccelX_25)*0.9<=abs(signalvalue1))&&(abs(signalvalue1)<=abs(@ecu_Signals::i_S4_SRR_RL_Obj_AccelX_25)*1.1))
	{
	testStepPass("Pass","i_S4_SRR_RL_Obj_AccelX_25 :%f",signalvalue1);
	}
	else
	{
	testStepFail("Fail","i_S4_SRR_RL_Obj_AccelX_25 :%f",signalvalue1);
	}
}

testcase S4_SRR_RL_Obj_Mes_8_S4_SRR_RL_Obj_DistY_25()
{
	signalvalue1 = getSignal(S4_SRR_RL_Obj_DistY_25);
	write("S4_SRR_RL_Obj_DistY_25 :%f",signalvalue1);
	write("i_S4_SRR_RL_Obj_DistY_25 :%f",@ecu_Signals::i_S4_SRR_RL_Obj_DistY_25);

	testStep("get expect variable value: ","i_S4_SRR_RL_Obj_DistY_25 :%f",@ecu_Signals::i_S4_SRR_RL_Obj_DistY_25);

	if((abs(@ecu_Signals::i_S4_SRR_RL_Obj_DistY_25)*0.9<=abs(signalvalue1))&&(abs(signalvalue1)<=abs(@ecu_Signals::i_S4_SRR_RL_Obj_DistY_25)*1.1))
	{
	testStepPass("Pass","i_S4_SRR_RL_Obj_DistY_25 :%f",signalvalue1);
	}
	else
	{
	testStepFail("Fail","i_S4_SRR_RL_Obj_DistY_25 :%f",signalvalue1);
	}
}

testcase S4_SRR_RL_Obj_Mes_8_S4_SRR_RL_Obj_RelVelY_25()
{
	signalvalue1 = getSignal(S4_SRR_RL_Obj_RelVelY_25);
	write("S4_SRR_RL_Obj_RelVelY_25 :%f",signalvalue1);
	write("i_S4_SRR_RL_Obj_RelVelY_25 :%f",@ecu_Signals::i_S4_SRR_RL_Obj_RelVelY_25);

	testStep("get expect variable value: ","i_S4_SRR_RL_Obj_RelVelY_25 :%f",@ecu_Signals::i_S4_SRR_RL_Obj_RelVelY_25);

	if((abs(@ecu_Signals::i_S4_SRR_RL_Obj_RelVelY_25)*0.9<=abs(signalvalue1))&&(abs(signalvalue1)<=abs(@ecu_Signals::i_S4_SRR_RL_Obj_RelVelY_25)*1.1))
	{
	testStepPass("Pass","i_S4_SRR_RL_Obj_RelVelY_25 :%f",signalvalue1);
	}
	else
	{
	testStepFail("Fail","i_S4_SRR_RL_Obj_RelVelY_25 :%f",signalvalue1);
	}
}

testcase S4_SRR_RL_Obj_Mes_8_S4_SRR_RL_Obj_AccelY_25()
{
	signalvalue1 = getSignal(S4_SRR_RL_Obj_AccelY_25);
	write("S4_SRR_RL_Obj_AccelY_25 :%f",signalvalue1);
	write("i_S4_SRR_RL_Obj_AccelY_25 :%f",@ecu_Signals::i_S4_SRR_RL_Obj_AccelY_25);

	testStep("get expect variable value: ","i_S4_SRR_RL_Obj_AccelY_25 :%f",@ecu_Signals::i_S4_SRR_RL_Obj_AccelY_25);

	if((abs(@ecu_Signals::i_S4_SRR_RL_Obj_AccelY_25)*0.9<=abs(signalvalue1))&&(abs(signalvalue1)<=abs(@ecu_Signals::i_S4_SRR_RL_Obj_AccelY_25)*1.1))
	{
	testStepPass("Pass","i_S4_SRR_RL_Obj_AccelY_25 :%f",signalvalue1);
	}
	else
	{
	testStepFail("Fail","i_S4_SRR_RL_Obj_AccelY_25 :%f",signalvalue1);
	}
}

testcase S4_SRR_RL_Obj_Mes_8_S4_SRR_RL_Obj_DistXStd_25()
{
	signalvalue1 = getSignal(S4_SRR_RL_Obj_DistXStd_25);
	write("S4_SRR_RL_Obj_DistXStd_25 :%f",signalvalue1);
	write("i_S4_SRR_RL_Obj_DistXStd_25 :%f",@ecu_Signals::i_S4_SRR_RL_Obj_DistXStd_25);

	testStep("get expect variable value: ","i_S4_SRR_RL_Obj_DistXStd_25 :%f",@ecu_Signals::i_S4_SRR_RL_Obj_DistXStd_25);

	if((abs(@ecu_Signals::i_S4_SRR_RL_Obj_DistXStd_25)*0.9<=abs(signalvalue1))&&(abs(signalvalue1)<=abs(@ecu_Signals::i_S4_SRR_RL_Obj_DistXStd_25)*1.1))
	{
	testStepPass("Pass","i_S4_SRR_RL_Obj_DistXStd_25 :%f",signalvalue1);
	}
	else
	{
	testStepFail("Fail","i_S4_SRR_RL_Obj_DistXStd_25 :%f",signalvalue1);
	}
}

testcase S4_SRR_RL_Obj_Mes_8_S4_SRR_RL_Obj_RelVelXStd_25()
{
	signalvalue1 = getSignal(S4_SRR_RL_Obj_RelVelXStd_25);
	write("S4_SRR_RL_Obj_RelVelXStd_25 :%f",signalvalue1);
	write("i_S4_SRR_RL_Obj_RelVelXStd_25 :%f",@ecu_Signals::i_S4_SRR_RL_Obj_RelVelXStd_25);

	testStep("get expect variable value: ","i_S4_SRR_RL_Obj_RelVelXStd_25 :%f",@ecu_Signals::i_S4_SRR_RL_Obj_RelVelXStd_25);

	if((abs(@ecu_Signals::i_S4_SRR_RL_Obj_RelVelXStd_25)*0.9<=abs(signalvalue1))&&(abs(signalvalue1)<=abs(@ecu_Signals::i_S4_SRR_RL_Obj_RelVelXStd_25)*1.1))
	{
	testStepPass("Pass","i_S4_SRR_RL_Obj_RelVelXStd_25 :%f",signalvalue1);
	}
	else
	{
	testStepFail("Fail","i_S4_SRR_RL_Obj_RelVelXStd_25 :%f",signalvalue1);
	}
}

testcase S4_SRR_RL_Obj_Mes_8_S4_SRR_RL_Obj_DistYStd_25()
{
	signalvalue1 = getSignal(S4_SRR_RL_Obj_DistYStd_25);
	write("S4_SRR_RL_Obj_DistYStd_25 :%f",signalvalue1);
	write("i_S4_SRR_RL_Obj_DistYStd_25 :%f",@ecu_Signals::i_S4_SRR_RL_Obj_DistYStd_25);

	testStep("get expect variable value: ","i_S4_SRR_RL_Obj_DistYStd_25 :%f",@ecu_Signals::i_S4_SRR_RL_Obj_DistYStd_25);

	if((abs(@ecu_Signals::i_S4_SRR_RL_Obj_DistYStd_25)*0.9<=abs(signalvalue1))&&(abs(signalvalue1)<=abs(@ecu_Signals::i_S4_SRR_RL_Obj_DistYStd_25)*1.1))
	{
	testStepPass("Pass","i_S4_SRR_RL_Obj_DistYStd_25 :%f",signalvalue1);
	}
	else
	{
	testStepFail("Fail","i_S4_SRR_RL_Obj_DistYStd_25 :%f",signalvalue1);
	}
}

testcase S4_SRR_RL_Obj_Mes_8_S4_SRR_RL_Obj_RelVelYStd_25()
{
	signalvalue1 = getSignal(S4_SRR_RL_Obj_RelVelYStd_25);
	write("S4_SRR_RL_Obj_RelVelYStd_25 :%f",signalvalue1);
	write("i_S4_SRR_RL_Obj_RelVelYStd_25 :%f",@ecu_Signals::i_S4_SRR_RL_Obj_RelVelYStd_25);

	testStep("get expect variable value: ","i_S4_SRR_RL_Obj_RelVelYStd_25 :%f",@ecu_Signals::i_S4_SRR_RL_Obj_RelVelYStd_25);

	if((abs(@ecu_Signals::i_S4_SRR_RL_Obj_RelVelYStd_25)*0.9<=abs(signalvalue1))&&(abs(signalvalue1)<=abs(@ecu_Signals::i_S4_SRR_RL_Obj_RelVelYStd_25)*1.1))
	{
	testStepPass("Pass","i_S4_SRR_RL_Obj_RelVelYStd_25 :%f",signalvalue1);
	}
	else
	{
	testStepFail("Fail","i_S4_SRR_RL_Obj_RelVelYStd_25 :%f",signalvalue1);
	}
}

testcase S4_SRR_RL_Obj_Mes_8_S4_SRR_RL_Obj_UpdateFlag_25()
{
	signalvalue1 = getSignal(S4_SRR_RL_Obj_UpdateFlag_25);
	write("S4_SRR_RL_Obj_UpdateFlag_25 :%f",signalvalue1);
	write("i_S4_SRR_RL_Obj_UpdateFlag_25 :%o",@ecu_Signals::i_S4_SRR_RL_Obj_UpdateFlag_25);

	testStep("get expect variable value: ","i_S4_SRR_RL_Obj_UpdateFlag_25 :%o",@ecu_Signals::i_S4_SRR_RL_Obj_UpdateFlag_25);

	if(signalvalue1==@ecu_Signals::i_S4_SRR_RL_Obj_UpdateFlag_25)
	{
	testStepPass("Pass","i_S4_SRR_RL_Obj_UpdateFlag_25 :%f",signalvalue1);
	}
	else
	{
	testStepFail("Fail","i_S4_SRR_RL_Obj_UpdateFlag_25 :%f",signalvalue1);
	}
}

testcase S4_SRR_RL_Obj_Mes_8_S4_SRR_RL_Obj_ExistProb_25()
{
	signalvalue1 = getSignal(S4_SRR_RL_Obj_ExistProb_25);
	write("S4_SRR_RL_Obj_ExistProb_25 :%f",signalvalue1);
	write("i_S4_SRR_RL_Obj_ExistProb_25 :%o",@ecu_Signals::i_S4_SRR_RL_Obj_ExistProb_25);

	testStep("get expect variable value: ","i_S4_SRR_RL_Obj_ExistProb_25 :%o",@ecu_Signals::i_S4_SRR_RL_Obj_ExistProb_25);

	if(signalvalue1==@ecu_Signals::i_S4_SRR_RL_Obj_ExistProb_25)
	{
	testStepPass("Pass","i_S4_SRR_RL_Obj_ExistProb_25 :%f",signalvalue1);
	}
	else
	{
	testStepFail("Fail","i_S4_SRR_RL_Obj_ExistProb_25 :%f",signalvalue1);
	}
}

testcase S4_SRR_RL_Obj_Mes_8_S4_SRR_RL_Obj_Type_25()
{
	signalvalue1 = getSignal(S4_SRR_RL_Obj_Type_25);
	write("S4_SRR_RL_Obj_Type_25 :%f",signalvalue1);
	write("i_S4_SRR_RL_Obj_Type_25 :%o",@ecu_Signals::i_S4_SRR_RL_Obj_Type_25);

	testStep("get expect variable value: ","i_S4_SRR_RL_Obj_Type_25 :%o",@ecu_Signals::i_S4_SRR_RL_Obj_Type_25);

	if(signalvalue1==@ecu_Signals::i_S4_SRR_RL_Obj_Type_25)
	{
	testStepPass("Pass","i_S4_SRR_RL_Obj_Type_25 :%f",signalvalue1);
	}
	else
	{
	testStepFail("Fail","i_S4_SRR_RL_Obj_Type_25 :%f",signalvalue1);
	}
}

testcase S4_SRR_RL_Obj_Mes_8_S4_SRR_RL_Obj_EDynProp_25()
{
	signalvalue1 = getSignal(S4_SRR_RL_Obj_EDynProp_25);
	write("S4_SRR_RL_Obj_EDynProp_25 :%f",signalvalue1);
	write("i_S4_SRR_RL_Obj_EDynProp_25 :%o",@ecu_Signals::i_S4_SRR_RL_Obj_EDynProp_25);

	testStep("get expect variable value: ","i_S4_SRR_RL_Obj_EDynProp_25 :%o",@ecu_Signals::i_S4_SRR_RL_Obj_EDynProp_25);

	if(signalvalue1==@ecu_Signals::i_S4_SRR_RL_Obj_EDynProp_25)
	{
	testStepPass("Pass","i_S4_SRR_RL_Obj_EDynProp_25 :%f",signalvalue1);
	}
	else
	{
	testStepFail("Fail","i_S4_SRR_RL_Obj_EDynProp_25 :%f",signalvalue1);
	}
}

testcase S4_SRR_RL_Obj_Mes_8_S4_SRR_RL_Obj_UiLifeCycles_25()
{
	signalvalue1 = getSignal(S4_SRR_RL_Obj_UiLifeCycles_25);
	write("S4_SRR_RL_Obj_UiLifeCycles_25 :%f",signalvalue1);
	write("i_S4_SRR_RL_Obj_UiLifeCycles_25 :%o",@ecu_Signals::i_S4_SRR_RL_Obj_UiLifeCycles_25);

	testStep("get expect variable value: ","i_S4_SRR_RL_Obj_UiLifeCycles_25 :%o",@ecu_Signals::i_S4_SRR_RL_Obj_UiLifeCycles_25);

	if(signalvalue1==@ecu_Signals::i_S4_SRR_RL_Obj_UiLifeCycles_25)
	{
	testStepPass("Pass","i_S4_SRR_RL_Obj_UiLifeCycles_25 :%f",signalvalue1);
	}
	else
	{
	testStepFail("Fail","i_S4_SRR_RL_Obj_UiLifeCycles_25 :%f",signalvalue1);
	}
}

testcase S4_SRR_RL_Obj_Mes_8_S4_SRR_RL_Obj_ID_26()
{
	signalvalue1 = getSignal(S4_SRR_RL_Obj_ID_26);
	write("S4_SRR_RL_Obj_ID_26 :%f",signalvalue1);
	write("i_S4_SRR_RL_Obj_ID_26 :%o",@ecu_Signals::i_S4_SRR_RL_Obj_ID_26);

	testStep("get expect variable value: ","i_S4_SRR_RL_Obj_ID_26 :%o",@ecu_Signals::i_S4_SRR_RL_Obj_ID_26);

	if(signalvalue1==@ecu_Signals::i_S4_SRR_RL_Obj_ID_26)
	{
	testStepPass("Pass","i_S4_SRR_RL_Obj_ID_26 :%f",signalvalue1);
	}
	else
	{
	testStepFail("Fail","i_S4_SRR_RL_Obj_ID_26 :%f",signalvalue1);
	}
}

testcase S4_SRR_RL_Obj_Mes_8_S4_SRR_RL_Obj_DistX_26()
{
	signalvalue1 = getSignal(S4_SRR_RL_Obj_DistX_26);
	write("S4_SRR_RL_Obj_DistX_26 :%f",signalvalue1);
	write("i_S4_SRR_RL_Obj_DistX_26 :%f",@ecu_Signals::i_S4_SRR_RL_Obj_DistX_26);

	testStep("get expect variable value: ","i_S4_SRR_RL_Obj_DistX_26 :%f",@ecu_Signals::i_S4_SRR_RL_Obj_DistX_26);

	if((abs(@ecu_Signals::i_S4_SRR_RL_Obj_DistX_26)*0.9<=abs(signalvalue1))&&(abs(signalvalue1)<=abs(@ecu_Signals::i_S4_SRR_RL_Obj_DistX_26)*1.1))
	{
	testStepPass("Pass","i_S4_SRR_RL_Obj_DistX_26 :%f",signalvalue1);
	}
	else
	{
	testStepFail("Fail","i_S4_SRR_RL_Obj_DistX_26 :%f",signalvalue1);
	}
}

testcase S4_SRR_RL_Obj_Mes_8_S4_SRR_RL_Obj_RelVelX_26()
{
	signalvalue1 = getSignal(S4_SRR_RL_Obj_RelVelX_26);
	write("S4_SRR_RL_Obj_RelVelX_26 :%f",signalvalue1);
	write("i_S4_SRR_RL_Obj_RelVelX_26 :%f",@ecu_Signals::i_S4_SRR_RL_Obj_RelVelX_26);

	testStep("get expect variable value: ","i_S4_SRR_RL_Obj_RelVelX_26 :%f",@ecu_Signals::i_S4_SRR_RL_Obj_RelVelX_26);

	if((abs(@ecu_Signals::i_S4_SRR_RL_Obj_RelVelX_26)*0.9<=abs(signalvalue1))&&(abs(signalvalue1)<=abs(@ecu_Signals::i_S4_SRR_RL_Obj_RelVelX_26)*1.1))
	{
	testStepPass("Pass","i_S4_SRR_RL_Obj_RelVelX_26 :%f",signalvalue1);
	}
	else
	{
	testStepFail("Fail","i_S4_SRR_RL_Obj_RelVelX_26 :%f",signalvalue1);
	}
}

testcase S4_SRR_RL_Obj_Mes_8_S4_SRR_RL_Obj_AccelX_26()
{
	signalvalue1 = getSignal(S4_SRR_RL_Obj_AccelX_26);
	write("S4_SRR_RL_Obj_AccelX_26 :%f",signalvalue1);
	write("i_S4_SRR_RL_Obj_AccelX_26 :%f",@ecu_Signals::i_S4_SRR_RL_Obj_AccelX_26);

	testStep("get expect variable value: ","i_S4_SRR_RL_Obj_AccelX_26 :%f",@ecu_Signals::i_S4_SRR_RL_Obj_AccelX_26);

	if((abs(@ecu_Signals::i_S4_SRR_RL_Obj_AccelX_26)*0.9<=abs(signalvalue1))&&(abs(signalvalue1)<=abs(@ecu_Signals::i_S4_SRR_RL_Obj_AccelX_26)*1.1))
	{
	testStepPass("Pass","i_S4_SRR_RL_Obj_AccelX_26 :%f",signalvalue1);
	}
	else
	{
	testStepFail("Fail","i_S4_SRR_RL_Obj_AccelX_26 :%f",signalvalue1);
	}
}

testcase S4_SRR_RL_Obj_Mes_8_S4_SRR_RL_Obj_DistY_26()
{
	signalvalue1 = getSignal(S4_SRR_RL_Obj_DistY_26);
	write("S4_SRR_RL_Obj_DistY_26 :%f",signalvalue1);
	write("i_S4_SRR_RL_Obj_DistY_26 :%f",@ecu_Signals::i_S4_SRR_RL_Obj_DistY_26);

	testStep("get expect variable value: ","i_S4_SRR_RL_Obj_DistY_26 :%f",@ecu_Signals::i_S4_SRR_RL_Obj_DistY_26);

	if((abs(@ecu_Signals::i_S4_SRR_RL_Obj_DistY_26)*0.9<=abs(signalvalue1))&&(abs(signalvalue1)<=abs(@ecu_Signals::i_S4_SRR_RL_Obj_DistY_26)*1.1))
	{
	testStepPass("Pass","i_S4_SRR_RL_Obj_DistY_26 :%f",signalvalue1);
	}
	else
	{
	testStepFail("Fail","i_S4_SRR_RL_Obj_DistY_26 :%f",signalvalue1);
	}
}

testcase S4_SRR_RL_Obj_Mes_8_S4_SRR_RL_Obj_RelVelY_26()
{
	signalvalue1 = getSignal(S4_SRR_RL_Obj_RelVelY_26);
	write("S4_SRR_RL_Obj_RelVelY_26 :%f",signalvalue1);
	write("i_S4_SRR_RL_Obj_RelVelY_26 :%f",@ecu_Signals::i_S4_SRR_RL_Obj_RelVelY_26);

	testStep("get expect variable value: ","i_S4_SRR_RL_Obj_RelVelY_26 :%f",@ecu_Signals::i_S4_SRR_RL_Obj_RelVelY_26);

	if((abs(@ecu_Signals::i_S4_SRR_RL_Obj_RelVelY_26)*0.9<=abs(signalvalue1))&&(abs(signalvalue1)<=abs(@ecu_Signals::i_S4_SRR_RL_Obj_RelVelY_26)*1.1))
	{
	testStepPass("Pass","i_S4_SRR_RL_Obj_RelVelY_26 :%f",signalvalue1);
	}
	else
	{
	testStepFail("Fail","i_S4_SRR_RL_Obj_RelVelY_26 :%f",signalvalue1);
	}
}

testcase S4_SRR_RL_Obj_Mes_8_S4_SRR_RL_Obj_AccelY_26()
{
	signalvalue1 = getSignal(S4_SRR_RL_Obj_AccelY_26);
	write("S4_SRR_RL_Obj_AccelY_26 :%f",signalvalue1);
	write("i_S4_SRR_RL_Obj_AccelY_26 :%f",@ecu_Signals::i_S4_SRR_RL_Obj_AccelY_26);

	testStep("get expect variable value: ","i_S4_SRR_RL_Obj_AccelY_26 :%f",@ecu_Signals::i_S4_SRR_RL_Obj_AccelY_26);

	if((abs(@ecu_Signals::i_S4_SRR_RL_Obj_AccelY_26)*0.9<=abs(signalvalue1))&&(abs(signalvalue1)<=abs(@ecu_Signals::i_S4_SRR_RL_Obj_AccelY_26)*1.1))
	{
	testStepPass("Pass","i_S4_SRR_RL_Obj_AccelY_26 :%f",signalvalue1);
	}
	else
	{
	testStepFail("Fail","i_S4_SRR_RL_Obj_AccelY_26 :%f",signalvalue1);
	}
}

testcase S4_SRR_RL_Obj_Mes_8_S4_SRR_RL_Obj_DistXStd_26()
{
	signalvalue1 = getSignal(S4_SRR_RL_Obj_DistXStd_26);
	write("S4_SRR_RL_Obj_DistXStd_26 :%f",signalvalue1);
	write("i_S4_SRR_RL_Obj_DistXStd_26 :%f",@ecu_Signals::i_S4_SRR_RL_Obj_DistXStd_26);

	testStep("get expect variable value: ","i_S4_SRR_RL_Obj_DistXStd_26 :%f",@ecu_Signals::i_S4_SRR_RL_Obj_DistXStd_26);

	if((abs(@ecu_Signals::i_S4_SRR_RL_Obj_DistXStd_26)*0.9<=abs(signalvalue1))&&(abs(signalvalue1)<=abs(@ecu_Signals::i_S4_SRR_RL_Obj_DistXStd_26)*1.1))
	{
	testStepPass("Pass","i_S4_SRR_RL_Obj_DistXStd_26 :%f",signalvalue1);
	}
	else
	{
	testStepFail("Fail","i_S4_SRR_RL_Obj_DistXStd_26 :%f",signalvalue1);
	}
}

testcase S4_SRR_RL_Obj_Mes_8_S4_SRR_RL_Obj_RelVelXStd_26()
{
	signalvalue1 = getSignal(S4_SRR_RL_Obj_RelVelXStd_26);
	write("S4_SRR_RL_Obj_RelVelXStd_26 :%f",signalvalue1);
	write("i_S4_SRR_RL_Obj_RelVelXStd_26 :%f",@ecu_Signals::i_S4_SRR_RL_Obj_RelVelXStd_26);

	testStep("get expect variable value: ","i_S4_SRR_RL_Obj_RelVelXStd_26 :%f",@ecu_Signals::i_S4_SRR_RL_Obj_RelVelXStd_26);

	if((abs(@ecu_Signals::i_S4_SRR_RL_Obj_RelVelXStd_26)*0.9<=abs(signalvalue1))&&(abs(signalvalue1)<=abs(@ecu_Signals::i_S4_SRR_RL_Obj_RelVelXStd_26)*1.1))
	{
	testStepPass("Pass","i_S4_SRR_RL_Obj_RelVelXStd_26 :%f",signalvalue1);
	}
	else
	{
	testStepFail("Fail","i_S4_SRR_RL_Obj_RelVelXStd_26 :%f",signalvalue1);
	}
}

testcase S4_SRR_RL_Obj_Mes_8_S4_SRR_RL_Obj_DistYStd_26()
{
	signalvalue1 = getSignal(S4_SRR_RL_Obj_DistYStd_26);
	write("S4_SRR_RL_Obj_DistYStd_26 :%f",signalvalue1);
	write("i_S4_SRR_RL_Obj_DistYStd_26 :%f",@ecu_Signals::i_S4_SRR_RL_Obj_DistYStd_26);

	testStep("get expect variable value: ","i_S4_SRR_RL_Obj_DistYStd_26 :%f",@ecu_Signals::i_S4_SRR_RL_Obj_DistYStd_26);

	if((abs(@ecu_Signals::i_S4_SRR_RL_Obj_DistYStd_26)*0.9<=abs(signalvalue1))&&(abs(signalvalue1)<=abs(@ecu_Signals::i_S4_SRR_RL_Obj_DistYStd_26)*1.1))
	{
	testStepPass("Pass","i_S4_SRR_RL_Obj_DistYStd_26 :%f",signalvalue1);
	}
	else
	{
	testStepFail("Fail","i_S4_SRR_RL_Obj_DistYStd_26 :%f",signalvalue1);
	}
}

testcase S4_SRR_RL_Obj_Mes_8_S4_SRR_RL_Obj_RelVelYStd_26()
{
	signalvalue1 = getSignal(S4_SRR_RL_Obj_RelVelYStd_26);
	write("S4_SRR_RL_Obj_RelVelYStd_26 :%f",signalvalue1);
	write("i_S4_SRR_RL_Obj_RelVelYStd_26 :%f",@ecu_Signals::i_S4_SRR_RL_Obj_RelVelYStd_26);

	testStep("get expect variable value: ","i_S4_SRR_RL_Obj_RelVelYStd_26 :%f",@ecu_Signals::i_S4_SRR_RL_Obj_RelVelYStd_26);

	if((abs(@ecu_Signals::i_S4_SRR_RL_Obj_RelVelYStd_26)*0.9<=abs(signalvalue1))&&(abs(signalvalue1)<=abs(@ecu_Signals::i_S4_SRR_RL_Obj_RelVelYStd_26)*1.1))
	{
	testStepPass("Pass","i_S4_SRR_RL_Obj_RelVelYStd_26 :%f",signalvalue1);
	}
	else
	{
	testStepFail("Fail","i_S4_SRR_RL_Obj_RelVelYStd_26 :%f",signalvalue1);
	}
}

testcase S4_SRR_RL_Obj_Mes_8_S4_SRR_RL_Obj_UpdateFlag_26()
{
	signalvalue1 = getSignal(S4_SRR_RL_Obj_UpdateFlag_26);
	write("S4_SRR_RL_Obj_UpdateFlag_26 :%f",signalvalue1);
	write("i_S4_SRR_RL_Obj_UpdateFlag_26 :%o",@ecu_Signals::i_S4_SRR_RL_Obj_UpdateFlag_26);

	testStep("get expect variable value: ","i_S4_SRR_RL_Obj_UpdateFlag_26 :%o",@ecu_Signals::i_S4_SRR_RL_Obj_UpdateFlag_26);

	if(signalvalue1==@ecu_Signals::i_S4_SRR_RL_Obj_UpdateFlag_26)
	{
	testStepPass("Pass","i_S4_SRR_RL_Obj_UpdateFlag_26 :%f",signalvalue1);
	}
	else
	{
	testStepFail("Fail","i_S4_SRR_RL_Obj_UpdateFlag_26 :%f",signalvalue1);
	}
}

testcase S4_SRR_RL_Obj_Mes_8_S4_SRR_RL_Obj_ExistProb_26()
{
	signalvalue1 = getSignal(S4_SRR_RL_Obj_ExistProb_26);
	write("S4_SRR_RL_Obj_ExistProb_26 :%f",signalvalue1);
	write("i_S4_SRR_RL_Obj_ExistProb_26 :%o",@ecu_Signals::i_S4_SRR_RL_Obj_ExistProb_26);

	testStep("get expect variable value: ","i_S4_SRR_RL_Obj_ExistProb_26 :%o",@ecu_Signals::i_S4_SRR_RL_Obj_ExistProb_26);

	if(signalvalue1==@ecu_Signals::i_S4_SRR_RL_Obj_ExistProb_26)
	{
	testStepPass("Pass","i_S4_SRR_RL_Obj_ExistProb_26 :%f",signalvalue1);
	}
	else
	{
	testStepFail("Fail","i_S4_SRR_RL_Obj_ExistProb_26 :%f",signalvalue1);
	}
}

testcase S4_SRR_RL_Obj_Mes_8_S4_SRR_RL_Obj_Type_26()
{
	signalvalue1 = getSignal(S4_SRR_RL_Obj_Type_26);
	write("S4_SRR_RL_Obj_Type_26 :%f",signalvalue1);
	write("i_S4_SRR_RL_Obj_Type_26 :%o",@ecu_Signals::i_S4_SRR_RL_Obj_Type_26);

	testStep("get expect variable value: ","i_S4_SRR_RL_Obj_Type_26 :%o",@ecu_Signals::i_S4_SRR_RL_Obj_Type_26);

	if(signalvalue1==@ecu_Signals::i_S4_SRR_RL_Obj_Type_26)
	{
	testStepPass("Pass","i_S4_SRR_RL_Obj_Type_26 :%f",signalvalue1);
	}
	else
	{
	testStepFail("Fail","i_S4_SRR_RL_Obj_Type_26 :%f",signalvalue1);
	}
}

testcase S4_SRR_RL_Obj_Mes_8_S4_SRR_RL_Obj_EDynProp_26()
{
	signalvalue1 = getSignal(S4_SRR_RL_Obj_EDynProp_26);
	write("S4_SRR_RL_Obj_EDynProp_26 :%f",signalvalue1);
	write("i_S4_SRR_RL_Obj_EDynProp_26 :%o",@ecu_Signals::i_S4_SRR_RL_Obj_EDynProp_26);

	testStep("get expect variable value: ","i_S4_SRR_RL_Obj_EDynProp_26 :%o",@ecu_Signals::i_S4_SRR_RL_Obj_EDynProp_26);

	if(signalvalue1==@ecu_Signals::i_S4_SRR_RL_Obj_EDynProp_26)
	{
	testStepPass("Pass","i_S4_SRR_RL_Obj_EDynProp_26 :%f",signalvalue1);
	}
	else
	{
	testStepFail("Fail","i_S4_SRR_RL_Obj_EDynProp_26 :%f",signalvalue1);
	}
}

testcase S4_SRR_RL_Obj_Mes_8_S4_SRR_RL_Obj_UiLifeCycles_26()
{
	signalvalue1 = getSignal(S4_SRR_RL_Obj_UiLifeCycles_26);
	write("S4_SRR_RL_Obj_UiLifeCycles_26 :%f",signalvalue1);
	write("i_S4_SRR_RL_Obj_UiLifeCycles_26 :%o",@ecu_Signals::i_S4_SRR_RL_Obj_UiLifeCycles_26);

	testStep("get expect variable value: ","i_S4_SRR_RL_Obj_UiLifeCycles_26 :%o",@ecu_Signals::i_S4_SRR_RL_Obj_UiLifeCycles_26);

	if(signalvalue1==@ecu_Signals::i_S4_SRR_RL_Obj_UiLifeCycles_26)
	{
	testStepPass("Pass","i_S4_SRR_RL_Obj_UiLifeCycles_26 :%f",signalvalue1);
	}
	else
	{
	testStepFail("Fail","i_S4_SRR_RL_Obj_UiLifeCycles_26 :%f",signalvalue1);
	}
}

testcase S4_SRR_RL_Obj_Mes_9_S4_SRR_RL_Obj_ID_27()
{
	signalvalue1 = getSignal(S4_SRR_RL_Obj_ID_27);
	write("S4_SRR_RL_Obj_ID_27 :%f",signalvalue1);
	write("i_S4_SRR_RL_Obj_ID_27 :%o",@ecu_Signals::i_S4_SRR_RL_Obj_ID_27);

	testStep("get expect variable value: ","i_S4_SRR_RL_Obj_ID_27 :%o",@ecu_Signals::i_S4_SRR_RL_Obj_ID_27);

	if(signalvalue1==@ecu_Signals::i_S4_SRR_RL_Obj_ID_27)
	{
	testStepPass("Pass","i_S4_SRR_RL_Obj_ID_27 :%f",signalvalue1);
	}
	else
	{
	testStepFail("Fail","i_S4_SRR_RL_Obj_ID_27 :%f",signalvalue1);
	}
}

testcase S4_SRR_RL_Obj_Mes_9_S4_SRR_RL_Obj_DistX_27()
{
	signalvalue1 = getSignal(S4_SRR_RL_Obj_DistX_27);
	write("S4_SRR_RL_Obj_DistX_27 :%f",signalvalue1);
	write("i_S4_SRR_RL_Obj_DistX_27 :%f",@ecu_Signals::i_S4_SRR_RL_Obj_DistX_27);

	testStep("get expect variable value: ","i_S4_SRR_RL_Obj_DistX_27 :%f",@ecu_Signals::i_S4_SRR_RL_Obj_DistX_27);

	if((abs(@ecu_Signals::i_S4_SRR_RL_Obj_DistX_27)*0.9<=abs(signalvalue1))&&(abs(signalvalue1)<=abs(@ecu_Signals::i_S4_SRR_RL_Obj_DistX_27)*1.1))
	{
	testStepPass("Pass","i_S4_SRR_RL_Obj_DistX_27 :%f",signalvalue1);
	}
	else
	{
	testStepFail("Fail","i_S4_SRR_RL_Obj_DistX_27 :%f",signalvalue1);
	}
}

testcase S4_SRR_RL_Obj_Mes_9_S4_SRR_RL_Obj_RelVelX_27()
{
	signalvalue1 = getSignal(S4_SRR_RL_Obj_RelVelX_27);
	write("S4_SRR_RL_Obj_RelVelX_27 :%f",signalvalue1);
	write("i_S4_SRR_RL_Obj_RelVelX_27 :%f",@ecu_Signals::i_S4_SRR_RL_Obj_RelVelX_27);

	testStep("get expect variable value: ","i_S4_SRR_RL_Obj_RelVelX_27 :%f",@ecu_Signals::i_S4_SRR_RL_Obj_RelVelX_27);

	if((abs(@ecu_Signals::i_S4_SRR_RL_Obj_RelVelX_27)*0.9<=abs(signalvalue1))&&(abs(signalvalue1)<=abs(@ecu_Signals::i_S4_SRR_RL_Obj_RelVelX_27)*1.1))
	{
	testStepPass("Pass","i_S4_SRR_RL_Obj_RelVelX_27 :%f",signalvalue1);
	}
	else
	{
	testStepFail("Fail","i_S4_SRR_RL_Obj_RelVelX_27 :%f",signalvalue1);
	}
}

testcase S4_SRR_RL_Obj_Mes_9_S4_SRR_RL_Obj_AccelX_27()
{
	signalvalue1 = getSignal(S4_SRR_RL_Obj_AccelX_27);
	write("S4_SRR_RL_Obj_AccelX_27 :%f",signalvalue1);
	write("i_S4_SRR_RL_Obj_AccelX_27 :%f",@ecu_Signals::i_S4_SRR_RL_Obj_AccelX_27);

	testStep("get expect variable value: ","i_S4_SRR_RL_Obj_AccelX_27 :%f",@ecu_Signals::i_S4_SRR_RL_Obj_AccelX_27);

	if((abs(@ecu_Signals::i_S4_SRR_RL_Obj_AccelX_27)*0.9<=abs(signalvalue1))&&(abs(signalvalue1)<=abs(@ecu_Signals::i_S4_SRR_RL_Obj_AccelX_27)*1.1))
	{
	testStepPass("Pass","i_S4_SRR_RL_Obj_AccelX_27 :%f",signalvalue1);
	}
	else
	{
	testStepFail("Fail","i_S4_SRR_RL_Obj_AccelX_27 :%f",signalvalue1);
	}
}

testcase S4_SRR_RL_Obj_Mes_9_S4_SRR_RL_Obj_DistY_27()
{
	signalvalue1 = getSignal(S4_SRR_RL_Obj_DistY_27);
	write("S4_SRR_RL_Obj_DistY_27 :%f",signalvalue1);
	write("i_S4_SRR_RL_Obj_DistY_27 :%f",@ecu_Signals::i_S4_SRR_RL_Obj_DistY_27);

	testStep("get expect variable value: ","i_S4_SRR_RL_Obj_DistY_27 :%f",@ecu_Signals::i_S4_SRR_RL_Obj_DistY_27);

	if((abs(@ecu_Signals::i_S4_SRR_RL_Obj_DistY_27)*0.9<=abs(signalvalue1))&&(abs(signalvalue1)<=abs(@ecu_Signals::i_S4_SRR_RL_Obj_DistY_27)*1.1))
	{
	testStepPass("Pass","i_S4_SRR_RL_Obj_DistY_27 :%f",signalvalue1);
	}
	else
	{
	testStepFail("Fail","i_S4_SRR_RL_Obj_DistY_27 :%f",signalvalue1);
	}
}

testcase S4_SRR_RL_Obj_Mes_9_S4_SRR_RL_Obj_RelVelY_27()
{
	signalvalue1 = getSignal(S4_SRR_RL_Obj_RelVelY_27);
	write("S4_SRR_RL_Obj_RelVelY_27 :%f",signalvalue1);
	write("i_S4_SRR_RL_Obj_RelVelY_27 :%f",@ecu_Signals::i_S4_SRR_RL_Obj_RelVelY_27);

	testStep("get expect variable value: ","i_S4_SRR_RL_Obj_RelVelY_27 :%f",@ecu_Signals::i_S4_SRR_RL_Obj_RelVelY_27);

	if((abs(@ecu_Signals::i_S4_SRR_RL_Obj_RelVelY_27)*0.9<=abs(signalvalue1))&&(abs(signalvalue1)<=abs(@ecu_Signals::i_S4_SRR_RL_Obj_RelVelY_27)*1.1))
	{
	testStepPass("Pass","i_S4_SRR_RL_Obj_RelVelY_27 :%f",signalvalue1);
	}
	else
	{
	testStepFail("Fail","i_S4_SRR_RL_Obj_RelVelY_27 :%f",signalvalue1);
	}
}

testcase S4_SRR_RL_Obj_Mes_9_S4_SRR_RL_Obj_AccelY_27()
{
	signalvalue1 = getSignal(S4_SRR_RL_Obj_AccelY_27);
	write("S4_SRR_RL_Obj_AccelY_27 :%f",signalvalue1);
	write("i_S4_SRR_RL_Obj_AccelY_27 :%f",@ecu_Signals::i_S4_SRR_RL_Obj_AccelY_27);

	testStep("get expect variable value: ","i_S4_SRR_RL_Obj_AccelY_27 :%f",@ecu_Signals::i_S4_SRR_RL_Obj_AccelY_27);

	if((abs(@ecu_Signals::i_S4_SRR_RL_Obj_AccelY_27)*0.9<=abs(signalvalue1))&&(abs(signalvalue1)<=abs(@ecu_Signals::i_S4_SRR_RL_Obj_AccelY_27)*1.1))
	{
	testStepPass("Pass","i_S4_SRR_RL_Obj_AccelY_27 :%f",signalvalue1);
	}
	else
	{
	testStepFail("Fail","i_S4_SRR_RL_Obj_AccelY_27 :%f",signalvalue1);
	}
}

testcase S4_SRR_RL_Obj_Mes_9_S4_SRR_RL_Obj_DistXStd_27()
{
	signalvalue1 = getSignal(S4_SRR_RL_Obj_DistXStd_27);
	write("S4_SRR_RL_Obj_DistXStd_27 :%f",signalvalue1);
	write("i_S4_SRR_RL_Obj_DistXStd_27 :%f",@ecu_Signals::i_S4_SRR_RL_Obj_DistXStd_27);

	testStep("get expect variable value: ","i_S4_SRR_RL_Obj_DistXStd_27 :%f",@ecu_Signals::i_S4_SRR_RL_Obj_DistXStd_27);

	if((abs(@ecu_Signals::i_S4_SRR_RL_Obj_DistXStd_27)*0.9<=abs(signalvalue1))&&(abs(signalvalue1)<=abs(@ecu_Signals::i_S4_SRR_RL_Obj_DistXStd_27)*1.1))
	{
	testStepPass("Pass","i_S4_SRR_RL_Obj_DistXStd_27 :%f",signalvalue1);
	}
	else
	{
	testStepFail("Fail","i_S4_SRR_RL_Obj_DistXStd_27 :%f",signalvalue1);
	}
}

testcase S4_SRR_RL_Obj_Mes_9_S4_SRR_RL_Obj_RelVelXStd_27()
{
	signalvalue1 = getSignal(S4_SRR_RL_Obj_RelVelXStd_27);
	write("S4_SRR_RL_Obj_RelVelXStd_27 :%f",signalvalue1);
	write("i_S4_SRR_RL_Obj_RelVelXStd_27 :%f",@ecu_Signals::i_S4_SRR_RL_Obj_RelVelXStd_27);

	testStep("get expect variable value: ","i_S4_SRR_RL_Obj_RelVelXStd_27 :%f",@ecu_Signals::i_S4_SRR_RL_Obj_RelVelXStd_27);

	if((abs(@ecu_Signals::i_S4_SRR_RL_Obj_RelVelXStd_27)*0.9<=abs(signalvalue1))&&(abs(signalvalue1)<=abs(@ecu_Signals::i_S4_SRR_RL_Obj_RelVelXStd_27)*1.1))
	{
	testStepPass("Pass","i_S4_SRR_RL_Obj_RelVelXStd_27 :%f",signalvalue1);
	}
	else
	{
	testStepFail("Fail","i_S4_SRR_RL_Obj_RelVelXStd_27 :%f",signalvalue1);
	}
}

testcase S4_SRR_RL_Obj_Mes_9_S4_SRR_RL_Obj_DistYStd_27()
{
	signalvalue1 = getSignal(S4_SRR_RL_Obj_DistYStd_27);
	write("S4_SRR_RL_Obj_DistYStd_27 :%f",signalvalue1);
	write("i_S4_SRR_RL_Obj_DistYStd_27 :%f",@ecu_Signals::i_S4_SRR_RL_Obj_DistYStd_27);

	testStep("get expect variable value: ","i_S4_SRR_RL_Obj_DistYStd_27 :%f",@ecu_Signals::i_S4_SRR_RL_Obj_DistYStd_27);

	if((abs(@ecu_Signals::i_S4_SRR_RL_Obj_DistYStd_27)*0.9<=abs(signalvalue1))&&(abs(signalvalue1)<=abs(@ecu_Signals::i_S4_SRR_RL_Obj_DistYStd_27)*1.1))
	{
	testStepPass("Pass","i_S4_SRR_RL_Obj_DistYStd_27 :%f",signalvalue1);
	}
	else
	{
	testStepFail("Fail","i_S4_SRR_RL_Obj_DistYStd_27 :%f",signalvalue1);
	}
}

testcase S4_SRR_RL_Obj_Mes_9_S4_SRR_RL_Obj_RelVelYStd_27()
{
	signalvalue1 = getSignal(S4_SRR_RL_Obj_RelVelYStd_27);
	write("S4_SRR_RL_Obj_RelVelYStd_27 :%f",signalvalue1);
	write("i_S4_SRR_RL_Obj_RelVelYStd_27 :%f",@ecu_Signals::i_S4_SRR_RL_Obj_RelVelYStd_27);

	testStep("get expect variable value: ","i_S4_SRR_RL_Obj_RelVelYStd_27 :%f",@ecu_Signals::i_S4_SRR_RL_Obj_RelVelYStd_27);

	if((abs(@ecu_Signals::i_S4_SRR_RL_Obj_RelVelYStd_27)*0.9<=abs(signalvalue1))&&(abs(signalvalue1)<=abs(@ecu_Signals::i_S4_SRR_RL_Obj_RelVelYStd_27)*1.1))
	{
	testStepPass("Pass","i_S4_SRR_RL_Obj_RelVelYStd_27 :%f",signalvalue1);
	}
	else
	{
	testStepFail("Fail","i_S4_SRR_RL_Obj_RelVelYStd_27 :%f",signalvalue1);
	}
}

testcase S4_SRR_RL_Obj_Mes_9_S4_SRR_RL_Obj_UpdateFlag_27()
{
	signalvalue1 = getSignal(S4_SRR_RL_Obj_UpdateFlag_27);
	write("S4_SRR_RL_Obj_UpdateFlag_27 :%f",signalvalue1);
	write("i_S4_SRR_RL_Obj_UpdateFlag_27 :%o",@ecu_Signals::i_S4_SRR_RL_Obj_UpdateFlag_27);

	testStep("get expect variable value: ","i_S4_SRR_RL_Obj_UpdateFlag_27 :%o",@ecu_Signals::i_S4_SRR_RL_Obj_UpdateFlag_27);

	if(signalvalue1==@ecu_Signals::i_S4_SRR_RL_Obj_UpdateFlag_27)
	{
	testStepPass("Pass","i_S4_SRR_RL_Obj_UpdateFlag_27 :%f",signalvalue1);
	}
	else
	{
	testStepFail("Fail","i_S4_SRR_RL_Obj_UpdateFlag_27 :%f",signalvalue1);
	}
}

testcase S4_SRR_RL_Obj_Mes_9_S4_SRR_RL_Obj_ExistProb_27()
{
	signalvalue1 = getSignal(S4_SRR_RL_Obj_ExistProb_27);
	write("S4_SRR_RL_Obj_ExistProb_27 :%f",signalvalue1);
	write("i_S4_SRR_RL_Obj_ExistProb_27 :%o",@ecu_Signals::i_S4_SRR_RL_Obj_ExistProb_27);

	testStep("get expect variable value: ","i_S4_SRR_RL_Obj_ExistProb_27 :%o",@ecu_Signals::i_S4_SRR_RL_Obj_ExistProb_27);

	if(signalvalue1==@ecu_Signals::i_S4_SRR_RL_Obj_ExistProb_27)
	{
	testStepPass("Pass","i_S4_SRR_RL_Obj_ExistProb_27 :%f",signalvalue1);
	}
	else
	{
	testStepFail("Fail","i_S4_SRR_RL_Obj_ExistProb_27 :%f",signalvalue1);
	}
}

testcase S4_SRR_RL_Obj_Mes_9_S4_SRR_RL_Obj_Type_27()
{
	signalvalue1 = getSignal(S4_SRR_RL_Obj_Type_27);
	write("S4_SRR_RL_Obj_Type_27 :%f",signalvalue1);
	write("i_S4_SRR_RL_Obj_Type_27 :%o",@ecu_Signals::i_S4_SRR_RL_Obj_Type_27);

	testStep("get expect variable value: ","i_S4_SRR_RL_Obj_Type_27 :%o",@ecu_Signals::i_S4_SRR_RL_Obj_Type_27);

	if(signalvalue1==@ecu_Signals::i_S4_SRR_RL_Obj_Type_27)
	{
	testStepPass("Pass","i_S4_SRR_RL_Obj_Type_27 :%f",signalvalue1);
	}
	else
	{
	testStepFail("Fail","i_S4_SRR_RL_Obj_Type_27 :%f",signalvalue1);
	}
}

testcase S4_SRR_RL_Obj_Mes_9_S4_SRR_RL_Obj_EDynProp_27()
{
	signalvalue1 = getSignal(S4_SRR_RL_Obj_EDynProp_27);
	write("S4_SRR_RL_Obj_EDynProp_27 :%f",signalvalue1);
	write("i_S4_SRR_RL_Obj_EDynProp_27 :%o",@ecu_Signals::i_S4_SRR_RL_Obj_EDynProp_27);

	testStep("get expect variable value: ","i_S4_SRR_RL_Obj_EDynProp_27 :%o",@ecu_Signals::i_S4_SRR_RL_Obj_EDynProp_27);

	if(signalvalue1==@ecu_Signals::i_S4_SRR_RL_Obj_EDynProp_27)
	{
	testStepPass("Pass","i_S4_SRR_RL_Obj_EDynProp_27 :%f",signalvalue1);
	}
	else
	{
	testStepFail("Fail","i_S4_SRR_RL_Obj_EDynProp_27 :%f",signalvalue1);
	}
}

testcase S4_SRR_RL_Obj_Mes_9_S4_SRR_RL_Obj_UiLifeCycles_27()
{
	signalvalue1 = getSignal(S4_SRR_RL_Obj_UiLifeCycles_27);
	write("S4_SRR_RL_Obj_UiLifeCycles_27 :%f",signalvalue1);
	write("i_S4_SRR_RL_Obj_UiLifeCycles_27 :%o",@ecu_Signals::i_S4_SRR_RL_Obj_UiLifeCycles_27);

	testStep("get expect variable value: ","i_S4_SRR_RL_Obj_UiLifeCycles_27 :%o",@ecu_Signals::i_S4_SRR_RL_Obj_UiLifeCycles_27);

	if(signalvalue1==@ecu_Signals::i_S4_SRR_RL_Obj_UiLifeCycles_27)
	{
	testStepPass("Pass","i_S4_SRR_RL_Obj_UiLifeCycles_27 :%f",signalvalue1);
	}
	else
	{
	testStepFail("Fail","i_S4_SRR_RL_Obj_UiLifeCycles_27 :%f",signalvalue1);
	}
}

testcase S4_SRR_RL_Obj_Mes_9_S4_SRR_RL_Obj_ID_28()
{
	signalvalue1 = getSignal(S4_SRR_RL_Obj_ID_28);
	write("S4_SRR_RL_Obj_ID_28 :%f",signalvalue1);
	write("i_S4_SRR_RL_Obj_ID_28 :%o",@ecu_Signals::i_S4_SRR_RL_Obj_ID_28);

	testStep("get expect variable value: ","i_S4_SRR_RL_Obj_ID_28 :%o",@ecu_Signals::i_S4_SRR_RL_Obj_ID_28);

	if(signalvalue1==@ecu_Signals::i_S4_SRR_RL_Obj_ID_28)
	{
	testStepPass("Pass","i_S4_SRR_RL_Obj_ID_28 :%f",signalvalue1);
	}
	else
	{
	testStepFail("Fail","i_S4_SRR_RL_Obj_ID_28 :%f",signalvalue1);
	}
}

testcase S4_SRR_RL_Obj_Mes_9_S4_SRR_RL_Obj_DistX_28()
{
	signalvalue1 = getSignal(S4_SRR_RL_Obj_DistX_28);
	write("S4_SRR_RL_Obj_DistX_28 :%f",signalvalue1);
	write("i_S4_SRR_RL_Obj_DistX_28 :%f",@ecu_Signals::i_S4_SRR_RL_Obj_DistX_28);

	testStep("get expect variable value: ","i_S4_SRR_RL_Obj_DistX_28 :%f",@ecu_Signals::i_S4_SRR_RL_Obj_DistX_28);

	if((abs(@ecu_Signals::i_S4_SRR_RL_Obj_DistX_28)*0.9<=abs(signalvalue1))&&(abs(signalvalue1)<=abs(@ecu_Signals::i_S4_SRR_RL_Obj_DistX_28)*1.1))
	{
	testStepPass("Pass","i_S4_SRR_RL_Obj_DistX_28 :%f",signalvalue1);
	}
	else
	{
	testStepFail("Fail","i_S4_SRR_RL_Obj_DistX_28 :%f",signalvalue1);
	}
}

testcase S4_SRR_RL_Obj_Mes_9_S4_SRR_RL_Obj_RelVelX_28()
{
	signalvalue1 = getSignal(S4_SRR_RL_Obj_RelVelX_28);
	write("S4_SRR_RL_Obj_RelVelX_28 :%f",signalvalue1);
	write("i_S4_SRR_RL_Obj_RelVelX_28 :%f",@ecu_Signals::i_S4_SRR_RL_Obj_RelVelX_28);

	testStep("get expect variable value: ","i_S4_SRR_RL_Obj_RelVelX_28 :%f",@ecu_Signals::i_S4_SRR_RL_Obj_RelVelX_28);

	if((abs(@ecu_Signals::i_S4_SRR_RL_Obj_RelVelX_28)*0.9<=abs(signalvalue1))&&(abs(signalvalue1)<=abs(@ecu_Signals::i_S4_SRR_RL_Obj_RelVelX_28)*1.1))
	{
	testStepPass("Pass","i_S4_SRR_RL_Obj_RelVelX_28 :%f",signalvalue1);
	}
	else
	{
	testStepFail("Fail","i_S4_SRR_RL_Obj_RelVelX_28 :%f",signalvalue1);
	}
}

testcase S4_SRR_RL_Obj_Mes_9_S4_SRR_RL_Obj_AccelX_28()
{
	signalvalue1 = getSignal(S4_SRR_RL_Obj_AccelX_28);
	write("S4_SRR_RL_Obj_AccelX_28 :%f",signalvalue1);
	write("i_S4_SRR_RL_Obj_AccelX_28 :%f",@ecu_Signals::i_S4_SRR_RL_Obj_AccelX_28);

	testStep("get expect variable value: ","i_S4_SRR_RL_Obj_AccelX_28 :%f",@ecu_Signals::i_S4_SRR_RL_Obj_AccelX_28);

	if((abs(@ecu_Signals::i_S4_SRR_RL_Obj_AccelX_28)*0.9<=abs(signalvalue1))&&(abs(signalvalue1)<=abs(@ecu_Signals::i_S4_SRR_RL_Obj_AccelX_28)*1.1))
	{
	testStepPass("Pass","i_S4_SRR_RL_Obj_AccelX_28 :%f",signalvalue1);
	}
	else
	{
	testStepFail("Fail","i_S4_SRR_RL_Obj_AccelX_28 :%f",signalvalue1);
	}
}

testcase S4_SRR_RL_Obj_Mes_9_S4_SRR_RL_Obj_DistY_28()
{
	signalvalue1 = getSignal(S4_SRR_RL_Obj_DistY_28);
	write("S4_SRR_RL_Obj_DistY_28 :%f",signalvalue1);
	write("i_S4_SRR_RL_Obj_DistY_28 :%f",@ecu_Signals::i_S4_SRR_RL_Obj_DistY_28);

	testStep("get expect variable value: ","i_S4_SRR_RL_Obj_DistY_28 :%f",@ecu_Signals::i_S4_SRR_RL_Obj_DistY_28);

	if((abs(@ecu_Signals::i_S4_SRR_RL_Obj_DistY_28)*0.9<=abs(signalvalue1))&&(abs(signalvalue1)<=abs(@ecu_Signals::i_S4_SRR_RL_Obj_DistY_28)*1.1))
	{
	testStepPass("Pass","i_S4_SRR_RL_Obj_DistY_28 :%f",signalvalue1);
	}
	else
	{
	testStepFail("Fail","i_S4_SRR_RL_Obj_DistY_28 :%f",signalvalue1);
	}
}

testcase S4_SRR_RL_Obj_Mes_9_S4_SRR_RL_Obj_RelVelY_28()
{
	signalvalue1 = getSignal(S4_SRR_RL_Obj_RelVelY_28);
	write("S4_SRR_RL_Obj_RelVelY_28 :%f",signalvalue1);
	write("i_S4_SRR_RL_Obj_RelVelY_28 :%f",@ecu_Signals::i_S4_SRR_RL_Obj_RelVelY_28);

	testStep("get expect variable value: ","i_S4_SRR_RL_Obj_RelVelY_28 :%f",@ecu_Signals::i_S4_SRR_RL_Obj_RelVelY_28);

	if((abs(@ecu_Signals::i_S4_SRR_RL_Obj_RelVelY_28)*0.9<=abs(signalvalue1))&&(abs(signalvalue1)<=abs(@ecu_Signals::i_S4_SRR_RL_Obj_RelVelY_28)*1.1))
	{
	testStepPass("Pass","i_S4_SRR_RL_Obj_RelVelY_28 :%f",signalvalue1);
	}
	else
	{
	testStepFail("Fail","i_S4_SRR_RL_Obj_RelVelY_28 :%f",signalvalue1);
	}
}

testcase S4_SRR_RL_Obj_Mes_9_S4_SRR_RL_Obj_AccelY_28()
{
	signalvalue1 = getSignal(S4_SRR_RL_Obj_AccelY_28);
	write("S4_SRR_RL_Obj_AccelY_28 :%f",signalvalue1);
	write("i_S4_SRR_RL_Obj_AccelY_28 :%f",@ecu_Signals::i_S4_SRR_RL_Obj_AccelY_28);

	testStep("get expect variable value: ","i_S4_SRR_RL_Obj_AccelY_28 :%f",@ecu_Signals::i_S4_SRR_RL_Obj_AccelY_28);

	if((abs(@ecu_Signals::i_S4_SRR_RL_Obj_AccelY_28)*0.9<=abs(signalvalue1))&&(abs(signalvalue1)<=abs(@ecu_Signals::i_S4_SRR_RL_Obj_AccelY_28)*1.1))
	{
	testStepPass("Pass","i_S4_SRR_RL_Obj_AccelY_28 :%f",signalvalue1);
	}
	else
	{
	testStepFail("Fail","i_S4_SRR_RL_Obj_AccelY_28 :%f",signalvalue1);
	}
}

testcase S4_SRR_RL_Obj_Mes_9_S4_SRR_RL_Obj_DistXStd_28()
{
	signalvalue1 = getSignal(S4_SRR_RL_Obj_DistXStd_28);
	write("S4_SRR_RL_Obj_DistXStd_28 :%f",signalvalue1);
	write("i_S4_SRR_RL_Obj_DistXStd_28 :%f",@ecu_Signals::i_S4_SRR_RL_Obj_DistXStd_28);

	testStep("get expect variable value: ","i_S4_SRR_RL_Obj_DistXStd_28 :%f",@ecu_Signals::i_S4_SRR_RL_Obj_DistXStd_28);

	if((abs(@ecu_Signals::i_S4_SRR_RL_Obj_DistXStd_28)*0.9<=abs(signalvalue1))&&(abs(signalvalue1)<=abs(@ecu_Signals::i_S4_SRR_RL_Obj_DistXStd_28)*1.1))
	{
	testStepPass("Pass","i_S4_SRR_RL_Obj_DistXStd_28 :%f",signalvalue1);
	}
	else
	{
	testStepFail("Fail","i_S4_SRR_RL_Obj_DistXStd_28 :%f",signalvalue1);
	}
}

testcase S4_SRR_RL_Obj_Mes_9_S4_SRR_RL_Obj_RelVelXStd_28()
{
	signalvalue1 = getSignal(S4_SRR_RL_Obj_RelVelXStd_28);
	write("S4_SRR_RL_Obj_RelVelXStd_28 :%f",signalvalue1);
	write("i_S4_SRR_RL_Obj_RelVelXStd_28 :%f",@ecu_Signals::i_S4_SRR_RL_Obj_RelVelXStd_28);

	testStep("get expect variable value: ","i_S4_SRR_RL_Obj_RelVelXStd_28 :%f",@ecu_Signals::i_S4_SRR_RL_Obj_RelVelXStd_28);

	if((abs(@ecu_Signals::i_S4_SRR_RL_Obj_RelVelXStd_28)*0.9<=abs(signalvalue1))&&(abs(signalvalue1)<=abs(@ecu_Signals::i_S4_SRR_RL_Obj_RelVelXStd_28)*1.1))
	{
	testStepPass("Pass","i_S4_SRR_RL_Obj_RelVelXStd_28 :%f",signalvalue1);
	}
	else
	{
	testStepFail("Fail","i_S4_SRR_RL_Obj_RelVelXStd_28 :%f",signalvalue1);
	}
}

testcase S4_SRR_RL_Obj_Mes_9_S4_SRR_RL_Obj_DistYStd_28()
{
	signalvalue1 = getSignal(S4_SRR_RL_Obj_DistYStd_28);
	write("S4_SRR_RL_Obj_DistYStd_28 :%f",signalvalue1);
	write("i_S4_SRR_RL_Obj_DistYStd_28 :%f",@ecu_Signals::i_S4_SRR_RL_Obj_DistYStd_28);

	testStep("get expect variable value: ","i_S4_SRR_RL_Obj_DistYStd_28 :%f",@ecu_Signals::i_S4_SRR_RL_Obj_DistYStd_28);

	if((abs(@ecu_Signals::i_S4_SRR_RL_Obj_DistYStd_28)*0.9<=abs(signalvalue1))&&(abs(signalvalue1)<=abs(@ecu_Signals::i_S4_SRR_RL_Obj_DistYStd_28)*1.1))
	{
	testStepPass("Pass","i_S4_SRR_RL_Obj_DistYStd_28 :%f",signalvalue1);
	}
	else
	{
	testStepFail("Fail","i_S4_SRR_RL_Obj_DistYStd_28 :%f",signalvalue1);
	}
}

testcase S4_SRR_RL_Obj_Mes_9_S4_SRR_RL_Obj_RelVelYStd_28()
{
	signalvalue1 = getSignal(S4_SRR_RL_Obj_RelVelYStd_28);
	write("S4_SRR_RL_Obj_RelVelYStd_28 :%f",signalvalue1);
	write("i_S4_SRR_RL_Obj_RelVelYStd_28 :%f",@ecu_Signals::i_S4_SRR_RL_Obj_RelVelYStd_28);

	testStep("get expect variable value: ","i_S4_SRR_RL_Obj_RelVelYStd_28 :%f",@ecu_Signals::i_S4_SRR_RL_Obj_RelVelYStd_28);

	if((abs(@ecu_Signals::i_S4_SRR_RL_Obj_RelVelYStd_28)*0.9<=abs(signalvalue1))&&(abs(signalvalue1)<=abs(@ecu_Signals::i_S4_SRR_RL_Obj_RelVelYStd_28)*1.1))
	{
	testStepPass("Pass","i_S4_SRR_RL_Obj_RelVelYStd_28 :%f",signalvalue1);
	}
	else
	{
	testStepFail("Fail","i_S4_SRR_RL_Obj_RelVelYStd_28 :%f",signalvalue1);
	}
}

testcase S4_SRR_RL_Obj_Mes_9_S4_SRR_RL_Obj_UpdateFlag_28()
{
	signalvalue1 = getSignal(S4_SRR_RL_Obj_UpdateFlag_28);
	write("S4_SRR_RL_Obj_UpdateFlag_28 :%f",signalvalue1);
	write("i_S4_SRR_RL_Obj_UpdateFlag_28 :%o",@ecu_Signals::i_S4_SRR_RL_Obj_UpdateFlag_28);

	testStep("get expect variable value: ","i_S4_SRR_RL_Obj_UpdateFlag_28 :%o",@ecu_Signals::i_S4_SRR_RL_Obj_UpdateFlag_28);

	if(signalvalue1==@ecu_Signals::i_S4_SRR_RL_Obj_UpdateFlag_28)
	{
	testStepPass("Pass","i_S4_SRR_RL_Obj_UpdateFlag_28 :%f",signalvalue1);
	}
	else
	{
	testStepFail("Fail","i_S4_SRR_RL_Obj_UpdateFlag_28 :%f",signalvalue1);
	}
}

testcase S4_SRR_RL_Obj_Mes_9_S4_SRR_RL_Obj_ExistProb_28()
{
	signalvalue1 = getSignal(S4_SRR_RL_Obj_ExistProb_28);
	write("S4_SRR_RL_Obj_ExistProb_28 :%f",signalvalue1);
	write("i_S4_SRR_RL_Obj_ExistProb_28 :%o",@ecu_Signals::i_S4_SRR_RL_Obj_ExistProb_28);

	testStep("get expect variable value: ","i_S4_SRR_RL_Obj_ExistProb_28 :%o",@ecu_Signals::i_S4_SRR_RL_Obj_ExistProb_28);

	if(signalvalue1==@ecu_Signals::i_S4_SRR_RL_Obj_ExistProb_28)
	{
	testStepPass("Pass","i_S4_SRR_RL_Obj_ExistProb_28 :%f",signalvalue1);
	}
	else
	{
	testStepFail("Fail","i_S4_SRR_RL_Obj_ExistProb_28 :%f",signalvalue1);
	}
}

testcase S4_SRR_RL_Obj_Mes_9_S4_SRR_RL_Obj_Type_28()
{
	signalvalue1 = getSignal(S4_SRR_RL_Obj_Type_28);
	write("S4_SRR_RL_Obj_Type_28 :%f",signalvalue1);
	write("i_S4_SRR_RL_Obj_Type_28 :%o",@ecu_Signals::i_S4_SRR_RL_Obj_Type_28);

	testStep("get expect variable value: ","i_S4_SRR_RL_Obj_Type_28 :%o",@ecu_Signals::i_S4_SRR_RL_Obj_Type_28);

	if(signalvalue1==@ecu_Signals::i_S4_SRR_RL_Obj_Type_28)
	{
	testStepPass("Pass","i_S4_SRR_RL_Obj_Type_28 :%f",signalvalue1);
	}
	else
	{
	testStepFail("Fail","i_S4_SRR_RL_Obj_Type_28 :%f",signalvalue1);
	}
}

testcase S4_SRR_RL_Obj_Mes_9_S4_SRR_RL_Obj_EDynProp_28()
{
	signalvalue1 = getSignal(S4_SRR_RL_Obj_EDynProp_28);
	write("S4_SRR_RL_Obj_EDynProp_28 :%f",signalvalue1);
	write("i_S4_SRR_RL_Obj_EDynProp_28 :%o",@ecu_Signals::i_S4_SRR_RL_Obj_EDynProp_28);

	testStep("get expect variable value: ","i_S4_SRR_RL_Obj_EDynProp_28 :%o",@ecu_Signals::i_S4_SRR_RL_Obj_EDynProp_28);

	if(signalvalue1==@ecu_Signals::i_S4_SRR_RL_Obj_EDynProp_28)
	{
	testStepPass("Pass","i_S4_SRR_RL_Obj_EDynProp_28 :%f",signalvalue1);
	}
	else
	{
	testStepFail("Fail","i_S4_SRR_RL_Obj_EDynProp_28 :%f",signalvalue1);
	}
}

testcase S4_SRR_RL_Obj_Mes_9_S4_SRR_RL_Obj_UiLifeCycles_28()
{
	signalvalue1 = getSignal(S4_SRR_RL_Obj_UiLifeCycles_28);
	write("S4_SRR_RL_Obj_UiLifeCycles_28 :%f",signalvalue1);
	write("i_S4_SRR_RL_Obj_UiLifeCycles_28 :%o",@ecu_Signals::i_S4_SRR_RL_Obj_UiLifeCycles_28);

	testStep("get expect variable value: ","i_S4_SRR_RL_Obj_UiLifeCycles_28 :%o",@ecu_Signals::i_S4_SRR_RL_Obj_UiLifeCycles_28);

	if(signalvalue1==@ecu_Signals::i_S4_SRR_RL_Obj_UiLifeCycles_28)
	{
	testStepPass("Pass","i_S4_SRR_RL_Obj_UiLifeCycles_28 :%f",signalvalue1);
	}
	else
	{
	testStepFail("Fail","i_S4_SRR_RL_Obj_UiLifeCycles_28 :%f",signalvalue1);
	}
}

testcase S4_SRR_RL_Obj_Mes_9_S4_SRR_RL_Obj_ID_29()
{
	signalvalue1 = getSignal(S4_SRR_RL_Obj_ID_29);
	write("S4_SRR_RL_Obj_ID_29 :%f",signalvalue1);
	write("i_S4_SRR_RL_Obj_ID_29 :%o",@ecu_Signals::i_S4_SRR_RL_Obj_ID_29);

	testStep("get expect variable value: ","i_S4_SRR_RL_Obj_ID_29 :%o",@ecu_Signals::i_S4_SRR_RL_Obj_ID_29);

	if(signalvalue1==@ecu_Signals::i_S4_SRR_RL_Obj_ID_29)
	{
	testStepPass("Pass","i_S4_SRR_RL_Obj_ID_29 :%f",signalvalue1);
	}
	else
	{
	testStepFail("Fail","i_S4_SRR_RL_Obj_ID_29 :%f",signalvalue1);
	}
}

testcase S4_SRR_RL_Obj_Mes_9_S4_SRR_RL_Obj_DistX_29()
{
	signalvalue1 = getSignal(S4_SRR_RL_Obj_DistX_29);
	write("S4_SRR_RL_Obj_DistX_29 :%f",signalvalue1);
	write("i_S4_SRR_RL_Obj_DistX_29 :%f",@ecu_Signals::i_S4_SRR_RL_Obj_DistX_29);

	testStep("get expect variable value: ","i_S4_SRR_RL_Obj_DistX_29 :%f",@ecu_Signals::i_S4_SRR_RL_Obj_DistX_29);

	if((abs(@ecu_Signals::i_S4_SRR_RL_Obj_DistX_29)*0.9<=abs(signalvalue1))&&(abs(signalvalue1)<=abs(@ecu_Signals::i_S4_SRR_RL_Obj_DistX_29)*1.1))
	{
	testStepPass("Pass","i_S4_SRR_RL_Obj_DistX_29 :%f",signalvalue1);
	}
	else
	{
	testStepFail("Fail","i_S4_SRR_RL_Obj_DistX_29 :%f",signalvalue1);
	}
}

testcase S4_SRR_RL_Obj_Mes_9_S4_SRR_RL_Obj_RelVelX_29()
{
	signalvalue1 = getSignal(S4_SRR_RL_Obj_RelVelX_29);
	write("S4_SRR_RL_Obj_RelVelX_29 :%f",signalvalue1);
	write("i_S4_SRR_RL_Obj_RelVelX_29 :%f",@ecu_Signals::i_S4_SRR_RL_Obj_RelVelX_29);

	testStep("get expect variable value: ","i_S4_SRR_RL_Obj_RelVelX_29 :%f",@ecu_Signals::i_S4_SRR_RL_Obj_RelVelX_29);

	if((abs(@ecu_Signals::i_S4_SRR_RL_Obj_RelVelX_29)*0.9<=abs(signalvalue1))&&(abs(signalvalue1)<=abs(@ecu_Signals::i_S4_SRR_RL_Obj_RelVelX_29)*1.1))
	{
	testStepPass("Pass","i_S4_SRR_RL_Obj_RelVelX_29 :%f",signalvalue1);
	}
	else
	{
	testStepFail("Fail","i_S4_SRR_RL_Obj_RelVelX_29 :%f",signalvalue1);
	}
}

testcase S4_SRR_RL_Obj_Mes_9_S4_SRR_RL_Obj_AccelX_29()
{
	signalvalue1 = getSignal(S4_SRR_RL_Obj_AccelX_29);
	write("S4_SRR_RL_Obj_AccelX_29 :%f",signalvalue1);
	write("i_S4_SRR_RL_Obj_AccelX_29 :%f",@ecu_Signals::i_S4_SRR_RL_Obj_AccelX_29);

	testStep("get expect variable value: ","i_S4_SRR_RL_Obj_AccelX_29 :%f",@ecu_Signals::i_S4_SRR_RL_Obj_AccelX_29);

	if((abs(@ecu_Signals::i_S4_SRR_RL_Obj_AccelX_29)*0.9<=abs(signalvalue1))&&(abs(signalvalue1)<=abs(@ecu_Signals::i_S4_SRR_RL_Obj_AccelX_29)*1.1))
	{
	testStepPass("Pass","i_S4_SRR_RL_Obj_AccelX_29 :%f",signalvalue1);
	}
	else
	{
	testStepFail("Fail","i_S4_SRR_RL_Obj_AccelX_29 :%f",signalvalue1);
	}
}

testcase S4_SRR_RL_Obj_Mes_9_S4_SRR_RL_Obj_DistY_29()
{
	signalvalue1 = getSignal(S4_SRR_RL_Obj_DistY_29);
	write("S4_SRR_RL_Obj_DistY_29 :%f",signalvalue1);
	write("i_S4_SRR_RL_Obj_DistY_29 :%f",@ecu_Signals::i_S4_SRR_RL_Obj_DistY_29);

	testStep("get expect variable value: ","i_S4_SRR_RL_Obj_DistY_29 :%f",@ecu_Signals::i_S4_SRR_RL_Obj_DistY_29);

	if((abs(@ecu_Signals::i_S4_SRR_RL_Obj_DistY_29)*0.9<=abs(signalvalue1))&&(abs(signalvalue1)<=abs(@ecu_Signals::i_S4_SRR_RL_Obj_DistY_29)*1.1))
	{
	testStepPass("Pass","i_S4_SRR_RL_Obj_DistY_29 :%f",signalvalue1);
	}
	else
	{
	testStepFail("Fail","i_S4_SRR_RL_Obj_DistY_29 :%f",signalvalue1);
	}
}

testcase S4_SRR_RL_Obj_Mes_9_S4_SRR_RL_Obj_RelVelY_29()
{
	signalvalue1 = getSignal(S4_SRR_RL_Obj_RelVelY_29);
	write("S4_SRR_RL_Obj_RelVelY_29 :%f",signalvalue1);
	write("i_S4_SRR_RL_Obj_RelVelY_29 :%f",@ecu_Signals::i_S4_SRR_RL_Obj_RelVelY_29);

	testStep("get expect variable value: ","i_S4_SRR_RL_Obj_RelVelY_29 :%f",@ecu_Signals::i_S4_SRR_RL_Obj_RelVelY_29);

	if((abs(@ecu_Signals::i_S4_SRR_RL_Obj_RelVelY_29)*0.9<=abs(signalvalue1))&&(abs(signalvalue1)<=abs(@ecu_Signals::i_S4_SRR_RL_Obj_RelVelY_29)*1.1))
	{
	testStepPass("Pass","i_S4_SRR_RL_Obj_RelVelY_29 :%f",signalvalue1);
	}
	else
	{
	testStepFail("Fail","i_S4_SRR_RL_Obj_RelVelY_29 :%f",signalvalue1);
	}
}

testcase S4_SRR_RL_Obj_Mes_9_S4_SRR_RL_Obj_AccelY_29()
{
	signalvalue1 = getSignal(S4_SRR_RL_Obj_AccelY_29);
	write("S4_SRR_RL_Obj_AccelY_29 :%f",signalvalue1);
	write("i_S4_SRR_RL_Obj_AccelY_29 :%f",@ecu_Signals::i_S4_SRR_RL_Obj_AccelY_29);

	testStep("get expect variable value: ","i_S4_SRR_RL_Obj_AccelY_29 :%f",@ecu_Signals::i_S4_SRR_RL_Obj_AccelY_29);

	if((abs(@ecu_Signals::i_S4_SRR_RL_Obj_AccelY_29)*0.9<=abs(signalvalue1))&&(abs(signalvalue1)<=abs(@ecu_Signals::i_S4_SRR_RL_Obj_AccelY_29)*1.1))
	{
	testStepPass("Pass","i_S4_SRR_RL_Obj_AccelY_29 :%f",signalvalue1);
	}
	else
	{
	testStepFail("Fail","i_S4_SRR_RL_Obj_AccelY_29 :%f",signalvalue1);
	}
}

testcase S4_SRR_RL_Obj_Mes_9_S4_SRR_RL_Obj_DistXStd_29()
{
	signalvalue1 = getSignal(S4_SRR_RL_Obj_DistXStd_29);
	write("S4_SRR_RL_Obj_DistXStd_29 :%f",signalvalue1);
	write("i_S4_SRR_RL_Obj_DistXStd_29 :%f",@ecu_Signals::i_S4_SRR_RL_Obj_DistXStd_29);

	testStep("get expect variable value: ","i_S4_SRR_RL_Obj_DistXStd_29 :%f",@ecu_Signals::i_S4_SRR_RL_Obj_DistXStd_29);

	if((abs(@ecu_Signals::i_S4_SRR_RL_Obj_DistXStd_29)*0.9<=abs(signalvalue1))&&(abs(signalvalue1)<=abs(@ecu_Signals::i_S4_SRR_RL_Obj_DistXStd_29)*1.1))
	{
	testStepPass("Pass","i_S4_SRR_RL_Obj_DistXStd_29 :%f",signalvalue1);
	}
	else
	{
	testStepFail("Fail","i_S4_SRR_RL_Obj_DistXStd_29 :%f",signalvalue1);
	}
}

testcase S4_SRR_RL_Obj_Mes_9_S4_SRR_RL_Obj_RelVelXStd_29()
{
	signalvalue1 = getSignal(S4_SRR_RL_Obj_RelVelXStd_29);
	write("S4_SRR_RL_Obj_RelVelXStd_29 :%f",signalvalue1);
	write("i_S4_SRR_RL_Obj_RelVelXStd_29 :%f",@ecu_Signals::i_S4_SRR_RL_Obj_RelVelXStd_29);

	testStep("get expect variable value: ","i_S4_SRR_RL_Obj_RelVelXStd_29 :%f",@ecu_Signals::i_S4_SRR_RL_Obj_RelVelXStd_29);

	if((abs(@ecu_Signals::i_S4_SRR_RL_Obj_RelVelXStd_29)*0.9<=abs(signalvalue1))&&(abs(signalvalue1)<=abs(@ecu_Signals::i_S4_SRR_RL_Obj_RelVelXStd_29)*1.1))
	{
	testStepPass("Pass","i_S4_SRR_RL_Obj_RelVelXStd_29 :%f",signalvalue1);
	}
	else
	{
	testStepFail("Fail","i_S4_SRR_RL_Obj_RelVelXStd_29 :%f",signalvalue1);
	}
}

testcase S4_SRR_RL_Obj_Mes_9_S4_SRR_RL_Obj_DistYStd_29()
{
	signalvalue1 = getSignal(S4_SRR_RL_Obj_DistYStd_29);
	write("S4_SRR_RL_Obj_DistYStd_29 :%f",signalvalue1);
	write("i_S4_SRR_RL_Obj_DistYStd_29 :%f",@ecu_Signals::i_S4_SRR_RL_Obj_DistYStd_29);

	testStep("get expect variable value: ","i_S4_SRR_RL_Obj_DistYStd_29 :%f",@ecu_Signals::i_S4_SRR_RL_Obj_DistYStd_29);

	if((abs(@ecu_Signals::i_S4_SRR_RL_Obj_DistYStd_29)*0.9<=abs(signalvalue1))&&(abs(signalvalue1)<=abs(@ecu_Signals::i_S4_SRR_RL_Obj_DistYStd_29)*1.1))
	{
	testStepPass("Pass","i_S4_SRR_RL_Obj_DistYStd_29 :%f",signalvalue1);
	}
	else
	{
	testStepFail("Fail","i_S4_SRR_RL_Obj_DistYStd_29 :%f",signalvalue1);
	}
}

testcase S4_SRR_RL_Obj_Mes_9_S4_SRR_RL_Obj_RelVelYStd_29()
{
	signalvalue1 = getSignal(S4_SRR_RL_Obj_RelVelYStd_29);
	write("S4_SRR_RL_Obj_RelVelYStd_29 :%f",signalvalue1);
	write("i_S4_SRR_RL_Obj_RelVelYStd_29 :%f",@ecu_Signals::i_S4_SRR_RL_Obj_RelVelYStd_29);

	testStep("get expect variable value: ","i_S4_SRR_RL_Obj_RelVelYStd_29 :%f",@ecu_Signals::i_S4_SRR_RL_Obj_RelVelYStd_29);

	if((abs(@ecu_Signals::i_S4_SRR_RL_Obj_RelVelYStd_29)*0.9<=abs(signalvalue1))&&(abs(signalvalue1)<=abs(@ecu_Signals::i_S4_SRR_RL_Obj_RelVelYStd_29)*1.1))
	{
	testStepPass("Pass","i_S4_SRR_RL_Obj_RelVelYStd_29 :%f",signalvalue1);
	}
	else
	{
	testStepFail("Fail","i_S4_SRR_RL_Obj_RelVelYStd_29 :%f",signalvalue1);
	}
}

testcase S4_SRR_RL_Obj_Mes_9_S4_SRR_RL_Obj_UpdateFlag_29()
{
	signalvalue1 = getSignal(S4_SRR_RL_Obj_UpdateFlag_29);
	write("S4_SRR_RL_Obj_UpdateFlag_29 :%f",signalvalue1);
	write("i_S4_SRR_RL_Obj_UpdateFlag_29 :%o",@ecu_Signals::i_S4_SRR_RL_Obj_UpdateFlag_29);

	testStep("get expect variable value: ","i_S4_SRR_RL_Obj_UpdateFlag_29 :%o",@ecu_Signals::i_S4_SRR_RL_Obj_UpdateFlag_29);

	if(signalvalue1==@ecu_Signals::i_S4_SRR_RL_Obj_UpdateFlag_29)
	{
	testStepPass("Pass","i_S4_SRR_RL_Obj_UpdateFlag_29 :%f",signalvalue1);
	}
	else
	{
	testStepFail("Fail","i_S4_SRR_RL_Obj_UpdateFlag_29 :%f",signalvalue1);
	}
}

testcase S4_SRR_RL_Obj_Mes_9_S4_SRR_RL_Obj_ExistProb_29()
{
	signalvalue1 = getSignal(S4_SRR_RL_Obj_ExistProb_29);
	write("S4_SRR_RL_Obj_ExistProb_29 :%f",signalvalue1);
	write("i_S4_SRR_RL_Obj_ExistProb_29 :%o",@ecu_Signals::i_S4_SRR_RL_Obj_ExistProb_29);

	testStep("get expect variable value: ","i_S4_SRR_RL_Obj_ExistProb_29 :%o",@ecu_Signals::i_S4_SRR_RL_Obj_ExistProb_29);

	if(signalvalue1==@ecu_Signals::i_S4_SRR_RL_Obj_ExistProb_29)
	{
	testStepPass("Pass","i_S4_SRR_RL_Obj_ExistProb_29 :%f",signalvalue1);
	}
	else
	{
	testStepFail("Fail","i_S4_SRR_RL_Obj_ExistProb_29 :%f",signalvalue1);
	}
}

testcase S4_SRR_RL_Obj_Mes_9_S4_SRR_RL_Obj_Type_29()
{
	signalvalue1 = getSignal(S4_SRR_RL_Obj_Type_29);
	write("S4_SRR_RL_Obj_Type_29 :%f",signalvalue1);
	write("i_S4_SRR_RL_Obj_Type_29 :%o",@ecu_Signals::i_S4_SRR_RL_Obj_Type_29);

	testStep("get expect variable value: ","i_S4_SRR_RL_Obj_Type_29 :%o",@ecu_Signals::i_S4_SRR_RL_Obj_Type_29);

	if(signalvalue1==@ecu_Signals::i_S4_SRR_RL_Obj_Type_29)
	{
	testStepPass("Pass","i_S4_SRR_RL_Obj_Type_29 :%f",signalvalue1);
	}
	else
	{
	testStepFail("Fail","i_S4_SRR_RL_Obj_Type_29 :%f",signalvalue1);
	}
}

testcase S4_SRR_RL_Obj_Mes_9_S4_SRR_RL_Obj_EDynProp_29()
{
	signalvalue1 = getSignal(S4_SRR_RL_Obj_EDynProp_29);
	write("S4_SRR_RL_Obj_EDynProp_29 :%f",signalvalue1);
	write("i_S4_SRR_RL_Obj_EDynProp_29 :%o",@ecu_Signals::i_S4_SRR_RL_Obj_EDynProp_29);

	testStep("get expect variable value: ","i_S4_SRR_RL_Obj_EDynProp_29 :%o",@ecu_Signals::i_S4_SRR_RL_Obj_EDynProp_29);

	if(signalvalue1==@ecu_Signals::i_S4_SRR_RL_Obj_EDynProp_29)
	{
	testStepPass("Pass","i_S4_SRR_RL_Obj_EDynProp_29 :%f",signalvalue1);
	}
	else
	{
	testStepFail("Fail","i_S4_SRR_RL_Obj_EDynProp_29 :%f",signalvalue1);
	}
}

testcase S4_SRR_RL_Obj_Mes_9_S4_SRR_RL_Obj_UiLifeCycles_29()
{
	signalvalue1 = getSignal(S4_SRR_RL_Obj_UiLifeCycles_29);
	write("S4_SRR_RL_Obj_UiLifeCycles_29 :%f",signalvalue1);
	write("i_S4_SRR_RL_Obj_UiLifeCycles_29 :%o",@ecu_Signals::i_S4_SRR_RL_Obj_UiLifeCycles_29);

	testStep("get expect variable value: ","i_S4_SRR_RL_Obj_UiLifeCycles_29 :%o",@ecu_Signals::i_S4_SRR_RL_Obj_UiLifeCycles_29);

	if(signalvalue1==@ecu_Signals::i_S4_SRR_RL_Obj_UiLifeCycles_29)
	{
	testStepPass("Pass","i_S4_SRR_RL_Obj_UiLifeCycles_29 :%f",signalvalue1);
	}
	else
	{
	testStepFail("Fail","i_S4_SRR_RL_Obj_UiLifeCycles_29 :%f",signalvalue1);
	}
}

testcase S4_SRR_RL_Obj_Mes_10_S4_SRR_RL_Obj_ID_30()
{
	signalvalue1 = getSignal(S4_SRR_RL_Obj_ID_30);
	write("S4_SRR_RL_Obj_ID_30 :%f",signalvalue1);
	write("i_S4_SRR_RL_Obj_ID_30 :%o",@ecu_Signals::i_S4_SRR_RL_Obj_ID_30);

	testStep("get expect variable value: ","i_S4_SRR_RL_Obj_ID_30 :%o",@ecu_Signals::i_S4_SRR_RL_Obj_ID_30);

	if(signalvalue1==@ecu_Signals::i_S4_SRR_RL_Obj_ID_30)
	{
	testStepPass("Pass","i_S4_SRR_RL_Obj_ID_30 :%f",signalvalue1);
	}
	else
	{
	testStepFail("Fail","i_S4_SRR_RL_Obj_ID_30 :%f",signalvalue1);
	}
}

testcase S4_SRR_RL_Obj_Mes_10_S4_SRR_RL_Obj_DistX_30()
{
	signalvalue1 = getSignal(S4_SRR_RL_Obj_DistX_30);
	write("S4_SRR_RL_Obj_DistX_30 :%f",signalvalue1);
	write("i_S4_SRR_RL_Obj_DistX_30 :%f",@ecu_Signals::i_S4_SRR_RL_Obj_DistX_30);

	testStep("get expect variable value: ","i_S4_SRR_RL_Obj_DistX_30 :%f",@ecu_Signals::i_S4_SRR_RL_Obj_DistX_30);

	if((abs(@ecu_Signals::i_S4_SRR_RL_Obj_DistX_30)*0.9<=abs(signalvalue1))&&(abs(signalvalue1)<=abs(@ecu_Signals::i_S4_SRR_RL_Obj_DistX_30)*1.1))
	{
	testStepPass("Pass","i_S4_SRR_RL_Obj_DistX_30 :%f",signalvalue1);
	}
	else
	{
	testStepFail("Fail","i_S4_SRR_RL_Obj_DistX_30 :%f",signalvalue1);
	}
}

testcase S4_SRR_RL_Obj_Mes_10_S4_SRR_RL_Obj_RelVelX_30()
{
	signalvalue1 = getSignal(S4_SRR_RL_Obj_RelVelX_30);
	write("S4_SRR_RL_Obj_RelVelX_30 :%f",signalvalue1);
	write("i_S4_SRR_RL_Obj_RelVelX_30 :%f",@ecu_Signals::i_S4_SRR_RL_Obj_RelVelX_30);

	testStep("get expect variable value: ","i_S4_SRR_RL_Obj_RelVelX_30 :%f",@ecu_Signals::i_S4_SRR_RL_Obj_RelVelX_30);

	if((abs(@ecu_Signals::i_S4_SRR_RL_Obj_RelVelX_30)*0.9<=abs(signalvalue1))&&(abs(signalvalue1)<=abs(@ecu_Signals::i_S4_SRR_RL_Obj_RelVelX_30)*1.1))
	{
	testStepPass("Pass","i_S4_SRR_RL_Obj_RelVelX_30 :%f",signalvalue1);
	}
	else
	{
	testStepFail("Fail","i_S4_SRR_RL_Obj_RelVelX_30 :%f",signalvalue1);
	}
}

testcase S4_SRR_RL_Obj_Mes_10_S4_SRR_RL_Obj_AccelX_30()
{
	signalvalue1 = getSignal(S4_SRR_RL_Obj_AccelX_30);
	write("S4_SRR_RL_Obj_AccelX_30 :%f",signalvalue1);
	write("i_S4_SRR_RL_Obj_AccelX_30 :%f",@ecu_Signals::i_S4_SRR_RL_Obj_AccelX_30);

	testStep("get expect variable value: ","i_S4_SRR_RL_Obj_AccelX_30 :%f",@ecu_Signals::i_S4_SRR_RL_Obj_AccelX_30);

	if((abs(@ecu_Signals::i_S4_SRR_RL_Obj_AccelX_30)*0.9<=abs(signalvalue1))&&(abs(signalvalue1)<=abs(@ecu_Signals::i_S4_SRR_RL_Obj_AccelX_30)*1.1))
	{
	testStepPass("Pass","i_S4_SRR_RL_Obj_AccelX_30 :%f",signalvalue1);
	}
	else
	{
	testStepFail("Fail","i_S4_SRR_RL_Obj_AccelX_30 :%f",signalvalue1);
	}
}

testcase S4_SRR_RL_Obj_Mes_10_S4_SRR_RL_Obj_DistY_30()
{
	signalvalue1 = getSignal(S4_SRR_RL_Obj_DistY_30);
	write("S4_SRR_RL_Obj_DistY_30 :%f",signalvalue1);
	write("i_S4_SRR_RL_Obj_DistY_30 :%f",@ecu_Signals::i_S4_SRR_RL_Obj_DistY_30);

	testStep("get expect variable value: ","i_S4_SRR_RL_Obj_DistY_30 :%f",@ecu_Signals::i_S4_SRR_RL_Obj_DistY_30);

	if((abs(@ecu_Signals::i_S4_SRR_RL_Obj_DistY_30)*0.9<=abs(signalvalue1))&&(abs(signalvalue1)<=abs(@ecu_Signals::i_S4_SRR_RL_Obj_DistY_30)*1.1))
	{
	testStepPass("Pass","i_S4_SRR_RL_Obj_DistY_30 :%f",signalvalue1);
	}
	else
	{
	testStepFail("Fail","i_S4_SRR_RL_Obj_DistY_30 :%f",signalvalue1);
	}
}

testcase S4_SRR_RL_Obj_Mes_10_S4_SRR_RL_Obj_RelVelY_30()
{
	signalvalue1 = getSignal(S4_SRR_RL_Obj_RelVelY_30);
	write("S4_SRR_RL_Obj_RelVelY_30 :%f",signalvalue1);
	write("i_S4_SRR_RL_Obj_RelVelY_30 :%f",@ecu_Signals::i_S4_SRR_RL_Obj_RelVelY_30);

	testStep("get expect variable value: ","i_S4_SRR_RL_Obj_RelVelY_30 :%f",@ecu_Signals::i_S4_SRR_RL_Obj_RelVelY_30);

	if((abs(@ecu_Signals::i_S4_SRR_RL_Obj_RelVelY_30)*0.9<=abs(signalvalue1))&&(abs(signalvalue1)<=abs(@ecu_Signals::i_S4_SRR_RL_Obj_RelVelY_30)*1.1))
	{
	testStepPass("Pass","i_S4_SRR_RL_Obj_RelVelY_30 :%f",signalvalue1);
	}
	else
	{
	testStepFail("Fail","i_S4_SRR_RL_Obj_RelVelY_30 :%f",signalvalue1);
	}
}

testcase S4_SRR_RL_Obj_Mes_10_S4_SRR_RL_Obj_AccelY_30()
{
	signalvalue1 = getSignal(S4_SRR_RL_Obj_AccelY_30);
	write("S4_SRR_RL_Obj_AccelY_30 :%f",signalvalue1);
	write("i_S4_SRR_RL_Obj_AccelY_30 :%f",@ecu_Signals::i_S4_SRR_RL_Obj_AccelY_30);

	testStep("get expect variable value: ","i_S4_SRR_RL_Obj_AccelY_30 :%f",@ecu_Signals::i_S4_SRR_RL_Obj_AccelY_30);

	if((abs(@ecu_Signals::i_S4_SRR_RL_Obj_AccelY_30)*0.9<=abs(signalvalue1))&&(abs(signalvalue1)<=abs(@ecu_Signals::i_S4_SRR_RL_Obj_AccelY_30)*1.1))
	{
	testStepPass("Pass","i_S4_SRR_RL_Obj_AccelY_30 :%f",signalvalue1);
	}
	else
	{
	testStepFail("Fail","i_S4_SRR_RL_Obj_AccelY_30 :%f",signalvalue1);
	}
}

testcase S4_SRR_RL_Obj_Mes_10_S4_SRR_RL_Obj_DistXStd_30()
{
	signalvalue1 = getSignal(S4_SRR_RL_Obj_DistXStd_30);
	write("S4_SRR_RL_Obj_DistXStd_30 :%f",signalvalue1);
	write("i_S4_SRR_RL_Obj_DistXStd_30 :%f",@ecu_Signals::i_S4_SRR_RL_Obj_DistXStd_30);

	testStep("get expect variable value: ","i_S4_SRR_RL_Obj_DistXStd_30 :%f",@ecu_Signals::i_S4_SRR_RL_Obj_DistXStd_30);

	if((abs(@ecu_Signals::i_S4_SRR_RL_Obj_DistXStd_30)*0.9<=abs(signalvalue1))&&(abs(signalvalue1)<=abs(@ecu_Signals::i_S4_SRR_RL_Obj_DistXStd_30)*1.1))
	{
	testStepPass("Pass","i_S4_SRR_RL_Obj_DistXStd_30 :%f",signalvalue1);
	}
	else
	{
	testStepFail("Fail","i_S4_SRR_RL_Obj_DistXStd_30 :%f",signalvalue1);
	}
}

testcase S4_SRR_RL_Obj_Mes_10_S4_SRR_RL_Obj_RelVelXStd_30()
{
	signalvalue1 = getSignal(S4_SRR_RL_Obj_RelVelXStd_30);
	write("S4_SRR_RL_Obj_RelVelXStd_30 :%f",signalvalue1);
	write("i_S4_SRR_RL_Obj_RelVelXStd_30 :%f",@ecu_Signals::i_S4_SRR_RL_Obj_RelVelXStd_30);

	testStep("get expect variable value: ","i_S4_SRR_RL_Obj_RelVelXStd_30 :%f",@ecu_Signals::i_S4_SRR_RL_Obj_RelVelXStd_30);

	if((abs(@ecu_Signals::i_S4_SRR_RL_Obj_RelVelXStd_30)*0.9<=abs(signalvalue1))&&(abs(signalvalue1)<=abs(@ecu_Signals::i_S4_SRR_RL_Obj_RelVelXStd_30)*1.1))
	{
	testStepPass("Pass","i_S4_SRR_RL_Obj_RelVelXStd_30 :%f",signalvalue1);
	}
	else
	{
	testStepFail("Fail","i_S4_SRR_RL_Obj_RelVelXStd_30 :%f",signalvalue1);
	}
}

testcase S4_SRR_RL_Obj_Mes_10_S4_SRR_RL_Obj_DistYStd_30()
{
	signalvalue1 = getSignal(S4_SRR_RL_Obj_DistYStd_30);
	write("S4_SRR_RL_Obj_DistYStd_30 :%f",signalvalue1);
	write("i_S4_SRR_RL_Obj_DistYStd_30 :%f",@ecu_Signals::i_S4_SRR_RL_Obj_DistYStd_30);

	testStep("get expect variable value: ","i_S4_SRR_RL_Obj_DistYStd_30 :%f",@ecu_Signals::i_S4_SRR_RL_Obj_DistYStd_30);

	if((abs(@ecu_Signals::i_S4_SRR_RL_Obj_DistYStd_30)*0.9<=abs(signalvalue1))&&(abs(signalvalue1)<=abs(@ecu_Signals::i_S4_SRR_RL_Obj_DistYStd_30)*1.1))
	{
	testStepPass("Pass","i_S4_SRR_RL_Obj_DistYStd_30 :%f",signalvalue1);
	}
	else
	{
	testStepFail("Fail","i_S4_SRR_RL_Obj_DistYStd_30 :%f",signalvalue1);
	}
}

testcase S4_SRR_RL_Obj_Mes_10_S4_SRR_RL_Obj_RelVelYStd_30()
{
	signalvalue1 = getSignal(S4_SRR_RL_Obj_RelVelYStd_30);
	write("S4_SRR_RL_Obj_RelVelYStd_30 :%f",signalvalue1);
	write("i_S4_SRR_RL_Obj_RelVelYStd_30 :%f",@ecu_Signals::i_S4_SRR_RL_Obj_RelVelYStd_30);

	testStep("get expect variable value: ","i_S4_SRR_RL_Obj_RelVelYStd_30 :%f",@ecu_Signals::i_S4_SRR_RL_Obj_RelVelYStd_30);

	if((abs(@ecu_Signals::i_S4_SRR_RL_Obj_RelVelYStd_30)*0.9<=abs(signalvalue1))&&(abs(signalvalue1)<=abs(@ecu_Signals::i_S4_SRR_RL_Obj_RelVelYStd_30)*1.1))
	{
	testStepPass("Pass","i_S4_SRR_RL_Obj_RelVelYStd_30 :%f",signalvalue1);
	}
	else
	{
	testStepFail("Fail","i_S4_SRR_RL_Obj_RelVelYStd_30 :%f",signalvalue1);
	}
}

testcase S4_SRR_RL_Obj_Mes_10_S4_SRR_RL_Obj_UpdateFlag_30()
{
	signalvalue1 = getSignal(S4_SRR_RL_Obj_UpdateFlag_30);
	write("S4_SRR_RL_Obj_UpdateFlag_30 :%f",signalvalue1);
	write("i_S4_SRR_RL_Obj_UpdateFlag_30 :%o",@ecu_Signals::i_S4_SRR_RL_Obj_UpdateFlag_30);

	testStep("get expect variable value: ","i_S4_SRR_RL_Obj_UpdateFlag_30 :%o",@ecu_Signals::i_S4_SRR_RL_Obj_UpdateFlag_30);

	if(signalvalue1==@ecu_Signals::i_S4_SRR_RL_Obj_UpdateFlag_30)
	{
	testStepPass("Pass","i_S4_SRR_RL_Obj_UpdateFlag_30 :%f",signalvalue1);
	}
	else
	{
	testStepFail("Fail","i_S4_SRR_RL_Obj_UpdateFlag_30 :%f",signalvalue1);
	}
}

testcase S4_SRR_RL_Obj_Mes_10_S4_SRR_RL_Obj_ExistProb_30()
{
	signalvalue1 = getSignal(S4_SRR_RL_Obj_ExistProb_30);
	write("S4_SRR_RL_Obj_ExistProb_30 :%f",signalvalue1);
	write("i_S4_SRR_RL_Obj_ExistProb_30 :%o",@ecu_Signals::i_S4_SRR_RL_Obj_ExistProb_30);

	testStep("get expect variable value: ","i_S4_SRR_RL_Obj_ExistProb_30 :%o",@ecu_Signals::i_S4_SRR_RL_Obj_ExistProb_30);

	if(signalvalue1==@ecu_Signals::i_S4_SRR_RL_Obj_ExistProb_30)
	{
	testStepPass("Pass","i_S4_SRR_RL_Obj_ExistProb_30 :%f",signalvalue1);
	}
	else
	{
	testStepFail("Fail","i_S4_SRR_RL_Obj_ExistProb_30 :%f",signalvalue1);
	}
}

testcase S4_SRR_RL_Obj_Mes_10_S4_SRR_RL_Obj_Type_30()
{
	signalvalue1 = getSignal(S4_SRR_RL_Obj_Type_30);
	write("S4_SRR_RL_Obj_Type_30 :%f",signalvalue1);
	write("i_S4_SRR_RL_Obj_Type_30 :%o",@ecu_Signals::i_S4_SRR_RL_Obj_Type_30);

	testStep("get expect variable value: ","i_S4_SRR_RL_Obj_Type_30 :%o",@ecu_Signals::i_S4_SRR_RL_Obj_Type_30);

	if(signalvalue1==@ecu_Signals::i_S4_SRR_RL_Obj_Type_30)
	{
	testStepPass("Pass","i_S4_SRR_RL_Obj_Type_30 :%f",signalvalue1);
	}
	else
	{
	testStepFail("Fail","i_S4_SRR_RL_Obj_Type_30 :%f",signalvalue1);
	}
}

testcase S4_SRR_RL_Obj_Mes_10_S4_SRR_RL_Obj_EDynProp_30()
{
	signalvalue1 = getSignal(S4_SRR_RL_Obj_EDynProp_30);
	write("S4_SRR_RL_Obj_EDynProp_30 :%f",signalvalue1);
	write("i_S4_SRR_RL_Obj_EDynProp_30 :%o",@ecu_Signals::i_S4_SRR_RL_Obj_EDynProp_30);

	testStep("get expect variable value: ","i_S4_SRR_RL_Obj_EDynProp_30 :%o",@ecu_Signals::i_S4_SRR_RL_Obj_EDynProp_30);

	if(signalvalue1==@ecu_Signals::i_S4_SRR_RL_Obj_EDynProp_30)
	{
	testStepPass("Pass","i_S4_SRR_RL_Obj_EDynProp_30 :%f",signalvalue1);
	}
	else
	{
	testStepFail("Fail","i_S4_SRR_RL_Obj_EDynProp_30 :%f",signalvalue1);
	}
}

testcase S4_SRR_RL_Obj_Mes_10_S4_SRR_RL_Obj_UiLifeCycles_30()
{
	signalvalue1 = getSignal(S4_SRR_RL_Obj_UiLifeCycles_30);
	write("S4_SRR_RL_Obj_UiLifeCycles_30 :%f",signalvalue1);
	write("i_S4_SRR_RL_Obj_UiLifeCycles_30 :%o",@ecu_Signals::i_S4_SRR_RL_Obj_UiLifeCycles_30);

	testStep("get expect variable value: ","i_S4_SRR_RL_Obj_UiLifeCycles_30 :%o",@ecu_Signals::i_S4_SRR_RL_Obj_UiLifeCycles_30);

	if(signalvalue1==@ecu_Signals::i_S4_SRR_RL_Obj_UiLifeCycles_30)
	{
	testStepPass("Pass","i_S4_SRR_RL_Obj_UiLifeCycles_30 :%f",signalvalue1);
	}
	else
	{
	testStepFail("Fail","i_S4_SRR_RL_Obj_UiLifeCycles_30 :%f",signalvalue1);
	}
}

testcase S4_SRR_RL_Obj_Mes_10_S4_SRR_RL_Obj_ID_31()
{
	signalvalue1 = getSignal(S4_SRR_RL_Obj_ID_31);
	write("S4_SRR_RL_Obj_ID_31 :%f",signalvalue1);
	write("i_S4_SRR_RL_Obj_ID_31 :%o",@ecu_Signals::i_S4_SRR_RL_Obj_ID_31);

	testStep("get expect variable value: ","i_S4_SRR_RL_Obj_ID_31 :%o",@ecu_Signals::i_S4_SRR_RL_Obj_ID_31);

	if(signalvalue1==@ecu_Signals::i_S4_SRR_RL_Obj_ID_31)
	{
	testStepPass("Pass","i_S4_SRR_RL_Obj_ID_31 :%f",signalvalue1);
	}
	else
	{
	testStepFail("Fail","i_S4_SRR_RL_Obj_ID_31 :%f",signalvalue1);
	}
}

testcase S4_SRR_RL_Obj_Mes_10_S4_SRR_RL_Obj_DistX_31()
{
	signalvalue1 = getSignal(S4_SRR_RL_Obj_DistX_31);
	write("S4_SRR_RL_Obj_DistX_31 :%f",signalvalue1);
	write("i_S4_SRR_RL_Obj_DistX_31 :%f",@ecu_Signals::i_S4_SRR_RL_Obj_DistX_31);

	testStep("get expect variable value: ","i_S4_SRR_RL_Obj_DistX_31 :%f",@ecu_Signals::i_S4_SRR_RL_Obj_DistX_31);

	if((abs(@ecu_Signals::i_S4_SRR_RL_Obj_DistX_31)*0.9<=abs(signalvalue1))&&(abs(signalvalue1)<=abs(@ecu_Signals::i_S4_SRR_RL_Obj_DistX_31)*1.1))
	{
	testStepPass("Pass","i_S4_SRR_RL_Obj_DistX_31 :%f",signalvalue1);
	}
	else
	{
	testStepFail("Fail","i_S4_SRR_RL_Obj_DistX_31 :%f",signalvalue1);
	}
}

testcase S4_SRR_RL_Obj_Mes_10_S4_SRR_RL_Obj_RelVelX_31()
{
	signalvalue1 = getSignal(S4_SRR_RL_Obj_RelVelX_31);
	write("S4_SRR_RL_Obj_RelVelX_31 :%f",signalvalue1);
	write("i_S4_SRR_RL_Obj_RelVelX_31 :%f",@ecu_Signals::i_S4_SRR_RL_Obj_RelVelX_31);

	testStep("get expect variable value: ","i_S4_SRR_RL_Obj_RelVelX_31 :%f",@ecu_Signals::i_S4_SRR_RL_Obj_RelVelX_31);

	if((abs(@ecu_Signals::i_S4_SRR_RL_Obj_RelVelX_31)*0.9<=abs(signalvalue1))&&(abs(signalvalue1)<=abs(@ecu_Signals::i_S4_SRR_RL_Obj_RelVelX_31)*1.1))
	{
	testStepPass("Pass","i_S4_SRR_RL_Obj_RelVelX_31 :%f",signalvalue1);
	}
	else
	{
	testStepFail("Fail","i_S4_SRR_RL_Obj_RelVelX_31 :%f",signalvalue1);
	}
}

testcase S4_SRR_RL_Obj_Mes_10_S4_SRR_RL_Obj_AccelX_31()
{
	signalvalue1 = getSignal(S4_SRR_RL_Obj_AccelX_31);
	write("S4_SRR_RL_Obj_AccelX_31 :%f",signalvalue1);
	write("i_S4_SRR_RL_Obj_AccelX_31 :%f",@ecu_Signals::i_S4_SRR_RL_Obj_AccelX_31);

	testStep("get expect variable value: ","i_S4_SRR_RL_Obj_AccelX_31 :%f",@ecu_Signals::i_S4_SRR_RL_Obj_AccelX_31);

	if((abs(@ecu_Signals::i_S4_SRR_RL_Obj_AccelX_31)*0.9<=abs(signalvalue1))&&(abs(signalvalue1)<=abs(@ecu_Signals::i_S4_SRR_RL_Obj_AccelX_31)*1.1))
	{
	testStepPass("Pass","i_S4_SRR_RL_Obj_AccelX_31 :%f",signalvalue1);
	}
	else
	{
	testStepFail("Fail","i_S4_SRR_RL_Obj_AccelX_31 :%f",signalvalue1);
	}
}

testcase S4_SRR_RL_Obj_Mes_10_S4_SRR_RL_Obj_DistY_31()
{
	signalvalue1 = getSignal(S4_SRR_RL_Obj_DistY_31);
	write("S4_SRR_RL_Obj_DistY_31 :%f",signalvalue1);
	write("i_S4_SRR_RL_Obj_DistY_31 :%f",@ecu_Signals::i_S4_SRR_RL_Obj_DistY_31);

	testStep("get expect variable value: ","i_S4_SRR_RL_Obj_DistY_31 :%f",@ecu_Signals::i_S4_SRR_RL_Obj_DistY_31);

	if((abs(@ecu_Signals::i_S4_SRR_RL_Obj_DistY_31)*0.9<=abs(signalvalue1))&&(abs(signalvalue1)<=abs(@ecu_Signals::i_S4_SRR_RL_Obj_DistY_31)*1.1))
	{
	testStepPass("Pass","i_S4_SRR_RL_Obj_DistY_31 :%f",signalvalue1);
	}
	else
	{
	testStepFail("Fail","i_S4_SRR_RL_Obj_DistY_31 :%f",signalvalue1);
	}
}

testcase S4_SRR_RL_Obj_Mes_10_S4_SRR_RL_Obj_RelVelY_31()
{
	signalvalue1 = getSignal(S4_SRR_RL_Obj_RelVelY_31);
	write("S4_SRR_RL_Obj_RelVelY_31 :%f",signalvalue1);
	write("i_S4_SRR_RL_Obj_RelVelY_31 :%f",@ecu_Signals::i_S4_SRR_RL_Obj_RelVelY_31);

	testStep("get expect variable value: ","i_S4_SRR_RL_Obj_RelVelY_31 :%f",@ecu_Signals::i_S4_SRR_RL_Obj_RelVelY_31);

	if((abs(@ecu_Signals::i_S4_SRR_RL_Obj_RelVelY_31)*0.9<=abs(signalvalue1))&&(abs(signalvalue1)<=abs(@ecu_Signals::i_S4_SRR_RL_Obj_RelVelY_31)*1.1))
	{
	testStepPass("Pass","i_S4_SRR_RL_Obj_RelVelY_31 :%f",signalvalue1);
	}
	else
	{
	testStepFail("Fail","i_S4_SRR_RL_Obj_RelVelY_31 :%f",signalvalue1);
	}
}

testcase S4_SRR_RL_Obj_Mes_10_S4_SRR_RL_Obj_AccelY_31()
{
	signalvalue1 = getSignal(S4_SRR_RL_Obj_AccelY_31);
	write("S4_SRR_RL_Obj_AccelY_31 :%f",signalvalue1);
	write("i_S4_SRR_RL_Obj_AccelY_31 :%f",@ecu_Signals::i_S4_SRR_RL_Obj_AccelY_31);

	testStep("get expect variable value: ","i_S4_SRR_RL_Obj_AccelY_31 :%f",@ecu_Signals::i_S4_SRR_RL_Obj_AccelY_31);

	if((abs(@ecu_Signals::i_S4_SRR_RL_Obj_AccelY_31)*0.9<=abs(signalvalue1))&&(abs(signalvalue1)<=abs(@ecu_Signals::i_S4_SRR_RL_Obj_AccelY_31)*1.1))
	{
	testStepPass("Pass","i_S4_SRR_RL_Obj_AccelY_31 :%f",signalvalue1);
	}
	else
	{
	testStepFail("Fail","i_S4_SRR_RL_Obj_AccelY_31 :%f",signalvalue1);
	}
}

testcase S4_SRR_RL_Obj_Mes_10_S4_SRR_RL_Obj_DistXStd_31()
{
	signalvalue1 = getSignal(S4_SRR_RL_Obj_DistXStd_31);
	write("S4_SRR_RL_Obj_DistXStd_31 :%f",signalvalue1);
	write("i_S4_SRR_RL_Obj_DistXStd_31 :%f",@ecu_Signals::i_S4_SRR_RL_Obj_DistXStd_31);

	testStep("get expect variable value: ","i_S4_SRR_RL_Obj_DistXStd_31 :%f",@ecu_Signals::i_S4_SRR_RL_Obj_DistXStd_31);

	if((abs(@ecu_Signals::i_S4_SRR_RL_Obj_DistXStd_31)*0.9<=abs(signalvalue1))&&(abs(signalvalue1)<=abs(@ecu_Signals::i_S4_SRR_RL_Obj_DistXStd_31)*1.1))
	{
	testStepPass("Pass","i_S4_SRR_RL_Obj_DistXStd_31 :%f",signalvalue1);
	}
	else
	{
	testStepFail("Fail","i_S4_SRR_RL_Obj_DistXStd_31 :%f",signalvalue1);
	}
}

testcase S4_SRR_RL_Obj_Mes_10_S4_SRR_RL_Obj_RelVelXStd_31()
{
	signalvalue1 = getSignal(S4_SRR_RL_Obj_RelVelXStd_31);
	write("S4_SRR_RL_Obj_RelVelXStd_31 :%f",signalvalue1);
	write("i_S4_SRR_RL_Obj_RelVelXStd_31 :%f",@ecu_Signals::i_S4_SRR_RL_Obj_RelVelXStd_31);

	testStep("get expect variable value: ","i_S4_SRR_RL_Obj_RelVelXStd_31 :%f",@ecu_Signals::i_S4_SRR_RL_Obj_RelVelXStd_31);

	if((abs(@ecu_Signals::i_S4_SRR_RL_Obj_RelVelXStd_31)*0.9<=abs(signalvalue1))&&(abs(signalvalue1)<=abs(@ecu_Signals::i_S4_SRR_RL_Obj_RelVelXStd_31)*1.1))
	{
	testStepPass("Pass","i_S4_SRR_RL_Obj_RelVelXStd_31 :%f",signalvalue1);
	}
	else
	{
	testStepFail("Fail","i_S4_SRR_RL_Obj_RelVelXStd_31 :%f",signalvalue1);
	}
}

testcase S4_SRR_RL_Obj_Mes_10_S4_SRR_RL_Obj_DistYStd_31()
{
	signalvalue1 = getSignal(S4_SRR_RL_Obj_DistYStd_31);
	write("S4_SRR_RL_Obj_DistYStd_31 :%f",signalvalue1);
	write("i_S4_SRR_RL_Obj_DistYStd_31 :%f",@ecu_Signals::i_S4_SRR_RL_Obj_DistYStd_31);

	testStep("get expect variable value: ","i_S4_SRR_RL_Obj_DistYStd_31 :%f",@ecu_Signals::i_S4_SRR_RL_Obj_DistYStd_31);

	if((abs(@ecu_Signals::i_S4_SRR_RL_Obj_DistYStd_31)*0.9<=abs(signalvalue1))&&(abs(signalvalue1)<=abs(@ecu_Signals::i_S4_SRR_RL_Obj_DistYStd_31)*1.1))
	{
	testStepPass("Pass","i_S4_SRR_RL_Obj_DistYStd_31 :%f",signalvalue1);
	}
	else
	{
	testStepFail("Fail","i_S4_SRR_RL_Obj_DistYStd_31 :%f",signalvalue1);
	}
}

testcase S4_SRR_RL_Obj_Mes_10_S4_SRR_RL_Obj_RelVelYStd_31()
{
	signalvalue1 = getSignal(S4_SRR_RL_Obj_RelVelYStd_31);
	write("S4_SRR_RL_Obj_RelVelYStd_31 :%f",signalvalue1);
	write("i_S4_SRR_RL_Obj_RelVelYStd_31 :%f",@ecu_Signals::i_S4_SRR_RL_Obj_RelVelYStd_31);

	testStep("get expect variable value: ","i_S4_SRR_RL_Obj_RelVelYStd_31 :%f",@ecu_Signals::i_S4_SRR_RL_Obj_RelVelYStd_31);

	if((abs(@ecu_Signals::i_S4_SRR_RL_Obj_RelVelYStd_31)*0.9<=abs(signalvalue1))&&(abs(signalvalue1)<=abs(@ecu_Signals::i_S4_SRR_RL_Obj_RelVelYStd_31)*1.1))
	{
	testStepPass("Pass","i_S4_SRR_RL_Obj_RelVelYStd_31 :%f",signalvalue1);
	}
	else
	{
	testStepFail("Fail","i_S4_SRR_RL_Obj_RelVelYStd_31 :%f",signalvalue1);
	}
}

testcase S4_SRR_RL_Obj_Mes_10_S4_SRR_RL_Obj_UpdateFlag_31()
{
	signalvalue1 = getSignal(S4_SRR_RL_Obj_UpdateFlag_31);
	write("S4_SRR_RL_Obj_UpdateFlag_31 :%f",signalvalue1);
	write("i_S4_SRR_RL_Obj_UpdateFlag_31 :%o",@ecu_Signals::i_S4_SRR_RL_Obj_UpdateFlag_31);

	testStep("get expect variable value: ","i_S4_SRR_RL_Obj_UpdateFlag_31 :%o",@ecu_Signals::i_S4_SRR_RL_Obj_UpdateFlag_31);

	if(signalvalue1==@ecu_Signals::i_S4_SRR_RL_Obj_UpdateFlag_31)
	{
	testStepPass("Pass","i_S4_SRR_RL_Obj_UpdateFlag_31 :%f",signalvalue1);
	}
	else
	{
	testStepFail("Fail","i_S4_SRR_RL_Obj_UpdateFlag_31 :%f",signalvalue1);
	}
}

testcase S4_SRR_RL_Obj_Mes_10_S4_SRR_RL_Obj_ExistProb_31()
{
	signalvalue1 = getSignal(S4_SRR_RL_Obj_ExistProb_31);
	write("S4_SRR_RL_Obj_ExistProb_31 :%f",signalvalue1);
	write("i_S4_SRR_RL_Obj_ExistProb_31 :%o",@ecu_Signals::i_S4_SRR_RL_Obj_ExistProb_31);

	testStep("get expect variable value: ","i_S4_SRR_RL_Obj_ExistProb_31 :%o",@ecu_Signals::i_S4_SRR_RL_Obj_ExistProb_31);

	if(signalvalue1==@ecu_Signals::i_S4_SRR_RL_Obj_ExistProb_31)
	{
	testStepPass("Pass","i_S4_SRR_RL_Obj_ExistProb_31 :%f",signalvalue1);
	}
	else
	{
	testStepFail("Fail","i_S4_SRR_RL_Obj_ExistProb_31 :%f",signalvalue1);
	}
}

testcase S4_SRR_RL_Obj_Mes_10_S4_SRR_RL_Obj_Type_31()
{
	signalvalue1 = getSignal(S4_SRR_RL_Obj_Type_31);
	write("S4_SRR_RL_Obj_Type_31 :%f",signalvalue1);
	write("i_S4_SRR_RL_Obj_Type_31 :%o",@ecu_Signals::i_S4_SRR_RL_Obj_Type_31);

	testStep("get expect variable value: ","i_S4_SRR_RL_Obj_Type_31 :%o",@ecu_Signals::i_S4_SRR_RL_Obj_Type_31);

	if(signalvalue1==@ecu_Signals::i_S4_SRR_RL_Obj_Type_31)
	{
	testStepPass("Pass","i_S4_SRR_RL_Obj_Type_31 :%f",signalvalue1);
	}
	else
	{
	testStepFail("Fail","i_S4_SRR_RL_Obj_Type_31 :%f",signalvalue1);
	}
}

testcase S4_SRR_RL_Obj_Mes_10_S4_SRR_RL_Obj_EDynProp_31()
{
	signalvalue1 = getSignal(S4_SRR_RL_Obj_EDynProp_31);
	write("S4_SRR_RL_Obj_EDynProp_31 :%f",signalvalue1);
	write("i_S4_SRR_RL_Obj_EDynProp_31 :%o",@ecu_Signals::i_S4_SRR_RL_Obj_EDynProp_31);

	testStep("get expect variable value: ","i_S4_SRR_RL_Obj_EDynProp_31 :%o",@ecu_Signals::i_S4_SRR_RL_Obj_EDynProp_31);

	if(signalvalue1==@ecu_Signals::i_S4_SRR_RL_Obj_EDynProp_31)
	{
	testStepPass("Pass","i_S4_SRR_RL_Obj_EDynProp_31 :%f",signalvalue1);
	}
	else
	{
	testStepFail("Fail","i_S4_SRR_RL_Obj_EDynProp_31 :%f",signalvalue1);
	}
}

testcase S4_SRR_RL_Obj_Mes_10_S4_SRR_RL_Obj_UiLifeCycles_31()
{
	signalvalue1 = getSignal(S4_SRR_RL_Obj_UiLifeCycles_31);
	write("S4_SRR_RL_Obj_UiLifeCycles_31 :%f",signalvalue1);
	write("i_S4_SRR_RL_Obj_UiLifeCycles_31 :%o",@ecu_Signals::i_S4_SRR_RL_Obj_UiLifeCycles_31);

	testStep("get expect variable value: ","i_S4_SRR_RL_Obj_UiLifeCycles_31 :%o",@ecu_Signals::i_S4_SRR_RL_Obj_UiLifeCycles_31);

	if(signalvalue1==@ecu_Signals::i_S4_SRR_RL_Obj_UiLifeCycles_31)
	{
	testStepPass("Pass","i_S4_SRR_RL_Obj_UiLifeCycles_31 :%f",signalvalue1);
	}
	else
	{
	testStepFail("Fail","i_S4_SRR_RL_Obj_UiLifeCycles_31 :%f",signalvalue1);
	}
}

MainTest()
{
S4_SRR_RL_Clu_Mes_0_S4_SRR_RL_Clu_Theta_0();
S4_SRR_RL_Clu_Mes_0_S4_SRR_RL_Clu_Dist_0();
S4_SRR_RL_Clu_Mes_0_S4_SRR_RL_Clu_Vel_0();
S4_SRR_RL_Clu_Mes_0_S4_SRR_RL_Clu_SNR_0();
S4_SRR_RL_Clu_Mes_0_S4_SRR_RL_Clu_DynProp_0();
S4_SRR_RL_Clu_Mes_0_S4_SRR_RL_Clu_Locationvalid_0();
S4_SRR_RL_Clu_Mes_0_S4_SRR_RL_Clu_Timestamps();
S4_SRR_RL_Clu_Mes_0_S4_SRR_RL_Clu_Timestamps();
S4_SRR_RL_Clu_Mes_0_S4_SRR_RL_Clu_Timestamps();
S4_SRR_RL_Obj_Mes_0_S4_SRR_RL_Obj_ID_0();
S4_SRR_RL_Obj_Mes_0_S4_SRR_RL_Obj_DistX_0();
S4_SRR_RL_Obj_Mes_0_S4_SRR_RL_Obj_RelVelX_0();
S4_SRR_RL_Obj_Mes_0_S4_SRR_RL_Obj_AccelX_0();
S4_SRR_RL_Obj_Mes_0_S4_SRR_RL_Obj_DistY_0();
S4_SRR_RL_Obj_Mes_0_S4_SRR_RL_Obj_RelVelY_0();
S4_SRR_RL_Obj_Mes_0_S4_SRR_RL_Obj_AccelY_0();
S4_SRR_RL_Obj_Mes_0_S4_SRR_RL_Obj_DistXStd_0();
S4_SRR_RL_Obj_Mes_0_S4_SRR_RL_Obj_RelVelXStd_0();
S4_SRR_RL_Obj_Mes_0_S4_SRR_RL_Obj_DistYStd_0();
S4_SRR_RL_Obj_Mes_0_S4_SRR_RL_Obj_RelVelYStd_0();
S4_SRR_RL_Obj_Mes_0_S4_SRR_RL_Obj_UpdateFlag_0();
S4_SRR_RL_Obj_Mes_0_S4_SRR_RL_Obj_ExistProb_0();
S4_SRR_RL_Obj_Mes_0_S4_SRR_RL_Obj_Type_0();
S4_SRR_RL_Obj_Mes_0_S4_SRR_RL_Obj_EDynProp_0();
S4_SRR_RL_Obj_Mes_0_S4_SRR_RL_Obj_UiLifeCycles_0();
S4_SRR_RL_Obj_Mes_0_S4_SRR_RL_Obj_Timestamps();
S4_SRR_RL_Obj_Mes_0_S4_SRR_RL_Obj_Timestamps();
S4_SRR_RL_Obj_Mes_0_S4_SRR_RL_Obj_Timestamps();
S4_SRR_RL_Clu_Mes_0_S4_SRR_RL_Clu_Theta_1();
S4_SRR_RL_Clu_Mes_0_S4_SRR_RL_Clu_Dist_1();
S4_SRR_RL_Clu_Mes_0_S4_SRR_RL_Clu_Vel_1();
S4_SRR_RL_Clu_Mes_0_S4_SRR_RL_Clu_SNR_1();
S4_SRR_RL_Clu_Mes_0_S4_SRR_RL_Clu_DynProp_1();
S4_SRR_RL_Clu_Mes_0_S4_SRR_RL_Clu_Locationvalid_1();
S4_SRR_RL_Clu_Mes_0_S4_SRR_RL_Clu_Theta_2();
S4_SRR_RL_Clu_Mes_0_S4_SRR_RL_Clu_Dist_2();
S4_SRR_RL_Clu_Mes_0_S4_SRR_RL_Clu_Vel_2();
S4_SRR_RL_Clu_Mes_0_S4_SRR_RL_Clu_SNR_2();
S4_SRR_RL_Clu_Mes_0_S4_SRR_RL_Clu_DynProp_2();
S4_SRR_RL_Clu_Mes_0_S4_SRR_RL_Clu_Locationvalid_2();
S4_SRR_RL_Clu_Mes_0_S4_SRR_RL_Clu_Theta_3();
S4_SRR_RL_Clu_Mes_0_S4_SRR_RL_Clu_Dist_3();
S4_SRR_RL_Clu_Mes_0_S4_SRR_RL_Clu_Vel_3();
S4_SRR_RL_Clu_Mes_0_S4_SRR_RL_Clu_SNR_3();
S4_SRR_RL_Clu_Mes_0_S4_SRR_RL_Clu_DynProp_3();
S4_SRR_RL_Clu_Mes_0_S4_SRR_RL_Clu_Locationvalid_3();
S4_SRR_RL_Clu_Mes_0_S4_SRR_RL_Clu_Theta_4();
S4_SRR_RL_Clu_Mes_0_S4_SRR_RL_Clu_Dist_4();
S4_SRR_RL_Clu_Mes_0_S4_SRR_RL_Clu_Vel_4();
S4_SRR_RL_Clu_Mes_0_S4_SRR_RL_Clu_SNR_4();
S4_SRR_RL_Clu_Mes_0_S4_SRR_RL_Clu_DynProp_4();
S4_SRR_RL_Clu_Mes_0_S4_SRR_RL_Clu_Locationvalid_4();
S4_SRR_RL_Clu_Mes_0_S4_SRR_RL_Clu_Theta_5();
S4_SRR_RL_Clu_Mes_0_S4_SRR_RL_Clu_Dist_5();
S4_SRR_RL_Clu_Mes_0_S4_SRR_RL_Clu_Vel_5();
S4_SRR_RL_Clu_Mes_0_S4_SRR_RL_Clu_SNR_5();
S4_SRR_RL_Clu_Mes_0_S4_SRR_RL_Clu_DynProp_5();
S4_SRR_RL_Clu_Mes_0_S4_SRR_RL_Clu_Locationvalid_5();
S4_SRR_RL_Clu_Mes_0_S4_SRR_RL_Clu_Theta_6();
S4_SRR_RL_Clu_Mes_0_S4_SRR_RL_Clu_Dist_6();
S4_SRR_RL_Clu_Mes_0_S4_SRR_RL_Clu_Vel_6();
S4_SRR_RL_Clu_Mes_0_S4_SRR_RL_Clu_SNR_6();
S4_SRR_RL_Clu_Mes_0_S4_SRR_RL_Clu_DynProp_6();
S4_SRR_RL_Clu_Mes_0_S4_SRR_RL_Clu_Locationvalid_6();
S4_SRR_RL_Clu_Mes_1_S4_SRR_RL_Clu_Theta_7();
S4_SRR_RL_Clu_Mes_1_S4_SRR_RL_Clu_Dist_7();
S4_SRR_RL_Clu_Mes_1_S4_SRR_RL_Clu_Vel_7();
S4_SRR_RL_Clu_Mes_1_S4_SRR_RL_Clu_SNR_7();
S4_SRR_RL_Clu_Mes_1_S4_SRR_RL_Clu_DynProp_7();
S4_SRR_RL_Clu_Mes_1_S4_SRR_RL_Clu_Locationvalid_7();
S4_SRR_RL_Clu_Mes_1_S4_SRR_RL_Clu_Theta_8();
S4_SRR_RL_Clu_Mes_1_S4_SRR_RL_Clu_Dist_8();
S4_SRR_RL_Clu_Mes_1_S4_SRR_RL_Clu_Vel_8();
S4_SRR_RL_Clu_Mes_1_S4_SRR_RL_Clu_SNR_8();
S4_SRR_RL_Clu_Mes_1_S4_SRR_RL_Clu_DynProp_8();
S4_SRR_RL_Clu_Mes_1_S4_SRR_RL_Clu_Locationvalid_8();
S4_SRR_RL_Clu_Mes_1_S4_SRR_RL_Clu_Theta_9();
S4_SRR_RL_Clu_Mes_1_S4_SRR_RL_Clu_Dist_9();
S4_SRR_RL_Clu_Mes_1_S4_SRR_RL_Clu_Vel_9();
S4_SRR_RL_Clu_Mes_1_S4_SRR_RL_Clu_SNR_9();
S4_SRR_RL_Clu_Mes_1_S4_SRR_RL_Clu_DynProp_9();
S4_SRR_RL_Clu_Mes_1_S4_SRR_RL_Clu_Locationvalid_9();
S4_SRR_RL_Clu_Mes_1_S4_SRR_RL_Clu_Theta_10();
S4_SRR_RL_Clu_Mes_1_S4_SRR_RL_Clu_Dist_10();
S4_SRR_RL_Clu_Mes_1_S4_SRR_RL_Clu_Vel_10();
S4_SRR_RL_Clu_Mes_1_S4_SRR_RL_Clu_SNR_10();
S4_SRR_RL_Clu_Mes_1_S4_SRR_RL_Clu_DynProp_10();
S4_SRR_RL_Clu_Mes_1_S4_SRR_RL_Clu_Locationvalid_10();
S4_SRR_RL_Clu_Mes_1_S4_SRR_RL_Clu_Theta_11();
S4_SRR_RL_Clu_Mes_1_S4_SRR_RL_Clu_Dist_11();
S4_SRR_RL_Clu_Mes_1_S4_SRR_RL_Clu_Vel_11();
S4_SRR_RL_Clu_Mes_1_S4_SRR_RL_Clu_SNR_11();
S4_SRR_RL_Clu_Mes_1_S4_SRR_RL_Clu_DynProp_11();
S4_SRR_RL_Clu_Mes_1_S4_SRR_RL_Clu_Locationvalid_11();
S4_SRR_RL_Clu_Mes_1_S4_SRR_RL_Clu_Theta_12();
S4_SRR_RL_Clu_Mes_1_S4_SRR_RL_Clu_Dist_12();
S4_SRR_RL_Clu_Mes_1_S4_SRR_RL_Clu_Vel_12();
S4_SRR_RL_Clu_Mes_1_S4_SRR_RL_Clu_SNR_12();
S4_SRR_RL_Clu_Mes_1_S4_SRR_RL_Clu_DynProp_12();
S4_SRR_RL_Clu_Mes_1_S4_SRR_RL_Clu_Locationvalid_12();
S4_SRR_RL_Clu_Mes_1_S4_SRR_RL_Clu_Theta_13();
S4_SRR_RL_Clu_Mes_1_S4_SRR_RL_Clu_Dist_13();
S4_SRR_RL_Clu_Mes_1_S4_SRR_RL_Clu_Vel_13();
S4_SRR_RL_Clu_Mes_1_S4_SRR_RL_Clu_SNR_13();
S4_SRR_RL_Clu_Mes_1_S4_SRR_RL_Clu_DynProp_13();
S4_SRR_RL_Clu_Mes_1_S4_SRR_RL_Clu_Locationvalid_13();
S4_SRR_RL_Clu_Mes_2_S4_SRR_RL_Clu_Theta_14();
S4_SRR_RL_Clu_Mes_2_S4_SRR_RL_Clu_Dist_14();
S4_SRR_RL_Clu_Mes_2_S4_SRR_RL_Clu_Vel_14();
S4_SRR_RL_Clu_Mes_2_S4_SRR_RL_Clu_SNR_14();
S4_SRR_RL_Clu_Mes_2_S4_SRR_RL_Clu_DynProp_14();
S4_SRR_RL_Clu_Mes_2_S4_SRR_RL_Clu_Locationvalid_14();
S4_SRR_RL_Clu_Mes_2_S4_SRR_RL_Clu_Theta_15();
S4_SRR_RL_Clu_Mes_2_S4_SRR_RL_Clu_Dist_15();
S4_SRR_RL_Clu_Mes_2_S4_SRR_RL_Clu_Vel_15();
S4_SRR_RL_Clu_Mes_2_S4_SRR_RL_Clu_SNR_15();
S4_SRR_RL_Clu_Mes_2_S4_SRR_RL_Clu_DynProp_15();
S4_SRR_RL_Clu_Mes_2_S4_SRR_RL_Clu_Locationvalid_15();
S4_SRR_RL_Clu_Mes_2_S4_SRR_RL_Clu_Theta_16();
S4_SRR_RL_Clu_Mes_2_S4_SRR_RL_Clu_Dist_16();
S4_SRR_RL_Clu_Mes_2_S4_SRR_RL_Clu_Vel_16();
S4_SRR_RL_Clu_Mes_2_S4_SRR_RL_Clu_SNR_16();
S4_SRR_RL_Clu_Mes_2_S4_SRR_RL_Clu_DynProp_16();
S4_SRR_RL_Clu_Mes_2_S4_SRR_RL_Clu_Locationvalid_16();
S4_SRR_RL_Clu_Mes_2_S4_SRR_RL_Clu_Theta_17();
S4_SRR_RL_Clu_Mes_2_S4_SRR_RL_Clu_Dist_17();
S4_SRR_RL_Clu_Mes_2_S4_SRR_RL_Clu_Vel_17();
S4_SRR_RL_Clu_Mes_2_S4_SRR_RL_Clu_SNR_17();
S4_SRR_RL_Clu_Mes_2_S4_SRR_RL_Clu_DynProp_17();
S4_SRR_RL_Clu_Mes_2_S4_SRR_RL_Clu_Locationvalid_17();
S4_SRR_RL_Clu_Mes_2_S4_SRR_RL_Clu_Theta_18();
S4_SRR_RL_Clu_Mes_2_S4_SRR_RL_Clu_Dist_18();
S4_SRR_RL_Clu_Mes_2_S4_SRR_RL_Clu_Vel_18();
S4_SRR_RL_Clu_Mes_2_S4_SRR_RL_Clu_SNR_18();
S4_SRR_RL_Clu_Mes_2_S4_SRR_RL_Clu_DynProp_18();
S4_SRR_RL_Clu_Mes_2_S4_SRR_RL_Clu_Locationvalid_18();
S4_SRR_RL_Clu_Mes_2_S4_SRR_RL_Clu_Theta_19();
S4_SRR_RL_Clu_Mes_2_S4_SRR_RL_Clu_Dist_19();
S4_SRR_RL_Clu_Mes_2_S4_SRR_RL_Clu_Vel_19();
S4_SRR_RL_Clu_Mes_2_S4_SRR_RL_Clu_SNR_19();
S4_SRR_RL_Clu_Mes_2_S4_SRR_RL_Clu_DynProp_19();
S4_SRR_RL_Clu_Mes_2_S4_SRR_RL_Clu_Locationvalid_19();
S4_SRR_RL_Clu_Mes_2_S4_SRR_RL_Clu_Theta_20();
S4_SRR_RL_Clu_Mes_2_S4_SRR_RL_Clu_Dist_20();
S4_SRR_RL_Clu_Mes_2_S4_SRR_RL_Clu_Vel_20();
S4_SRR_RL_Clu_Mes_2_S4_SRR_RL_Clu_SNR_20();
S4_SRR_RL_Clu_Mes_2_S4_SRR_RL_Clu_DynProp_20();
S4_SRR_RL_Clu_Mes_2_S4_SRR_RL_Clu_Locationvalid_20();
S4_SRR_RL_Clu_Mes_3_S4_SRR_RL_Clu_Theta_21();
S4_SRR_RL_Clu_Mes_3_S4_SRR_RL_Clu_Dist_21();
S4_SRR_RL_Clu_Mes_3_S4_SRR_RL_Clu_Vel_21();
S4_SRR_RL_Clu_Mes_3_S4_SRR_RL_Clu_SNR_21();
S4_SRR_RL_Clu_Mes_3_S4_SRR_RL_Clu_DynProp_21();
S4_SRR_RL_Clu_Mes_3_S4_SRR_RL_Clu_Locationvalid_21();
S4_SRR_RL_Clu_Mes_3_S4_SRR_RL_Clu_Theta_22();
S4_SRR_RL_Clu_Mes_3_S4_SRR_RL_Clu_Dist_22();
S4_SRR_RL_Clu_Mes_3_S4_SRR_RL_Clu_Vel_22();
S4_SRR_RL_Clu_Mes_3_S4_SRR_RL_Clu_SNR_22();
S4_SRR_RL_Clu_Mes_3_S4_SRR_RL_Clu_DynProp_22();
S4_SRR_RL_Clu_Mes_3_S4_SRR_RL_Clu_Locationvalid_22();
S4_SRR_RL_Clu_Mes_3_S4_SRR_RL_Clu_Theta_23();
S4_SRR_RL_Clu_Mes_3_S4_SRR_RL_Clu_Dist_23();
S4_SRR_RL_Clu_Mes_3_S4_SRR_RL_Clu_Vel_23();
S4_SRR_RL_Clu_Mes_3_S4_SRR_RL_Clu_SNR_23();
S4_SRR_RL_Clu_Mes_3_S4_SRR_RL_Clu_DynProp_23();
S4_SRR_RL_Clu_Mes_3_S4_SRR_RL_Clu_Locationvalid_23();
S4_SRR_RL_Clu_Mes_3_S4_SRR_RL_Clu_Theta_24();
S4_SRR_RL_Clu_Mes_3_S4_SRR_RL_Clu_Dist_24();
S4_SRR_RL_Clu_Mes_3_S4_SRR_RL_Clu_Vel_24();
S4_SRR_RL_Clu_Mes_3_S4_SRR_RL_Clu_SNR_24();
S4_SRR_RL_Clu_Mes_3_S4_SRR_RL_Clu_DynProp_24();
S4_SRR_RL_Clu_Mes_3_S4_SRR_RL_Clu_Locationvalid_24();
S4_SRR_RL_Clu_Mes_3_S4_SRR_RL_Clu_Theta_25();
S4_SRR_RL_Clu_Mes_3_S4_SRR_RL_Clu_Dist_25();
S4_SRR_RL_Clu_Mes_3_S4_SRR_RL_Clu_Vel_25();
S4_SRR_RL_Clu_Mes_3_S4_SRR_RL_Clu_SNR_25();
S4_SRR_RL_Clu_Mes_3_S4_SRR_RL_Clu_DynProp_25();
S4_SRR_RL_Clu_Mes_3_S4_SRR_RL_Clu_Locationvalid_25();
S4_SRR_RL_Clu_Mes_3_S4_SRR_RL_Clu_Theta_26();
S4_SRR_RL_Clu_Mes_3_S4_SRR_RL_Clu_Dist_26();
S4_SRR_RL_Clu_Mes_3_S4_SRR_RL_Clu_Vel_26();
S4_SRR_RL_Clu_Mes_3_S4_SRR_RL_Clu_SNR_26();
S4_SRR_RL_Clu_Mes_3_S4_SRR_RL_Clu_DynProp_26();
S4_SRR_RL_Clu_Mes_3_S4_SRR_RL_Clu_Locationvalid_26();
S4_SRR_RL_Clu_Mes_3_S4_SRR_RL_Clu_Theta_27();
S4_SRR_RL_Clu_Mes_3_S4_SRR_RL_Clu_Dist_27();
S4_SRR_RL_Clu_Mes_3_S4_SRR_RL_Clu_Vel_27();
S4_SRR_RL_Clu_Mes_3_S4_SRR_RL_Clu_SNR_27();
S4_SRR_RL_Clu_Mes_3_S4_SRR_RL_Clu_DynProp_27();
S4_SRR_RL_Clu_Mes_3_S4_SRR_RL_Clu_Locationvalid_27();
S4_SRR_RL_Clu_Mes_4_S4_SRR_RL_Clu_Theta_28();
S4_SRR_RL_Clu_Mes_4_S4_SRR_RL_Clu_Dist_28();
S4_SRR_RL_Clu_Mes_4_S4_SRR_RL_Clu_Vel_28();
S4_SRR_RL_Clu_Mes_4_S4_SRR_RL_Clu_SNR_28();
S4_SRR_RL_Clu_Mes_4_S4_SRR_RL_Clu_DynProp_28();
S4_SRR_RL_Clu_Mes_4_S4_SRR_RL_Clu_Locationvalid_28();
S4_SRR_RL_Clu_Mes_4_S4_SRR_RL_Clu_Theta_29();
S4_SRR_RL_Clu_Mes_4_S4_SRR_RL_Clu_Dist_29();
S4_SRR_RL_Clu_Mes_4_S4_SRR_RL_Clu_Vel_29();
S4_SRR_RL_Clu_Mes_4_S4_SRR_RL_Clu_SNR_29();
S4_SRR_RL_Clu_Mes_4_S4_SRR_RL_Clu_DynProp_29();
S4_SRR_RL_Clu_Mes_4_S4_SRR_RL_Clu_Locationvalid_29();
S4_SRR_RL_Clu_Mes_4_S4_SRR_RL_Clu_Theta_30();
S4_SRR_RL_Clu_Mes_4_S4_SRR_RL_Clu_Dist_30();
S4_SRR_RL_Clu_Mes_4_S4_SRR_RL_Clu_Vel_30();
S4_SRR_RL_Clu_Mes_4_S4_SRR_RL_Clu_SNR_30();
S4_SRR_RL_Clu_Mes_4_S4_SRR_RL_Clu_DynProp_30();
S4_SRR_RL_Clu_Mes_4_S4_SRR_RL_Clu_Locationvalid_30();
S4_SRR_RL_Clu_Mes_4_S4_SRR_RL_Clu_Theta_31();
S4_SRR_RL_Clu_Mes_4_S4_SRR_RL_Clu_Dist_31();
S4_SRR_RL_Clu_Mes_4_S4_SRR_RL_Clu_Vel_31();
S4_SRR_RL_Clu_Mes_4_S4_SRR_RL_Clu_SNR_31();
S4_SRR_RL_Clu_Mes_4_S4_SRR_RL_Clu_DynProp_31();
S4_SRR_RL_Clu_Mes_4_S4_SRR_RL_Clu_Locationvalid_31();
S4_SRR_RL_Clu_Mes_4_S4_SRR_RL_Clu_Theta_32();
S4_SRR_RL_Clu_Mes_4_S4_SRR_RL_Clu_Dist_32();
S4_SRR_RL_Clu_Mes_4_S4_SRR_RL_Clu_Vel_32();
S4_SRR_RL_Clu_Mes_4_S4_SRR_RL_Clu_SNR_32();
S4_SRR_RL_Clu_Mes_4_S4_SRR_RL_Clu_DynProp_32();
S4_SRR_RL_Clu_Mes_4_S4_SRR_RL_Clu_Locationvalid_32();
S4_SRR_RL_Clu_Mes_4_S4_SRR_RL_Clu_Theta_33();
S4_SRR_RL_Clu_Mes_4_S4_SRR_RL_Clu_Dist_33();
S4_SRR_RL_Clu_Mes_4_S4_SRR_RL_Clu_Vel_33();
S4_SRR_RL_Clu_Mes_4_S4_SRR_RL_Clu_SNR_33();
S4_SRR_RL_Clu_Mes_4_S4_SRR_RL_Clu_DynProp_33();
S4_SRR_RL_Clu_Mes_4_S4_SRR_RL_Clu_Locationvalid_33();
S4_SRR_RL_Clu_Mes_4_S4_SRR_RL_Clu_Theta_34();
S4_SRR_RL_Clu_Mes_4_S4_SRR_RL_Clu_Dist_34();
S4_SRR_RL_Clu_Mes_4_S4_SRR_RL_Clu_Vel_34();
S4_SRR_RL_Clu_Mes_4_S4_SRR_RL_Clu_SNR_34();
S4_SRR_RL_Clu_Mes_4_S4_SRR_RL_Clu_DynProp_34();
S4_SRR_RL_Clu_Mes_4_S4_SRR_RL_Clu_Locationvalid_34();
S4_SRR_RL_Clu_Mes_5_S4_SRR_RL_Clu_Theta_35();
S4_SRR_RL_Clu_Mes_5_S4_SRR_RL_Clu_Dist_35();
S4_SRR_RL_Clu_Mes_5_S4_SRR_RL_Clu_Vel_35();
S4_SRR_RL_Clu_Mes_5_S4_SRR_RL_Clu_SNR_35();
S4_SRR_RL_Clu_Mes_5_S4_SRR_RL_Clu_DynProp_35();
S4_SRR_RL_Clu_Mes_5_S4_SRR_RL_Clu_Locationvalid_35();
S4_SRR_RL_Clu_Mes_5_S4_SRR_RL_Clu_Theta_36();
S4_SRR_RL_Clu_Mes_5_S4_SRR_RL_Clu_Dist_36();
S4_SRR_RL_Clu_Mes_5_S4_SRR_RL_Clu_Vel_36();
S4_SRR_RL_Clu_Mes_5_S4_SRR_RL_Clu_SNR_36();
S4_SRR_RL_Clu_Mes_5_S4_SRR_RL_Clu_DynProp_36();
S4_SRR_RL_Clu_Mes_5_S4_SRR_RL_Clu_Locationvalid_36();
S4_SRR_RL_Clu_Mes_5_S4_SRR_RL_Clu_Theta_37();
S4_SRR_RL_Clu_Mes_5_S4_SRR_RL_Clu_Dist_37();
S4_SRR_RL_Clu_Mes_5_S4_SRR_RL_Clu_Vel_37();
S4_SRR_RL_Clu_Mes_5_S4_SRR_RL_Clu_SNR_37();
S4_SRR_RL_Clu_Mes_5_S4_SRR_RL_Clu_DynProp_37();
S4_SRR_RL_Clu_Mes_5_S4_SRR_RL_Clu_Locationvalid_37();
S4_SRR_RL_Clu_Mes_5_S4_SRR_RL_Clu_Theta_38();
S4_SRR_RL_Clu_Mes_5_S4_SRR_RL_Clu_Dist_38();
S4_SRR_RL_Clu_Mes_5_S4_SRR_RL_Clu_Vel_38();
S4_SRR_RL_Clu_Mes_5_S4_SRR_RL_Clu_SNR_38();
S4_SRR_RL_Clu_Mes_5_S4_SRR_RL_Clu_DynProp_38();
S4_SRR_RL_Clu_Mes_5_S4_SRR_RL_Clu_Locationvalid_38();
S4_SRR_RL_Clu_Mes_5_S4_SRR_RL_Clu_Theta_39();
S4_SRR_RL_Clu_Mes_5_S4_SRR_RL_Clu_Dist_39();
S4_SRR_RL_Clu_Mes_5_S4_SRR_RL_Clu_Vel_39();
S4_SRR_RL_Clu_Mes_5_S4_SRR_RL_Clu_SNR_39();
S4_SRR_RL_Clu_Mes_5_S4_SRR_RL_Clu_DynProp_39();
S4_SRR_RL_Clu_Mes_5_S4_SRR_RL_Clu_Locationvalid_39();
S4_SRR_RL_Clu_Mes_5_S4_SRR_RL_Clu_Theta_40();
S4_SRR_RL_Clu_Mes_5_S4_SRR_RL_Clu_Dist_40();
S4_SRR_RL_Clu_Mes_5_S4_SRR_RL_Clu_Vel_40();
S4_SRR_RL_Clu_Mes_5_S4_SRR_RL_Clu_SNR_40();
S4_SRR_RL_Clu_Mes_5_S4_SRR_RL_Clu_DynProp_40();
S4_SRR_RL_Clu_Mes_5_S4_SRR_RL_Clu_Locationvalid_40();
S4_SRR_RL_Clu_Mes_5_S4_SRR_RL_Clu_Theta_41();
S4_SRR_RL_Clu_Mes_5_S4_SRR_RL_Clu_Dist_41();
S4_SRR_RL_Clu_Mes_5_S4_SRR_RL_Clu_Vel_41();
S4_SRR_RL_Clu_Mes_5_S4_SRR_RL_Clu_SNR_41();
S4_SRR_RL_Clu_Mes_5_S4_SRR_RL_Clu_DynProp_41();
S4_SRR_RL_Clu_Mes_5_S4_SRR_RL_Clu_Locationvalid_41();
S4_SRR_RL_Clu_Mes_6_S4_SRR_RL_Clu_Theta_42();
S4_SRR_RL_Clu_Mes_6_S4_SRR_RL_Clu_Dist_42();
S4_SRR_RL_Clu_Mes_6_S4_SRR_RL_Clu_Vel_42();
S4_SRR_RL_Clu_Mes_6_S4_SRR_RL_Clu_SNR_42();
S4_SRR_RL_Clu_Mes_6_S4_SRR_RL_Clu_DynProp_42();
S4_SRR_RL_Clu_Mes_6_S4_SRR_RL_Clu_Locationvalid_42();
S4_SRR_RL_Clu_Mes_6_S4_SRR_RL_Clu_Theta_43();
S4_SRR_RL_Clu_Mes_6_S4_SRR_RL_Clu_Dist_43();
S4_SRR_RL_Clu_Mes_6_S4_SRR_RL_Clu_Vel_43();
S4_SRR_RL_Clu_Mes_6_S4_SRR_RL_Clu_SNR_43();
S4_SRR_RL_Clu_Mes_6_S4_SRR_RL_Clu_DynProp_43();
S4_SRR_RL_Clu_Mes_6_S4_SRR_RL_Clu_Locationvalid_43();
S4_SRR_RL_Clu_Mes_6_S4_SRR_RL_Clu_Theta_44();
S4_SRR_RL_Clu_Mes_6_S4_SRR_RL_Clu_Dist_44();
S4_SRR_RL_Clu_Mes_6_S4_SRR_RL_Clu_Vel_44();
S4_SRR_RL_Clu_Mes_6_S4_SRR_RL_Clu_SNR_44();
S4_SRR_RL_Clu_Mes_6_S4_SRR_RL_Clu_DynProp_44();
S4_SRR_RL_Clu_Mes_6_S4_SRR_RL_Clu_Locationvalid_44();
S4_SRR_RL_Clu_Mes_6_S4_SRR_RL_Clu_Theta_45();
S4_SRR_RL_Clu_Mes_6_S4_SRR_RL_Clu_Dist_45();
S4_SRR_RL_Clu_Mes_6_S4_SRR_RL_Clu_Vel_45();
S4_SRR_RL_Clu_Mes_6_S4_SRR_RL_Clu_SNR_45();
S4_SRR_RL_Clu_Mes_6_S4_SRR_RL_Clu_DynProp_45();
S4_SRR_RL_Clu_Mes_6_S4_SRR_RL_Clu_Locationvalid_45();
S4_SRR_RL_Clu_Mes_6_S4_SRR_RL_Clu_Theta_46();
S4_SRR_RL_Clu_Mes_6_S4_SRR_RL_Clu_Dist_46();
S4_SRR_RL_Clu_Mes_6_S4_SRR_RL_Clu_Vel_46();
S4_SRR_RL_Clu_Mes_6_S4_SRR_RL_Clu_SNR_46();
S4_SRR_RL_Clu_Mes_6_S4_SRR_RL_Clu_DynProp_46();
S4_SRR_RL_Clu_Mes_6_S4_SRR_RL_Clu_Locationvalid_46();
S4_SRR_RL_Clu_Mes_6_S4_SRR_RL_Clu_Theta_47();
S4_SRR_RL_Clu_Mes_6_S4_SRR_RL_Clu_Dist_47();
S4_SRR_RL_Clu_Mes_6_S4_SRR_RL_Clu_Vel_47();
S4_SRR_RL_Clu_Mes_6_S4_SRR_RL_Clu_SNR_47();
S4_SRR_RL_Clu_Mes_6_S4_SRR_RL_Clu_DynProp_47();
S4_SRR_RL_Clu_Mes_6_S4_SRR_RL_Clu_Locationvalid_47();
S4_SRR_RL_Clu_Mes_6_S4_SRR_RL_Clu_Theta_48();
S4_SRR_RL_Clu_Mes_6_S4_SRR_RL_Clu_Dist_48();
S4_SRR_RL_Clu_Mes_6_S4_SRR_RL_Clu_Vel_48();
S4_SRR_RL_Clu_Mes_6_S4_SRR_RL_Clu_SNR_48();
S4_SRR_RL_Clu_Mes_6_S4_SRR_RL_Clu_DynProp_48();
S4_SRR_RL_Clu_Mes_6_S4_SRR_RL_Clu_Locationvalid_48();
S4_SRR_RL_Clu_Mes_7_S4_SRR_RL_Clu_Theta_49();
S4_SRR_RL_Clu_Mes_7_S4_SRR_RL_Clu_Dist_49();
S4_SRR_RL_Clu_Mes_7_S4_SRR_RL_Clu_Vel_49();
S4_SRR_RL_Clu_Mes_7_S4_SRR_RL_Clu_SNR_49();
S4_SRR_RL_Clu_Mes_7_S4_SRR_RL_Clu_DynProp_49();
S4_SRR_RL_Clu_Mes_7_S4_SRR_RL_Clu_Locationvalid_49();
S4_SRR_RL_Clu_Mes_7_S4_SRR_RL_Clu_Theta_50();
S4_SRR_RL_Clu_Mes_7_S4_SRR_RL_Clu_Dist_50();
S4_SRR_RL_Clu_Mes_7_S4_SRR_RL_Clu_Vel_50();
S4_SRR_RL_Clu_Mes_7_S4_SRR_RL_Clu_SNR_50();
S4_SRR_RL_Clu_Mes_7_S4_SRR_RL_Clu_DynProp_50();
S4_SRR_RL_Clu_Mes_7_S4_SRR_RL_Clu_Locationvalid_50();
S4_SRR_RL_Clu_Mes_7_S4_SRR_RL_Clu_Theta_51();
S4_SRR_RL_Clu_Mes_7_S4_SRR_RL_Clu_Dist_51();
S4_SRR_RL_Clu_Mes_7_S4_SRR_RL_Clu_Vel_51();
S4_SRR_RL_Clu_Mes_7_S4_SRR_RL_Clu_SNR_51();
S4_SRR_RL_Clu_Mes_7_S4_SRR_RL_Clu_DynProp_51();
S4_SRR_RL_Clu_Mes_7_S4_SRR_RL_Clu_Locationvalid_51();
S4_SRR_RL_Clu_Mes_7_S4_SRR_RL_Clu_Theta_52();
S4_SRR_RL_Clu_Mes_7_S4_SRR_RL_Clu_Dist_52();
S4_SRR_RL_Clu_Mes_7_S4_SRR_RL_Clu_Vel_52();
S4_SRR_RL_Clu_Mes_7_S4_SRR_RL_Clu_SNR_52();
S4_SRR_RL_Clu_Mes_7_S4_SRR_RL_Clu_DynProp_52();
S4_SRR_RL_Clu_Mes_7_S4_SRR_RL_Clu_Locationvalid_52();
S4_SRR_RL_Clu_Mes_7_S4_SRR_RL_Clu_Theta_53();
S4_SRR_RL_Clu_Mes_7_S4_SRR_RL_Clu_Dist_53();
S4_SRR_RL_Clu_Mes_7_S4_SRR_RL_Clu_Vel_53();
S4_SRR_RL_Clu_Mes_7_S4_SRR_RL_Clu_SNR_53();
S4_SRR_RL_Clu_Mes_7_S4_SRR_RL_Clu_DynProp_53();
S4_SRR_RL_Clu_Mes_7_S4_SRR_RL_Clu_Locationvalid_53();
S4_SRR_RL_Clu_Mes_7_S4_SRR_RL_Clu_Theta_54();
S4_SRR_RL_Clu_Mes_7_S4_SRR_RL_Clu_Dist_54();
S4_SRR_RL_Clu_Mes_7_S4_SRR_RL_Clu_Vel_54();
S4_SRR_RL_Clu_Mes_7_S4_SRR_RL_Clu_SNR_54();
S4_SRR_RL_Clu_Mes_7_S4_SRR_RL_Clu_DynProp_54();
S4_SRR_RL_Clu_Mes_7_S4_SRR_RL_Clu_Locationvalid_54();
S4_SRR_RL_Clu_Mes_7_S4_SRR_RL_Clu_Theta_55();
S4_SRR_RL_Clu_Mes_7_S4_SRR_RL_Clu_Dist_55();
S4_SRR_RL_Clu_Mes_7_S4_SRR_RL_Clu_Vel_55();
S4_SRR_RL_Clu_Mes_7_S4_SRR_RL_Clu_SNR_55();
S4_SRR_RL_Clu_Mes_7_S4_SRR_RL_Clu_DynProp_55();
S4_SRR_RL_Clu_Mes_7_S4_SRR_RL_Clu_Locationvalid_55();
S4_SRR_RL_Clu_Mes_8_S4_SRR_RL_Clu_Theta_56();
S4_SRR_RL_Clu_Mes_8_S4_SRR_RL_Clu_Dist_56();
S4_SRR_RL_Clu_Mes_8_S4_SRR_RL_Clu_Vel_56();
S4_SRR_RL_Clu_Mes_8_S4_SRR_RL_Clu_SNR_56();
S4_SRR_RL_Clu_Mes_8_S4_SRR_RL_Clu_DynProp_56();
S4_SRR_RL_Clu_Mes_8_S4_SRR_RL_Clu_Locationvalid_56();
S4_SRR_RL_Clu_Mes_8_S4_SRR_RL_Clu_Theta_57();
S4_SRR_RL_Clu_Mes_8_S4_SRR_RL_Clu_Dist_57();
S4_SRR_RL_Clu_Mes_8_S4_SRR_RL_Clu_Vel_57();
S4_SRR_RL_Clu_Mes_8_S4_SRR_RL_Clu_SNR_57();
S4_SRR_RL_Clu_Mes_8_S4_SRR_RL_Clu_DynProp_57();
S4_SRR_RL_Clu_Mes_8_S4_SRR_RL_Clu_Locationvalid_57();
S4_SRR_RL_Clu_Mes_8_S4_SRR_RL_Clu_Theta_58();
S4_SRR_RL_Clu_Mes_8_S4_SRR_RL_Clu_Dist_58();
S4_SRR_RL_Clu_Mes_8_S4_SRR_RL_Clu_Vel_58();
S4_SRR_RL_Clu_Mes_8_S4_SRR_RL_Clu_SNR_58();
S4_SRR_RL_Clu_Mes_8_S4_SRR_RL_Clu_DynProp_58();
S4_SRR_RL_Clu_Mes_8_S4_SRR_RL_Clu_Locationvalid_58();
S4_SRR_RL_Clu_Mes_8_S4_SRR_RL_Clu_Theta_59();
S4_SRR_RL_Clu_Mes_8_S4_SRR_RL_Clu_Dist_59();
S4_SRR_RL_Clu_Mes_8_S4_SRR_RL_Clu_Vel_59();
S4_SRR_RL_Clu_Mes_8_S4_SRR_RL_Clu_SNR_59();
S4_SRR_RL_Clu_Mes_8_S4_SRR_RL_Clu_DynProp_59();
S4_SRR_RL_Clu_Mes_8_S4_SRR_RL_Clu_Locationvalid_59();
S4_SRR_RL_Clu_Mes_8_S4_SRR_RL_Clu_Theta_60();
S4_SRR_RL_Clu_Mes_8_S4_SRR_RL_Clu_Dist_60();
S4_SRR_RL_Clu_Mes_8_S4_SRR_RL_Clu_Vel_60();
S4_SRR_RL_Clu_Mes_8_S4_SRR_RL_Clu_SNR_60();
S4_SRR_RL_Clu_Mes_8_S4_SRR_RL_Clu_DynProp_60();
S4_SRR_RL_Clu_Mes_8_S4_SRR_RL_Clu_Locationvalid_60();
S4_SRR_RL_Clu_Mes_8_S4_SRR_RL_Clu_Theta_61();
S4_SRR_RL_Clu_Mes_8_S4_SRR_RL_Clu_Dist_61();
S4_SRR_RL_Clu_Mes_8_S4_SRR_RL_Clu_Vel_61();
S4_SRR_RL_Clu_Mes_8_S4_SRR_RL_Clu_SNR_61();
S4_SRR_RL_Clu_Mes_8_S4_SRR_RL_Clu_DynProp_61();
S4_SRR_RL_Clu_Mes_8_S4_SRR_RL_Clu_Locationvalid_61();
S4_SRR_RL_Clu_Mes_8_S4_SRR_RL_Clu_Theta_62();
S4_SRR_RL_Clu_Mes_8_S4_SRR_RL_Clu_Dist_62();
S4_SRR_RL_Clu_Mes_8_S4_SRR_RL_Clu_Vel_62();
S4_SRR_RL_Clu_Mes_8_S4_SRR_RL_Clu_SNR_62();
S4_SRR_RL_Clu_Mes_8_S4_SRR_RL_Clu_DynProp_62();
S4_SRR_RL_Clu_Mes_8_S4_SRR_RL_Clu_Locationvalid_62();
S4_SRR_RL_Clu_Mes_9_S4_SRR_RL_Clu_Theta_63();
S4_SRR_RL_Clu_Mes_9_S4_SRR_RL_Clu_Dist_63();
S4_SRR_RL_Clu_Mes_9_S4_SRR_RL_Clu_Vel_63();
S4_SRR_RL_Clu_Mes_9_S4_SRR_RL_Clu_SNR_63();
S4_SRR_RL_Clu_Mes_9_S4_SRR_RL_Clu_DynProp_63();
S4_SRR_RL_Clu_Mes_9_S4_SRR_RL_Clu_Locationvalid_63();
S4_SRR_RL_Clu_Mes_9_S4_SRR_RL_Clu_Theta_64();
S4_SRR_RL_Clu_Mes_9_S4_SRR_RL_Clu_Dist_64();
S4_SRR_RL_Clu_Mes_9_S4_SRR_RL_Clu_Vel_64();
S4_SRR_RL_Clu_Mes_9_S4_SRR_RL_Clu_SNR_64();
S4_SRR_RL_Clu_Mes_9_S4_SRR_RL_Clu_DynProp_64();
S4_SRR_RL_Clu_Mes_9_S4_SRR_RL_Clu_Locationvalid_64();
S4_SRR_RL_Clu_Mes_9_S4_SRR_RL_Clu_Theta_65();
S4_SRR_RL_Clu_Mes_9_S4_SRR_RL_Clu_Dist_65();
S4_SRR_RL_Clu_Mes_9_S4_SRR_RL_Clu_Vel_65();
S4_SRR_RL_Clu_Mes_9_S4_SRR_RL_Clu_SNR_65();
S4_SRR_RL_Clu_Mes_9_S4_SRR_RL_Clu_DynProp_65();
S4_SRR_RL_Clu_Mes_9_S4_SRR_RL_Clu_Locationvalid_65();
S4_SRR_RL_Clu_Mes_9_S4_SRR_RL_Clu_Theta_66();
S4_SRR_RL_Clu_Mes_9_S4_SRR_RL_Clu_Dist_66();
S4_SRR_RL_Clu_Mes_9_S4_SRR_RL_Clu_Vel_66();
S4_SRR_RL_Clu_Mes_9_S4_SRR_RL_Clu_SNR_66();
S4_SRR_RL_Clu_Mes_9_S4_SRR_RL_Clu_DynProp_66();
S4_SRR_RL_Clu_Mes_9_S4_SRR_RL_Clu_Locationvalid_66();
S4_SRR_RL_Clu_Mes_9_S4_SRR_RL_Clu_Theta_67();
S4_SRR_RL_Clu_Mes_9_S4_SRR_RL_Clu_Dist_67();
S4_SRR_RL_Clu_Mes_9_S4_SRR_RL_Clu_Vel_67();
S4_SRR_RL_Clu_Mes_9_S4_SRR_RL_Clu_SNR_67();
S4_SRR_RL_Clu_Mes_9_S4_SRR_RL_Clu_DynProp_67();
S4_SRR_RL_Clu_Mes_9_S4_SRR_RL_Clu_Locationvalid_67();
S4_SRR_RL_Clu_Mes_9_S4_SRR_RL_Clu_Theta_68();
S4_SRR_RL_Clu_Mes_9_S4_SRR_RL_Clu_Dist_68();
S4_SRR_RL_Clu_Mes_9_S4_SRR_RL_Clu_Vel_68();
S4_SRR_RL_Clu_Mes_9_S4_SRR_RL_Clu_SNR_68();
S4_SRR_RL_Clu_Mes_9_S4_SRR_RL_Clu_DynProp_68();
S4_SRR_RL_Clu_Mes_9_S4_SRR_RL_Clu_Locationvalid_68();
S4_SRR_RL_Clu_Mes_9_S4_SRR_RL_Clu_Theta_69();
S4_SRR_RL_Clu_Mes_9_S4_SRR_RL_Clu_Dist_69();
S4_SRR_RL_Clu_Mes_9_S4_SRR_RL_Clu_Vel_69();
S4_SRR_RL_Clu_Mes_9_S4_SRR_RL_Clu_SNR_69();
S4_SRR_RL_Clu_Mes_9_S4_SRR_RL_Clu_DynProp_69();
S4_SRR_RL_Clu_Mes_9_S4_SRR_RL_Clu_Locationvalid_69();
S4_SRR_RL_Clu_Mes_10_S4_SRR_RL_Clu_Theta_70();
S4_SRR_RL_Clu_Mes_10_S4_SRR_RL_Clu_Dist_70();
S4_SRR_RL_Clu_Mes_10_S4_SRR_RL_Clu_Vel_70();
S4_SRR_RL_Clu_Mes_10_S4_SRR_RL_Clu_SNR_70();
S4_SRR_RL_Clu_Mes_10_S4_SRR_RL_Clu_DynProp_70();
S4_SRR_RL_Clu_Mes_10_S4_SRR_RL_Clu_Locationvalid_70();
S4_SRR_RL_Clu_Mes_10_S4_SRR_RL_Clu_Theta_71();
S4_SRR_RL_Clu_Mes_10_S4_SRR_RL_Clu_Dist_71();
S4_SRR_RL_Clu_Mes_10_S4_SRR_RL_Clu_Vel_71();
S4_SRR_RL_Clu_Mes_10_S4_SRR_RL_Clu_SNR_71();
S4_SRR_RL_Clu_Mes_10_S4_SRR_RL_Clu_DynProp_71();
S4_SRR_RL_Clu_Mes_10_S4_SRR_RL_Clu_Locationvalid_71();
S4_SRR_RL_Clu_Mes_10_S4_SRR_RL_Clu_Theta_72();
S4_SRR_RL_Clu_Mes_10_S4_SRR_RL_Clu_Dist_72();
S4_SRR_RL_Clu_Mes_10_S4_SRR_RL_Clu_Vel_72();
S4_SRR_RL_Clu_Mes_10_S4_SRR_RL_Clu_SNR_72();
S4_SRR_RL_Clu_Mes_10_S4_SRR_RL_Clu_DynProp_72();
S4_SRR_RL_Clu_Mes_10_S4_SRR_RL_Clu_Locationvalid_72();
S4_SRR_RL_Clu_Mes_10_S4_SRR_RL_Clu_Theta_73();
S4_SRR_RL_Clu_Mes_10_S4_SRR_RL_Clu_Dist_73();
S4_SRR_RL_Clu_Mes_10_S4_SRR_RL_Clu_Vel_73();
S4_SRR_RL_Clu_Mes_10_S4_SRR_RL_Clu_SNR_73();
S4_SRR_RL_Clu_Mes_10_S4_SRR_RL_Clu_DynProp_73();
S4_SRR_RL_Clu_Mes_10_S4_SRR_RL_Clu_Locationvalid_73();
S4_SRR_RL_Clu_Mes_10_S4_SRR_RL_Clu_Theta_74();
S4_SRR_RL_Clu_Mes_10_S4_SRR_RL_Clu_Dist_74();
S4_SRR_RL_Clu_Mes_10_S4_SRR_RL_Clu_Vel_74();
S4_SRR_RL_Clu_Mes_10_S4_SRR_RL_Clu_SNR_74();
S4_SRR_RL_Clu_Mes_10_S4_SRR_RL_Clu_DynProp_74();
S4_SRR_RL_Clu_Mes_10_S4_SRR_RL_Clu_Locationvalid_74();
S4_SRR_RL_Clu_Mes_10_S4_SRR_RL_Clu_Theta_75();
S4_SRR_RL_Clu_Mes_10_S4_SRR_RL_Clu_Dist_75();
S4_SRR_RL_Clu_Mes_10_S4_SRR_RL_Clu_Vel_75();
S4_SRR_RL_Clu_Mes_10_S4_SRR_RL_Clu_SNR_75();
S4_SRR_RL_Clu_Mes_10_S4_SRR_RL_Clu_DynProp_75();
S4_SRR_RL_Clu_Mes_10_S4_SRR_RL_Clu_Locationvalid_75();
S4_SRR_RL_Clu_Mes_10_S4_SRR_RL_Clu_Theta_76();
S4_SRR_RL_Clu_Mes_10_S4_SRR_RL_Clu_Dist_76();
S4_SRR_RL_Clu_Mes_10_S4_SRR_RL_Clu_Vel_76();
S4_SRR_RL_Clu_Mes_10_S4_SRR_RL_Clu_SNR_76();
S4_SRR_RL_Clu_Mes_10_S4_SRR_RL_Clu_DynProp_76();
S4_SRR_RL_Clu_Mes_10_S4_SRR_RL_Clu_Locationvalid_76();
S4_SRR_RL_Clu_Mes_11_S4_SRR_RL_Clu_Theta_77();
S4_SRR_RL_Clu_Mes_11_S4_SRR_RL_Clu_Dist_77();
S4_SRR_RL_Clu_Mes_11_S4_SRR_RL_Clu_Vel_77();
S4_SRR_RL_Clu_Mes_11_S4_SRR_RL_Clu_SNR_77();
S4_SRR_RL_Clu_Mes_11_S4_SRR_RL_Clu_DynProp_77();
S4_SRR_RL_Clu_Mes_11_S4_SRR_RL_Clu_Locationvalid_77();
S4_SRR_RL_Clu_Mes_11_S4_SRR_RL_Clu_Theta_78();
S4_SRR_RL_Clu_Mes_11_S4_SRR_RL_Clu_Dist_78();
S4_SRR_RL_Clu_Mes_11_S4_SRR_RL_Clu_Vel_78();
S4_SRR_RL_Clu_Mes_11_S4_SRR_RL_Clu_SNR_78();
S4_SRR_RL_Clu_Mes_11_S4_SRR_RL_Clu_DynProp_78();
S4_SRR_RL_Clu_Mes_11_S4_SRR_RL_Clu_Locationvalid_78();
S4_SRR_RL_Clu_Mes_11_S4_SRR_RL_Clu_Theta_79();
S4_SRR_RL_Clu_Mes_11_S4_SRR_RL_Clu_Dist_79();
S4_SRR_RL_Clu_Mes_11_S4_SRR_RL_Clu_Vel_79();
S4_SRR_RL_Clu_Mes_11_S4_SRR_RL_Clu_SNR_79();
S4_SRR_RL_Clu_Mes_11_S4_SRR_RL_Clu_DynProp_79();
S4_SRR_RL_Clu_Mes_11_S4_SRR_RL_Clu_Locationvalid_79();
S4_SRR_RL_Clu_Mes_11_S4_SRR_RL_Clu_Theta_80();
S4_SRR_RL_Clu_Mes_11_S4_SRR_RL_Clu_Dist_80();
S4_SRR_RL_Clu_Mes_11_S4_SRR_RL_Clu_Vel_80();
S4_SRR_RL_Clu_Mes_11_S4_SRR_RL_Clu_SNR_80();
S4_SRR_RL_Clu_Mes_11_S4_SRR_RL_Clu_DynProp_80();
S4_SRR_RL_Clu_Mes_11_S4_SRR_RL_Clu_Locationvalid_80();
S4_SRR_RL_Clu_Mes_11_S4_SRR_RL_Clu_Theta_81();
S4_SRR_RL_Clu_Mes_11_S4_SRR_RL_Clu_Dist_81();
S4_SRR_RL_Clu_Mes_11_S4_SRR_RL_Clu_Vel_81();
S4_SRR_RL_Clu_Mes_11_S4_SRR_RL_Clu_SNR_81();
S4_SRR_RL_Clu_Mes_11_S4_SRR_RL_Clu_DynProp_81();
S4_SRR_RL_Clu_Mes_11_S4_SRR_RL_Clu_Locationvalid_81();
S4_SRR_RL_Clu_Mes_11_S4_SRR_RL_Clu_Theta_82();
S4_SRR_RL_Clu_Mes_11_S4_SRR_RL_Clu_Dist_82();
S4_SRR_RL_Clu_Mes_11_S4_SRR_RL_Clu_Vel_82();
S4_SRR_RL_Clu_Mes_11_S4_SRR_RL_Clu_SNR_82();
S4_SRR_RL_Clu_Mes_11_S4_SRR_RL_Clu_DynProp_82();
S4_SRR_RL_Clu_Mes_11_S4_SRR_RL_Clu_Locationvalid_82();
S4_SRR_RL_Clu_Mes_11_S4_SRR_RL_Clu_Theta_83();
S4_SRR_RL_Clu_Mes_11_S4_SRR_RL_Clu_Dist_83();
S4_SRR_RL_Clu_Mes_11_S4_SRR_RL_Clu_Vel_83();
S4_SRR_RL_Clu_Mes_11_S4_SRR_RL_Clu_SNR_83();
S4_SRR_RL_Clu_Mes_11_S4_SRR_RL_Clu_DynProp_83();
S4_SRR_RL_Clu_Mes_11_S4_SRR_RL_Clu_Locationvalid_83();
S4_SRR_RL_Clu_Mes_12_S4_SRR_RL_Clu_Theta_84();
S4_SRR_RL_Clu_Mes_12_S4_SRR_RL_Clu_Dist_84();
S4_SRR_RL_Clu_Mes_12_S4_SRR_RL_Clu_Vel_84();
S4_SRR_RL_Clu_Mes_12_S4_SRR_RL_Clu_SNR_84();
S4_SRR_RL_Clu_Mes_12_S4_SRR_RL_Clu_DynProp_84();
S4_SRR_RL_Clu_Mes_12_S4_SRR_RL_Clu_Locationvalid_84();
S4_SRR_RL_Clu_Mes_12_S4_SRR_RL_Clu_Theta_85();
S4_SRR_RL_Clu_Mes_12_S4_SRR_RL_Clu_Dist_85();
S4_SRR_RL_Clu_Mes_12_S4_SRR_RL_Clu_Vel_85();
S4_SRR_RL_Clu_Mes_12_S4_SRR_RL_Clu_SNR_85();
S4_SRR_RL_Clu_Mes_12_S4_SRR_RL_Clu_DynProp_85();
S4_SRR_RL_Clu_Mes_12_S4_SRR_RL_Clu_Locationvalid_85();
S4_SRR_RL_Clu_Mes_12_S4_SRR_RL_Clu_Theta_86();
S4_SRR_RL_Clu_Mes_12_S4_SRR_RL_Clu_Dist_86();
S4_SRR_RL_Clu_Mes_12_S4_SRR_RL_Clu_Vel_86();
S4_SRR_RL_Clu_Mes_12_S4_SRR_RL_Clu_SNR_86();
S4_SRR_RL_Clu_Mes_12_S4_SRR_RL_Clu_DynProp_86();
S4_SRR_RL_Clu_Mes_12_S4_SRR_RL_Clu_Locationvalid_86();
S4_SRR_RL_Clu_Mes_12_S4_SRR_RL_Clu_Theta_87();
S4_SRR_RL_Clu_Mes_12_S4_SRR_RL_Clu_Dist_87();
S4_SRR_RL_Clu_Mes_12_S4_SRR_RL_Clu_Vel_87();
S4_SRR_RL_Clu_Mes_12_S4_SRR_RL_Clu_SNR_87();
S4_SRR_RL_Clu_Mes_12_S4_SRR_RL_Clu_DynProp_87();
S4_SRR_RL_Clu_Mes_12_S4_SRR_RL_Clu_Locationvalid_87();
S4_SRR_RL_Clu_Mes_12_S4_SRR_RL_Clu_Theta_88();
S4_SRR_RL_Clu_Mes_12_S4_SRR_RL_Clu_Dist_88();
S4_SRR_RL_Clu_Mes_12_S4_SRR_RL_Clu_Vel_88();
S4_SRR_RL_Clu_Mes_12_S4_SRR_RL_Clu_SNR_88();
S4_SRR_RL_Clu_Mes_12_S4_SRR_RL_Clu_DynProp_88();
S4_SRR_RL_Clu_Mes_12_S4_SRR_RL_Clu_Locationvalid_88();
S4_SRR_RL_Clu_Mes_12_S4_SRR_RL_Clu_Theta_89();
S4_SRR_RL_Clu_Mes_12_S4_SRR_RL_Clu_Dist_89();
S4_SRR_RL_Clu_Mes_12_S4_SRR_RL_Clu_Vel_89();
S4_SRR_RL_Clu_Mes_12_S4_SRR_RL_Clu_SNR_89();
S4_SRR_RL_Clu_Mes_12_S4_SRR_RL_Clu_DynProp_89();
S4_SRR_RL_Clu_Mes_12_S4_SRR_RL_Clu_Locationvalid_89();
S4_SRR_RL_Clu_Mes_12_S4_SRR_RL_Clu_Theta_90();
S4_SRR_RL_Clu_Mes_12_S4_SRR_RL_Clu_Dist_90();
S4_SRR_RL_Clu_Mes_12_S4_SRR_RL_Clu_Vel_90();
S4_SRR_RL_Clu_Mes_12_S4_SRR_RL_Clu_SNR_90();
S4_SRR_RL_Clu_Mes_12_S4_SRR_RL_Clu_DynProp_90();
S4_SRR_RL_Clu_Mes_12_S4_SRR_RL_Clu_Locationvalid_90();
S4_SRR_RL_Clu_Mes_13_S4_SRR_RL_Clu_Theta_91();
S4_SRR_RL_Clu_Mes_13_S4_SRR_RL_Clu_Dist_91();
S4_SRR_RL_Clu_Mes_13_S4_SRR_RL_Clu_Vel_91();
S4_SRR_RL_Clu_Mes_13_S4_SRR_RL_Clu_SNR_91();
S4_SRR_RL_Clu_Mes_13_S4_SRR_RL_Clu_DynProp_91();
S4_SRR_RL_Clu_Mes_13_S4_SRR_RL_Clu_Locationvalid_91();
S4_SRR_RL_Clu_Mes_13_S4_SRR_RL_Clu_Theta_92();
S4_SRR_RL_Clu_Mes_13_S4_SRR_RL_Clu_Dist_92();
S4_SRR_RL_Clu_Mes_13_S4_SRR_RL_Clu_Vel_92();
S4_SRR_RL_Clu_Mes_13_S4_SRR_RL_Clu_SNR_92();
S4_SRR_RL_Clu_Mes_13_S4_SRR_RL_Clu_DynProp_92();
S4_SRR_RL_Clu_Mes_13_S4_SRR_RL_Clu_Locationvalid_92();
S4_SRR_RL_Clu_Mes_13_S4_SRR_RL_Clu_Theta_93();
S4_SRR_RL_Clu_Mes_13_S4_SRR_RL_Clu_Dist_93();
S4_SRR_RL_Clu_Mes_13_S4_SRR_RL_Clu_Vel_93();
S4_SRR_RL_Clu_Mes_13_S4_SRR_RL_Clu_SNR_93();
S4_SRR_RL_Clu_Mes_13_S4_SRR_RL_Clu_DynProp_93();
S4_SRR_RL_Clu_Mes_13_S4_SRR_RL_Clu_Locationvalid_93();
S4_SRR_RL_Clu_Mes_13_S4_SRR_RL_Clu_Theta_94();
S4_SRR_RL_Clu_Mes_13_S4_SRR_RL_Clu_Dist_94();
S4_SRR_RL_Clu_Mes_13_S4_SRR_RL_Clu_Vel_94();
S4_SRR_RL_Clu_Mes_13_S4_SRR_RL_Clu_SNR_94();
S4_SRR_RL_Clu_Mes_13_S4_SRR_RL_Clu_DynProp_94();
S4_SRR_RL_Clu_Mes_13_S4_SRR_RL_Clu_Locationvalid_94();
S4_SRR_RL_Clu_Mes_13_S4_SRR_RL_Clu_Theta_95();
S4_SRR_RL_Clu_Mes_13_S4_SRR_RL_Clu_Dist_95();
S4_SRR_RL_Clu_Mes_13_S4_SRR_RL_Clu_Vel_95();
S4_SRR_RL_Clu_Mes_13_S4_SRR_RL_Clu_SNR_95();
S4_SRR_RL_Clu_Mes_13_S4_SRR_RL_Clu_DynProp_95();
S4_SRR_RL_Clu_Mes_13_S4_SRR_RL_Clu_Locationvalid_95();
S4_SRR_RL_Clu_Mes_13_S4_SRR_RL_Clu_Theta_96();
S4_SRR_RL_Clu_Mes_13_S4_SRR_RL_Clu_Dist_96();
S4_SRR_RL_Clu_Mes_13_S4_SRR_RL_Clu_Vel_96();
S4_SRR_RL_Clu_Mes_13_S4_SRR_RL_Clu_SNR_96();
S4_SRR_RL_Clu_Mes_13_S4_SRR_RL_Clu_DynProp_96();
S4_SRR_RL_Clu_Mes_13_S4_SRR_RL_Clu_Locationvalid_96();
S4_SRR_RL_Clu_Mes_13_S4_SRR_RL_Clu_Theta_97();
S4_SRR_RL_Clu_Mes_13_S4_SRR_RL_Clu_Dist_97();
S4_SRR_RL_Clu_Mes_13_S4_SRR_RL_Clu_Vel_97();
S4_SRR_RL_Clu_Mes_13_S4_SRR_RL_Clu_SNR_97();
S4_SRR_RL_Clu_Mes_13_S4_SRR_RL_Clu_DynProp_97();
S4_SRR_RL_Clu_Mes_13_S4_SRR_RL_Clu_Locationvalid_97();
S4_SRR_RL_Clu_Mes_14_S4_SRR_RL_Clu_Theta_98();
S4_SRR_RL_Clu_Mes_14_S4_SRR_RL_Clu_Dist_98();
S4_SRR_RL_Clu_Mes_14_S4_SRR_RL_Clu_Vel_98();
S4_SRR_RL_Clu_Mes_14_S4_SRR_RL_Clu_SNR_98();
S4_SRR_RL_Clu_Mes_14_S4_SRR_RL_Clu_DynProp_98();
S4_SRR_RL_Clu_Mes_14_S4_SRR_RL_Clu_Locationvalid_98();
S4_SRR_RL_Clu_Mes_14_S4_SRR_RL_Clu_Theta_99();
S4_SRR_RL_Clu_Mes_14_S4_SRR_RL_Clu_Dist_99();
S4_SRR_RL_Clu_Mes_14_S4_SRR_RL_Clu_Vel_99();
S4_SRR_RL_Clu_Mes_14_S4_SRR_RL_Clu_SNR_99();
S4_SRR_RL_Clu_Mes_14_S4_SRR_RL_Clu_DynProp_99();
S4_SRR_RL_Clu_Mes_14_S4_SRR_RL_Clu_Locationvalid_99();
S4_SRR_RL_Clu_Mes_14_S4_SRR_RL_Clu_Theta_100();
S4_SRR_RL_Clu_Mes_14_S4_SRR_RL_Clu_Dist_100();
S4_SRR_RL_Clu_Mes_14_S4_SRR_RL_Clu_Vel_100();
S4_SRR_RL_Clu_Mes_14_S4_SRR_RL_Clu_SNR_100();
S4_SRR_RL_Clu_Mes_14_S4_SRR_RL_Clu_DynProp_100();
S4_SRR_RL_Clu_Mes_14_S4_SRR_RL_Clu_Locationvalid_100();
S4_SRR_RL_Clu_Mes_14_S4_SRR_RL_Clu_Theta_101();
S4_SRR_RL_Clu_Mes_14_S4_SRR_RL_Clu_Dist_101();
S4_SRR_RL_Clu_Mes_14_S4_SRR_RL_Clu_Vel_101();
S4_SRR_RL_Clu_Mes_14_S4_SRR_RL_Clu_SNR_101();
S4_SRR_RL_Clu_Mes_14_S4_SRR_RL_Clu_DynProp_101();
S4_SRR_RL_Clu_Mes_14_S4_SRR_RL_Clu_Locationvalid_101();
S4_SRR_RL_Clu_Mes_14_S4_SRR_RL_Clu_Theta_102();
S4_SRR_RL_Clu_Mes_14_S4_SRR_RL_Clu_Dist_102();
S4_SRR_RL_Clu_Mes_14_S4_SRR_RL_Clu_Vel_102();
S4_SRR_RL_Clu_Mes_14_S4_SRR_RL_Clu_SNR_102();
S4_SRR_RL_Clu_Mes_14_S4_SRR_RL_Clu_DynProp_102();
S4_SRR_RL_Clu_Mes_14_S4_SRR_RL_Clu_Locationvalid_102();
S4_SRR_RL_Clu_Mes_14_S4_SRR_RL_Clu_Theta_103();
S4_SRR_RL_Clu_Mes_14_S4_SRR_RL_Clu_Dist_103();
S4_SRR_RL_Clu_Mes_14_S4_SRR_RL_Clu_Vel_103();
S4_SRR_RL_Clu_Mes_14_S4_SRR_RL_Clu_SNR_103();
S4_SRR_RL_Clu_Mes_14_S4_SRR_RL_Clu_DynProp_103();
S4_SRR_RL_Clu_Mes_14_S4_SRR_RL_Clu_Locationvalid_103();
S4_SRR_RL_Clu_Mes_14_S4_SRR_RL_Clu_Theta_104();
S4_SRR_RL_Clu_Mes_14_S4_SRR_RL_Clu_Dist_104();
S4_SRR_RL_Clu_Mes_14_S4_SRR_RL_Clu_Vel_104();
S4_SRR_RL_Clu_Mes_14_S4_SRR_RL_Clu_SNR_104();
S4_SRR_RL_Clu_Mes_14_S4_SRR_RL_Clu_DynProp_104();
S4_SRR_RL_Clu_Mes_14_S4_SRR_RL_Clu_Locationvalid_104();
S4_SRR_RL_Clu_Mes_15_S4_SRR_RL_Clu_Theta_105();
S4_SRR_RL_Clu_Mes_15_S4_SRR_RL_Clu_Dist_105();
S4_SRR_RL_Clu_Mes_15_S4_SRR_RL_Clu_Vel_105();
S4_SRR_RL_Clu_Mes_15_S4_SRR_RL_Clu_SNR_105();
S4_SRR_RL_Clu_Mes_15_S4_SRR_RL_Clu_DynProp_105();
S4_SRR_RL_Clu_Mes_15_S4_SRR_RL_Clu_Locationvalid_105();
S4_SRR_RL_Clu_Mes_15_S4_SRR_RL_Clu_Theta_106();
S4_SRR_RL_Clu_Mes_15_S4_SRR_RL_Clu_Dist_106();
S4_SRR_RL_Clu_Mes_15_S4_SRR_RL_Clu_Vel_106();
S4_SRR_RL_Clu_Mes_15_S4_SRR_RL_Clu_SNR_106();
S4_SRR_RL_Clu_Mes_15_S4_SRR_RL_Clu_DynProp_106();
S4_SRR_RL_Clu_Mes_15_S4_SRR_RL_Clu_Locationvalid_106();
S4_SRR_RL_Clu_Mes_15_S4_SRR_RL_Clu_Theta_107();
S4_SRR_RL_Clu_Mes_15_S4_SRR_RL_Clu_Dist_107();
S4_SRR_RL_Clu_Mes_15_S4_SRR_RL_Clu_Vel_107();
S4_SRR_RL_Clu_Mes_15_S4_SRR_RL_Clu_SNR_107();
S4_SRR_RL_Clu_Mes_15_S4_SRR_RL_Clu_DynProp_107();
S4_SRR_RL_Clu_Mes_15_S4_SRR_RL_Clu_Locationvalid_107();
S4_SRR_RL_Clu_Mes_15_S4_SRR_RL_Clu_Theta_108();
S4_SRR_RL_Clu_Mes_15_S4_SRR_RL_Clu_Dist_108();
S4_SRR_RL_Clu_Mes_15_S4_SRR_RL_Clu_Vel_108();
S4_SRR_RL_Clu_Mes_15_S4_SRR_RL_Clu_SNR_108();
S4_SRR_RL_Clu_Mes_15_S4_SRR_RL_Clu_DynProp_108();
S4_SRR_RL_Clu_Mes_15_S4_SRR_RL_Clu_Locationvalid_108();
S4_SRR_RL_Clu_Mes_15_S4_SRR_RL_Clu_Theta_109();
S4_SRR_RL_Clu_Mes_15_S4_SRR_RL_Clu_Dist_109();
S4_SRR_RL_Clu_Mes_15_S4_SRR_RL_Clu_Vel_109();
S4_SRR_RL_Clu_Mes_15_S4_SRR_RL_Clu_SNR_109();
S4_SRR_RL_Clu_Mes_15_S4_SRR_RL_Clu_DynProp_109();
S4_SRR_RL_Clu_Mes_15_S4_SRR_RL_Clu_Locationvalid_109();
S4_SRR_RL_Clu_Mes_15_S4_SRR_RL_Clu_Theta_110();
S4_SRR_RL_Clu_Mes_15_S4_SRR_RL_Clu_Dist_110();
S4_SRR_RL_Clu_Mes_15_S4_SRR_RL_Clu_Vel_110();
S4_SRR_RL_Clu_Mes_15_S4_SRR_RL_Clu_SNR_110();
S4_SRR_RL_Clu_Mes_15_S4_SRR_RL_Clu_DynProp_110();
S4_SRR_RL_Clu_Mes_15_S4_SRR_RL_Clu_Locationvalid_110();
S4_SRR_RL_Clu_Mes_15_S4_SRR_RL_Clu_Theta_111();
S4_SRR_RL_Clu_Mes_15_S4_SRR_RL_Clu_Dist_111();
S4_SRR_RL_Clu_Mes_15_S4_SRR_RL_Clu_Vel_111();
S4_SRR_RL_Clu_Mes_15_S4_SRR_RL_Clu_SNR_111();
S4_SRR_RL_Clu_Mes_15_S4_SRR_RL_Clu_DynProp_111();
S4_SRR_RL_Clu_Mes_15_S4_SRR_RL_Clu_Locationvalid_111();
S4_SRR_RL_Clu_Mes_16_S4_SRR_RL_Clu_Theta_112();
S4_SRR_RL_Clu_Mes_16_S4_SRR_RL_Clu_Dist_112();
S4_SRR_RL_Clu_Mes_16_S4_SRR_RL_Clu_Vel_112();
S4_SRR_RL_Clu_Mes_16_S4_SRR_RL_Clu_SNR_112();
S4_SRR_RL_Clu_Mes_16_S4_SRR_RL_Clu_DynProp_112();
S4_SRR_RL_Clu_Mes_16_S4_SRR_RL_Clu_Locationvalid_112();
S4_SRR_RL_Clu_Mes_16_S4_SRR_RL_Clu_Theta_113();
S4_SRR_RL_Clu_Mes_16_S4_SRR_RL_Clu_Dist_113();
S4_SRR_RL_Clu_Mes_16_S4_SRR_RL_Clu_Vel_113();
S4_SRR_RL_Clu_Mes_16_S4_SRR_RL_Clu_SNR_113();
S4_SRR_RL_Clu_Mes_16_S4_SRR_RL_Clu_DynProp_113();
S4_SRR_RL_Clu_Mes_16_S4_SRR_RL_Clu_Locationvalid_113();
S4_SRR_RL_Clu_Mes_16_S4_SRR_RL_Clu_Theta_114();
S4_SRR_RL_Clu_Mes_16_S4_SRR_RL_Clu_Dist_114();
S4_SRR_RL_Clu_Mes_16_S4_SRR_RL_Clu_Vel_114();
S4_SRR_RL_Clu_Mes_16_S4_SRR_RL_Clu_SNR_114();
S4_SRR_RL_Clu_Mes_16_S4_SRR_RL_Clu_DynProp_114();
S4_SRR_RL_Clu_Mes_16_S4_SRR_RL_Clu_Locationvalid_114();
S4_SRR_RL_Clu_Mes_16_S4_SRR_RL_Clu_Theta_115();
S4_SRR_RL_Clu_Mes_16_S4_SRR_RL_Clu_Dist_115();
S4_SRR_RL_Clu_Mes_16_S4_SRR_RL_Clu_Vel_115();
S4_SRR_RL_Clu_Mes_16_S4_SRR_RL_Clu_SNR_115();
S4_SRR_RL_Clu_Mes_16_S4_SRR_RL_Clu_DynProp_115();
S4_SRR_RL_Clu_Mes_16_S4_SRR_RL_Clu_Locationvalid_115();
S4_SRR_RL_Clu_Mes_16_S4_SRR_RL_Clu_Theta_116();
S4_SRR_RL_Clu_Mes_16_S4_SRR_RL_Clu_Dist_116();
S4_SRR_RL_Clu_Mes_16_S4_SRR_RL_Clu_Vel_116();
S4_SRR_RL_Clu_Mes_16_S4_SRR_RL_Clu_SNR_116();
S4_SRR_RL_Clu_Mes_16_S4_SRR_RL_Clu_DynProp_116();
S4_SRR_RL_Clu_Mes_16_S4_SRR_RL_Clu_Locationvalid_116();
S4_SRR_RL_Clu_Mes_16_S4_SRR_RL_Clu_Theta_117();
S4_SRR_RL_Clu_Mes_16_S4_SRR_RL_Clu_Dist_117();
S4_SRR_RL_Clu_Mes_16_S4_SRR_RL_Clu_Vel_117();
S4_SRR_RL_Clu_Mes_16_S4_SRR_RL_Clu_SNR_117();
S4_SRR_RL_Clu_Mes_16_S4_SRR_RL_Clu_DynProp_117();
S4_SRR_RL_Clu_Mes_16_S4_SRR_RL_Clu_Locationvalid_117();
S4_SRR_RL_Clu_Mes_16_S4_SRR_RL_Clu_Theta_118();
S4_SRR_RL_Clu_Mes_16_S4_SRR_RL_Clu_Dist_118();
S4_SRR_RL_Clu_Mes_16_S4_SRR_RL_Clu_Vel_118();
S4_SRR_RL_Clu_Mes_16_S4_SRR_RL_Clu_SNR_118();
S4_SRR_RL_Clu_Mes_16_S4_SRR_RL_Clu_DynProp_118();
S4_SRR_RL_Clu_Mes_16_S4_SRR_RL_Clu_Locationvalid_118();
S4_SRR_RL_Clu_Mes_17_S4_SRR_RL_Clu_Theta_119();
S4_SRR_RL_Clu_Mes_17_S4_SRR_RL_Clu_Dist_119();
S4_SRR_RL_Clu_Mes_17_S4_SRR_RL_Clu_Vel_119();
S4_SRR_RL_Clu_Mes_17_S4_SRR_RL_Clu_SNR_119();
S4_SRR_RL_Clu_Mes_17_S4_SRR_RL_Clu_DynProp_119();
S4_SRR_RL_Clu_Mes_17_S4_SRR_RL_Clu_Locationvalid_119();
S4_SRR_RL_Clu_Mes_17_S4_SRR_RL_Clu_Theta_120();
S4_SRR_RL_Clu_Mes_17_S4_SRR_RL_Clu_Dist_120();
S4_SRR_RL_Clu_Mes_17_S4_SRR_RL_Clu_Vel_120();
S4_SRR_RL_Clu_Mes_17_S4_SRR_RL_Clu_SNR_120();
S4_SRR_RL_Clu_Mes_17_S4_SRR_RL_Clu_DynProp_120();
S4_SRR_RL_Clu_Mes_17_S4_SRR_RL_Clu_Locationvalid_120();
S4_SRR_RL_Clu_Mes_17_S4_SRR_RL_Clu_Theta_121();
S4_SRR_RL_Clu_Mes_17_S4_SRR_RL_Clu_Dist_121();
S4_SRR_RL_Clu_Mes_17_S4_SRR_RL_Clu_Vel_121();
S4_SRR_RL_Clu_Mes_17_S4_SRR_RL_Clu_SNR_121();
S4_SRR_RL_Clu_Mes_17_S4_SRR_RL_Clu_DynProp_121();
S4_SRR_RL_Clu_Mes_17_S4_SRR_RL_Clu_Locationvalid_121();
S4_SRR_RL_Clu_Mes_17_S4_SRR_RL_Clu_Theta_122();
S4_SRR_RL_Clu_Mes_17_S4_SRR_RL_Clu_Dist_122();
S4_SRR_RL_Clu_Mes_17_S4_SRR_RL_Clu_Vel_122();
S4_SRR_RL_Clu_Mes_17_S4_SRR_RL_Clu_SNR_122();
S4_SRR_RL_Clu_Mes_17_S4_SRR_RL_Clu_DynProp_122();
S4_SRR_RL_Clu_Mes_17_S4_SRR_RL_Clu_Locationvalid_122();
S4_SRR_RL_Clu_Mes_17_S4_SRR_RL_Clu_Theta_123();
S4_SRR_RL_Clu_Mes_17_S4_SRR_RL_Clu_Dist_123();
S4_SRR_RL_Clu_Mes_17_S4_SRR_RL_Clu_Vel_123();
S4_SRR_RL_Clu_Mes_17_S4_SRR_RL_Clu_SNR_123();
S4_SRR_RL_Clu_Mes_17_S4_SRR_RL_Clu_DynProp_123();
S4_SRR_RL_Clu_Mes_17_S4_SRR_RL_Clu_Locationvalid_123();
S4_SRR_RL_Clu_Mes_17_S4_SRR_RL_Clu_Theta_124();
S4_SRR_RL_Clu_Mes_17_S4_SRR_RL_Clu_Dist_124();
S4_SRR_RL_Clu_Mes_17_S4_SRR_RL_Clu_Vel_124();
S4_SRR_RL_Clu_Mes_17_S4_SRR_RL_Clu_SNR_124();
S4_SRR_RL_Clu_Mes_17_S4_SRR_RL_Clu_DynProp_124();
S4_SRR_RL_Clu_Mes_17_S4_SRR_RL_Clu_Locationvalid_124();
S4_SRR_RL_Clu_Mes_17_S4_SRR_RL_Clu_Theta_125();
S4_SRR_RL_Clu_Mes_17_S4_SRR_RL_Clu_Dist_125();
S4_SRR_RL_Clu_Mes_17_S4_SRR_RL_Clu_Vel_125();
S4_SRR_RL_Clu_Mes_17_S4_SRR_RL_Clu_SNR_125();
S4_SRR_RL_Clu_Mes_17_S4_SRR_RL_Clu_DynProp_125();
S4_SRR_RL_Clu_Mes_17_S4_SRR_RL_Clu_Locationvalid_125();
S4_SRR_RL_Clu_Mes_18_S4_SRR_RL_Clu_Theta_126();
S4_SRR_RL_Clu_Mes_18_S4_SRR_RL_Clu_Dist_126();
S4_SRR_RL_Clu_Mes_18_S4_SRR_RL_Clu_Vel_126();
S4_SRR_RL_Clu_Mes_18_S4_SRR_RL_Clu_SNR_126();
S4_SRR_RL_Clu_Mes_18_S4_SRR_RL_Clu_DynProp_126();
S4_SRR_RL_Clu_Mes_18_S4_SRR_RL_Clu_Locationvalid_126();
S4_SRR_RL_Clu_Mes_18_S4_SRR_RL_Clu_Theta_127();
S4_SRR_RL_Clu_Mes_18_S4_SRR_RL_Clu_Dist_127();
S4_SRR_RL_Clu_Mes_18_S4_SRR_RL_Clu_Vel_127();
S4_SRR_RL_Clu_Mes_18_S4_SRR_RL_Clu_SNR_127();
S4_SRR_RL_Clu_Mes_18_S4_SRR_RL_Clu_DynProp_127();
S4_SRR_RL_Clu_Mes_18_S4_SRR_RL_Clu_Locationvalid_127();
S4_SRR_RL_Clu_Mes_18_S4_SRR_RL_Clu_Theta_128();
S4_SRR_RL_Clu_Mes_18_S4_SRR_RL_Clu_Dist_128();
S4_SRR_RL_Clu_Mes_18_S4_SRR_RL_Clu_Vel_128();
S4_SRR_RL_Clu_Mes_18_S4_SRR_RL_Clu_SNR_128();
S4_SRR_RL_Clu_Mes_18_S4_SRR_RL_Clu_DynProp_128();
S4_SRR_RL_Clu_Mes_18_S4_SRR_RL_Clu_Locationvalid_128();
S4_SRR_RL_Clu_Mes_18_S4_SRR_RL_Clu_Theta_129();
S4_SRR_RL_Clu_Mes_18_S4_SRR_RL_Clu_Dist_129();
S4_SRR_RL_Clu_Mes_18_S4_SRR_RL_Clu_Vel_129();
S4_SRR_RL_Clu_Mes_18_S4_SRR_RL_Clu_SNR_129();
S4_SRR_RL_Clu_Mes_18_S4_SRR_RL_Clu_DynProp_129();
S4_SRR_RL_Clu_Mes_18_S4_SRR_RL_Clu_Locationvalid_129();
S4_SRR_RL_Clu_Mes_18_S4_SRR_RL_Clu_Theta_130();
S4_SRR_RL_Clu_Mes_18_S4_SRR_RL_Clu_Dist_130();
S4_SRR_RL_Clu_Mes_18_S4_SRR_RL_Clu_Vel_130();
S4_SRR_RL_Clu_Mes_18_S4_SRR_RL_Clu_SNR_130();
S4_SRR_RL_Clu_Mes_18_S4_SRR_RL_Clu_DynProp_130();
S4_SRR_RL_Clu_Mes_18_S4_SRR_RL_Clu_Locationvalid_130();
S4_SRR_RL_Clu_Mes_18_S4_SRR_RL_Clu_Theta_131();
S4_SRR_RL_Clu_Mes_18_S4_SRR_RL_Clu_Dist_131();
S4_SRR_RL_Clu_Mes_18_S4_SRR_RL_Clu_Vel_131();
S4_SRR_RL_Clu_Mes_18_S4_SRR_RL_Clu_SNR_131();
S4_SRR_RL_Clu_Mes_18_S4_SRR_RL_Clu_DynProp_131();
S4_SRR_RL_Clu_Mes_18_S4_SRR_RL_Clu_Locationvalid_131();
S4_SRR_RL_Clu_Mes_18_S4_SRR_RL_Clu_Theta_132();
S4_SRR_RL_Clu_Mes_18_S4_SRR_RL_Clu_Dist_132();
S4_SRR_RL_Clu_Mes_18_S4_SRR_RL_Clu_Vel_132();
S4_SRR_RL_Clu_Mes_18_S4_SRR_RL_Clu_SNR_132();
S4_SRR_RL_Clu_Mes_18_S4_SRR_RL_Clu_DynProp_132();
S4_SRR_RL_Clu_Mes_18_S4_SRR_RL_Clu_Locationvalid_132();
S4_SRR_RL_Clu_Mes_19_S4_SRR_RL_Clu_Theta_133();
S4_SRR_RL_Clu_Mes_19_S4_SRR_RL_Clu_Dist_133();
S4_SRR_RL_Clu_Mes_19_S4_SRR_RL_Clu_Vel_133();
S4_SRR_RL_Clu_Mes_19_S4_SRR_RL_Clu_SNR_133();
S4_SRR_RL_Clu_Mes_19_S4_SRR_RL_Clu_DynProp_133();
S4_SRR_RL_Clu_Mes_19_S4_SRR_RL_Clu_Locationvalid_133();
S4_SRR_RL_Clu_Mes_19_S4_SRR_RL_Clu_Theta_134();
S4_SRR_RL_Clu_Mes_19_S4_SRR_RL_Clu_Dist_134();
S4_SRR_RL_Clu_Mes_19_S4_SRR_RL_Clu_Vel_134();
S4_SRR_RL_Clu_Mes_19_S4_SRR_RL_Clu_SNR_134();
S4_SRR_RL_Clu_Mes_19_S4_SRR_RL_Clu_DynProp_134();
S4_SRR_RL_Clu_Mes_19_S4_SRR_RL_Clu_Locationvalid_134();
S4_SRR_RL_Clu_Mes_19_S4_SRR_RL_Clu_Theta_135();
S4_SRR_RL_Clu_Mes_19_S4_SRR_RL_Clu_Dist_135();
S4_SRR_RL_Clu_Mes_19_S4_SRR_RL_Clu_Vel_135();
S4_SRR_RL_Clu_Mes_19_S4_SRR_RL_Clu_SNR_135();
S4_SRR_RL_Clu_Mes_19_S4_SRR_RL_Clu_DynProp_135();
S4_SRR_RL_Clu_Mes_19_S4_SRR_RL_Clu_Locationvalid_135();
S4_SRR_RL_Clu_Mes_19_S4_SRR_RL_Clu_Theta_136();
S4_SRR_RL_Clu_Mes_19_S4_SRR_RL_Clu_Dist_136();
S4_SRR_RL_Clu_Mes_19_S4_SRR_RL_Clu_Vel_136();
S4_SRR_RL_Clu_Mes_19_S4_SRR_RL_Clu_SNR_136();
S4_SRR_RL_Clu_Mes_19_S4_SRR_RL_Clu_DynProp_136();
S4_SRR_RL_Clu_Mes_19_S4_SRR_RL_Clu_Locationvalid_136();
S4_SRR_RL_Clu_Mes_19_S4_SRR_RL_Clu_Theta_137();
S4_SRR_RL_Clu_Mes_19_S4_SRR_RL_Clu_Dist_137();
S4_SRR_RL_Clu_Mes_19_S4_SRR_RL_Clu_Vel_137();
S4_SRR_RL_Clu_Mes_19_S4_SRR_RL_Clu_SNR_137();
S4_SRR_RL_Clu_Mes_19_S4_SRR_RL_Clu_DynProp_137();
S4_SRR_RL_Clu_Mes_19_S4_SRR_RL_Clu_Locationvalid_137();
S4_SRR_RL_Clu_Mes_19_S4_SRR_RL_Clu_Theta_138();
S4_SRR_RL_Clu_Mes_19_S4_SRR_RL_Clu_Dist_138();
S4_SRR_RL_Clu_Mes_19_S4_SRR_RL_Clu_Vel_138();
S4_SRR_RL_Clu_Mes_19_S4_SRR_RL_Clu_SNR_138();
S4_SRR_RL_Clu_Mes_19_S4_SRR_RL_Clu_DynProp_138();
S4_SRR_RL_Clu_Mes_19_S4_SRR_RL_Clu_Locationvalid_138();
S4_SRR_RL_Clu_Mes_19_S4_SRR_RL_Clu_Theta_139();
S4_SRR_RL_Clu_Mes_19_S4_SRR_RL_Clu_Dist_139();
S4_SRR_RL_Clu_Mes_19_S4_SRR_RL_Clu_Vel_139();
S4_SRR_RL_Clu_Mes_19_S4_SRR_RL_Clu_SNR_139();
S4_SRR_RL_Clu_Mes_19_S4_SRR_RL_Clu_DynProp_139();
S4_SRR_RL_Clu_Mes_19_S4_SRR_RL_Clu_Locationvalid_139();
S4_SRR_RL_Clu_Mes_20_S4_SRR_RL_Clu_Theta_140();
S4_SRR_RL_Clu_Mes_20_S4_SRR_RL_Clu_Dist_140();
S4_SRR_RL_Clu_Mes_20_S4_SRR_RL_Clu_Vel_140();
S4_SRR_RL_Clu_Mes_20_S4_SRR_RL_Clu_SNR_140();
S4_SRR_RL_Clu_Mes_20_S4_SRR_RL_Clu_DynProp_140();
S4_SRR_RL_Clu_Mes_20_S4_SRR_RL_Clu_Locationvalid_140();
S4_SRR_RL_Clu_Mes_20_S4_SRR_RL_Clu_Theta_141();
S4_SRR_RL_Clu_Mes_20_S4_SRR_RL_Clu_Dist_141();
S4_SRR_RL_Clu_Mes_20_S4_SRR_RL_Clu_Vel_141();
S4_SRR_RL_Clu_Mes_20_S4_SRR_RL_Clu_SNR_141();
S4_SRR_RL_Clu_Mes_20_S4_SRR_RL_Clu_DynProp_141();
S4_SRR_RL_Clu_Mes_20_S4_SRR_RL_Clu_Locationvalid_141();
S4_SRR_RL_Clu_Mes_20_S4_SRR_RL_Clu_Theta_142();
S4_SRR_RL_Clu_Mes_20_S4_SRR_RL_Clu_Dist_142();
S4_SRR_RL_Clu_Mes_20_S4_SRR_RL_Clu_Vel_142();
S4_SRR_RL_Clu_Mes_20_S4_SRR_RL_Clu_SNR_142();
S4_SRR_RL_Clu_Mes_20_S4_SRR_RL_Clu_DynProp_142();
S4_SRR_RL_Clu_Mes_20_S4_SRR_RL_Clu_Locationvalid_142();
S4_SRR_RL_Clu_Mes_20_S4_SRR_RL_Clu_Theta_143();
S4_SRR_RL_Clu_Mes_20_S4_SRR_RL_Clu_Dist_143();
S4_SRR_RL_Clu_Mes_20_S4_SRR_RL_Clu_Vel_143();
S4_SRR_RL_Clu_Mes_20_S4_SRR_RL_Clu_SNR_143();
S4_SRR_RL_Clu_Mes_20_S4_SRR_RL_Clu_DynProp_143();
S4_SRR_RL_Clu_Mes_20_S4_SRR_RL_Clu_Locationvalid_143();
S4_SRR_RL_Clu_Mes_20_S4_SRR_RL_Clu_Theta_144();
S4_SRR_RL_Clu_Mes_20_S4_SRR_RL_Clu_Dist_144();
S4_SRR_RL_Clu_Mes_20_S4_SRR_RL_Clu_Vel_144();
S4_SRR_RL_Clu_Mes_20_S4_SRR_RL_Clu_SNR_144();
S4_SRR_RL_Clu_Mes_20_S4_SRR_RL_Clu_DynProp_144();
S4_SRR_RL_Clu_Mes_20_S4_SRR_RL_Clu_Locationvalid_144();
S4_SRR_RL_Clu_Mes_20_S4_SRR_RL_Clu_Theta_145();
S4_SRR_RL_Clu_Mes_20_S4_SRR_RL_Clu_Dist_145();
S4_SRR_RL_Clu_Mes_20_S4_SRR_RL_Clu_Vel_145();
S4_SRR_RL_Clu_Mes_20_S4_SRR_RL_Clu_SNR_145();
S4_SRR_RL_Clu_Mes_20_S4_SRR_RL_Clu_DynProp_145();
S4_SRR_RL_Clu_Mes_20_S4_SRR_RL_Clu_Locationvalid_145();
S4_SRR_RL_Clu_Mes_20_S4_SRR_RL_Clu_Theta_146();
S4_SRR_RL_Clu_Mes_20_S4_SRR_RL_Clu_Dist_146();
S4_SRR_RL_Clu_Mes_20_S4_SRR_RL_Clu_Vel_146();
S4_SRR_RL_Clu_Mes_20_S4_SRR_RL_Clu_SNR_146();
S4_SRR_RL_Clu_Mes_20_S4_SRR_RL_Clu_DynProp_146();
S4_SRR_RL_Clu_Mes_20_S4_SRR_RL_Clu_Locationvalid_146();
S4_SRR_RL_Clu_Mes_21_S4_SRR_RL_Clu_Theta_147();
S4_SRR_RL_Clu_Mes_21_S4_SRR_RL_Clu_Dist_147();
S4_SRR_RL_Clu_Mes_21_S4_SRR_RL_Clu_Vel_147();
S4_SRR_RL_Clu_Mes_21_S4_SRR_RL_Clu_SNR_147();
S4_SRR_RL_Clu_Mes_21_S4_SRR_RL_Clu_DynProp_147();
S4_SRR_RL_Clu_Mes_21_S4_SRR_RL_Clu_Locationvalid_147();
S4_SRR_RL_Clu_Mes_21_S4_SRR_RL_Clu_Theta_148();
S4_SRR_RL_Clu_Mes_21_S4_SRR_RL_Clu_Dist_148();
S4_SRR_RL_Clu_Mes_21_S4_SRR_RL_Clu_Vel_148();
S4_SRR_RL_Clu_Mes_21_S4_SRR_RL_Clu_SNR_148();
S4_SRR_RL_Clu_Mes_21_S4_SRR_RL_Clu_DynProp_148();
S4_SRR_RL_Clu_Mes_21_S4_SRR_RL_Clu_Locationvalid_148();
S4_SRR_RL_Clu_Mes_21_S4_SRR_RL_Clu_Theta_149();
S4_SRR_RL_Clu_Mes_21_S4_SRR_RL_Clu_Dist_149();
S4_SRR_RL_Clu_Mes_21_S4_SRR_RL_Clu_Vel_149();
S4_SRR_RL_Clu_Mes_21_S4_SRR_RL_Clu_SNR_149();
S4_SRR_RL_Clu_Mes_21_S4_SRR_RL_Clu_DynProp_149();
S4_SRR_RL_Clu_Mes_21_S4_SRR_RL_Clu_Locationvalid_149();
S4_SRR_RL_Clu_Mes_21_S4_SRR_RL_Clu_Theta_150();
S4_SRR_RL_Clu_Mes_21_S4_SRR_RL_Clu_Dist_150();
S4_SRR_RL_Clu_Mes_21_S4_SRR_RL_Clu_Vel_150();
S4_SRR_RL_Clu_Mes_21_S4_SRR_RL_Clu_SNR_150();
S4_SRR_RL_Clu_Mes_21_S4_SRR_RL_Clu_DynProp_150();
S4_SRR_RL_Clu_Mes_21_S4_SRR_RL_Clu_Locationvalid_150();
S4_SRR_RL_Clu_Mes_21_S4_SRR_RL_Clu_Theta_151();
S4_SRR_RL_Clu_Mes_21_S4_SRR_RL_Clu_Dist_151();
S4_SRR_RL_Clu_Mes_21_S4_SRR_RL_Clu_Vel_151();
S4_SRR_RL_Clu_Mes_21_S4_SRR_RL_Clu_SNR_151();
S4_SRR_RL_Clu_Mes_21_S4_SRR_RL_Clu_DynProp_151();
S4_SRR_RL_Clu_Mes_21_S4_SRR_RL_Clu_Locationvalid_151();
S4_SRR_RL_Clu_Mes_21_S4_SRR_RL_Clu_Theta_152();
S4_SRR_RL_Clu_Mes_21_S4_SRR_RL_Clu_Dist_152();
S4_SRR_RL_Clu_Mes_21_S4_SRR_RL_Clu_Vel_152();
S4_SRR_RL_Clu_Mes_21_S4_SRR_RL_Clu_SNR_152();
S4_SRR_RL_Clu_Mes_21_S4_SRR_RL_Clu_DynProp_152();
S4_SRR_RL_Clu_Mes_21_S4_SRR_RL_Clu_Locationvalid_152();
S4_SRR_RL_Clu_Mes_21_S4_SRR_RL_Clu_Theta_153();
S4_SRR_RL_Clu_Mes_21_S4_SRR_RL_Clu_Dist_153();
S4_SRR_RL_Clu_Mes_21_S4_SRR_RL_Clu_Vel_153();
S4_SRR_RL_Clu_Mes_21_S4_SRR_RL_Clu_SNR_153();
S4_SRR_RL_Clu_Mes_21_S4_SRR_RL_Clu_DynProp_153();
S4_SRR_RL_Clu_Mes_21_S4_SRR_RL_Clu_Locationvalid_153();
S4_SRR_RL_Clu_Mes_22_S4_SRR_RL_Clu_Theta_154();
S4_SRR_RL_Clu_Mes_22_S4_SRR_RL_Clu_Dist_154();
S4_SRR_RL_Clu_Mes_22_S4_SRR_RL_Clu_Vel_154();
S4_SRR_RL_Clu_Mes_22_S4_SRR_RL_Clu_SNR_154();
S4_SRR_RL_Clu_Mes_22_S4_SRR_RL_Clu_DynProp_154();
S4_SRR_RL_Clu_Mes_22_S4_SRR_RL_Clu_Locationvalid_154();
S4_SRR_RL_Clu_Mes_22_S4_SRR_RL_Clu_Theta_155();
S4_SRR_RL_Clu_Mes_22_S4_SRR_RL_Clu_Dist_155();
S4_SRR_RL_Clu_Mes_22_S4_SRR_RL_Clu_Vel_155();
S4_SRR_RL_Clu_Mes_22_S4_SRR_RL_Clu_SNR_155();
S4_SRR_RL_Clu_Mes_22_S4_SRR_RL_Clu_DynProp_155();
S4_SRR_RL_Clu_Mes_22_S4_SRR_RL_Clu_Locationvalid_155();
S4_SRR_RL_Clu_Mes_22_S4_SRR_RL_Clu_Theta_156();
S4_SRR_RL_Clu_Mes_22_S4_SRR_RL_Clu_Dist_156();
S4_SRR_RL_Clu_Mes_22_S4_SRR_RL_Clu_Vel_156();
S4_SRR_RL_Clu_Mes_22_S4_SRR_RL_Clu_SNR_156();
S4_SRR_RL_Clu_Mes_22_S4_SRR_RL_Clu_DynProp_156();
S4_SRR_RL_Clu_Mes_22_S4_SRR_RL_Clu_Locationvalid_156();
S4_SRR_RL_Clu_Mes_22_S4_SRR_RL_Clu_Theta_157();
S4_SRR_RL_Clu_Mes_22_S4_SRR_RL_Clu_Dist_157();
S4_SRR_RL_Clu_Mes_22_S4_SRR_RL_Clu_Vel_157();
S4_SRR_RL_Clu_Mes_22_S4_SRR_RL_Clu_SNR_157();
S4_SRR_RL_Clu_Mes_22_S4_SRR_RL_Clu_DynProp_157();
S4_SRR_RL_Clu_Mes_22_S4_SRR_RL_Clu_Locationvalid_157();
S4_SRR_RL_Clu_Mes_22_S4_SRR_RL_Clu_Theta_158();
S4_SRR_RL_Clu_Mes_22_S4_SRR_RL_Clu_Dist_158();
S4_SRR_RL_Clu_Mes_22_S4_SRR_RL_Clu_Vel_158();
S4_SRR_RL_Clu_Mes_22_S4_SRR_RL_Clu_SNR_158();
S4_SRR_RL_Clu_Mes_22_S4_SRR_RL_Clu_DynProp_158();
S4_SRR_RL_Clu_Mes_22_S4_SRR_RL_Clu_Locationvalid_158();
S4_SRR_RL_Clu_Mes_22_S4_SRR_RL_Clu_Theta_159();
S4_SRR_RL_Clu_Mes_22_S4_SRR_RL_Clu_Dist_159();
S4_SRR_RL_Clu_Mes_22_S4_SRR_RL_Clu_Vel_159();
S4_SRR_RL_Clu_Mes_22_S4_SRR_RL_Clu_SNR_159();
S4_SRR_RL_Clu_Mes_22_S4_SRR_RL_Clu_DynProp_159();
S4_SRR_RL_Clu_Mes_22_S4_SRR_RL_Clu_Locationvalid_159();
S4_SRR_RL_Clu_Mes_22_S4_SRR_RL_Clu_Theta_160();
S4_SRR_RL_Clu_Mes_22_S4_SRR_RL_Clu_Dist_160();
S4_SRR_RL_Clu_Mes_22_S4_SRR_RL_Clu_Vel_160();
S4_SRR_RL_Clu_Mes_22_S4_SRR_RL_Clu_SNR_160();
S4_SRR_RL_Clu_Mes_22_S4_SRR_RL_Clu_DynProp_160();
S4_SRR_RL_Clu_Mes_22_S4_SRR_RL_Clu_Locationvalid_160();
S4_SRR_RL_Clu_Mes_23_S4_SRR_RL_Clu_Theta_161();
S4_SRR_RL_Clu_Mes_23_S4_SRR_RL_Clu_Dist_161();
S4_SRR_RL_Clu_Mes_23_S4_SRR_RL_Clu_Vel_161();
S4_SRR_RL_Clu_Mes_23_S4_SRR_RL_Clu_SNR_161();
S4_SRR_RL_Clu_Mes_23_S4_SRR_RL_Clu_DynProp_161();
S4_SRR_RL_Clu_Mes_23_S4_SRR_RL_Clu_Locationvalid_161();
S4_SRR_RL_Clu_Mes_23_S4_SRR_RL_Clu_Theta_162();
S4_SRR_RL_Clu_Mes_23_S4_SRR_RL_Clu_Dist_162();
S4_SRR_RL_Clu_Mes_23_S4_SRR_RL_Clu_Vel_162();
S4_SRR_RL_Clu_Mes_23_S4_SRR_RL_Clu_SNR_162();
S4_SRR_RL_Clu_Mes_23_S4_SRR_RL_Clu_DynProp_162();
S4_SRR_RL_Clu_Mes_23_S4_SRR_RL_Clu_Locationvalid_162();
S4_SRR_RL_Clu_Mes_23_S4_SRR_RL_Clu_Theta_163();
S4_SRR_RL_Clu_Mes_23_S4_SRR_RL_Clu_Dist_163();
S4_SRR_RL_Clu_Mes_23_S4_SRR_RL_Clu_Vel_163();
S4_SRR_RL_Clu_Mes_23_S4_SRR_RL_Clu_SNR_163();
S4_SRR_RL_Clu_Mes_23_S4_SRR_RL_Clu_DynProp_163();
S4_SRR_RL_Clu_Mes_23_S4_SRR_RL_Clu_Locationvalid_163();
S4_SRR_RL_Clu_Mes_23_S4_SRR_RL_Clu_Theta_164();
S4_SRR_RL_Clu_Mes_23_S4_SRR_RL_Clu_Dist_164();
S4_SRR_RL_Clu_Mes_23_S4_SRR_RL_Clu_Vel_164();
S4_SRR_RL_Clu_Mes_23_S4_SRR_RL_Clu_SNR_164();
S4_SRR_RL_Clu_Mes_23_S4_SRR_RL_Clu_DynProp_164();
S4_SRR_RL_Clu_Mes_23_S4_SRR_RL_Clu_Locationvalid_164();
S4_SRR_RL_Clu_Mes_23_S4_SRR_RL_Clu_Theta_165();
S4_SRR_RL_Clu_Mes_23_S4_SRR_RL_Clu_Dist_165();
S4_SRR_RL_Clu_Mes_23_S4_SRR_RL_Clu_Vel_165();
S4_SRR_RL_Clu_Mes_23_S4_SRR_RL_Clu_SNR_165();
S4_SRR_RL_Clu_Mes_23_S4_SRR_RL_Clu_DynProp_165();
S4_SRR_RL_Clu_Mes_23_S4_SRR_RL_Clu_Locationvalid_165();
S4_SRR_RL_Clu_Mes_23_S4_SRR_RL_Clu_Theta_166();
S4_SRR_RL_Clu_Mes_23_S4_SRR_RL_Clu_Dist_166();
S4_SRR_RL_Clu_Mes_23_S4_SRR_RL_Clu_Vel_166();
S4_SRR_RL_Clu_Mes_23_S4_SRR_RL_Clu_SNR_166();
S4_SRR_RL_Clu_Mes_23_S4_SRR_RL_Clu_DynProp_166();
S4_SRR_RL_Clu_Mes_23_S4_SRR_RL_Clu_Locationvalid_166();
S4_SRR_RL_Clu_Mes_23_S4_SRR_RL_Clu_Theta_167();
S4_SRR_RL_Clu_Mes_23_S4_SRR_RL_Clu_Dist_167();
S4_SRR_RL_Clu_Mes_23_S4_SRR_RL_Clu_Vel_167();
S4_SRR_RL_Clu_Mes_23_S4_SRR_RL_Clu_SNR_167();
S4_SRR_RL_Clu_Mes_23_S4_SRR_RL_Clu_DynProp_167();
S4_SRR_RL_Clu_Mes_23_S4_SRR_RL_Clu_Locationvalid_167();
S4_SRR_RL_Clu_Mes_24_S4_SRR_RL_Clu_Theta_168();
S4_SRR_RL_Clu_Mes_24_S4_SRR_RL_Clu_Dist_168();
S4_SRR_RL_Clu_Mes_24_S4_SRR_RL_Clu_Vel_168();
S4_SRR_RL_Clu_Mes_24_S4_SRR_RL_Clu_SNR_168();
S4_SRR_RL_Clu_Mes_24_S4_SRR_RL_Clu_DynProp_168();
S4_SRR_RL_Clu_Mes_24_S4_SRR_RL_Clu_Locationvalid_168();
S4_SRR_RL_Clu_Mes_24_S4_SRR_RL_Clu_Theta_169();
S4_SRR_RL_Clu_Mes_24_S4_SRR_RL_Clu_Dist_169();
S4_SRR_RL_Clu_Mes_24_S4_SRR_RL_Clu_Vel_169();
S4_SRR_RL_Clu_Mes_24_S4_SRR_RL_Clu_SNR_169();
S4_SRR_RL_Clu_Mes_24_S4_SRR_RL_Clu_DynProp_169();
S4_SRR_RL_Clu_Mes_24_S4_SRR_RL_Clu_Locationvalid_169();
S4_SRR_RL_Clu_Mes_24_S4_SRR_RL_Clu_Theta_170();
S4_SRR_RL_Clu_Mes_24_S4_SRR_RL_Clu_Dist_170();
S4_SRR_RL_Clu_Mes_24_S4_SRR_RL_Clu_Vel_170();
S4_SRR_RL_Clu_Mes_24_S4_SRR_RL_Clu_SNR_170();
S4_SRR_RL_Clu_Mes_24_S4_SRR_RL_Clu_DynProp_170();
S4_SRR_RL_Clu_Mes_24_S4_SRR_RL_Clu_Locationvalid_170();
S4_SRR_RL_Clu_Mes_24_S4_SRR_RL_Clu_Theta_171();
S4_SRR_RL_Clu_Mes_24_S4_SRR_RL_Clu_Dist_171();
S4_SRR_RL_Clu_Mes_24_S4_SRR_RL_Clu_Vel_171();
S4_SRR_RL_Clu_Mes_24_S4_SRR_RL_Clu_SNR_171();
S4_SRR_RL_Clu_Mes_24_S4_SRR_RL_Clu_DynProp_171();
S4_SRR_RL_Clu_Mes_24_S4_SRR_RL_Clu_Locationvalid_171();
S4_SRR_RL_Clu_Mes_24_S4_SRR_RL_Clu_Theta_172();
S4_SRR_RL_Clu_Mes_24_S4_SRR_RL_Clu_Dist_172();
S4_SRR_RL_Clu_Mes_24_S4_SRR_RL_Clu_Vel_172();
S4_SRR_RL_Clu_Mes_24_S4_SRR_RL_Clu_SNR_172();
S4_SRR_RL_Clu_Mes_24_S4_SRR_RL_Clu_DynProp_172();
S4_SRR_RL_Clu_Mes_24_S4_SRR_RL_Clu_Locationvalid_172();
S4_SRR_RL_Clu_Mes_24_S4_SRR_RL_Clu_Theta_173();
S4_SRR_RL_Clu_Mes_24_S4_SRR_RL_Clu_Dist_173();
S4_SRR_RL_Clu_Mes_24_S4_SRR_RL_Clu_Vel_173();
S4_SRR_RL_Clu_Mes_24_S4_SRR_RL_Clu_SNR_173();
S4_SRR_RL_Clu_Mes_24_S4_SRR_RL_Clu_DynProp_173();
S4_SRR_RL_Clu_Mes_24_S4_SRR_RL_Clu_Locationvalid_173();
S4_SRR_RL_Clu_Mes_24_S4_SRR_RL_Clu_Theta_174();
S4_SRR_RL_Clu_Mes_24_S4_SRR_RL_Clu_Dist_174();
S4_SRR_RL_Clu_Mes_24_S4_SRR_RL_Clu_Vel_174();
S4_SRR_RL_Clu_Mes_24_S4_SRR_RL_Clu_SNR_174();
S4_SRR_RL_Clu_Mes_24_S4_SRR_RL_Clu_DynProp_174();
S4_SRR_RL_Clu_Mes_24_S4_SRR_RL_Clu_Locationvalid_174();
S4_SRR_RL_Clu_Mes_25_S4_SRR_RL_Clu_Theta_175();
S4_SRR_RL_Clu_Mes_25_S4_SRR_RL_Clu_Dist_175();
S4_SRR_RL_Clu_Mes_25_S4_SRR_RL_Clu_Vel_175();
S4_SRR_RL_Clu_Mes_25_S4_SRR_RL_Clu_SNR_175();
S4_SRR_RL_Clu_Mes_25_S4_SRR_RL_Clu_DynProp_175();
S4_SRR_RL_Clu_Mes_25_S4_SRR_RL_Clu_Locationvalid_175();
S4_SRR_RL_Clu_Mes_25_S4_SRR_RL_Clu_Theta_176();
S4_SRR_RL_Clu_Mes_25_S4_SRR_RL_Clu_Dist_176();
S4_SRR_RL_Clu_Mes_25_S4_SRR_RL_Clu_Vel_176();
S4_SRR_RL_Clu_Mes_25_S4_SRR_RL_Clu_SNR_176();
S4_SRR_RL_Clu_Mes_25_S4_SRR_RL_Clu_DynProp_176();
S4_SRR_RL_Clu_Mes_25_S4_SRR_RL_Clu_Locationvalid_176();
S4_SRR_RL_Clu_Mes_25_S4_SRR_RL_Clu_Theta_177();
S4_SRR_RL_Clu_Mes_25_S4_SRR_RL_Clu_Dist_177();
S4_SRR_RL_Clu_Mes_25_S4_SRR_RL_Clu_Vel_177();
S4_SRR_RL_Clu_Mes_25_S4_SRR_RL_Clu_SNR_177();
S4_SRR_RL_Clu_Mes_25_S4_SRR_RL_Clu_DynProp_177();
S4_SRR_RL_Clu_Mes_25_S4_SRR_RL_Clu_Locationvalid_177();
S4_SRR_RL_Clu_Mes_25_S4_SRR_RL_Clu_Theta_178();
S4_SRR_RL_Clu_Mes_25_S4_SRR_RL_Clu_Dist_178();
S4_SRR_RL_Clu_Mes_25_S4_SRR_RL_Clu_Vel_178();
S4_SRR_RL_Clu_Mes_25_S4_SRR_RL_Clu_SNR_178();
S4_SRR_RL_Clu_Mes_25_S4_SRR_RL_Clu_DynProp_178();
S4_SRR_RL_Clu_Mes_25_S4_SRR_RL_Clu_Locationvalid_178();
S4_SRR_RL_Clu_Mes_25_S4_SRR_RL_Clu_Theta_179();
S4_SRR_RL_Clu_Mes_25_S4_SRR_RL_Clu_Dist_179();
S4_SRR_RL_Clu_Mes_25_S4_SRR_RL_Clu_Vel_179();
S4_SRR_RL_Clu_Mes_25_S4_SRR_RL_Clu_SNR_179();
S4_SRR_RL_Clu_Mes_25_S4_SRR_RL_Clu_DynProp_179();
S4_SRR_RL_Clu_Mes_25_S4_SRR_RL_Clu_Locationvalid_179();
S4_SRR_RL_Clu_Mes_25_S4_SRR_RL_Clu_Theta_180();
S4_SRR_RL_Clu_Mes_25_S4_SRR_RL_Clu_Dist_180();
S4_SRR_RL_Clu_Mes_25_S4_SRR_RL_Clu_Vel_180();
S4_SRR_RL_Clu_Mes_25_S4_SRR_RL_Clu_SNR_180();
S4_SRR_RL_Clu_Mes_25_S4_SRR_RL_Clu_DynProp_180();
S4_SRR_RL_Clu_Mes_25_S4_SRR_RL_Clu_Locationvalid_180();
S4_SRR_RL_Clu_Mes_25_S4_SRR_RL_Clu_Theta_181();
S4_SRR_RL_Clu_Mes_25_S4_SRR_RL_Clu_Dist_181();
S4_SRR_RL_Clu_Mes_25_S4_SRR_RL_Clu_Vel_181();
S4_SRR_RL_Clu_Mes_25_S4_SRR_RL_Clu_SNR_181();
S4_SRR_RL_Clu_Mes_25_S4_SRR_RL_Clu_DynProp_181();
S4_SRR_RL_Clu_Mes_25_S4_SRR_RL_Clu_Locationvalid_181();
S4_SRR_RL_Clu_Mes_26_S4_SRR_RL_Clu_Theta_182();
S4_SRR_RL_Clu_Mes_26_S4_SRR_RL_Clu_Dist_182();
S4_SRR_RL_Clu_Mes_26_S4_SRR_RL_Clu_Vel_182();
S4_SRR_RL_Clu_Mes_26_S4_SRR_RL_Clu_SNR_182();
S4_SRR_RL_Clu_Mes_26_S4_SRR_RL_Clu_DynProp_182();
S4_SRR_RL_Clu_Mes_26_S4_SRR_RL_Clu_Locationvalid_182();
S4_SRR_RL_Clu_Mes_26_S4_SRR_RL_Clu_Theta_183();
S4_SRR_RL_Clu_Mes_26_S4_SRR_RL_Clu_Dist_183();
S4_SRR_RL_Clu_Mes_26_S4_SRR_RL_Clu_Vel_183();
S4_SRR_RL_Clu_Mes_26_S4_SRR_RL_Clu_SNR_183();
S4_SRR_RL_Clu_Mes_26_S4_SRR_RL_Clu_DynProp_183();
S4_SRR_RL_Clu_Mes_26_S4_SRR_RL_Clu_Locationvalid_183();
S4_SRR_RL_Clu_Mes_26_S4_SRR_RL_Clu_Theta_184();
S4_SRR_RL_Clu_Mes_26_S4_SRR_RL_Clu_Dist_184();
S4_SRR_RL_Clu_Mes_26_S4_SRR_RL_Clu_Vel_184();
S4_SRR_RL_Clu_Mes_26_S4_SRR_RL_Clu_SNR_184();
S4_SRR_RL_Clu_Mes_26_S4_SRR_RL_Clu_DynProp_184();
S4_SRR_RL_Clu_Mes_26_S4_SRR_RL_Clu_Locationvalid_184();
S4_SRR_RL_Clu_Mes_26_S4_SRR_RL_Clu_Theta_185();
S4_SRR_RL_Clu_Mes_26_S4_SRR_RL_Clu_Dist_185();
S4_SRR_RL_Clu_Mes_26_S4_SRR_RL_Clu_Vel_185();
S4_SRR_RL_Clu_Mes_26_S4_SRR_RL_Clu_SNR_185();
S4_SRR_RL_Clu_Mes_26_S4_SRR_RL_Clu_DynProp_185();
S4_SRR_RL_Clu_Mes_26_S4_SRR_RL_Clu_Locationvalid_185();
S4_SRR_RL_Clu_Mes_26_S4_SRR_RL_Clu_Theta_186();
S4_SRR_RL_Clu_Mes_26_S4_SRR_RL_Clu_Dist_186();
S4_SRR_RL_Clu_Mes_26_S4_SRR_RL_Clu_Vel_186();
S4_SRR_RL_Clu_Mes_26_S4_SRR_RL_Clu_SNR_186();
S4_SRR_RL_Clu_Mes_26_S4_SRR_RL_Clu_DynProp_186();
S4_SRR_RL_Clu_Mes_26_S4_SRR_RL_Clu_Locationvalid_186();
S4_SRR_RL_Clu_Mes_26_S4_SRR_RL_Clu_Theta_187();
S4_SRR_RL_Clu_Mes_26_S4_SRR_RL_Clu_Dist_187();
S4_SRR_RL_Clu_Mes_26_S4_SRR_RL_Clu_Vel_187();
S4_SRR_RL_Clu_Mes_26_S4_SRR_RL_Clu_SNR_187();
S4_SRR_RL_Clu_Mes_26_S4_SRR_RL_Clu_DynProp_187();
S4_SRR_RL_Clu_Mes_26_S4_SRR_RL_Clu_Locationvalid_187();
S4_SRR_RL_Clu_Mes_26_S4_SRR_RL_Clu_Theta_188();
S4_SRR_RL_Clu_Mes_26_S4_SRR_RL_Clu_Dist_188();
S4_SRR_RL_Clu_Mes_26_S4_SRR_RL_Clu_Vel_188();
S4_SRR_RL_Clu_Mes_26_S4_SRR_RL_Clu_SNR_188();
S4_SRR_RL_Clu_Mes_26_S4_SRR_RL_Clu_DynProp_188();
S4_SRR_RL_Clu_Mes_26_S4_SRR_RL_Clu_Locationvalid_188();
S4_SRR_RL_Clu_Mes_27_S4_SRR_RL_Clu_Theta_189();
S4_SRR_RL_Clu_Mes_27_S4_SRR_RL_Clu_Dist_189();
S4_SRR_RL_Clu_Mes_27_S4_SRR_RL_Clu_Vel_189();
S4_SRR_RL_Clu_Mes_27_S4_SRR_RL_Clu_SNR_189();
S4_SRR_RL_Clu_Mes_27_S4_SRR_RL_Clu_DynProp_189();
S4_SRR_RL_Clu_Mes_27_S4_SRR_RL_Clu_Locationvalid_189();
S4_SRR_RL_Clu_Mes_27_S4_SRR_RL_Clu_Theta_190();
S4_SRR_RL_Clu_Mes_27_S4_SRR_RL_Clu_Dist_190();
S4_SRR_RL_Clu_Mes_27_S4_SRR_RL_Clu_Vel_190();
S4_SRR_RL_Clu_Mes_27_S4_SRR_RL_Clu_SNR_190();
S4_SRR_RL_Clu_Mes_27_S4_SRR_RL_Clu_DynProp_190();
S4_SRR_RL_Clu_Mes_27_S4_SRR_RL_Clu_Locationvalid_190();
S4_SRR_RL_Clu_Mes_27_S4_SRR_RL_Clu_Theta_191();
S4_SRR_RL_Clu_Mes_27_S4_SRR_RL_Clu_Dist_191();
S4_SRR_RL_Clu_Mes_27_S4_SRR_RL_Clu_Vel_191();
S4_SRR_RL_Clu_Mes_27_S4_SRR_RL_Clu_SNR_191();
S4_SRR_RL_Clu_Mes_27_S4_SRR_RL_Clu_DynProp_191();
S4_SRR_RL_Clu_Mes_27_S4_SRR_RL_Clu_Locationvalid_191();
S4_SRR_RL_Clu_Mes_27_S4_SRR_RL_Clu_Theta_192();
S4_SRR_RL_Clu_Mes_27_S4_SRR_RL_Clu_Dist_192();
S4_SRR_RL_Clu_Mes_27_S4_SRR_RL_Clu_Vel_192();
S4_SRR_RL_Clu_Mes_27_S4_SRR_RL_Clu_SNR_192();
S4_SRR_RL_Clu_Mes_27_S4_SRR_RL_Clu_DynProp_192();
S4_SRR_RL_Clu_Mes_27_S4_SRR_RL_Clu_Locationvalid_192();
S4_SRR_RL_Clu_Mes_27_S4_SRR_RL_Clu_Theta_193();
S4_SRR_RL_Clu_Mes_27_S4_SRR_RL_Clu_Dist_193();
S4_SRR_RL_Clu_Mes_27_S4_SRR_RL_Clu_Vel_193();
S4_SRR_RL_Clu_Mes_27_S4_SRR_RL_Clu_SNR_193();
S4_SRR_RL_Clu_Mes_27_S4_SRR_RL_Clu_DynProp_193();
S4_SRR_RL_Clu_Mes_27_S4_SRR_RL_Clu_Locationvalid_193();
S4_SRR_RL_Clu_Mes_27_S4_SRR_RL_Clu_Theta_194();
S4_SRR_RL_Clu_Mes_27_S4_SRR_RL_Clu_Dist_194();
S4_SRR_RL_Clu_Mes_27_S4_SRR_RL_Clu_Vel_194();
S4_SRR_RL_Clu_Mes_27_S4_SRR_RL_Clu_SNR_194();
S4_SRR_RL_Clu_Mes_27_S4_SRR_RL_Clu_DynProp_194();
S4_SRR_RL_Clu_Mes_27_S4_SRR_RL_Clu_Locationvalid_194();
S4_SRR_RL_Clu_Mes_27_S4_SRR_RL_Clu_Theta_195();
S4_SRR_RL_Clu_Mes_27_S4_SRR_RL_Clu_Dist_195();
S4_SRR_RL_Clu_Mes_27_S4_SRR_RL_Clu_Vel_195();
S4_SRR_RL_Clu_Mes_27_S4_SRR_RL_Clu_SNR_195();
S4_SRR_RL_Clu_Mes_27_S4_SRR_RL_Clu_DynProp_195();
S4_SRR_RL_Clu_Mes_27_S4_SRR_RL_Clu_Locationvalid_195();
S4_SRR_RL_Clu_Mes_28_S4_SRR_RL_Clu_Theta_196();
S4_SRR_RL_Clu_Mes_28_S4_SRR_RL_Clu_Dist_196();
S4_SRR_RL_Clu_Mes_28_S4_SRR_RL_Clu_Vel_196();
S4_SRR_RL_Clu_Mes_28_S4_SRR_RL_Clu_SNR_196();
S4_SRR_RL_Clu_Mes_28_S4_SRR_RL_Clu_DynProp_196();
S4_SRR_RL_Clu_Mes_28_S4_SRR_RL_Clu_Locationvalid_196();
S4_SRR_RL_Clu_Mes_28_S4_SRR_RL_Clu_Theta_197();
S4_SRR_RL_Clu_Mes_28_S4_SRR_RL_Clu_Dist_197();
S4_SRR_RL_Clu_Mes_28_S4_SRR_RL_Clu_Vel_197();
S4_SRR_RL_Clu_Mes_28_S4_SRR_RL_Clu_SNR_197();
S4_SRR_RL_Clu_Mes_28_S4_SRR_RL_Clu_DynProp_197();
S4_SRR_RL_Clu_Mes_28_S4_SRR_RL_Clu_Locationvalid_197();
S4_SRR_RL_Clu_Mes_28_S4_SRR_RL_Clu_Theta_198();
S4_SRR_RL_Clu_Mes_28_S4_SRR_RL_Clu_Dist_198();
S4_SRR_RL_Clu_Mes_28_S4_SRR_RL_Clu_Vel_198();
S4_SRR_RL_Clu_Mes_28_S4_SRR_RL_Clu_SNR_198();
S4_SRR_RL_Clu_Mes_28_S4_SRR_RL_Clu_DynProp_198();
S4_SRR_RL_Clu_Mes_28_S4_SRR_RL_Clu_Locationvalid_198();
S4_SRR_RL_Clu_Mes_28_S4_SRR_RL_Clu_Theta_199();
S4_SRR_RL_Clu_Mes_28_S4_SRR_RL_Clu_Dist_199();
S4_SRR_RL_Clu_Mes_28_S4_SRR_RL_Clu_Vel_199();
S4_SRR_RL_Clu_Mes_28_S4_SRR_RL_Clu_SNR_199();
S4_SRR_RL_Clu_Mes_28_S4_SRR_RL_Clu_DynProp_199();
S4_SRR_RL_Clu_Mes_28_S4_SRR_RL_Clu_Locationvalid_199();
S4_SRR_RL_Obj_Mes_0_S4_SRR_RL_Obj_ID_1();
S4_SRR_RL_Obj_Mes_0_S4_SRR_RL_Obj_DistX_1();
S4_SRR_RL_Obj_Mes_0_S4_SRR_RL_Obj_RelVelX_1();
S4_SRR_RL_Obj_Mes_0_S4_SRR_RL_Obj_AccelX_1();
S4_SRR_RL_Obj_Mes_0_S4_SRR_RL_Obj_DistY_1();
S4_SRR_RL_Obj_Mes_0_S4_SRR_RL_Obj_RelVelY_1();
S4_SRR_RL_Obj_Mes_0_S4_SRR_RL_Obj_AccelY_1();
S4_SRR_RL_Obj_Mes_0_S4_SRR_RL_Obj_DistXStd_1();
S4_SRR_RL_Obj_Mes_0_S4_SRR_RL_Obj_RelVelXStd_1();
S4_SRR_RL_Obj_Mes_0_S4_SRR_RL_Obj_DistYStd_1();
S4_SRR_RL_Obj_Mes_0_S4_SRR_RL_Obj_RelVelYStd_1();
S4_SRR_RL_Obj_Mes_0_S4_SRR_RL_Obj_UpdateFlag_1();
S4_SRR_RL_Obj_Mes_0_S4_SRR_RL_Obj_ExistProb_1();
S4_SRR_RL_Obj_Mes_0_S4_SRR_RL_Obj_Type_1();
S4_SRR_RL_Obj_Mes_0_S4_SRR_RL_Obj_EDynProp_1();
S4_SRR_RL_Obj_Mes_0_S4_SRR_RL_Obj_UiLifeCycles_1();
S4_SRR_RL_Obj_Mes_0_S4_SRR_RL_Obj_ID_2();
S4_SRR_RL_Obj_Mes_0_S4_SRR_RL_Obj_DistX_2();
S4_SRR_RL_Obj_Mes_0_S4_SRR_RL_Obj_RelVelX_2();
S4_SRR_RL_Obj_Mes_0_S4_SRR_RL_Obj_AccelX_2();
S4_SRR_RL_Obj_Mes_0_S4_SRR_RL_Obj_DistY_2();
S4_SRR_RL_Obj_Mes_0_S4_SRR_RL_Obj_RelVelY_2();
S4_SRR_RL_Obj_Mes_0_S4_SRR_RL_Obj_AccelY_2();
S4_SRR_RL_Obj_Mes_0_S4_SRR_RL_Obj_DistXStd_2();
S4_SRR_RL_Obj_Mes_0_S4_SRR_RL_Obj_RelVelXStd_2();
S4_SRR_RL_Obj_Mes_0_S4_SRR_RL_Obj_DistYStd_2();
S4_SRR_RL_Obj_Mes_0_S4_SRR_RL_Obj_RelVelYStd_2();
S4_SRR_RL_Obj_Mes_0_S4_SRR_RL_Obj_UpdateFlag_2();
S4_SRR_RL_Obj_Mes_0_S4_SRR_RL_Obj_ExistProb_2();
S4_SRR_RL_Obj_Mes_0_S4_SRR_RL_Obj_Type_2();
S4_SRR_RL_Obj_Mes_0_S4_SRR_RL_Obj_EDynProp_2();
S4_SRR_RL_Obj_Mes_0_S4_SRR_RL_Obj_UiLifeCycles_2();
S4_SRR_RL_Obj_Mes_1_S4_SRR_RL_Obj_ID_3();
S4_SRR_RL_Obj_Mes_1_S4_SRR_RL_Obj_DistX_3();
S4_SRR_RL_Obj_Mes_1_S4_SRR_RL_Obj_RelVelX_3();
S4_SRR_RL_Obj_Mes_1_S4_SRR_RL_Obj_AccelX_3();
S4_SRR_RL_Obj_Mes_1_S4_SRR_RL_Obj_DistY_3();
S4_SRR_RL_Obj_Mes_1_S4_SRR_RL_Obj_RelVelY_3();
S4_SRR_RL_Obj_Mes_1_S4_SRR_RL_Obj_AccelY_3();
S4_SRR_RL_Obj_Mes_1_S4_SRR_RL_Obj_DistXStd_3();
S4_SRR_RL_Obj_Mes_1_S4_SRR_RL_Obj_RelVelXStd_3();
S4_SRR_RL_Obj_Mes_1_S4_SRR_RL_Obj_DistYStd_3();
S4_SRR_RL_Obj_Mes_1_S4_SRR_RL_Obj_RelVelYStd_3();
S4_SRR_RL_Obj_Mes_1_S4_SRR_RL_Obj_UpdateFlag_3();
S4_SRR_RL_Obj_Mes_1_S4_SRR_RL_Obj_ExistProb_3();
S4_SRR_RL_Obj_Mes_1_S4_SRR_RL_Obj_Type_3();
S4_SRR_RL_Obj_Mes_1_S4_SRR_RL_Obj_EDynProp_3();
S4_SRR_RL_Obj_Mes_1_S4_SRR_RL_Obj_UiLifeCycles_3();
S4_SRR_RL_Obj_Mes_1_S4_SRR_RL_Obj_ID_4();
S4_SRR_RL_Obj_Mes_1_S4_SRR_RL_Obj_DistX_4();
S4_SRR_RL_Obj_Mes_1_S4_SRR_RL_Obj_RelVelX_4();
S4_SRR_RL_Obj_Mes_1_S4_SRR_RL_Obj_AccelX_4();
S4_SRR_RL_Obj_Mes_1_S4_SRR_RL_Obj_DistY_4();
S4_SRR_RL_Obj_Mes_1_S4_SRR_RL_Obj_RelVelY_4();
S4_SRR_RL_Obj_Mes_1_S4_SRR_RL_Obj_AccelY_4();
S4_SRR_RL_Obj_Mes_1_S4_SRR_RL_Obj_DistXStd_4();
S4_SRR_RL_Obj_Mes_1_S4_SRR_RL_Obj_RelVelXStd_4();
S4_SRR_RL_Obj_Mes_1_S4_SRR_RL_Obj_DistYStd_4();
S4_SRR_RL_Obj_Mes_1_S4_SRR_RL_Obj_RelVelYStd_4();
S4_SRR_RL_Obj_Mes_1_S4_SRR_RL_Obj_UpdateFlag_4();
S4_SRR_RL_Obj_Mes_1_S4_SRR_RL_Obj_ExistProb_4();
S4_SRR_RL_Obj_Mes_1_S4_SRR_RL_Obj_Type_4();
S4_SRR_RL_Obj_Mes_1_S4_SRR_RL_Obj_EDynProp_4();
S4_SRR_RL_Obj_Mes_1_S4_SRR_RL_Obj_UiLifeCycles_4();
S4_SRR_RL_Obj_Mes_1_S4_SRR_RL_Obj_ID_5();
S4_SRR_RL_Obj_Mes_1_S4_SRR_RL_Obj_DistX_5();
S4_SRR_RL_Obj_Mes_1_S4_SRR_RL_Obj_RelVelX_5();
S4_SRR_RL_Obj_Mes_1_S4_SRR_RL_Obj_AccelX_5();
S4_SRR_RL_Obj_Mes_1_S4_SRR_RL_Obj_DistY_5();
S4_SRR_RL_Obj_Mes_1_S4_SRR_RL_Obj_RelVelY_5();
S4_SRR_RL_Obj_Mes_1_S4_SRR_RL_Obj_AccelY_5();
S4_SRR_RL_Obj_Mes_1_S4_SRR_RL_Obj_DistXStd_5();
S4_SRR_RL_Obj_Mes_1_S4_SRR_RL_Obj_RelVelXStd_5();
S4_SRR_RL_Obj_Mes_1_S4_SRR_RL_Obj_DistYStd_5();
S4_SRR_RL_Obj_Mes_1_S4_SRR_RL_Obj_RelVelYStd_5();
S4_SRR_RL_Obj_Mes_1_S4_SRR_RL_Obj_UpdateFlag_5();
S4_SRR_RL_Obj_Mes_1_S4_SRR_RL_Obj_ExistProb_5();
S4_SRR_RL_Obj_Mes_1_S4_SRR_RL_Obj_Type_5();
S4_SRR_RL_Obj_Mes_1_S4_SRR_RL_Obj_EDynProp_5();
S4_SRR_RL_Obj_Mes_1_S4_SRR_RL_Obj_UiLifeCycles_5();
S4_SRR_RL_Obj_Mes_2_S4_SRR_RL_Obj_ID_6();
S4_SRR_RL_Obj_Mes_2_S4_SRR_RL_Obj_DistX_6();
S4_SRR_RL_Obj_Mes_2_S4_SRR_RL_Obj_RelVelX_6();
S4_SRR_RL_Obj_Mes_2_S4_SRR_RL_Obj_AccelX_6();
S4_SRR_RL_Obj_Mes_2_S4_SRR_RL_Obj_DistY_6();
S4_SRR_RL_Obj_Mes_2_S4_SRR_RL_Obj_RelVelY_6();
S4_SRR_RL_Obj_Mes_2_S4_SRR_RL_Obj_AccelY_6();
S4_SRR_RL_Obj_Mes_2_S4_SRR_RL_Obj_DistXStd_6();
S4_SRR_RL_Obj_Mes_2_S4_SRR_RL_Obj_RelVelXStd_6();
S4_SRR_RL_Obj_Mes_2_S4_SRR_RL_Obj_DistYStd_6();
S4_SRR_RL_Obj_Mes_2_S4_SRR_RL_Obj_RelVelYStd_6();
S4_SRR_RL_Obj_Mes_2_S4_SRR_RL_Obj_UpdateFlag_6();
S4_SRR_RL_Obj_Mes_2_S4_SRR_RL_Obj_ExistProb_6();
S4_SRR_RL_Obj_Mes_2_S4_SRR_RL_Obj_Type_6();
S4_SRR_RL_Obj_Mes_2_S4_SRR_RL_Obj_EDynProp_6();
S4_SRR_RL_Obj_Mes_2_S4_SRR_RL_Obj_UiLifeCycles_6();
S4_SRR_RL_Obj_Mes_2_S4_SRR_RL_Obj_ID_7();
S4_SRR_RL_Obj_Mes_2_S4_SRR_RL_Obj_DistX_7();
S4_SRR_RL_Obj_Mes_2_S4_SRR_RL_Obj_RelVelX_7();
S4_SRR_RL_Obj_Mes_2_S4_SRR_RL_Obj_AccelX_7();
S4_SRR_RL_Obj_Mes_2_S4_SRR_RL_Obj_DistY_7();
S4_SRR_RL_Obj_Mes_2_S4_SRR_RL_Obj_RelVelY_7();
S4_SRR_RL_Obj_Mes_2_S4_SRR_RL_Obj_AccelY_7();
S4_SRR_RL_Obj_Mes_2_S4_SRR_RL_Obj_DistXStd_7();
S4_SRR_RL_Obj_Mes_2_S4_SRR_RL_Obj_RelVelXStd_7();
S4_SRR_RL_Obj_Mes_2_S4_SRR_RL_Obj_DistYStd_7();
S4_SRR_RL_Obj_Mes_2_S4_SRR_RL_Obj_RelVelYStd_7();
S4_SRR_RL_Obj_Mes_2_S4_SRR_RL_Obj_UpdateFlag_7();
S4_SRR_RL_Obj_Mes_2_S4_SRR_RL_Obj_ExistProb_7();
S4_SRR_RL_Obj_Mes_2_S4_SRR_RL_Obj_Type_7();
S4_SRR_RL_Obj_Mes_2_S4_SRR_RL_Obj_EDynProp_7();
S4_SRR_RL_Obj_Mes_2_S4_SRR_RL_Obj_UiLifeCycles_7();
S4_SRR_RL_Obj_Mes_2_S4_SRR_RL_Obj_ID_8();
S4_SRR_RL_Obj_Mes_2_S4_SRR_RL_Obj_DistX_8();
S4_SRR_RL_Obj_Mes_2_S4_SRR_RL_Obj_RelVelX_8();
S4_SRR_RL_Obj_Mes_2_S4_SRR_RL_Obj_AccelX_8();
S4_SRR_RL_Obj_Mes_2_S4_SRR_RL_Obj_DistY_8();
S4_SRR_RL_Obj_Mes_2_S4_SRR_RL_Obj_RelVelY_8();
S4_SRR_RL_Obj_Mes_2_S4_SRR_RL_Obj_AccelY_8();
S4_SRR_RL_Obj_Mes_2_S4_SRR_RL_Obj_DistXStd_8();
S4_SRR_RL_Obj_Mes_2_S4_SRR_RL_Obj_RelVelXStd_8();
S4_SRR_RL_Obj_Mes_2_S4_SRR_RL_Obj_DistYStd_8();
S4_SRR_RL_Obj_Mes_2_S4_SRR_RL_Obj_RelVelYStd_8();
S4_SRR_RL_Obj_Mes_2_S4_SRR_RL_Obj_UpdateFlag_8();
S4_SRR_RL_Obj_Mes_2_S4_SRR_RL_Obj_ExistProb_8();
S4_SRR_RL_Obj_Mes_2_S4_SRR_RL_Obj_Type_8();
S4_SRR_RL_Obj_Mes_2_S4_SRR_RL_Obj_EDynProp_8();
S4_SRR_RL_Obj_Mes_2_S4_SRR_RL_Obj_UiLifeCycles_8();
S4_SRR_RL_Obj_Mes_3_S4_SRR_RL_Obj_ID_9();
S4_SRR_RL_Obj_Mes_3_S4_SRR_RL_Obj_DistX_9();
S4_SRR_RL_Obj_Mes_3_S4_SRR_RL_Obj_RelVelX_9();
S4_SRR_RL_Obj_Mes_3_S4_SRR_RL_Obj_AccelX_9();
S4_SRR_RL_Obj_Mes_3_S4_SRR_RL_Obj_DistY_9();
S4_SRR_RL_Obj_Mes_3_S4_SRR_RL_Obj_RelVelY_9();
S4_SRR_RL_Obj_Mes_3_S4_SRR_RL_Obj_AccelY_9();
S4_SRR_RL_Obj_Mes_3_S4_SRR_RL_Obj_DistXStd_9();
S4_SRR_RL_Obj_Mes_3_S4_SRR_RL_Obj_RelVelXStd_9();
S4_SRR_RL_Obj_Mes_3_S4_SRR_RL_Obj_DistYStd_9();
S4_SRR_RL_Obj_Mes_3_S4_SRR_RL_Obj_RelVelYStd_9();
S4_SRR_RL_Obj_Mes_3_S4_SRR_RL_Obj_UpdateFlag_9();
S4_SRR_RL_Obj_Mes_3_S4_SRR_RL_Obj_ExistProb_9();
S4_SRR_RL_Obj_Mes_3_S4_SRR_RL_Obj_Type_9();
S4_SRR_RL_Obj_Mes_3_S4_SRR_RL_Obj_EDynProp_9();
S4_SRR_RL_Obj_Mes_3_S4_SRR_RL_Obj_UiLifeCycles_9();
S4_SRR_RL_Obj_Mes_3_S4_SRR_RL_Obj_ID_10();
S4_SRR_RL_Obj_Mes_3_S4_SRR_RL_Obj_DistX_10();
S4_SRR_RL_Obj_Mes_3_S4_SRR_RL_Obj_RelVelX_10();
S4_SRR_RL_Obj_Mes_3_S4_SRR_RL_Obj_AccelX_10();
S4_SRR_RL_Obj_Mes_3_S4_SRR_RL_Obj_DistY_10();
S4_SRR_RL_Obj_Mes_3_S4_SRR_RL_Obj_RelVelY_10();
S4_SRR_RL_Obj_Mes_3_S4_SRR_RL_Obj_AccelY_10();
S4_SRR_RL_Obj_Mes_3_S4_SRR_RL_Obj_DistXStd_10();
S4_SRR_RL_Obj_Mes_3_S4_SRR_RL_Obj_RelVelXStd_10();
S4_SRR_RL_Obj_Mes_3_S4_SRR_RL_Obj_DistYStd_10();
S4_SRR_RL_Obj_Mes_3_S4_SRR_RL_Obj_RelVelYStd_10();
S4_SRR_RL_Obj_Mes_3_S4_SRR_RL_Obj_UpdateFlag_10();
S4_SRR_RL_Obj_Mes_3_S4_SRR_RL_Obj_ExistProb_10();
S4_SRR_RL_Obj_Mes_3_S4_SRR_RL_Obj_Type_10();
S4_SRR_RL_Obj_Mes_3_S4_SRR_RL_Obj_EDynProp_10();
S4_SRR_RL_Obj_Mes_3_S4_SRR_RL_Obj_UiLifeCycles_10();
S4_SRR_RL_Obj_Mes_3_S4_SRR_RL_Obj_ID_11();
S4_SRR_RL_Obj_Mes_3_S4_SRR_RL_Obj_DistX_11();
S4_SRR_RL_Obj_Mes_3_S4_SRR_RL_Obj_RelVelX_11();
S4_SRR_RL_Obj_Mes_3_S4_SRR_RL_Obj_AccelX_11();
S4_SRR_RL_Obj_Mes_3_S4_SRR_RL_Obj_DistY_11();
S4_SRR_RL_Obj_Mes_3_S4_SRR_RL_Obj_RelVelY_11();
S4_SRR_RL_Obj_Mes_3_S4_SRR_RL_Obj_AccelY_11();
S4_SRR_RL_Obj_Mes_3_S4_SRR_RL_Obj_DistXStd_11();
S4_SRR_RL_Obj_Mes_3_S4_SRR_RL_Obj_RelVelXStd_11();
S4_SRR_RL_Obj_Mes_3_S4_SRR_RL_Obj_DistYStd_11();
S4_SRR_RL_Obj_Mes_3_S4_SRR_RL_Obj_RelVelYStd_11();
S4_SRR_RL_Obj_Mes_3_S4_SRR_RL_Obj_UpdateFlag_11();
S4_SRR_RL_Obj_Mes_3_S4_SRR_RL_Obj_ExistProb_11();
S4_SRR_RL_Obj_Mes_3_S4_SRR_RL_Obj_Type_11();
S4_SRR_RL_Obj_Mes_3_S4_SRR_RL_Obj_EDynProp_11();
S4_SRR_RL_Obj_Mes_3_S4_SRR_RL_Obj_UiLifeCycles_11();
S4_SRR_RL_Obj_Mes_4_S4_SRR_RL_Obj_ID_12();
S4_SRR_RL_Obj_Mes_4_S4_SRR_RL_Obj_DistX_12();
S4_SRR_RL_Obj_Mes_4_S4_SRR_RL_Obj_RelVelX_12();
S4_SRR_RL_Obj_Mes_4_S4_SRR_RL_Obj_AccelX_12();
S4_SRR_RL_Obj_Mes_4_S4_SRR_RL_Obj_DistY_12();
S4_SRR_RL_Obj_Mes_4_S4_SRR_RL_Obj_RelVelY_12();
S4_SRR_RL_Obj_Mes_4_S4_SRR_RL_Obj_AccelY_12();
S4_SRR_RL_Obj_Mes_4_S4_SRR_RL_Obj_DistXStd_12();
S4_SRR_RL_Obj_Mes_4_S4_SRR_RL_Obj_RelVelXStd_12();
S4_SRR_RL_Obj_Mes_4_S4_SRR_RL_Obj_DistYStd_12();
S4_SRR_RL_Obj_Mes_4_S4_SRR_RL_Obj_RelVelYStd_12();
S4_SRR_RL_Obj_Mes_4_S4_SRR_RL_Obj_UpdateFlag_12();
S4_SRR_RL_Obj_Mes_4_S4_SRR_RL_Obj_ExistProb_12();
S4_SRR_RL_Obj_Mes_4_S4_SRR_RL_Obj_Type_12();
S4_SRR_RL_Obj_Mes_4_S4_SRR_RL_Obj_EDynProp_12();
S4_SRR_RL_Obj_Mes_4_S4_SRR_RL_Obj_UiLifeCycles_12();
S4_SRR_RL_Obj_Mes_4_S4_SRR_RL_Obj_ID_13();
S4_SRR_RL_Obj_Mes_4_S4_SRR_RL_Obj_DistX_13();
S4_SRR_RL_Obj_Mes_4_S4_SRR_RL_Obj_RelVelX_13();
S4_SRR_RL_Obj_Mes_4_S4_SRR_RL_Obj_AccelX_13();
S4_SRR_RL_Obj_Mes_4_S4_SRR_RL_Obj_DistY_13();
S4_SRR_RL_Obj_Mes_4_S4_SRR_RL_Obj_RelVelY_13();
S4_SRR_RL_Obj_Mes_4_S4_SRR_RL_Obj_AccelY_13();
S4_SRR_RL_Obj_Mes_4_S4_SRR_RL_Obj_DistXStd_13();
S4_SRR_RL_Obj_Mes_4_S4_SRR_RL_Obj_RelVelXStd_13();
S4_SRR_RL_Obj_Mes_4_S4_SRR_RL_Obj_DistYStd_13();
S4_SRR_RL_Obj_Mes_4_S4_SRR_RL_Obj_RelVelYStd_13();
S4_SRR_RL_Obj_Mes_4_S4_SRR_RL_Obj_UpdateFlag_13();
S4_SRR_RL_Obj_Mes_4_S4_SRR_RL_Obj_ExistProb_13();
S4_SRR_RL_Obj_Mes_4_S4_SRR_RL_Obj_Type_13();
S4_SRR_RL_Obj_Mes_4_S4_SRR_RL_Obj_EDynProp_13();
S4_SRR_RL_Obj_Mes_4_S4_SRR_RL_Obj_UiLifeCycles_13();
S4_SRR_RL_Obj_Mes_4_S4_SRR_RL_Obj_ID_14();
S4_SRR_RL_Obj_Mes_4_S4_SRR_RL_Obj_DistX_14();
S4_SRR_RL_Obj_Mes_4_S4_SRR_RL_Obj_RelVelX_14();
S4_SRR_RL_Obj_Mes_4_S4_SRR_RL_Obj_AccelX_14();
S4_SRR_RL_Obj_Mes_4_S4_SRR_RL_Obj_DistY_14();
S4_SRR_RL_Obj_Mes_4_S4_SRR_RL_Obj_RelVelY_14();
S4_SRR_RL_Obj_Mes_4_S4_SRR_RL_Obj_AccelY_14();
S4_SRR_RL_Obj_Mes_4_S4_SRR_RL_Obj_DistXStd_14();
S4_SRR_RL_Obj_Mes_4_S4_SRR_RL_Obj_RelVelXStd_14();
S4_SRR_RL_Obj_Mes_4_S4_SRR_RL_Obj_DistYStd_14();
S4_SRR_RL_Obj_Mes_4_S4_SRR_RL_Obj_RelVelYStd_14();
S4_SRR_RL_Obj_Mes_4_S4_SRR_RL_Obj_UpdateFlag_14();
S4_SRR_RL_Obj_Mes_4_S4_SRR_RL_Obj_ExistProb_14();
S4_SRR_RL_Obj_Mes_4_S4_SRR_RL_Obj_Type_14();
S4_SRR_RL_Obj_Mes_4_S4_SRR_RL_Obj_EDynProp_14();
S4_SRR_RL_Obj_Mes_4_S4_SRR_RL_Obj_UiLifeCycles_14();
S4_SRR_RL_Obj_Mes_5_S4_SRR_RL_Obj_ID_15();
S4_SRR_RL_Obj_Mes_5_S4_SRR_RL_Obj_DistX_15();
S4_SRR_RL_Obj_Mes_5_S4_SRR_RL_Obj_RelVelX_15();
S4_SRR_RL_Obj_Mes_5_S4_SRR_RL_Obj_AccelX_15();
S4_SRR_RL_Obj_Mes_5_S4_SRR_RL_Obj_DistY_15();
S4_SRR_RL_Obj_Mes_5_S4_SRR_RL_Obj_RelVelY_15();
S4_SRR_RL_Obj_Mes_5_S4_SRR_RL_Obj_AccelY_15();
S4_SRR_RL_Obj_Mes_5_S4_SRR_RL_Obj_DistXStd_15();
S4_SRR_RL_Obj_Mes_5_S4_SRR_RL_Obj_RelVelXStd_15();
S4_SRR_RL_Obj_Mes_5_S4_SRR_RL_Obj_DistYStd_15();
S4_SRR_RL_Obj_Mes_5_S4_SRR_RL_Obj_RelVelYStd_15();
S4_SRR_RL_Obj_Mes_5_S4_SRR_RL_Obj_UpdateFlag_15();
S4_SRR_RL_Obj_Mes_5_S4_SRR_RL_Obj_ExistProb_15();
S4_SRR_RL_Obj_Mes_5_S4_SRR_RL_Obj_Type_15();
S4_SRR_RL_Obj_Mes_5_S4_SRR_RL_Obj_EDynProp_15();
S4_SRR_RL_Obj_Mes_5_S4_SRR_RL_Obj_UiLifeCycles_15();
S4_SRR_RL_Obj_Mes_5_S4_SRR_RL_Obj_ID_16();
S4_SRR_RL_Obj_Mes_5_S4_SRR_RL_Obj_DistX_16();
S4_SRR_RL_Obj_Mes_5_S4_SRR_RL_Obj_RelVelX_16();
S4_SRR_RL_Obj_Mes_5_S4_SRR_RL_Obj_AccelX_16();
S4_SRR_RL_Obj_Mes_5_S4_SRR_RL_Obj_DistY_16();
S4_SRR_RL_Obj_Mes_5_S4_SRR_RL_Obj_RelVelY_16();
S4_SRR_RL_Obj_Mes_5_S4_SRR_RL_Obj_AccelY_16();
S4_SRR_RL_Obj_Mes_5_S4_SRR_RL_Obj_DistXStd_16();
S4_SRR_RL_Obj_Mes_5_S4_SRR_RL_Obj_RelVelXStd_16();
S4_SRR_RL_Obj_Mes_5_S4_SRR_RL_Obj_DistYStd_16();
S4_SRR_RL_Obj_Mes_5_S4_SRR_RL_Obj_RelVelYStd_16();
S4_SRR_RL_Obj_Mes_5_S4_SRR_RL_Obj_UpdateFlag_16();
S4_SRR_RL_Obj_Mes_5_S4_SRR_RL_Obj_ExistProb_16();
S4_SRR_RL_Obj_Mes_5_S4_SRR_RL_Obj_Type_16();
S4_SRR_RL_Obj_Mes_5_S4_SRR_RL_Obj_EDynProp_16();
S4_SRR_RL_Obj_Mes_5_S4_SRR_RL_Obj_UiLifeCycles_16();
S4_SRR_RL_Obj_Mes_5_S4_SRR_RL_Obj_ID_17();
S4_SRR_RL_Obj_Mes_5_S4_SRR_RL_Obj_DistX_17();
S4_SRR_RL_Obj_Mes_5_S4_SRR_RL_Obj_RelVelX_17();
S4_SRR_RL_Obj_Mes_5_S4_SRR_RL_Obj_AccelX_17();
S4_SRR_RL_Obj_Mes_5_S4_SRR_RL_Obj_DistY_17();
S4_SRR_RL_Obj_Mes_5_S4_SRR_RL_Obj_RelVelY_17();
S4_SRR_RL_Obj_Mes_5_S4_SRR_RL_Obj_AccelY_17();
S4_SRR_RL_Obj_Mes_5_S4_SRR_RL_Obj_DistXStd_17();
S4_SRR_RL_Obj_Mes_5_S4_SRR_RL_Obj_RelVelXStd_17();
S4_SRR_RL_Obj_Mes_5_S4_SRR_RL_Obj_DistYStd_17();
S4_SRR_RL_Obj_Mes_5_S4_SRR_RL_Obj_RelVelYStd_17();
S4_SRR_RL_Obj_Mes_5_S4_SRR_RL_Obj_UpdateFlag_17();
S4_SRR_RL_Obj_Mes_5_S4_SRR_RL_Obj_ExistProb_17();
S4_SRR_RL_Obj_Mes_5_S4_SRR_RL_Obj_Type_17();
S4_SRR_RL_Obj_Mes_5_S4_SRR_RL_Obj_EDynProp_17();
S4_SRR_RL_Obj_Mes_5_S4_SRR_RL_Obj_UiLifeCycles_17();
S4_SRR_RL_Obj_Mes_6_S4_SRR_RL_Obj_ID_18();
S4_SRR_RL_Obj_Mes_6_S4_SRR_RL_Obj_DistX_18();
S4_SRR_RL_Obj_Mes_6_S4_SRR_RL_Obj_RelVelX_18();
S4_SRR_RL_Obj_Mes_6_S4_SRR_RL_Obj_AccelX_18();
S4_SRR_RL_Obj_Mes_6_S4_SRR_RL_Obj_DistY_18();
S4_SRR_RL_Obj_Mes_6_S4_SRR_RL_Obj_RelVelY_18();
S4_SRR_RL_Obj_Mes_6_S4_SRR_RL_Obj_AccelY_18();
S4_SRR_RL_Obj_Mes_6_S4_SRR_RL_Obj_DistXStd_18();
S4_SRR_RL_Obj_Mes_6_S4_SRR_RL_Obj_RelVelXStd_18();
S4_SRR_RL_Obj_Mes_6_S4_SRR_RL_Obj_DistYStd_18();
S4_SRR_RL_Obj_Mes_6_S4_SRR_RL_Obj_RelVelYStd_18();
S4_SRR_RL_Obj_Mes_6_S4_SRR_RL_Obj_UpdateFlag_18();
S4_SRR_RL_Obj_Mes_6_S4_SRR_RL_Obj_ExistProb_18();
S4_SRR_RL_Obj_Mes_6_S4_SRR_RL_Obj_Type_18();
S4_SRR_RL_Obj_Mes_6_S4_SRR_RL_Obj_EDynProp_18();
S4_SRR_RL_Obj_Mes_6_S4_SRR_RL_Obj_UiLifeCycles_18();
S4_SRR_RL_Obj_Mes_6_S4_SRR_RL_Obj_ID_19();
S4_SRR_RL_Obj_Mes_6_S4_SRR_RL_Obj_DistX_19();
S4_SRR_RL_Obj_Mes_6_S4_SRR_RL_Obj_RelVelX_19();
S4_SRR_RL_Obj_Mes_6_S4_SRR_RL_Obj_AccelX_19();
S4_SRR_RL_Obj_Mes_6_S4_SRR_RL_Obj_DistY_19();
S4_SRR_RL_Obj_Mes_6_S4_SRR_RL_Obj_RelVelY_19();
S4_SRR_RL_Obj_Mes_6_S4_SRR_RL_Obj_AccelY_19();
S4_SRR_RL_Obj_Mes_6_S4_SRR_RL_Obj_DistXStd_19();
S4_SRR_RL_Obj_Mes_6_S4_SRR_RL_Obj_RelVelXStd_19();
S4_SRR_RL_Obj_Mes_6_S4_SRR_RL_Obj_DistYStd_19();
S4_SRR_RL_Obj_Mes_6_S4_SRR_RL_Obj_RelVelYStd_19();
S4_SRR_RL_Obj_Mes_6_S4_SRR_RL_Obj_UpdateFlag_19();
S4_SRR_RL_Obj_Mes_6_S4_SRR_RL_Obj_ExistProb_19();
S4_SRR_RL_Obj_Mes_6_S4_SRR_RL_Obj_Type_19();
S4_SRR_RL_Obj_Mes_6_S4_SRR_RL_Obj_EDynProp_19();
S4_SRR_RL_Obj_Mes_6_S4_SRR_RL_Obj_UiLifeCycles_19();
S4_SRR_RL_Obj_Mes_6_S4_SRR_RL_Obj_ID_20();
S4_SRR_RL_Obj_Mes_6_S4_SRR_RL_Obj_DistX_20();
S4_SRR_RL_Obj_Mes_6_S4_SRR_RL_Obj_RelVelX_20();
S4_SRR_RL_Obj_Mes_6_S4_SRR_RL_Obj_AccelX_20();
S4_SRR_RL_Obj_Mes_6_S4_SRR_RL_Obj_DistY_20();
S4_SRR_RL_Obj_Mes_6_S4_SRR_RL_Obj_RelVelY_20();
S4_SRR_RL_Obj_Mes_6_S4_SRR_RL_Obj_AccelY_20();
S4_SRR_RL_Obj_Mes_6_S4_SRR_RL_Obj_DistXStd_20();
S4_SRR_RL_Obj_Mes_6_S4_SRR_RL_Obj_RelVelXStd_20();
S4_SRR_RL_Obj_Mes_6_S4_SRR_RL_Obj_DistYStd_20();
S4_SRR_RL_Obj_Mes_6_S4_SRR_RL_Obj_RelVelYStd_20();
S4_SRR_RL_Obj_Mes_6_S4_SRR_RL_Obj_UpdateFlag_20();
S4_SRR_RL_Obj_Mes_6_S4_SRR_RL_Obj_ExistProb_20();
S4_SRR_RL_Obj_Mes_6_S4_SRR_RL_Obj_Type_20();
S4_SRR_RL_Obj_Mes_6_S4_SRR_RL_Obj_EDynProp_20();
S4_SRR_RL_Obj_Mes_6_S4_SRR_RL_Obj_UiLifeCycles_20();
S4_SRR_RL_Obj_Mes_7_S4_SRR_RL_Obj_ID_21();
S4_SRR_RL_Obj_Mes_7_S4_SRR_RL_Obj_DistX_21();
S4_SRR_RL_Obj_Mes_7_S4_SRR_RL_Obj_RelVelX_21();
S4_SRR_RL_Obj_Mes_7_S4_SRR_RL_Obj_AccelX_21();
S4_SRR_RL_Obj_Mes_7_S4_SRR_RL_Obj_DistY_21();
S4_SRR_RL_Obj_Mes_7_S4_SRR_RL_Obj_RelVelY_21();
S4_SRR_RL_Obj_Mes_7_S4_SRR_RL_Obj_AccelY_21();
S4_SRR_RL_Obj_Mes_7_S4_SRR_RL_Obj_DistXStd_21();
S4_SRR_RL_Obj_Mes_7_S4_SRR_RL_Obj_RelVelXStd_21();
S4_SRR_RL_Obj_Mes_7_S4_SRR_RL_Obj_DistYStd_21();
S4_SRR_RL_Obj_Mes_7_S4_SRR_RL_Obj_RelVelYStd_21();
S4_SRR_RL_Obj_Mes_7_S4_SRR_RL_Obj_UpdateFlag_21();
S4_SRR_RL_Obj_Mes_7_S4_SRR_RL_Obj_ExistProb_21();
S4_SRR_RL_Obj_Mes_7_S4_SRR_RL_Obj_Type_21();
S4_SRR_RL_Obj_Mes_7_S4_SRR_RL_Obj_EDynProp_21();
S4_SRR_RL_Obj_Mes_7_S4_SRR_RL_Obj_UiLifeCycles_21();
S4_SRR_RL_Obj_Mes_7_S4_SRR_RL_Obj_ID_22();
S4_SRR_RL_Obj_Mes_7_S4_SRR_RL_Obj_DistX_22();
S4_SRR_RL_Obj_Mes_7_S4_SRR_RL_Obj_RelVelX_22();
S4_SRR_RL_Obj_Mes_7_S4_SRR_RL_Obj_AccelX_22();
S4_SRR_RL_Obj_Mes_7_S4_SRR_RL_Obj_DistY_22();
S4_SRR_RL_Obj_Mes_7_S4_SRR_RL_Obj_RelVelY_22();
S4_SRR_RL_Obj_Mes_7_S4_SRR_RL_Obj_AccelY_22();
S4_SRR_RL_Obj_Mes_7_S4_SRR_RL_Obj_DistXStd_22();
S4_SRR_RL_Obj_Mes_7_S4_SRR_RL_Obj_RelVelXStd_22();
S4_SRR_RL_Obj_Mes_7_S4_SRR_RL_Obj_DistYStd_22();
S4_SRR_RL_Obj_Mes_7_S4_SRR_RL_Obj_RelVelYStd_22();
S4_SRR_RL_Obj_Mes_7_S4_SRR_RL_Obj_UpdateFlag_22();
S4_SRR_RL_Obj_Mes_7_S4_SRR_RL_Obj_ExistProb_22();
S4_SRR_RL_Obj_Mes_7_S4_SRR_RL_Obj_Type_22();
S4_SRR_RL_Obj_Mes_7_S4_SRR_RL_Obj_EDynProp_22();
S4_SRR_RL_Obj_Mes_7_S4_SRR_RL_Obj_UiLifeCycles_22();
S4_SRR_RL_Obj_Mes_7_S4_SRR_RL_Obj_ID_23();
S4_SRR_RL_Obj_Mes_7_S4_SRR_RL_Obj_DistX_23();
S4_SRR_RL_Obj_Mes_7_S4_SRR_RL_Obj_RelVelX_23();
S4_SRR_RL_Obj_Mes_7_S4_SRR_RL_Obj_AccelX_23();
S4_SRR_RL_Obj_Mes_7_S4_SRR_RL_Obj_DistY_23();
S4_SRR_RL_Obj_Mes_7_S4_SRR_RL_Obj_RelVelY_23();
S4_SRR_RL_Obj_Mes_7_S4_SRR_RL_Obj_AccelY_23();
S4_SRR_RL_Obj_Mes_7_S4_SRR_RL_Obj_DistXStd_23();
S4_SRR_RL_Obj_Mes_7_S4_SRR_RL_Obj_RelVelXStd_23();
S4_SRR_RL_Obj_Mes_7_S4_SRR_RL_Obj_DistYStd_23();
S4_SRR_RL_Obj_Mes_7_S4_SRR_RL_Obj_RelVelYStd_23();
S4_SRR_RL_Obj_Mes_7_S4_SRR_RL_Obj_UpdateFlag_23();
S4_SRR_RL_Obj_Mes_7_S4_SRR_RL_Obj_ExistProb_23();
S4_SRR_RL_Obj_Mes_7_S4_SRR_RL_Obj_Type_23();
S4_SRR_RL_Obj_Mes_7_S4_SRR_RL_Obj_EDynProp_23();
S4_SRR_RL_Obj_Mes_7_S4_SRR_RL_Obj_UiLifeCycles_23();
S4_SRR_RL_Obj_Mes_8_S4_SRR_RL_Obj_ID_24();
S4_SRR_RL_Obj_Mes_8_S4_SRR_RL_Obj_DistX_24();
S4_SRR_RL_Obj_Mes_8_S4_SRR_RL_Obj_RelVelX_24();
S4_SRR_RL_Obj_Mes_8_S4_SRR_RL_Obj_AccelX_24();
S4_SRR_RL_Obj_Mes_8_S4_SRR_RL_Obj_DistY_24();
S4_SRR_RL_Obj_Mes_8_S4_SRR_RL_Obj_RelVelY_24();
S4_SRR_RL_Obj_Mes_8_S4_SRR_RL_Obj_AccelY_24();
S4_SRR_RL_Obj_Mes_8_S4_SRR_RL_Obj_DistXStd_24();
S4_SRR_RL_Obj_Mes_8_S4_SRR_RL_Obj_RelVelXStd_24();
S4_SRR_RL_Obj_Mes_8_S4_SRR_RL_Obj_DistYStd_24();
S4_SRR_RL_Obj_Mes_8_S4_SRR_RL_Obj_RelVelYStd_24();
S4_SRR_RL_Obj_Mes_8_S4_SRR_RL_Obj_UpdateFlag_24();
S4_SRR_RL_Obj_Mes_8_S4_SRR_RL_Obj_ExistProb_24();
S4_SRR_RL_Obj_Mes_8_S4_SRR_RL_Obj_Type_24();
S4_SRR_RL_Obj_Mes_8_S4_SRR_RL_Obj_EDynProp_24();
S4_SRR_RL_Obj_Mes_8_S4_SRR_RL_Obj_UiLifeCycles_24();
S4_SRR_RL_Obj_Mes_8_S4_SRR_RL_Obj_ID_25();
S4_SRR_RL_Obj_Mes_8_S4_SRR_RL_Obj_DistX_25();
S4_SRR_RL_Obj_Mes_8_S4_SRR_RL_Obj_RelVelX_25();
S4_SRR_RL_Obj_Mes_8_S4_SRR_RL_Obj_AccelX_25();
S4_SRR_RL_Obj_Mes_8_S4_SRR_RL_Obj_DistY_25();
S4_SRR_RL_Obj_Mes_8_S4_SRR_RL_Obj_RelVelY_25();
S4_SRR_RL_Obj_Mes_8_S4_SRR_RL_Obj_AccelY_25();
S4_SRR_RL_Obj_Mes_8_S4_SRR_RL_Obj_DistXStd_25();
S4_SRR_RL_Obj_Mes_8_S4_SRR_RL_Obj_RelVelXStd_25();
S4_SRR_RL_Obj_Mes_8_S4_SRR_RL_Obj_DistYStd_25();
S4_SRR_RL_Obj_Mes_8_S4_SRR_RL_Obj_RelVelYStd_25();
S4_SRR_RL_Obj_Mes_8_S4_SRR_RL_Obj_UpdateFlag_25();
S4_SRR_RL_Obj_Mes_8_S4_SRR_RL_Obj_ExistProb_25();
S4_SRR_RL_Obj_Mes_8_S4_SRR_RL_Obj_Type_25();
S4_SRR_RL_Obj_Mes_8_S4_SRR_RL_Obj_EDynProp_25();
S4_SRR_RL_Obj_Mes_8_S4_SRR_RL_Obj_UiLifeCycles_25();
S4_SRR_RL_Obj_Mes_8_S4_SRR_RL_Obj_ID_26();
S4_SRR_RL_Obj_Mes_8_S4_SRR_RL_Obj_DistX_26();
S4_SRR_RL_Obj_Mes_8_S4_SRR_RL_Obj_RelVelX_26();
S4_SRR_RL_Obj_Mes_8_S4_SRR_RL_Obj_AccelX_26();
S4_SRR_RL_Obj_Mes_8_S4_SRR_RL_Obj_DistY_26();
S4_SRR_RL_Obj_Mes_8_S4_SRR_RL_Obj_RelVelY_26();
S4_SRR_RL_Obj_Mes_8_S4_SRR_RL_Obj_AccelY_26();
S4_SRR_RL_Obj_Mes_8_S4_SRR_RL_Obj_DistXStd_26();
S4_SRR_RL_Obj_Mes_8_S4_SRR_RL_Obj_RelVelXStd_26();
S4_SRR_RL_Obj_Mes_8_S4_SRR_RL_Obj_DistYStd_26();
S4_SRR_RL_Obj_Mes_8_S4_SRR_RL_Obj_RelVelYStd_26();
S4_SRR_RL_Obj_Mes_8_S4_SRR_RL_Obj_UpdateFlag_26();
S4_SRR_RL_Obj_Mes_8_S4_SRR_RL_Obj_ExistProb_26();
S4_SRR_RL_Obj_Mes_8_S4_SRR_RL_Obj_Type_26();
S4_SRR_RL_Obj_Mes_8_S4_SRR_RL_Obj_EDynProp_26();
S4_SRR_RL_Obj_Mes_8_S4_SRR_RL_Obj_UiLifeCycles_26();
S4_SRR_RL_Obj_Mes_9_S4_SRR_RL_Obj_ID_27();
S4_SRR_RL_Obj_Mes_9_S4_SRR_RL_Obj_DistX_27();
S4_SRR_RL_Obj_Mes_9_S4_SRR_RL_Obj_RelVelX_27();
S4_SRR_RL_Obj_Mes_9_S4_SRR_RL_Obj_AccelX_27();
S4_SRR_RL_Obj_Mes_9_S4_SRR_RL_Obj_DistY_27();
S4_SRR_RL_Obj_Mes_9_S4_SRR_RL_Obj_RelVelY_27();
S4_SRR_RL_Obj_Mes_9_S4_SRR_RL_Obj_AccelY_27();
S4_SRR_RL_Obj_Mes_9_S4_SRR_RL_Obj_DistXStd_27();
S4_SRR_RL_Obj_Mes_9_S4_SRR_RL_Obj_RelVelXStd_27();
S4_SRR_RL_Obj_Mes_9_S4_SRR_RL_Obj_DistYStd_27();
S4_SRR_RL_Obj_Mes_9_S4_SRR_RL_Obj_RelVelYStd_27();
S4_SRR_RL_Obj_Mes_9_S4_SRR_RL_Obj_UpdateFlag_27();
S4_SRR_RL_Obj_Mes_9_S4_SRR_RL_Obj_ExistProb_27();
S4_SRR_RL_Obj_Mes_9_S4_SRR_RL_Obj_Type_27();
S4_SRR_RL_Obj_Mes_9_S4_SRR_RL_Obj_EDynProp_27();
S4_SRR_RL_Obj_Mes_9_S4_SRR_RL_Obj_UiLifeCycles_27();
S4_SRR_RL_Obj_Mes_9_S4_SRR_RL_Obj_ID_28();
S4_SRR_RL_Obj_Mes_9_S4_SRR_RL_Obj_DistX_28();
S4_SRR_RL_Obj_Mes_9_S4_SRR_RL_Obj_RelVelX_28();
S4_SRR_RL_Obj_Mes_9_S4_SRR_RL_Obj_AccelX_28();
S4_SRR_RL_Obj_Mes_9_S4_SRR_RL_Obj_DistY_28();
S4_SRR_RL_Obj_Mes_9_S4_SRR_RL_Obj_RelVelY_28();
S4_SRR_RL_Obj_Mes_9_S4_SRR_RL_Obj_AccelY_28();
S4_SRR_RL_Obj_Mes_9_S4_SRR_RL_Obj_DistXStd_28();
S4_SRR_RL_Obj_Mes_9_S4_SRR_RL_Obj_RelVelXStd_28();
S4_SRR_RL_Obj_Mes_9_S4_SRR_RL_Obj_DistYStd_28();
S4_SRR_RL_Obj_Mes_9_S4_SRR_RL_Obj_RelVelYStd_28();
S4_SRR_RL_Obj_Mes_9_S4_SRR_RL_Obj_UpdateFlag_28();
S4_SRR_RL_Obj_Mes_9_S4_SRR_RL_Obj_ExistProb_28();
S4_SRR_RL_Obj_Mes_9_S4_SRR_RL_Obj_Type_28();
S4_SRR_RL_Obj_Mes_9_S4_SRR_RL_Obj_EDynProp_28();
S4_SRR_RL_Obj_Mes_9_S4_SRR_RL_Obj_UiLifeCycles_28();
S4_SRR_RL_Obj_Mes_9_S4_SRR_RL_Obj_ID_29();
S4_SRR_RL_Obj_Mes_9_S4_SRR_RL_Obj_DistX_29();
S4_SRR_RL_Obj_Mes_9_S4_SRR_RL_Obj_RelVelX_29();
S4_SRR_RL_Obj_Mes_9_S4_SRR_RL_Obj_AccelX_29();
S4_SRR_RL_Obj_Mes_9_S4_SRR_RL_Obj_DistY_29();
S4_SRR_RL_Obj_Mes_9_S4_SRR_RL_Obj_RelVelY_29();
S4_SRR_RL_Obj_Mes_9_S4_SRR_RL_Obj_AccelY_29();
S4_SRR_RL_Obj_Mes_9_S4_SRR_RL_Obj_DistXStd_29();
S4_SRR_RL_Obj_Mes_9_S4_SRR_RL_Obj_RelVelXStd_29();
S4_SRR_RL_Obj_Mes_9_S4_SRR_RL_Obj_DistYStd_29();
S4_SRR_RL_Obj_Mes_9_S4_SRR_RL_Obj_RelVelYStd_29();
S4_SRR_RL_Obj_Mes_9_S4_SRR_RL_Obj_UpdateFlag_29();
S4_SRR_RL_Obj_Mes_9_S4_SRR_RL_Obj_ExistProb_29();
S4_SRR_RL_Obj_Mes_9_S4_SRR_RL_Obj_Type_29();
S4_SRR_RL_Obj_Mes_9_S4_SRR_RL_Obj_EDynProp_29();
S4_SRR_RL_Obj_Mes_9_S4_SRR_RL_Obj_UiLifeCycles_29();
S4_SRR_RL_Obj_Mes_10_S4_SRR_RL_Obj_ID_30();
S4_SRR_RL_Obj_Mes_10_S4_SRR_RL_Obj_DistX_30();
S4_SRR_RL_Obj_Mes_10_S4_SRR_RL_Obj_RelVelX_30();
S4_SRR_RL_Obj_Mes_10_S4_SRR_RL_Obj_AccelX_30();
S4_SRR_RL_Obj_Mes_10_S4_SRR_RL_Obj_DistY_30();
S4_SRR_RL_Obj_Mes_10_S4_SRR_RL_Obj_RelVelY_30();
S4_SRR_RL_Obj_Mes_10_S4_SRR_RL_Obj_AccelY_30();
S4_SRR_RL_Obj_Mes_10_S4_SRR_RL_Obj_DistXStd_30();
S4_SRR_RL_Obj_Mes_10_S4_SRR_RL_Obj_RelVelXStd_30();
S4_SRR_RL_Obj_Mes_10_S4_SRR_RL_Obj_DistYStd_30();
S4_SRR_RL_Obj_Mes_10_S4_SRR_RL_Obj_RelVelYStd_30();
S4_SRR_RL_Obj_Mes_10_S4_SRR_RL_Obj_UpdateFlag_30();
S4_SRR_RL_Obj_Mes_10_S4_SRR_RL_Obj_ExistProb_30();
S4_SRR_RL_Obj_Mes_10_S4_SRR_RL_Obj_Type_30();
S4_SRR_RL_Obj_Mes_10_S4_SRR_RL_Obj_EDynProp_30();
S4_SRR_RL_Obj_Mes_10_S4_SRR_RL_Obj_UiLifeCycles_30();
S4_SRR_RL_Obj_Mes_10_S4_SRR_RL_Obj_ID_31();
S4_SRR_RL_Obj_Mes_10_S4_SRR_RL_Obj_DistX_31();
S4_SRR_RL_Obj_Mes_10_S4_SRR_RL_Obj_RelVelX_31();
S4_SRR_RL_Obj_Mes_10_S4_SRR_RL_Obj_AccelX_31();
S4_SRR_RL_Obj_Mes_10_S4_SRR_RL_Obj_DistY_31();
S4_SRR_RL_Obj_Mes_10_S4_SRR_RL_Obj_RelVelY_31();
S4_SRR_RL_Obj_Mes_10_S4_SRR_RL_Obj_AccelY_31();
S4_SRR_RL_Obj_Mes_10_S4_SRR_RL_Obj_DistXStd_31();
S4_SRR_RL_Obj_Mes_10_S4_SRR_RL_Obj_RelVelXStd_31();
S4_SRR_RL_Obj_Mes_10_S4_SRR_RL_Obj_DistYStd_31();
S4_SRR_RL_Obj_Mes_10_S4_SRR_RL_Obj_RelVelYStd_31();
S4_SRR_RL_Obj_Mes_10_S4_SRR_RL_Obj_UpdateFlag_31();
S4_SRR_RL_Obj_Mes_10_S4_SRR_RL_Obj_ExistProb_31();
S4_SRR_RL_Obj_Mes_10_S4_SRR_RL_Obj_Type_31();
S4_SRR_RL_Obj_Mes_10_S4_SRR_RL_Obj_EDynProp_31();
S4_SRR_RL_Obj_Mes_10_S4_SRR_RL_Obj_UiLifeCycles_31();
  
}