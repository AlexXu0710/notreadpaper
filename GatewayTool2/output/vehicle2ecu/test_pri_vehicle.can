/*@!Encoding:1252*/
includes
{
  
}

variables
{
  
float signalvalue1;
  
}



MainTest()
{

  
}