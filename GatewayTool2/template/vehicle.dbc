VERSION "2023_6_12_103836"

NS_ :

BS_:

BU_: XPU SRR_RL Tester
BO_ 601 S4_SRR_RL_Clu_Mes_16: 64 SRR_RL
 SG_ S4_SRR_RL_Clu_ID_112 : 7|8@0+ (1,0) [0|199] "" Vector__XXX
 SG_ S4_SRR_RL_Clu_Theta_112 : 15|9@0+ (0.0062,-1.571) [-1.571|1.5972] "rad" Vector__XXX
 SG_ S4_SRR_RL_Clu_Dist_112 : 22|12@0+ (0.1,0.4) [0.4|300] "m" Vector__XXX
 SG_ S4_SRR_RL_Clu_Vel_112 : 26|11@0+ (0.1,-111.11) [-111.11|55.59] "mps" Vector__XXX
 SG_ S4_SRR_RL_Clu_SNR_112 : 47|7@0+ (0.5,0) [0|63.5] "dB" Vector__XXX
 SG_ S4_SRR_RL_Clu_RCS_112 : 40|5@0+ (2,-40) [-40|22] "" Vector__XXX
 SG_ S4_SRR_RL_Clu_DynProp_112 : 51|1@0+ (1,0) [0|1] "Unitless" Vector__XXX
 SG_ S4_SRR_RL_Clu_Locationvalid_112 : 50|1@0+ (1,0) [0|1] "" Vector__XXX
 SG_ S4_SRR_RL_Clu_ID_113 : 59|8@0+ (1,0) [0|199] "" Vector__XXX
 SG_ S4_SRR_RL_Clu_Theta_113 : 67|9@0+ (0.0062,-1.571) [-1.571|1.5972] "rad" Vector__XXX
 SG_ S4_SRR_RL_Clu_Dist_113 : 74|12@0+ (0.1,0.4) [0.4|300] "m" Vector__XXX
 SG_ S4_SRR_RL_Clu_Vel_113 : 94|11@0+ (0.1,-111.11) [-111.11|55.59] "mps" Vector__XXX
 SG_ S4_SRR_RL_Clu_SNR_113 : 99|7@0+ (0.5,0) [0|63.5] "dB" Vector__XXX
 SG_ S4_SRR_RL_Clu_RCS_113 : 108|5@0+ (2,-40) [-40|22] "" Vector__XXX
 SG_ S4_SRR_RL_Clu_DynProp_113 : 119|1@0+ (1,0) [0|1] "Unitless" Vector__XXX
 SG_ S4_SRR_RL_Clu_Locationvalid_113 : 118|1@0+ (1,0) [0|1] "" Vector__XXX
 SG_ S4_SRR_RL_Clu_ID_114 : 127|8@0+ (1,0) [0|199] "" Vector__XXX
 SG_ S4_SRR_RL_Clu_Theta_114 : 135|9@0+ (0.0062,-1.571) [-1.571|1.5972] "rad" Vector__XXX
 SG_ S4_SRR_RL_Clu_Dist_114 : 142|12@0+ (0.1,0.4) [0.4|300] "m" Vector__XXX
 SG_ S4_SRR_RL_Clu_Vel_114 : 146|11@0+ (0.1,-111.11) [-111.11|55.59] "mps" Vector__XXX
 SG_ S4_SRR_RL_Clu_SNR_114 : 167|7@0+ (0.5,0) [0|63.5] "dB" Vector__XXX
 SG_ S4_SRR_RL_Clu_RCS_114 : 160|5@0+ (2,-40) [-40|22] "" Vector__XXX
 SG_ S4_SRR_RL_Clu_DynProp_114 : 171|1@0+ (1,0) [0|1] "Unitless" Vector__XXX
 SG_ S4_SRR_RL_Clu_Locationvalid_114 : 170|1@0+ (1,0) [0|1] "" Vector__XXX
 SG_ S4_SRR_RL_Clu_ID_115 : 179|8@0+ (1,0) [0|199] "" Vector__XXX
 SG_ S4_SRR_RL_Clu_Theta_115 : 187|9@0+ (0.0062,-1.571) [-1.571|1.5972] "rad" Vector__XXX
 SG_ S4_SRR_RL_Clu_Dist_115 : 194|12@0+ (0.1,0.4) [0.4|300] "m" Vector__XXX
 SG_ S4_SRR_RL_Clu_Vel_115 : 214|11@0+ (0.1,-111.11) [-111.11|55.59] "mps" Vector__XXX
 SG_ S4_SRR_RL_Clu_SNR_115 : 219|7@0+ (0.5,0) [0|63.5] "dB" Vector__XXX
 SG_ S4_SRR_RL_Clu_RCS_115 : 228|5@0+ (2,-40) [-40|22] "" Vector__XXX
 SG_ S4_SRR_RL_Clu_DynProp_115 : 239|1@0+ (1,0) [0|1] "Unitless" Vector__XXX
 SG_ S4_SRR_RL_Clu_Locationvalid_115 : 238|1@0+ (1,0) [0|1] "" Vector__XXX
 SG_ S4_SRR_RL_Clu_ID_116 : 247|8@0+ (1,0) [0|199] "" Vector__XXX
 SG_ S4_SRR_RL_Clu_Theta_116 : 255|9@0+ (0.0062,-1.571) [-1.571|1.5972] "rad" Vector__XXX
 SG_ S4_SRR_RL_Clu_Dist_116 : 262|12@0+ (0.1,0.4) [0.4|300] "m" Vector__XXX
 SG_ S4_SRR_RL_Clu_Vel_116 : 266|11@0+ (0.1,-111.11) [-111.11|55.59] "mps" Vector__XXX
 SG_ S4_SRR_RL_Clu_SNR_116 : 287|7@0+ (0.5,0) [0|63.5] "dB" Vector__XXX
 SG_ S4_SRR_RL_Clu_RCS_116 : 280|5@0+ (2,-40) [-40|22] "" Vector__XXX
 SG_ S4_SRR_RL_Clu_DynProp_116 : 291|1@0+ (1,0) [0|1] "Unitless" Vector__XXX
 SG_ S4_SRR_RL_Clu_Locationvalid_116 : 290|1@0+ (1,0) [0|1] "" Vector__XXX
 SG_ S4_SRR_RL_Clu_ID_117 : 299|8@0+ (1,0) [0|199] "" Vector__XXX
 SG_ S4_SRR_RL_Clu_Theta_117 : 307|9@0+ (0.0062,-1.571) [-1.571|1.5972] "rad" Vector__XXX
 SG_ S4_SRR_RL_Clu_Dist_117 : 314|12@0+ (0.1,0.4) [0.4|300] "m" Vector__XXX
 SG_ S4_SRR_RL_Clu_Vel_117 : 334|11@0+ (0.1,-111.11) [-111.11|55.59] "mps" Vector__XXX
 SG_ S4_SRR_RL_Clu_SNR_117 : 339|7@0+ (0.5,0) [0|63.5] "dB" Vector__XXX
 SG_ S4_SRR_RL_Clu_RCS_117 : 348|5@0+ (2,-40) [-40|22] "" Vector__XXX
 SG_ S4_SRR_RL_Clu_DynProp_117 : 359|1@0+ (1,0) [0|1] "Unitless" Vector__XXX
 SG_ S4_SRR_RL_Clu_Locationvalid_117 : 358|1@0+ (1,0) [0|1] "" Vector__XXX
 SG_ S4_SRR_RL_Clu_ID_118 : 367|8@0+ (1,0) [0|199] "" Vector__XXX
 SG_ S4_SRR_RL_Clu_Theta_118 : 375|9@0+ (0.0062,-1.571) [-1.571|1.5972] "rad" Vector__XXX
 SG_ S4_SRR_RL_Clu_Dist_118 : 382|12@0+ (0.1,0.4) [0.4|300] "m" Vector__XXX
 SG_ S4_SRR_RL_Clu_Vel_118 : 386|11@0+ (0.1,-111.11) [-111.11|55.59] "mps" Vector__XXX
 SG_ S4_SRR_RL_Clu_SNR_118 : 407|7@0+ (0.5,0) [0|63.5] "dB" Vector__XXX
 SG_ S4_SRR_RL_Clu_RCS_118 : 400|5@0+ (2,-40) [-40|22] "" Vector__XXX
 SG_ S4_SRR_RL_Clu_DynProp_118 : 411|1@0+ (1,0) [0|1] "Unitless" Vector__XXX
 SG_ S4_SRR_RL_Clu_Locationvalid_118 : 410|1@0+ (1,0) [0|1] "" Vector__XXX
 SG_ S4_SRR_RL_Clu_Mes_16_blockcounter : 503|4@0+ (1,0) [0|15] "" Vector__XXX
 SG_ S4_SRR_RL_Clu_16_MsgCounter : 499|4@0+ (1,0) [0|14] "" Vector__XXX
 SG_ S4_SRR_RL_Clu_16_E2EChecksum : 511|8@0+ (1,0) [0|255] "" Vector__XXX

BO_ 603 S4_SRR_RL_Clu_Mes_17: 64 SRR_RL
 SG_ S4_SRR_RL_Clu_ID_119 : 7|8@0+ (1,0) [0|199] "" Vector__XXX
 SG_ S4_SRR_RL_Clu_Theta_119 : 15|9@0+ (0.0062,-1.571) [-1.571|1.5972] "rad" Vector__XXX
 SG_ S4_SRR_RL_Clu_Dist_119 : 22|12@0+ (0.1,0.4) [0.4|300] "m" Vector__XXX
 SG_ S4_SRR_RL_Clu_Vel_119 : 26|11@0+ (0.1,-111.11) [-111.11|55.59] "mps" Vector__XXX
 SG_ S4_SRR_RL_Clu_SNR_119 : 47|7@0+ (0.5,0) [0|63.5] "dB" Vector__XXX
 SG_ S4_SRR_RL_Clu_RCS_119 : 40|5@0+ (2,-40) [-40|22] "" Vector__XXX
 SG_ S4_SRR_RL_Clu_DynProp_119 : 51|1@0+ (1,0) [0|1] "Unitless" Vector__XXX
 SG_ S4_SRR_RL_Clu_Locationvalid_119 : 50|1@0+ (1,0) [0|1] "" Vector__XXX
 SG_ S4_SRR_RL_Clu_ID_120 : 59|8@0+ (1,0) [0|199] "" Vector__XXX
 SG_ S4_SRR_RL_Clu_Theta_120 : 67|9@0+ (0.0062,-1.571) [-1.571|1.5972] "rad" Vector__XXX
 SG_ S4_SRR_RL_Clu_Dist_120 : 74|12@0+ (0.1,0.4) [0.4|300] "m" Vector__XXX
 SG_ S4_SRR_RL_Clu_Vel_120 : 94|11@0+ (0.1,-111.11) [-111.11|55.59] "mps" Vector__XXX
 SG_ S4_SRR_RL_Clu_SNR_120 : 99|7@0+ (0.5,0) [0|63.5] "dB" Vector__XXX
 SG_ S4_SRR_RL_Clu_RCS_120 : 108|5@0+ (2,-40) [-40|22] "" Vector__XXX
 SG_ S4_SRR_RL_Clu_DynProp_120 : 119|1@0+ (1,0) [0|1] "Unitless" Vector__XXX
 SG_ S4_SRR_RL_Clu_Locationvalid_120 : 118|1@0+ (1,0) [0|1] "" Vector__XXX
 SG_ S4_SRR_RL_Clu_ID_121 : 127|8@0+ (1,0) [0|199] "" Vector__XXX
 SG_ S4_SRR_RL_Clu_Theta_121 : 135|9@0+ (0.0062,-1.571) [-1.571|1.5972] "rad" Vector__XXX
 SG_ S4_SRR_RL_Clu_Dist_121 : 142|12@0+ (0.1,0.4) [0.4|300] "m" Vector__XXX
 SG_ S4_SRR_RL_Clu_Vel_121 : 146|11@0+ (0.1,-111.11) [-111.11|55.59] "mps" Vector__XXX
 SG_ S4_SRR_RL_Clu_SNR_121 : 167|7@0+ (0.5,0) [0|63.5] "dB" Vector__XXX
 SG_ S4_SRR_RL_Clu_RCS_121 : 160|5@0+ (2,-40) [-40|22] "" Vector__XXX
 SG_ S4_SRR_RL_Clu_DynProp_121 : 171|1@0+ (1,0) [0|1] "Unitless" Vector__XXX
 SG_ S4_SRR_RL_Clu_Locationvalid_121 : 170|1@0+ (1,0) [0|1] "" Vector__XXX
 SG_ S4_SRR_RL_Clu_ID_122 : 179|8@0+ (1,0) [0|199] "" Vector__XXX
 SG_ S4_SRR_RL_Clu_Theta_122 : 187|9@0+ (0.0062,-1.571) [-1.571|1.5972] "rad" Vector__XXX
 SG_ S4_SRR_RL_Clu_Dist_122 : 194|12@0+ (0.1,0.4) [0.4|300] "m" Vector__XXX
 SG_ S4_SRR_RL_Clu_Vel_122 : 214|11@0+ (0.1,-111.11) [-111.11|55.59] "mps" Vector__XXX
 SG_ S4_SRR_RL_Clu_SNR_122 : 219|7@0+ (0.5,0) [0|63.5] "dB" Vector__XXX
 SG_ S4_SRR_RL_Clu_RCS_122 : 228|5@0+ (2,-40) [-40|22] "" Vector__XXX
 SG_ S4_SRR_RL_Clu_DynProp_122 : 239|1@0+ (1,0) [0|1] "Unitless" Vector__XXX
 SG_ S4_SRR_RL_Clu_Locationvalid_122 : 238|1@0+ (1,0) [0|1] "" Vector__XXX
 SG_ S4_SRR_RL_Clu_ID_123 : 247|8@0+ (1,0) [0|199] "" Vector__XXX
 SG_ S4_SRR_RL_Clu_Theta_123 : 255|9@0+ (0.0062,-1.571) [-1.571|1.5972] "rad" Vector__XXX
 SG_ S4_SRR_RL_Clu_Dist_123 : 262|12@0+ (0.1,0.4) [0.4|300] "m" Vector__XXX
 SG_ S4_SRR_RL_Clu_Vel_123 : 266|11@0+ (0.1,-111.11) [-111.11|55.59] "mps" Vector__XXX
 SG_ S4_SRR_RL_Clu_SNR_123 : 287|7@0+ (0.5,0) [0|63.5] "dB" Vector__XXX
 SG_ S4_SRR_RL_Clu_RCS_123 : 280|5@0+ (2,-40) [-40|22] "" Vector__XXX
 SG_ S4_SRR_RL_Clu_DynProp_123 : 291|1@0+ (1,0) [0|1] "Unitless" Vector__XXX
 SG_ S4_SRR_RL_Clu_Locationvalid_123 : 290|1@0+ (1,0) [0|1] "" Vector__XXX
 SG_ S4_SRR_RL_Clu_ID_124 : 299|8@0+ (1,0) [0|199] "" Vector__XXX
 SG_ S4_SRR_RL_Clu_Theta_124 : 307|9@0+ (0.0062,-1.571) [-1.571|1.5972] "rad" Vector__XXX
 SG_ S4_SRR_RL_Clu_Dist_124 : 314|12@0+ (0.1,0.4) [0.4|300] "m" Vector__XXX
 SG_ S4_SRR_RL_Clu_Vel_124 : 334|11@0+ (0.1,-111.11) [-111.11|55.59] "mps" Vector__XXX
 SG_ S4_SRR_RL_Clu_SNR_124 : 339|7@0+ (0.5,0) [0|63.5] "dB" Vector__XXX
 SG_ S4_SRR_RL_Clu_RCS_124 : 348|5@0+ (2,-40) [-40|22] "" Vector__XXX
 SG_ S4_SRR_RL_Clu_DynProp_124 : 359|1@0+ (1,0) [0|1] "Unitless" Vector__XXX
 SG_ S4_SRR_RL_Clu_Locationvalid_124 : 358|1@0+ (1,0) [0|1] "" Vector__XXX
 SG_ S4_SRR_RL_Clu_ID_125 : 367|8@0+ (1,0) [0|199] "" Vector__XXX
 SG_ S4_SRR_RL_Clu_Theta_125 : 375|9@0+ (0.0062,-1.571) [-1.571|1.5972] "rad" Vector__XXX
 SG_ S4_SRR_RL_Clu_Dist_125 : 382|12@0+ (0.1,0.4) [0.4|300] "m" Vector__XXX
 SG_ S4_SRR_RL_Clu_Vel_125 : 386|11@0+ (0.1,-111.11) [-111.11|55.59] "mps" Vector__XXX
 SG_ S4_SRR_RL_Clu_SNR_125 : 407|7@0+ (0.5,0) [0|63.5] "dB" Vector__XXX
 SG_ S4_SRR_RL_Clu_RCS_125 : 400|5@0+ (2,-40) [-40|22] "" Vector__XXX
 SG_ S4_SRR_RL_Clu_DynProp_125 : 411|1@0+ (1,0) [0|1] "Unitless" Vector__XXX
 SG_ S4_SRR_RL_Clu_Locationvalid_125 : 410|1@0+ (1,0) [0|1] "" Vector__XXX
 SG_ S4_SRR_RL_Clu_Mes_17_blockcounter : 503|4@0+ (1,0) [0|15] "" Vector__XXX
 SG_ S4_SRR_RL_Clu_17_MsgCounter : 499|4@0+ (1,0) [0|14] "" Vector__XXX
 SG_ S4_SRR_RL_Clu_17_E2EChecksum : 511|8@0+ (1,0) [0|255] "" Vector__XXX

BO_ 604 S4_SRR_RL_Clu_Mes_18: 64 SRR_RL
 SG_ S4_SRR_RL_Clu_ID_126 : 7|8@0+ (1,0) [0|199] "" Vector__XXX
 SG_ S4_SRR_RL_Clu_Theta_126 : 15|9@0+ (0.0062,-1.571) [-1.571|1.5972] "rad" Vector__XXX
 SG_ S4_SRR_RL_Clu_Dist_126 : 22|12@0+ (0.1,0.4) [0.4|300] "m" Vector__XXX
 SG_ S4_SRR_RL_Clu_Vel_126 : 26|11@0+ (0.1,-111.11) [-111.11|55.59] "mps" Vector__XXX
 SG_ S4_SRR_RL_Clu_SNR_126 : 47|7@0+ (0.5,0) [0|63.5] "dB" Vector__XXX
 SG_ S4_SRR_RL_Clu_RCS_126 : 40|5@0+ (2,-40) [-40|22] "" Vector__XXX
 SG_ S4_SRR_RL_Clu_DynProp_126 : 51|1@0+ (1,0) [0|1] "Unitless" Vector__XXX
 SG_ S4_SRR_RL_Clu_Locationvalid_126 : 50|1@0+ (1,0) [0|1] "" Vector__XXX
 SG_ S4_SRR_RL_Clu_ID_127 : 59|8@0+ (1,0) [0|199] "" Vector__XXX
 SG_ S4_SRR_RL_Clu_Theta_127 : 67|9@0+ (0.0062,-1.571) [-1.571|1.5972] "rad" Vector__XXX
 SG_ S4_SRR_RL_Clu_Dist_127 : 74|12@0+ (0.1,0.4) [0.4|300] "m" Vector__XXX
 SG_ S4_SRR_RL_Clu_Vel_127 : 94|11@0+ (0.1,-111.11) [-111.11|55.59] "mps" Vector__XXX
 SG_ S4_SRR_RL_Clu_SNR_127 : 99|7@0+ (0.5,0) [0|63.5] "dB" Vector__XXX
 SG_ S4_SRR_RL_Clu_RCS_127 : 108|5@0+ (2,-40) [-40|22] "" Vector__XXX
 SG_ S4_SRR_RL_Clu_DynProp_127 : 119|1@0+ (1,0) [0|1] "Unitless" Vector__XXX
 SG_ S4_SRR_RL_Clu_Locationvalid_127 : 118|1@0+ (1,0) [0|1] "" Vector__XXX
 SG_ S4_SRR_RL_Clu_ID_128 : 127|8@0+ (1,0) [0|199] "" Vector__XXX
 SG_ S4_SRR_RL_Clu_Theta_128 : 135|9@0+ (0.0062,-1.571) [-1.571|1.5972] "rad" Vector__XXX
 SG_ S4_SRR_RL_Clu_Dist_128 : 142|12@0+ (0.1,0.4) [0.4|300] "m" Vector__XXX
 SG_ S4_SRR_RL_Clu_Vel_128 : 146|11@0+ (0.1,-111.11) [-111.11|55.59] "mps" Vector__XXX
 SG_ S4_SRR_RL_Clu_SNR_128 : 167|7@0+ (0.5,0) [0|63.5] "dB" Vector__XXX
 SG_ S4_SRR_RL_Clu_RCS_128 : 160|5@0+ (2,-40) [-40|22] "" Vector__XXX
 SG_ S4_SRR_RL_Clu_DynProp_128 : 171|1@0+ (1,0) [0|1] "Unitless" Vector__XXX
 SG_ S4_SRR_RL_Clu_Locationvalid_128 : 170|1@0+ (1,0) [0|1] "" Vector__XXX
 SG_ S4_SRR_RL_Clu_ID_129 : 179|8@0+ (1,0) [0|199] "" Vector__XXX
 SG_ S4_SRR_RL_Clu_Theta_129 : 187|9@0+ (0.0062,-1.571) [-1.571|1.5972] "rad" Vector__XXX
 SG_ S4_SRR_RL_Clu_Dist_129 : 194|12@0+ (0.1,0.4) [0.4|300] "m" Vector__XXX
 SG_ S4_SRR_RL_Clu_Vel_129 : 214|11@0+ (0.1,-111.11) [-111.11|55.59] "mps" Vector__XXX
 SG_ S4_SRR_RL_Clu_SNR_129 : 219|7@0+ (0.5,0) [0|63.5] "dB" Vector__XXX
 SG_ S4_SRR_RL_Clu_RCS_129 : 228|5@0+ (2,-40) [-40|22] "" Vector__XXX
 SG_ S4_SRR_RL_Clu_DynProp_129 : 239|1@0+ (1,0) [0|1] "Unitless" Vector__XXX
 SG_ S4_SRR_RL_Clu_Locationvalid_129 : 238|1@0+ (1,0) [0|1] "" Vector__XXX
 SG_ S4_SRR_RL_Clu_ID_130 : 247|8@0+ (1,0) [0|199] "" Vector__XXX
 SG_ S4_SRR_RL_Clu_Theta_130 : 255|9@0+ (0.0062,-1.571) [-1.571|1.5972] "rad" Vector__XXX
 SG_ S4_SRR_RL_Clu_Dist_130 : 262|12@0+ (0.1,0.4) [0.4|300] "m" Vector__XXX
 SG_ S4_SRR_RL_Clu_Vel_130 : 266|11@0+ (0.1,-111.11) [-111.11|55.59] "mps" Vector__XXX
 SG_ S4_SRR_RL_Clu_SNR_130 : 287|7@0+ (0.5,0) [0|63.5] "dB" Vector__XXX
 SG_ S4_SRR_RL_Clu_RCS_130 : 280|5@0+ (2,-40) [-40|22] "" Vector__XXX
 SG_ S4_SRR_RL_Clu_DynProp_130 : 291|1@0+ (1,0) [0|1] "Unitless" Vector__XXX
 SG_ S4_SRR_RL_Clu_Locationvalid_130 : 290|1@0+ (1,0) [0|1] "" Vector__XXX
 SG_ S4_SRR_RL_Clu_ID_131 : 299|8@0+ (1,0) [0|199] "" Vector__XXX
 SG_ S4_SRR_RL_Clu_Theta_131 : 307|9@0+ (0.0062,-1.571) [-1.571|1.5972] "rad" Vector__XXX
 SG_ S4_SRR_RL_Clu_Dist_131 : 314|12@0+ (0.1,0.4) [0.4|300] "m" Vector__XXX
 SG_ S4_SRR_RL_Clu_Vel_131 : 334|11@0+ (0.1,-111.11) [-111.11|55.59] "mps" Vector__XXX
 SG_ S4_SRR_RL_Clu_SNR_131 : 339|7@0+ (0.5,0) [0|63.5] "dB" Vector__XXX
 SG_ S4_SRR_RL_Clu_RCS_131 : 348|5@0+ (2,-40) [-40|22] "" Vector__XXX
 SG_ S4_SRR_RL_Clu_DynProp_131 : 359|1@0+ (1,0) [0|1] "Unitless" Vector__XXX
 SG_ S4_SRR_RL_Clu_Locationvalid_131 : 358|1@0+ (1,0) [0|1] "" Vector__XXX
 SG_ S4_SRR_RL_Clu_ID_132 : 367|8@0+ (1,0) [0|199] "" Vector__XXX
 SG_ S4_SRR_RL_Clu_Theta_132 : 375|9@0+ (0.0062,-1.571) [-1.571|1.5972] "rad" Vector__XXX
 SG_ S4_SRR_RL_Clu_Dist_132 : 382|12@0+ (0.1,0.4) [0.4|300] "m" Vector__XXX
 SG_ S4_SRR_RL_Clu_Vel_132 : 386|11@0+ (0.1,-111.11) [-111.11|55.59] "mps" Vector__XXX
 SG_ S4_SRR_RL_Clu_SNR_132 : 407|7@0+ (0.5,0) [0|63.5] "dB" Vector__XXX
 SG_ S4_SRR_RL_Clu_RCS_132 : 400|5@0+ (2,-40) [-40|22] "" Vector__XXX
 SG_ S4_SRR_RL_Clu_DynProp_132 : 411|1@0+ (1,0) [0|1] "Unitless" Vector__XXX
 SG_ S4_SRR_RL_Clu_Locationvalid_132 : 410|1@0+ (1,0) [0|1] "" Vector__XXX
 SG_ S4_SRR_RL_Clu_Mes_18_blockcounter : 503|4@0+ (1,0) [0|15] "" Vector__XXX
 SG_ S4_SRR_RL_Clu_18_MsgCounter : 499|4@0+ (1,0) [0|14] "" Vector__XXX
 SG_ S4_SRR_RL_Clu_18_E2EChecksum : 511|8@0+ (1,0) [0|255] "" Vector__XXX

BO_ 605 S4_SRR_RL_Clu_Mes_19: 64 SRR_RL
 SG_ S4_SRR_RL_Clu_ID_133 : 7|8@0+ (1,0) [0|199] "" Vector__XXX
 SG_ S4_SRR_RL_Clu_Theta_133 : 15|9@0+ (0.0062,-1.571) [-1.571|1.5972] "rad" Vector__XXX
 SG_ S4_SRR_RL_Clu_Dist_133 : 22|12@0+ (0.1,0.4) [0.4|300] "m" Vector__XXX
 SG_ S4_SRR_RL_Clu_Vel_133 : 26|11@0+ (0.1,-111.11) [-111.11|55.59] "mps" Vector__XXX
 SG_ S4_SRR_RL_Clu_SNR_133 : 47|7@0+ (0.5,0) [0|63.5] "dB" Vector__XXX
 SG_ S4_SRR_RL_Clu_RCS_133 : 40|5@0+ (2,-40) [-40|22] "" Vector__XXX
 SG_ S4_SRR_RL_Clu_DynProp_133 : 51|1@0+ (1,0) [0|1] "Unitless" Vector__XXX
 SG_ S4_SRR_RL_Clu_Locationvalid_133 : 50|1@0+ (1,0) [0|1] "" Vector__XXX
 SG_ S4_SRR_RL_Clu_ID_134 : 59|8@0+ (1,0) [0|199] "" Vector__XXX
 SG_ S4_SRR_RL_Clu_Theta_134 : 67|9@0+ (0.0062,-1.571) [-1.571|1.5972] "rad" Vector__XXX
 SG_ S4_SRR_RL_Clu_Dist_134 : 74|12@0+ (0.1,0.4) [0.4|300] "m" Vector__XXX
 SG_ S4_SRR_RL_Clu_Vel_134 : 94|11@0+ (0.1,-111.11) [-111.11|55.59] "mps" Vector__XXX
 SG_ S4_SRR_RL_Clu_SNR_134 : 99|7@0+ (0.5,0) [0|63.5] "dB" Vector__XXX
 SG_ S4_SRR_RL_Clu_RCS_134 : 108|5@0+ (2,-40) [-40|22] "" Vector__XXX
 SG_ S4_SRR_RL_Clu_DynProp_134 : 119|1@0+ (1,0) [0|1] "Unitless" Vector__XXX
 SG_ S4_SRR_RL_Clu_Locationvalid_134 : 118|1@0+ (1,0) [0|1] "" Vector__XXX
 SG_ S4_SRR_RL_Clu_ID_135 : 127|8@0+ (1,0) [0|199] "" Vector__XXX
 SG_ S4_SRR_RL_Clu_Theta_135 : 135|9@0+ (0.0062,-1.571) [-1.571|1.5972] "rad" Vector__XXX
 SG_ S4_SRR_RL_Clu_Dist_135 : 142|12@0+ (0.1,0.4) [0.4|300] "m" Vector__XXX
 SG_ S4_SRR_RL_Clu_Vel_135 : 146|11@0+ (0.1,-111.11) [-111.11|55.59] "mps" Vector__XXX
 SG_ S4_SRR_RL_Clu_SNR_135 : 167|7@0+ (0.5,0) [0|63.5] "dB" Vector__XXX
 SG_ S4_SRR_RL_Clu_RCS_135 : 160|5@0+ (2,-40) [-40|22] "" Vector__XXX
 SG_ S4_SRR_RL_Clu_DynProp_135 : 171|1@0+ (1,0) [0|1] "Unitless" Vector__XXX
 SG_ S4_SRR_RL_Clu_Locationvalid_135 : 170|1@0+ (1,0) [0|1] "" Vector__XXX
 SG_ S4_SRR_RL_Clu_ID_136 : 179|8@0+ (1,0) [0|199] "" Vector__XXX
 SG_ S4_SRR_RL_Clu_Theta_136 : 187|9@0+ (0.0062,-1.571) [-1.571|1.5972] "rad" Vector__XXX
 SG_ S4_SRR_RL_Clu_Dist_136 : 194|12@0+ (0.1,0.4) [0.4|300] "m" Vector__XXX
 SG_ S4_SRR_RL_Clu_Vel_136 : 214|11@0+ (0.1,-111.11) [-111.11|55.59] "mps" Vector__XXX
 SG_ S4_SRR_RL_Clu_SNR_136 : 219|7@0+ (0.5,0) [0|63.5] "dB" Vector__XXX
 SG_ S4_SRR_RL_Clu_RCS_136 : 228|5@0+ (2,-40) [-40|22] "" Vector__XXX
 SG_ S4_SRR_RL_Clu_DynProp_136 : 239|1@0+ (1,0) [0|1] "Unitless" Vector__XXX
 SG_ S4_SRR_RL_Clu_Locationvalid_136 : 238|1@0+ (1,0) [0|1] "" Vector__XXX
 SG_ S4_SRR_RL_Clu_ID_137 : 247|8@0+ (1,0) [0|199] "" Vector__XXX
 SG_ S4_SRR_RL_Clu_Theta_137 : 255|9@0+ (0.0062,-1.571) [-1.571|1.5972] "rad" Vector__XXX
 SG_ S4_SRR_RL_Clu_Dist_137 : 262|12@0+ (0.1,0.4) [0.4|300] "m" Vector__XXX
 SG_ S4_SRR_RL_Clu_Vel_137 : 266|11@0+ (0.1,-111.11) [-111.11|55.59] "mps" Vector__XXX
 SG_ S4_SRR_RL_Clu_SNR_137 : 287|7@0+ (0.5,0) [0|63.5] "dB" Vector__XXX
 SG_ S4_SRR_RL_Clu_RCS_137 : 280|5@0+ (2,-40) [-40|22] "" Vector__XXX
 SG_ S4_SRR_RL_Clu_DynProp_137 : 291|1@0+ (1,0) [0|1] "Unitless" Vector__XXX
 SG_ S4_SRR_RL_Clu_Locationvalid_137 : 290|1@0+ (1,0) [0|1] "" Vector__XXX
 SG_ S4_SRR_RL_Clu_ID_138 : 299|8@0+ (1,0) [0|199] "" Vector__XXX
 SG_ S4_SRR_RL_Clu_Theta_138 : 307|9@0+ (0.0062,-1.571) [-1.571|1.5972] "rad" Vector__XXX
 SG_ S4_SRR_RL_Clu_Dist_138 : 314|12@0+ (0.1,0.4) [0.4|300] "m" Vector__XXX
 SG_ S4_SRR_RL_Clu_Vel_138 : 334|11@0+ (0.1,-111.11) [-111.11|55.59] "mps" Vector__XXX
 SG_ S4_SRR_RL_Clu_SNR_138 : 339|7@0+ (0.5,0) [0|63.5] "dB" Vector__XXX
 SG_ S4_SRR_RL_Clu_RCS_138 : 348|5@0+ (2,-40) [-40|22] "" Vector__XXX
 SG_ S4_SRR_RL_Clu_DynProp_138 : 359|1@0+ (1,0) [0|1] "Unitless" Vector__XXX
 SG_ S4_SRR_RL_Clu_Locationvalid_138 : 358|1@0+ (1,0) [0|1] "" Vector__XXX
 SG_ S4_SRR_RL_Clu_ID_139 : 367|8@0+ (1,0) [0|199] "" Vector__XXX
 SG_ S4_SRR_RL_Clu_Theta_139 : 375|9@0+ (0.0062,-1.571) [-1.571|1.5972] "rad" Vector__XXX
 SG_ S4_SRR_RL_Clu_Dist_139 : 382|12@0+ (0.1,0.4) [0.4|300] "m" Vector__XXX
 SG_ S4_SRR_RL_Clu_Vel_139 : 386|11@0+ (0.1,-111.11) [-111.11|55.59] "mps" Vector__XXX
 SG_ S4_SRR_RL_Clu_SNR_139 : 407|7@0+ (0.5,0) [0|63.5] "dB" Vector__XXX
 SG_ S4_SRR_RL_Clu_RCS_139 : 400|5@0+ (2,-40) [-40|22] "" Vector__XXX
 SG_ S4_SRR_RL_Clu_DynProp_139 : 411|1@0+ (1,0) [0|1] "Unitless" Vector__XXX
 SG_ S4_SRR_RL_Clu_Locationvalid_139 : 410|1@0+ (1,0) [0|1] "" Vector__XXX
 SG_ S4_SRR_RL_Clu_Mes_19_blockcounter : 503|4@0+ (1,0) [0|15] "" Vector__XXX
 SG_ S4_SRR_RL_Clu_19_MsgCounter : 499|4@0+ (1,0) [0|14] "" Vector__XXX
 SG_ S4_SRR_RL_Clu_19_E2EChecksum : 511|8@0+ (1,0) [0|255] "" Vector__XXX

BO_ 606 S4_SRR_RL_Clu_Mes_20: 64 SRR_RL
 SG_ S4_SRR_RL_Clu_ID_140 : 7|8@0+ (1,0) [0|199] "" Vector__XXX
 SG_ S4_SRR_RL_Clu_Theta_140 : 15|9@0+ (0.0062,-1.571) [-1.571|1.5972] "rad" Vector__XXX
 SG_ S4_SRR_RL_Clu_Dist_140 : 22|12@0+ (0.1,0.4) [0.4|300] "m" Vector__XXX
 SG_ S4_SRR_RL_Clu_Vel_140 : 26|11@0+ (0.1,-111.11) [-111.11|55.59] "mps" Vector__XXX
 SG_ S4_SRR_RL_Clu_SNR_140 : 47|7@0+ (0.5,0) [0|63.5] "dB" Vector__XXX
 SG_ S4_SRR_RL_Clu_RCS_140 : 40|5@0+ (2,-40) [-40|22] "" Vector__XXX
 SG_ S4_SRR_RL_Clu_DynProp_140 : 51|1@0+ (1,0) [0|1] "Unitless" Vector__XXX
 SG_ S4_SRR_RL_Clu_Locationvalid_140 : 50|1@0+ (1,0) [0|1] "" Vector__XXX
 SG_ S4_SRR_RL_Clu_ID_141 : 59|8@0+ (1,0) [0|199] "" Vector__XXX
 SG_ S4_SRR_RL_Clu_Theta_141 : 67|9@0+ (0.0062,-1.571) [-1.571|1.5972] "rad" Vector__XXX
 SG_ S4_SRR_RL_Clu_Dist_141 : 74|12@0+ (0.1,0.4) [0.4|300] "m" Vector__XXX
 SG_ S4_SRR_RL_Clu_Vel_141 : 94|11@0+ (0.1,-111.11) [-111.11|55.59] "mps" Vector__XXX
 SG_ S4_SRR_RL_Clu_SNR_141 : 99|7@0+ (0.5,0) [0|63.5] "dB" Vector__XXX
 SG_ S4_SRR_RL_Clu_RCS_141 : 108|5@0+ (2,-40) [-40|22] "" Vector__XXX
 SG_ S4_SRR_RL_Clu_DynProp_141 : 119|1@0+ (1,0) [0|1] "Unitless" Vector__XXX
 SG_ S4_SRR_RL_Clu_Locationvalid_141 : 118|1@0+ (1,0) [0|1] "" Vector__XXX
 SG_ S4_SRR_RL_Clu_ID_142 : 127|8@0+ (1,0) [0|199] "" Vector__XXX
 SG_ S4_SRR_RL_Clu_Theta_142 : 135|9@0+ (0.0062,-1.571) [-1.571|1.5972] "rad" Vector__XXX
 SG_ S4_SRR_RL_Clu_Dist_142 : 142|12@0+ (0.1,0.4) [0.4|300] "m" Vector__XXX
 SG_ S4_SRR_RL_Clu_Vel_142 : 146|11@0+ (0.1,-111.11) [-111.11|55.59] "mps" Vector__XXX
 SG_ S4_SRR_RL_Clu_SNR_142 : 167|7@0+ (0.5,0) [0|63.5] "dB" Vector__XXX
 SG_ S4_SRR_RL_Clu_RCS_142 : 160|5@0+ (2,-40) [-40|22] "" Vector__XXX
 SG_ S4_SRR_RL_Clu_DynProp_142 : 171|1@0+ (1,0) [0|1] "Unitless" Vector__XXX
 SG_ S4_SRR_RL_Clu_Locationvalid_142 : 170|1@0+ (1,0) [0|1] "" Vector__XXX
 SG_ S4_SRR_RL_Clu_ID_143 : 179|8@0+ (1,0) [0|199] "" Vector__XXX
 SG_ S4_SRR_RL_Clu_Theta_143 : 187|9@0+ (0.0062,-1.571) [-1.571|1.5972] "rad" Vector__XXX
 SG_ S4_SRR_RL_Clu_Dist_143 : 194|12@0+ (0.1,0.4) [0.4|300] "m" Vector__XXX
 SG_ S4_SRR_RL_Clu_Vel_143 : 214|11@0+ (0.1,-111.11) [-111.11|55.59] "mps" Vector__XXX
 SG_ S4_SRR_RL_Clu_SNR_143 : 219|7@0+ (0.5,0) [0|63.5] "dB" Vector__XXX
 SG_ S4_SRR_RL_Clu_RCS_143 : 228|5@0+ (2,-40) [-40|22] "" Vector__XXX
 SG_ S4_SRR_RL_Clu_DynProp_143 : 239|1@0+ (1,0) [0|1] "Unitless" Vector__XXX
 SG_ S4_SRR_RL_Clu_Locationvalid_143 : 238|1@0+ (1,0) [0|1] "" Vector__XXX
 SG_ S4_SRR_RL_Clu_ID_144 : 247|8@0+ (1,0) [0|199] "" Vector__XXX
 SG_ S4_SRR_RL_Clu_Theta_144 : 255|9@0+ (0.0062,-1.571) [-1.571|1.5972] "rad" Vector__XXX
 SG_ S4_SRR_RL_Clu_Dist_144 : 262|12@0+ (0.1,0.4) [0.4|300] "m" Vector__XXX
 SG_ S4_SRR_RL_Clu_Vel_144 : 266|11@0+ (0.1,-111.11) [-111.11|55.59] "mps" Vector__XXX
 SG_ S4_SRR_RL_Clu_SNR_144 : 287|7@0+ (0.5,0) [0|63.5] "dB" Vector__XXX
 SG_ S4_SRR_RL_Clu_RCS_144 : 280|5@0+ (2,-40) [-40|22] "" Vector__XXX
 SG_ S4_SRR_RL_Clu_DynProp_144 : 291|1@0+ (1,0) [0|1] "Unitless" Vector__XXX
 SG_ S4_SRR_RL_Clu_Locationvalid_144 : 290|1@0+ (1,0) [0|1] "" Vector__XXX
 SG_ S4_SRR_RL_Clu_ID_145 : 299|8@0+ (1,0) [0|199] "" Vector__XXX
 SG_ S4_SRR_RL_Clu_Theta_145 : 307|9@0+ (0.0062,-1.571) [-1.571|1.5972] "rad" Vector__XXX
 SG_ S4_SRR_RL_Clu_Dist_145 : 314|12@0+ (0.1,0.4) [0.4|300] "m" Vector__XXX
 SG_ S4_SRR_RL_Clu_Vel_145 : 334|11@0+ (0.1,-111.11) [-111.11|55.59] "mps" Vector__XXX
 SG_ S4_SRR_RL_Clu_SNR_145 : 339|7@0+ (0.5,0) [0|63.5] "dB" Vector__XXX
 SG_ S4_SRR_RL_Clu_RCS_145 : 348|5@0+ (2,-40) [-40|22] "" Vector__XXX
 SG_ S4_SRR_RL_Clu_DynProp_145 : 359|1@0+ (1,0) [0|1] "Unitless" Vector__XXX
 SG_ S4_SRR_RL_Clu_Locationvalid_145 : 358|1@0+ (1,0) [0|1] "" Vector__XXX
 SG_ S4_SRR_RL_Clu_ID_146 : 367|8@0+ (1,0) [0|199] "" Vector__XXX
 SG_ S4_SRR_RL_Clu_Theta_146 : 375|9@0+ (0.0062,-1.571) [-1.571|1.5972] "rad" Vector__XXX
 SG_ S4_SRR_RL_Clu_Dist_146 : 382|12@0+ (0.1,0.4) [0.4|300] "m" Vector__XXX
 SG_ S4_SRR_RL_Clu_Vel_146 : 386|11@0+ (0.1,-111.11) [-111.11|55.59] "mps" Vector__XXX
 SG_ S4_SRR_RL_Clu_SNR_146 : 407|7@0+ (0.5,0) [0|63.5] "dB" Vector__XXX
 SG_ S4_SRR_RL_Clu_RCS_146 : 400|5@0+ (2,-40) [-40|22] "" Vector__XXX
 SG_ S4_SRR_RL_Clu_DynProp_146 : 411|1@0+ (1,0) [0|1] "Unitless" Vector__XXX
 SG_ S4_SRR_RL_Clu_Locationvalid_146 : 410|1@0+ (1,0) [0|1] "" Vector__XXX
 SG_ S4_SRR_RL_Clu_Mes_20_blockcounter : 503|4@0+ (1,0) [0|15] "" Vector__XXX
 SG_ S4_SRR_RL_Clu_20_MsgCounter : 499|4@0+ (1,0) [0|14] "" Vector__XXX
 SG_ S4_SRR_RL_Clu_20_E2EChecksum : 511|8@0+ (1,0) [0|255] "" Vector__XXX

BO_ 607 S4_SRR_RL_Clu_Mes_21: 64 SRR_RL
 SG_ S4_SRR_RL_Clu_ID_147 : 7|8@0+ (1,0) [0|199] "" Vector__XXX
 SG_ S4_SRR_RL_Clu_Theta_147 : 15|9@0+ (0.0062,-1.571) [-1.571|1.5972] "rad" Vector__XXX
 SG_ S4_SRR_RL_Clu_Dist_147 : 22|12@0+ (0.1,0.4) [0.4|300] "m" Vector__XXX
 SG_ S4_SRR_RL_Clu_Vel_147 : 26|11@0+ (0.1,-111.11) [-111.11|55.59] "mps" Vector__XXX
 SG_ S4_SRR_RL_Clu_SNR_147 : 47|7@0+ (0.5,0) [0|63.5] "dB" Vector__XXX
 SG_ S4_SRR_RL_Clu_RCS_147 : 40|5@0+ (2,-40) [-40|22] "" Vector__XXX
 SG_ S4_SRR_RL_Clu_DynProp_147 : 51|1@0+ (1,0) [0|1] "Unitless" Vector__XXX
 SG_ S4_SRR_RL_Clu_Locationvalid_147 : 50|1@0+ (1,0) [0|1] "" Vector__XXX
 SG_ S4_SRR_RL_Clu_ID_148 : 59|8@0+ (1,0) [0|199] "" Vector__XXX
 SG_ S4_SRR_RL_Clu_Theta_148 : 67|9@0+ (0.0062,-1.571) [-1.571|1.5972] "rad" Vector__XXX
 SG_ S4_SRR_RL_Clu_Dist_148 : 74|12@0+ (0.1,0.4) [0.4|300] "m" Vector__XXX
 SG_ S4_SRR_RL_Clu_Vel_148 : 94|11@0+ (0.1,-111.11) [-111.11|55.59] "mps" Vector__XXX
 SG_ S4_SRR_RL_Clu_SNR_148 : 99|7@0+ (0.5,0) [0|63.5] "dB" Vector__XXX
 SG_ S4_SRR_RL_Clu_RCS_148 : 108|5@0+ (2,-40) [-40|22] "" Vector__XXX
 SG_ S4_SRR_RL_Clu_DynProp_148 : 119|1@0+ (1,0) [0|1] "Unitless" Vector__XXX
 SG_ S4_SRR_RL_Clu_Locationvalid_148 : 118|1@0+ (1,0) [0|1] "" Vector__XXX
 SG_ S4_SRR_RL_Clu_ID_149 : 127|8@0+ (1,0) [0|199] "" Vector__XXX
 SG_ S4_SRR_RL_Clu_Theta_149 : 135|9@0+ (0.0062,-1.571) [-1.571|1.5972] "rad" Vector__XXX
 SG_ S4_SRR_RL_Clu_Dist_149 : 142|12@0+ (0.1,0.4) [0.4|300] "m" Vector__XXX
 SG_ S4_SRR_RL_Clu_Vel_149 : 146|11@0+ (0.1,-111.11) [-111.11|55.59] "mps" Vector__XXX
 SG_ S4_SRR_RL_Clu_SNR_149 : 167|7@0+ (0.5,0) [0|63.5] "dB" Vector__XXX
 SG_ S4_SRR_RL_Clu_RCS_149 : 160|5@0+ (2,-40) [-40|22] "" Vector__XXX
 SG_ S4_SRR_RL_Clu_DynProp_149 : 171|1@0+ (1,0) [0|1] "Unitless" Vector__XXX
 SG_ S4_SRR_RL_Clu_Locationvalid_149 : 170|1@0+ (1,0) [0|1] "" Vector__XXX
 SG_ S4_SRR_RL_Clu_ID_150 : 179|8@0+ (1,0) [0|199] "" Vector__XXX
 SG_ S4_SRR_RL_Clu_Theta_150 : 187|9@0+ (0.0062,-1.571) [-1.571|1.5972] "rad" Vector__XXX
 SG_ S4_SRR_RL_Clu_Dist_150 : 194|12@0+ (0.1,0.4) [0.4|300] "m" Vector__XXX
 SG_ S4_SRR_RL_Clu_Vel_150 : 214|11@0+ (0.1,-111.11) [-111.11|55.59] "mps" Vector__XXX
 SG_ S4_SRR_RL_Clu_SNR_150 : 219|7@0+ (0.5,0) [0|63.5] "dB" Vector__XXX
 SG_ S4_SRR_RL_Clu_RCS_150 : 228|5@0+ (2,-40) [-40|22] "" Vector__XXX
 SG_ S4_SRR_RL_Clu_DynProp_150 : 239|1@0+ (1,0) [0|1] "Unitless" Vector__XXX
 SG_ S4_SRR_RL_Clu_Locationvalid_150 : 238|1@0+ (1,0) [0|1] "" Vector__XXX
 SG_ S4_SRR_RL_Clu_ID_151 : 247|8@0+ (1,0) [0|199] "" Vector__XXX
 SG_ S4_SRR_RL_Clu_Theta_151 : 255|9@0+ (0.0062,-1.571) [-1.571|1.5972] "rad" Vector__XXX
 SG_ S4_SRR_RL_Clu_Dist_151 : 262|12@0+ (0.1,0.4) [0.4|300] "m" Vector__XXX
 SG_ S4_SRR_RL_Clu_Vel_151 : 266|11@0+ (0.1,-111.11) [-111.11|55.59] "mps" Vector__XXX
 SG_ S4_SRR_RL_Clu_SNR_151 : 287|7@0+ (0.5,0) [0|63.5] "dB" Vector__XXX
 SG_ S4_SRR_RL_Clu_RCS_151 : 280|5@0+ (2,-40) [-40|22] "" Vector__XXX
 SG_ S4_SRR_RL_Clu_DynProp_151 : 291|1@0+ (1,0) [0|1] "Unitless" Vector__XXX
 SG_ S4_SRR_RL_Clu_Locationvalid_151 : 290|1@0+ (1,0) [0|1] "" Vector__XXX
 SG_ S4_SRR_RL_Clu_ID_152 : 299|8@0+ (1,0) [0|199] "" Vector__XXX
 SG_ S4_SRR_RL_Clu_Theta_152 : 307|9@0+ (0.0062,-1.571) [-1.571|1.5972] "rad" Vector__XXX
 SG_ S4_SRR_RL_Clu_Dist_152 : 314|12@0+ (0.1,0.4) [0.4|300] "m" Vector__XXX
 SG_ S4_SRR_RL_Clu_Vel_152 : 334|11@0+ (0.1,-111.11) [-111.11|55.59] "mps" Vector__XXX
 SG_ S4_SRR_RL_Clu_SNR_152 : 339|7@0+ (0.5,0) [0|63.5] "dB" Vector__XXX
 SG_ S4_SRR_RL_Clu_RCS_152 : 348|5@0+ (2,-40) [-40|22] "" Vector__XXX
 SG_ S4_SRR_RL_Clu_DynProp_152 : 359|1@0+ (1,0) [0|1] "Unitless" Vector__XXX
 SG_ S4_SRR_RL_Clu_Locationvalid_152 : 358|1@0+ (1,0) [0|1] "" Vector__XXX
 SG_ S4_SRR_RL_Clu_ID_153 : 367|8@0+ (1,0) [0|199] "" Vector__XXX
 SG_ S4_SRR_RL_Clu_Theta_153 : 375|9@0+ (0.0062,-1.571) [-1.571|1.5972] "rad" Vector__XXX
 SG_ S4_SRR_RL_Clu_Dist_153 : 382|12@0+ (0.1,0.4) [0.4|300] "m" Vector__XXX
 SG_ S4_SRR_RL_Clu_Vel_153 : 386|11@0+ (0.1,-111.11) [-111.11|55.59] "mps" Vector__XXX
 SG_ S4_SRR_RL_Clu_SNR_153 : 407|7@0+ (0.5,0) [0|63.5] "dB" Vector__XXX
 SG_ S4_SRR_RL_Clu_RCS_153 : 400|5@0+ (2,-40) [-40|22] "" Vector__XXX
 SG_ S4_SRR_RL_Clu_DynProp_153 : 411|1@0+ (1,0) [0|1] "Unitless" Vector__XXX
 SG_ S4_SRR_RL_Clu_Locationvalid_153 : 410|1@0+ (1,0) [0|1] "" Vector__XXX
 SG_ S4_SRR_RL_Clu_Mes_21_blockcounter : 503|4@0+ (1,0) [0|15] "" Vector__XXX
 SG_ S4_SRR_RL_Clu_21_MsgCounter : 499|4@0+ (1,0) [0|14] "" Vector__XXX
 SG_ S4_SRR_RL_Clu_21_E2EChecksum : 511|8@0+ (1,0) [0|255] "" Vector__XXX

BO_ 608 S4_SRR_RL_Clu_Mes_22: 64 SRR_RL
 SG_ S4_SRR_RL_Clu_ID_154 : 7|8@0+ (1,0) [0|199] "" Vector__XXX
 SG_ S4_SRR_RL_Clu_Theta_154 : 15|9@0+ (0.0062,-1.571) [-1.571|1.5972] "rad" Vector__XXX
 SG_ S4_SRR_RL_Clu_Dist_154 : 22|12@0+ (0.1,0.4) [0.4|300] "m" Vector__XXX
 SG_ S4_SRR_RL_Clu_Vel_154 : 26|11@0+ (0.1,-111.11) [-111.11|55.59] "mps" Vector__XXX
 SG_ S4_SRR_RL_Clu_SNR_154 : 47|7@0+ (0.5,0) [0|63.5] "dB" Vector__XXX
 SG_ S4_SRR_RL_Clu_RCS_154 : 40|5@0+ (2,-40) [-40|22] "" Vector__XXX
 SG_ S4_SRR_RL_Clu_DynProp_154 : 51|1@0+ (1,0) [0|1] "Unitless" Vector__XXX
 SG_ S4_SRR_RL_Clu_Locationvalid_154 : 50|1@0+ (1,0) [0|1] "" Vector__XXX
 SG_ S4_SRR_RL_Clu_ID_155 : 59|8@0+ (1,0) [0|199] "" Vector__XXX
 SG_ S4_SRR_RL_Clu_Theta_155 : 67|9@0+ (0.0062,-1.571) [-1.571|1.5972] "rad" Vector__XXX
 SG_ S4_SRR_RL_Clu_Dist_155 : 74|12@0+ (0.1,0.4) [0.4|300] "m" Vector__XXX
 SG_ S4_SRR_RL_Clu_Vel_155 : 94|11@0+ (0.1,-111.11) [-111.11|55.59] "mps" Vector__XXX
 SG_ S4_SRR_RL_Clu_SNR_155 : 99|7@0+ (0.5,0) [0|63.5] "dB" Vector__XXX
 SG_ S4_SRR_RL_Clu_RCS_155 : 108|5@0+ (2,-40) [-40|22] "" Vector__XXX
 SG_ S4_SRR_RL_Clu_DynProp_155 : 119|1@0+ (1,0) [0|1] "Unitless" Vector__XXX
 SG_ S4_SRR_RL_Clu_Locationvalid_155 : 118|1@0+ (1,0) [0|1] "" Vector__XXX
 SG_ S4_SRR_RL_Clu_ID_156 : 127|8@0+ (1,0) [0|199] "" Vector__XXX
 SG_ S4_SRR_RL_Clu_Theta_156 : 135|9@0+ (0.0062,-1.571) [-1.571|1.5972] "rad" Vector__XXX
 SG_ S4_SRR_RL_Clu_Dist_156 : 142|12@0+ (0.1,0.4) [0.4|300] "m" Vector__XXX
 SG_ S4_SRR_RL_Clu_Vel_156 : 146|11@0+ (0.1,-111.11) [-111.11|55.59] "mps" Vector__XXX
 SG_ S4_SRR_RL_Clu_SNR_156 : 167|7@0+ (0.5,0) [0|63.5] "dB" Vector__XXX
 SG_ S4_SRR_RL_Clu_RCS_156 : 160|5@0+ (2,-40) [-40|22] "" Vector__XXX
 SG_ S4_SRR_RL_Clu_DynProp_156 : 171|1@0+ (1,0) [0|1] "Unitless" Vector__XXX
 SG_ S4_SRR_RL_Clu_Locationvalid_156 : 170|1@0+ (1,0) [0|1] "" Vector__XXX
 SG_ S4_SRR_RL_Clu_ID_157 : 179|8@0+ (1,0) [0|199] "" Vector__XXX
 SG_ S4_SRR_RL_Clu_Theta_157 : 187|9@0+ (0.0062,-1.571) [-1.571|1.5972] "rad" Vector__XXX
 SG_ S4_SRR_RL_Clu_Dist_157 : 194|12@0+ (0.1,0.4) [0.4|300] "m" Vector__XXX
 SG_ S4_SRR_RL_Clu_Vel_157 : 214|11@0+ (0.1,-111.11) [-111.11|55.59] "mps" Vector__XXX
 SG_ S4_SRR_RL_Clu_SNR_157 : 219|7@0+ (0.5,0) [0|63.5] "dB" Vector__XXX
 SG_ S4_SRR_RL_Clu_RCS_157 : 228|5@0+ (2,-40) [-40|22] "" Vector__XXX
 SG_ S4_SRR_RL_Clu_DynProp_157 : 239|1@0+ (1,0) [0|1] "Unitless" Vector__XXX
 SG_ S4_SRR_RL_Clu_Locationvalid_157 : 238|1@0+ (1,0) [0|1] "" Vector__XXX
 SG_ S4_SRR_RL_Clu_ID_158 : 247|8@0+ (1,0) [0|199] "" Vector__XXX
 SG_ S4_SRR_RL_Clu_Theta_158 : 255|9@0+ (0.0062,-1.571) [-1.571|1.5972] "rad" Vector__XXX
 SG_ S4_SRR_RL_Clu_Dist_158 : 262|12@0+ (0.1,0.4) [0.4|300] "m" Vector__XXX
 SG_ S4_SRR_RL_Clu_Vel_158 : 266|11@0+ (0.1,-111.11) [-111.11|55.59] "mps" Vector__XXX
 SG_ S4_SRR_RL_Clu_SNR_158 : 287|7@0+ (0.5,0) [0|63.5] "dB" Vector__XXX
 SG_ S4_SRR_RL_Clu_RCS_158 : 280|5@0+ (2,-40) [-40|22] "" Vector__XXX
 SG_ S4_SRR_RL_Clu_DynProp_158 : 291|1@0+ (1,0) [0|1] "Unitless" Vector__XXX
 SG_ S4_SRR_RL_Clu_Locationvalid_158 : 290|1@0+ (1,0) [0|1] "" Vector__XXX
 SG_ S4_SRR_RL_Clu_ID_159 : 299|8@0+ (1,0) [0|199] "" Vector__XXX
 SG_ S4_SRR_RL_Clu_Theta_159 : 307|9@0+ (0.0062,-1.571) [-1.571|1.5972] "rad" Vector__XXX
 SG_ S4_SRR_RL_Clu_Dist_159 : 314|12@0+ (0.1,0.4) [0.4|300] "m" Vector__XXX
 SG_ S4_SRR_RL_Clu_Vel_159 : 334|11@0+ (0.1,-111.11) [-111.11|55.59] "mps" Vector__XXX
 SG_ S4_SRR_RL_Clu_SNR_159 : 339|7@0+ (0.5,0) [0|63.5] "dB" Vector__XXX
 SG_ S4_SRR_RL_Clu_RCS_159 : 348|5@0+ (2,-40) [-40|22] "" Vector__XXX
 SG_ S4_SRR_RL_Clu_DynProp_159 : 359|1@0+ (1,0) [0|1] "Unitless" Vector__XXX
 SG_ S4_SRR_RL_Clu_Locationvalid_159 : 358|1@0+ (1,0) [0|1] "" Vector__XXX
 SG_ S4_SRR_RL_Clu_ID_160 : 367|8@0+ (1,0) [0|199] "" Vector__XXX
 SG_ S4_SRR_RL_Clu_Theta_160 : 375|9@0+ (0.0062,-1.571) [-1.571|1.5972] "rad" Vector__XXX
 SG_ S4_SRR_RL_Clu_Dist_160 : 382|12@0+ (0.1,0.4) [0.4|300] "m" Vector__XXX
 SG_ S4_SRR_RL_Clu_Vel_160 : 386|11@0+ (0.1,-111.11) [-111.11|55.59] "mps" Vector__XXX
 SG_ S4_SRR_RL_Clu_SNR_160 : 407|7@0+ (0.5,0) [0|63.5] "dB" Vector__XXX
 SG_ S4_SRR_RL_Clu_RCS_160 : 400|5@0+ (2,-40) [-40|22] "" Vector__XXX
 SG_ S4_SRR_RL_Clu_DynProp_160 : 411|1@0+ (1,0) [0|1] "Unitless" Vector__XXX
 SG_ S4_SRR_RL_Clu_Locationvalid_160 : 410|1@0+ (1,0) [0|1] "" Vector__XXX
 SG_ S4_SRR_RL_Clu_Mes_22_blockcounter : 503|4@0+ (1,0) [0|15] "" Vector__XXX
 SG_ S4_SRR_RL_Clu_22_MsgCounter : 499|4@0+ (1,0) [0|14] "" Vector__XXX
 SG_ S4_SRR_RL_Clu_22_E2EChecksum : 511|8@0+ (1,0) [0|255] "" Vector__XXX

BO_ 609 S4_SRR_RL_Clu_Mes_23: 64 SRR_RL
 SG_ S4_SRR_RL_Clu_ID_161 : 7|8@0+ (1,0) [0|199] "" Vector__XXX
 SG_ S4_SRR_RL_Clu_Theta_161 : 15|9@0+ (0.0062,-1.571) [-1.571|1.5972] "rad" Vector__XXX
 SG_ S4_SRR_RL_Clu_Dist_161 : 22|12@0+ (0.1,0.4) [0.4|300] "m" Vector__XXX
 SG_ S4_SRR_RL_Clu_Vel_161 : 26|11@0+ (0.1,-111.11) [-111.11|55.59] "mps" Vector__XXX
 SG_ S4_SRR_RL_Clu_SNR_161 : 47|7@0+ (0.5,0) [0|63.5] "dB" Vector__XXX
 SG_ S4_SRR_RL_Clu_RCS_161 : 40|5@0+ (2,-40) [-40|22] "" Vector__XXX
 SG_ S4_SRR_RL_Clu_DynProp_161 : 51|1@0+ (1,0) [0|1] "Unitless" Vector__XXX
 SG_ S4_SRR_RL_Clu_Locationvalid_161 : 50|1@0+ (1,0) [0|1] "" Vector__XXX
 SG_ S4_SRR_RL_Clu_ID_162 : 59|8@0+ (1,0) [0|199] "" Vector__XXX
 SG_ S4_SRR_RL_Clu_Theta_162 : 67|9@0+ (0.0062,-1.571) [-1.571|1.5972] "rad" Vector__XXX
 SG_ S4_SRR_RL_Clu_Dist_162 : 74|12@0+ (0.1,0.4) [0.4|300] "m" Vector__XXX
 SG_ S4_SRR_RL_Clu_Vel_162 : 94|11@0+ (0.1,-111.11) [-111.11|55.59] "mps" Vector__XXX
 SG_ S4_SRR_RL_Clu_SNR_162 : 99|7@0+ (0.5,0) [0|63.5] "dB" Vector__XXX
 SG_ S4_SRR_RL_Clu_RCS_162 : 108|5@0+ (2,-40) [-40|22] "" Vector__XXX
 SG_ S4_SRR_RL_Clu_DynProp_162 : 119|1@0+ (1,0) [0|1] "Unitless" Vector__XXX
 SG_ S4_SRR_RL_Clu_Locationvalid_162 : 118|1@0+ (1,0) [0|1] "" Vector__XXX
 SG_ S4_SRR_RL_Clu_ID_163 : 127|8@0+ (1,0) [0|199] "" Vector__XXX
 SG_ S4_SRR_RL_Clu_Theta_163 : 135|9@0+ (0.0062,-1.571) [-1.571|1.5972] "rad" Vector__XXX
 SG_ S4_SRR_RL_Clu_Dist_163 : 142|12@0+ (0.1,0.4) [0.4|300] "m" Vector__XXX
 SG_ S4_SRR_RL_Clu_Vel_163 : 146|11@0+ (0.1,-111.11) [-111.11|55.59] "mps" Vector__XXX
 SG_ S4_SRR_RL_Clu_SNR_163 : 167|7@0+ (0.5,0) [0|63.5] "dB" Vector__XXX
 SG_ S4_SRR_RL_Clu_RCS_163 : 160|5@0+ (2,-40) [-40|22] "" Vector__XXX
 SG_ S4_SRR_RL_Clu_DynProp_163 : 171|1@0+ (1,0) [0|1] "Unitless" Vector__XXX
 SG_ S4_SRR_RL_Clu_Locationvalid_163 : 170|1@0+ (1,0) [0|1] "" Vector__XXX
 SG_ S4_SRR_RL_Clu_ID_164 : 179|8@0+ (1,0) [0|199] "" Vector__XXX
 SG_ S4_SRR_RL_Clu_Theta_164 : 187|9@0+ (0.0062,-1.571) [-1.571|1.5972] "rad" Vector__XXX
 SG_ S4_SRR_RL_Clu_Dist_164 : 194|12@0+ (0.1,0.4) [0.4|300] "m" Vector__XXX
 SG_ S4_SRR_RL_Clu_Vel_164 : 214|11@0+ (0.1,-111.11) [-111.11|55.59] "mps" Vector__XXX
 SG_ S4_SRR_RL_Clu_SNR_164 : 219|7@0+ (0.5,0) [0|63.5] "dB" Vector__XXX
 SG_ S4_SRR_RL_Clu_RCS_164 : 228|5@0+ (2,-40) [-40|22] "" Vector__XXX
 SG_ S4_SRR_RL_Clu_DynProp_164 : 239|1@0+ (1,0) [0|1] "Unitless" Vector__XXX
 SG_ S4_SRR_RL_Clu_Locationvalid_164 : 238|1@0+ (1,0) [0|1] "" Vector__XXX
 SG_ S4_SRR_RL_Clu_ID_165 : 247|8@0+ (1,0) [0|199] "" Vector__XXX
 SG_ S4_SRR_RL_Clu_Theta_165 : 255|9@0+ (0.0062,-1.571) [-1.571|1.5972] "rad" Vector__XXX
 SG_ S4_SRR_RL_Clu_Dist_165 : 262|12@0+ (0.1,0.4) [0.4|300] "m" Vector__XXX
 SG_ S4_SRR_RL_Clu_Vel_165 : 266|11@0+ (0.1,-111.11) [-111.11|55.59] "mps" Vector__XXX
 SG_ S4_SRR_RL_Clu_SNR_165 : 287|7@0+ (0.5,0) [0|63.5] "dB" Vector__XXX
 SG_ S4_SRR_RL_Clu_RCS_165 : 280|5@0+ (2,-40) [-40|22] "" Vector__XXX
 SG_ S4_SRR_RL_Clu_DynProp_165 : 291|1@0+ (1,0) [0|1] "Unitless" Vector__XXX
 SG_ S4_SRR_RL_Clu_Locationvalid_165 : 290|1@0+ (1,0) [0|1] "" Vector__XXX
 SG_ S4_SRR_RL_Clu_ID_166 : 299|8@0+ (1,0) [0|199] "" Vector__XXX
 SG_ S4_SRR_RL_Clu_Theta_166 : 307|9@0+ (0.0062,-1.571) [-1.571|1.5972] "rad" Vector__XXX
 SG_ S4_SRR_RL_Clu_Dist_166 : 314|12@0+ (0.1,0.4) [0.4|300] "m" Vector__XXX
 SG_ S4_SRR_RL_Clu_Vel_166 : 334|11@0+ (0.1,-111.11) [-111.11|55.59] "mps" Vector__XXX
 SG_ S4_SRR_RL_Clu_SNR_166 : 339|7@0+ (0.5,0) [0|63.5] "dB" Vector__XXX
 SG_ S4_SRR_RL_Clu_RCS_166 : 348|5@0+ (2,-40) [-40|22] "" Vector__XXX
 SG_ S4_SRR_RL_Clu_DynProp_166 : 359|1@0+ (1,0) [0|1] "Unitless" Vector__XXX
 SG_ S4_SRR_RL_Clu_Locationvalid_166 : 358|1@0+ (1,0) [0|1] "" Vector__XXX
 SG_ S4_SRR_RL_Clu_ID_167 : 367|8@0+ (1,0) [0|199] "" Vector__XXX
 SG_ S4_SRR_RL_Clu_Theta_167 : 375|9@0+ (0.0062,-1.571) [-1.571|1.5972] "rad" Vector__XXX
 SG_ S4_SRR_RL_Clu_Dist_167 : 382|12@0+ (0.1,0.4) [0.4|300] "m" Vector__XXX
 SG_ S4_SRR_RL_Clu_Vel_167 : 386|11@0+ (0.1,-111.11) [-111.11|55.59] "mps" Vector__XXX
 SG_ S4_SRR_RL_Clu_SNR_167 : 407|7@0+ (0.5,0) [0|63.5] "dB" Vector__XXX
 SG_ S4_SRR_RL_Clu_RCS_167 : 400|5@0+ (2,-40) [-40|22] "" Vector__XXX
 SG_ S4_SRR_RL_Clu_DynProp_167 : 411|1@0+ (1,0) [0|1] "Unitless" Vector__XXX
 SG_ S4_SRR_RL_Clu_Locationvalid_167 : 410|1@0+ (1,0) [0|1] "" Vector__XXX
 SG_ S4_SRR_RL_Clu_Mes_23_blockcounter : 503|4@0+ (1,0) [0|15] "" Vector__XXX
 SG_ S4_SRR_RL_Clu_23_MsgCounter : 499|4@0+ (1,0) [0|14] "" Vector__XXX
 SG_ S4_SRR_RL_Clu_23_E2EChecksum : 511|8@0+ (1,0) [0|255] "" Vector__XXX

BO_ 610 S4_SRR_RL_Clu_Mes_24: 64 SRR_RL
 SG_ S4_SRR_RL_Clu_ID_168 : 7|8@0+ (1,0) [0|199] "" Vector__XXX
 SG_ S4_SRR_RL_Clu_Theta_168 : 15|9@0+ (0.0062,-1.571) [-1.571|1.5972] "rad" Vector__XXX
 SG_ S4_SRR_RL_Clu_Dist_168 : 22|12@0+ (0.1,0.4) [0.4|300] "m" Vector__XXX
 SG_ S4_SRR_RL_Clu_Vel_168 : 26|11@0+ (0.1,-111.11) [-111.11|55.59] "mps" Vector__XXX
 SG_ S4_SRR_RL_Clu_SNR_168 : 47|7@0+ (0.5,0) [0|63.5] "dB" Vector__XXX
 SG_ S4_SRR_RL_Clu_RCS_168 : 40|5@0+ (2,-40) [-40|22] "" Vector__XXX
 SG_ S4_SRR_RL_Clu_DynProp_168 : 51|1@0+ (1,0) [0|1] "Unitless" Vector__XXX
 SG_ S4_SRR_RL_Clu_Locationvalid_168 : 50|1@0+ (1,0) [0|1] "" Vector__XXX
 SG_ S4_SRR_RL_Clu_ID_169 : 59|8@0+ (1,0) [0|199] "" Vector__XXX
 SG_ S4_SRR_RL_Clu_Theta_169 : 67|9@0+ (0.0062,-1.571) [-1.571|1.5972] "rad" Vector__XXX
 SG_ S4_SRR_RL_Clu_Dist_169 : 74|12@0+ (0.1,0.4) [0.4|300] "m" Vector__XXX
 SG_ S4_SRR_RL_Clu_Vel_169 : 94|11@0+ (0.1,-111.11) [-111.11|55.59] "mps" Vector__XXX
 SG_ S4_SRR_RL_Clu_SNR_169 : 99|7@0+ (0.5,0) [0|63.5] "dB" Vector__XXX
 SG_ S4_SRR_RL_Clu_RCS_169 : 108|5@0+ (2,-40) [-40|22] "" Vector__XXX
 SG_ S4_SRR_RL_Clu_DynProp_169 : 119|1@0+ (1,0) [0|1] "Unitless" Vector__XXX
 SG_ S4_SRR_RL_Clu_Locationvalid_169 : 118|1@0+ (1,0) [0|1] "" Vector__XXX
 SG_ S4_SRR_RL_Clu_ID_170 : 127|8@0+ (1,0) [0|199] "" Vector__XXX
 SG_ S4_SRR_RL_Clu_Theta_170 : 135|9@0+ (0.0062,-1.571) [-1.571|1.5972] "rad" Vector__XXX
 SG_ S4_SRR_RL_Clu_Dist_170 : 142|12@0+ (0.1,0.4) [0.4|300] "m" Vector__XXX
 SG_ S4_SRR_RL_Clu_Vel_170 : 146|11@0+ (0.1,-111.11) [-111.11|55.59] "mps" Vector__XXX
 SG_ S4_SRR_RL_Clu_SNR_170 : 167|7@0+ (0.5,0) [0|63.5] "dB" Vector__XXX
 SG_ S4_SRR_RL_Clu_RCS_170 : 160|5@0+ (2,-40) [-40|22] "" Vector__XXX
 SG_ S4_SRR_RL_Clu_DynProp_170 : 171|1@0+ (1,0) [0|1] "Unitless" Vector__XXX
 SG_ S4_SRR_RL_Clu_Locationvalid_170 : 170|1@0+ (1,0) [0|1] "" Vector__XXX
 SG_ S4_SRR_RL_Clu_ID_171 : 179|8@0+ (1,0) [0|199] "" Vector__XXX
 SG_ S4_SRR_RL_Clu_Theta_171 : 187|9@0+ (0.0062,-1.571) [-1.571|1.5972] "rad" Vector__XXX
 SG_ S4_SRR_RL_Clu_Dist_171 : 194|12@0+ (0.1,0.4) [0.4|300] "m" Vector__XXX
 SG_ S4_SRR_RL_Clu_Vel_171 : 214|11@0+ (0.1,-111.11) [-111.11|55.59] "mps" Vector__XXX
 SG_ S4_SRR_RL_Clu_SNR_171 : 219|7@0+ (0.5,0) [0|63.5] "dB" Vector__XXX
 SG_ S4_SRR_RL_Clu_RCS_171 : 228|5@0+ (2,-40) [-40|22] "" Vector__XXX
 SG_ S4_SRR_RL_Clu_DynProp_171 : 239|1@0+ (1,0) [0|1] "Unitless" Vector__XXX
 SG_ S4_SRR_RL_Clu_Locationvalid_171 : 238|1@0+ (1,0) [0|1] "" Vector__XXX
 SG_ S4_SRR_RL_Clu_ID_172 : 247|8@0+ (1,0) [0|199] "" Vector__XXX
 SG_ S4_SRR_RL_Clu_Theta_172 : 255|9@0+ (0.0062,-1.571) [-1.571|1.5972] "rad" Vector__XXX
 SG_ S4_SRR_RL_Clu_Dist_172 : 262|12@0+ (0.1,0.4) [0.4|300] "m" Vector__XXX
 SG_ S4_SRR_RL_Clu_Vel_172 : 266|11@0+ (0.1,-111.11) [-111.11|55.59] "mps" Vector__XXX
 SG_ S4_SRR_RL_Clu_SNR_172 : 287|7@0+ (0.5,0) [0|63.5] "dB" Vector__XXX
 SG_ S4_SRR_RL_Clu_RCS_172 : 280|5@0+ (2,-40) [-40|22] "" Vector__XXX
 SG_ S4_SRR_RL_Clu_DynProp_172 : 291|1@0+ (1,0) [0|1] "Unitless" Vector__XXX
 SG_ S4_SRR_RL_Clu_Locationvalid_172 : 290|1@0+ (1,0) [0|1] "" Vector__XXX
 SG_ S4_SRR_RL_Clu_ID_173 : 299|8@0+ (1,0) [0|199] "" Vector__XXX
 SG_ S4_SRR_RL_Clu_Theta_173 : 307|9@0+ (0.0062,-1.571) [-1.571|1.5972] "rad" Vector__XXX
 SG_ S4_SRR_RL_Clu_Dist_173 : 314|12@0+ (0.1,0.4) [0.4|300] "m" Vector__XXX
 SG_ S4_SRR_RL_Clu_Vel_173 : 334|11@0+ (0.1,-111.11) [-111.11|55.59] "mps" Vector__XXX
 SG_ S4_SRR_RL_Clu_SNR_173 : 339|7@0+ (0.5,0) [0|63.5] "dB" Vector__XXX
 SG_ S4_SRR_RL_Clu_RCS_173 : 348|5@0+ (2,-40) [-40|22] "" Vector__XXX
 SG_ S4_SRR_RL_Clu_DynProp_173 : 359|1@0+ (1,0) [0|1] "Unitless" Vector__XXX
 SG_ S4_SRR_RL_Clu_Locationvalid_173 : 358|1@0+ (1,0) [0|1] "" Vector__XXX
 SG_ S4_SRR_RL_Clu_ID_174 : 367|8@0+ (1,0) [0|199] "" Vector__XXX
 SG_ S4_SRR_RL_Clu_Theta_174 : 375|9@0+ (0.0062,-1.571) [-1.571|1.5972] "rad" Vector__XXX
 SG_ S4_SRR_RL_Clu_Dist_174 : 382|12@0+ (0.1,0.4) [0.4|300] "m" Vector__XXX
 SG_ S4_SRR_RL_Clu_Vel_174 : 386|11@0+ (0.1,-111.11) [-111.11|55.59] "mps" Vector__XXX
 SG_ S4_SRR_RL_Clu_SNR_174 : 407|7@0+ (0.5,0) [0|63.5] "dB" Vector__XXX
 SG_ S4_SRR_RL_Clu_RCS_174 : 400|5@0+ (2,-40) [-40|22] "" Vector__XXX
 SG_ S4_SRR_RL_Clu_DynProp_174 : 411|1@0+ (1,0) [0|1] "Unitless" Vector__XXX
 SG_ S4_SRR_RL_Clu_Locationvalid_174 : 410|1@0+ (1,0) [0|1] "" Vector__XXX
 SG_ S4_SRR_RL_Clu_Mes_24_blockcounter : 503|4@0+ (1,0) [0|15] "" Vector__XXX
 SG_ S4_SRR_RL_Clu_24_MsgCounter : 499|4@0+ (1,0) [0|14] "" Vector__XXX
 SG_ S4_SRR_RL_Clu_24_E2EChecksum : 511|8@0+ (1,0) [0|255] "" Vector__XXX

BO_ 611 S4_SRR_RL_Clu_Mes_25: 64 SRR_RL
 SG_ S4_SRR_RL_Clu_ID_175 : 7|8@0+ (1,0) [0|199] "" Vector__XXX
 SG_ S4_SRR_RL_Clu_Theta_175 : 15|9@0+ (0.0062,-1.571) [-1.571|1.5972] "rad" Vector__XXX
 SG_ S4_SRR_RL_Clu_Dist_175 : 22|12@0+ (0.1,0.4) [0.4|300] "m" Vector__XXX
 SG_ S4_SRR_RL_Clu_Vel_175 : 26|11@0+ (0.1,-111.11) [-111.11|55.59] "mps" Vector__XXX
 SG_ S4_SRR_RL_Clu_SNR_175 : 47|7@0+ (0.5,0) [0|63.5] "dB" Vector__XXX
 SG_ S4_SRR_RL_Clu_RCS_175 : 40|5@0+ (2,-40) [-40|22] "" Vector__XXX
 SG_ S4_SRR_RL_Clu_DynProp_175 : 51|1@0+ (1,0) [0|1] "Unitless" Vector__XXX
 SG_ S4_SRR_RL_Clu_Locationvalid_175 : 50|1@0+ (1,0) [0|1] "" Vector__XXX
 SG_ S4_SRR_RL_Clu_ID_176 : 59|8@0+ (1,0) [0|199] "" Vector__XXX
 SG_ S4_SRR_RL_Clu_Theta_176 : 67|9@0+ (0.0062,-1.571) [-1.571|1.5972] "rad" Vector__XXX
 SG_ S4_SRR_RL_Clu_Dist_176 : 74|12@0+ (0.1,0.4) [0.4|300] "m" Vector__XXX
 SG_ S4_SRR_RL_Clu_Vel_176 : 94|11@0+ (0.1,-111.11) [-111.11|55.59] "mps" Vector__XXX
 SG_ S4_SRR_RL_Clu_SNR_176 : 99|7@0+ (0.5,0) [0|63.5] "dB" Vector__XXX
 SG_ S4_SRR_RL_Clu_RCS_176 : 108|5@0+ (2,-40) [-40|22] "" Vector__XXX
 SG_ S4_SRR_RL_Clu_DynProp_176 : 119|1@0+ (1,0) [0|1] "Unitless" Vector__XXX
 SG_ S4_SRR_RL_Clu_Locationvalid_176 : 118|1@0+ (1,0) [0|1] "" Vector__XXX
 SG_ S4_SRR_RL_Clu_ID_177 : 127|8@0+ (1,0) [0|199] "" Vector__XXX
 SG_ S4_SRR_RL_Clu_Theta_177 : 135|9@0+ (0.0062,-1.571) [-1.571|1.5972] "rad" Vector__XXX
 SG_ S4_SRR_RL_Clu_Dist_177 : 142|12@0+ (0.1,0.4) [0.4|300] "m" Vector__XXX
 SG_ S4_SRR_RL_Clu_Vel_177 : 146|11@0+ (0.1,-111.11) [-111.11|55.59] "mps" Vector__XXX
 SG_ S4_SRR_RL_Clu_SNR_177 : 167|7@0+ (0.5,0) [0|63.5] "dB" Vector__XXX
 SG_ S4_SRR_RL_Clu_RCS_177 : 160|5@0+ (2,-40) [-40|22] "" Vector__XXX
 SG_ S4_SRR_RL_Clu_DynProp_177 : 171|1@0+ (1,0) [0|1] "Unitless" Vector__XXX
 SG_ S4_SRR_RL_Clu_Locationvalid_177 : 170|1@0+ (1,0) [0|1] "" Vector__XXX
 SG_ S4_SRR_RL_Clu_ID_178 : 179|8@0+ (1,0) [0|199] "" Vector__XXX
 SG_ S4_SRR_RL_Clu_Theta_178 : 187|9@0+ (0.0062,-1.571) [-1.571|1.5972] "rad" Vector__XXX
 SG_ S4_SRR_RL_Clu_Dist_178 : 194|12@0+ (0.1,0.4) [0.4|300] "m" Vector__XXX
 SG_ S4_SRR_RL_Clu_Vel_178 : 214|11@0+ (0.1,-111.11) [-111.11|55.59] "mps" Vector__XXX
 SG_ S4_SRR_RL_Clu_SNR_178 : 219|7@0+ (0.5,0) [0|63.5] "dB" Vector__XXX
 SG_ S4_SRR_RL_Clu_RCS_178 : 228|5@0+ (2,-40) [-40|22] "" Vector__XXX
 SG_ S4_SRR_RL_Clu_DynProp_178 : 239|1@0+ (1,0) [0|1] "Unitless" Vector__XXX
 SG_ S4_SRR_RL_Clu_Locationvalid_178 : 238|1@0+ (1,0) [0|1] "" Vector__XXX
 SG_ S4_SRR_RL_Clu_ID_179 : 247|8@0+ (1,0) [0|199] "" Vector__XXX
 SG_ S4_SRR_RL_Clu_Theta_179 : 255|9@0+ (0.0062,-1.571) [-1.571|1.5972] "rad" Vector__XXX
 SG_ S4_SRR_RL_Clu_Dist_179 : 262|12@0+ (0.1,0.4) [0.4|300] "m" Vector__XXX
 SG_ S4_SRR_RL_Clu_Vel_179 : 266|11@0+ (0.1,-111.11) [-111.11|55.59] "mps" Vector__XXX
 SG_ S4_SRR_RL_Clu_SNR_179 : 287|7@0+ (0.5,0) [0|63.5] "dB" Vector__XXX
 SG_ S4_SRR_RL_Clu_RCS_179 : 280|5@0+ (2,-40) [-40|22] "" Vector__XXX
 SG_ S4_SRR_RL_Clu_DynProp_179 : 291|1@0+ (1,0) [0|1] "Unitless" Vector__XXX
 SG_ S4_SRR_RL_Clu_Locationvalid_179 : 290|1@0+ (1,0) [0|1] "" Vector__XXX
 SG_ S4_SRR_RL_Clu_ID_180 : 299|8@0+ (1,0) [0|199] "" Vector__XXX
 SG_ S4_SRR_RL_Clu_Theta_180 : 307|9@0+ (0.0062,-1.571) [-1.571|1.5972] "rad" Vector__XXX
 SG_ S4_SRR_RL_Clu_Dist_180 : 314|12@0+ (0.1,0.4) [0.4|300] "m" Vector__XXX
 SG_ S4_SRR_RL_Clu_Vel_180 : 334|11@0+ (0.1,-111.11) [-111.11|55.59] "mps" Vector__XXX
 SG_ S4_SRR_RL_Clu_SNR_180 : 339|7@0+ (0.5,0) [0|63.5] "dB" Vector__XXX
 SG_ S4_SRR_RL_Clu_RCS_180 : 348|5@0+ (2,-40) [-40|22] "" Vector__XXX
 SG_ S4_SRR_RL_Clu_DynProp_180 : 359|1@0+ (1,0) [0|1] "Unitless" Vector__XXX
 SG_ S4_SRR_RL_Clu_Locationvalid_180 : 358|1@0+ (1,0) [0|1] "" Vector__XXX
 SG_ S4_SRR_RL_Clu_ID_181 : 367|8@0+ (1,0) [0|199] "" Vector__XXX
 SG_ S4_SRR_RL_Clu_Theta_181 : 375|9@0+ (0.0062,-1.571) [-1.571|1.5972] "rad" Vector__XXX
 SG_ S4_SRR_RL_Clu_Dist_181 : 382|12@0+ (0.1,0.4) [0.4|300] "m" Vector__XXX
 SG_ S4_SRR_RL_Clu_Vel_181 : 386|11@0+ (0.1,-111.11) [-111.11|55.59] "mps" Vector__XXX
 SG_ S4_SRR_RL_Clu_SNR_181 : 407|7@0+ (0.5,0) [0|63.5] "dB" Vector__XXX
 SG_ S4_SRR_RL_Clu_RCS_181 : 400|5@0+ (2,-40) [-40|22] "" Vector__XXX
 SG_ S4_SRR_RL_Clu_DynProp_181 : 411|1@0+ (1,0) [0|1] "Unitless" Vector__XXX
 SG_ S4_SRR_RL_Clu_Locationvalid_181 : 410|1@0+ (1,0) [0|1] "" Vector__XXX
 SG_ S4_SRR_RL_Clu_Mes_25_blockcounter : 503|4@0+ (1,0) [0|15] "" Vector__XXX
 SG_ S4_SRR_RL_Clu_25_MsgCounter : 499|4@0+ (1,0) [0|14] "" Vector__XXX
 SG_ S4_SRR_RL_Clu_25_E2EChecksum : 511|8@0+ (1,0) [0|255] "" Vector__XXX

BO_ 612 S4_SRR_RL_Clu_Mes_26: 64 SRR_RL
 SG_ S4_SRR_RL_Clu_ID_182 : 7|8@0+ (1,0) [0|199] "" Vector__XXX
 SG_ S4_SRR_RL_Clu_Theta_182 : 15|9@0+ (0.0062,-1.571) [-1.571|1.5972] "rad" Vector__XXX
 SG_ S4_SRR_RL_Clu_Dist_182 : 22|12@0+ (0.1,0.4) [0.4|300] "m" Vector__XXX
 SG_ S4_SRR_RL_Clu_Vel_182 : 26|11@0+ (0.1,-111.11) [-111.11|55.59] "mps" Vector__XXX
 SG_ S4_SRR_RL_Clu_SNR_182 : 47|7@0+ (0.5,0) [0|63.5] "dB" Vector__XXX
 SG_ S4_SRR_RL_Clu_RCS_182 : 40|5@0+ (2,-40) [-40|22] "" Vector__XXX
 SG_ S4_SRR_RL_Clu_DynProp_182 : 51|1@0+ (1,0) [0|1] "Unitless" Vector__XXX
 SG_ S4_SRR_RL_Clu_Locationvalid_182 : 50|1@0+ (1,0) [0|1] "" Vector__XXX
 SG_ S4_SRR_RL_Clu_ID_183 : 59|8@0+ (1,0) [0|199] "" Vector__XXX
 SG_ S4_SRR_RL_Clu_Theta_183 : 67|9@0+ (0.0062,-1.571) [-1.571|1.5972] "rad" Vector__XXX
 SG_ S4_SRR_RL_Clu_Dist_183 : 74|12@0+ (0.1,0.4) [0.4|300] "m" Vector__XXX
 SG_ S4_SRR_RL_Clu_Vel_183 : 94|11@0+ (0.1,-111.11) [-111.11|55.59] "mps" Vector__XXX
 SG_ S4_SRR_RL_Clu_SNR_183 : 99|7@0+ (0.5,0) [0|63.5] "dB" Vector__XXX
 SG_ S4_SRR_RL_Clu_RCS_183 : 108|5@0+ (2,-40) [-40|22] "" Vector__XXX
 SG_ S4_SRR_RL_Clu_DynProp_183 : 119|1@0+ (1,0) [0|1] "Unitless" Vector__XXX
 SG_ S4_SRR_RL_Clu_Locationvalid_183 : 118|1@0+ (1,0) [0|1] "" Vector__XXX
 SG_ S4_SRR_RL_Clu_ID_184 : 127|8@0+ (1,0) [0|199] "" Vector__XXX
 SG_ S4_SRR_RL_Clu_Theta_184 : 135|9@0+ (0.0062,-1.571) [-1.571|1.5972] "rad" Vector__XXX
 SG_ S4_SRR_RL_Clu_Dist_184 : 142|12@0+ (0.1,0.4) [0.4|300] "m" Vector__XXX
 SG_ S4_SRR_RL_Clu_Vel_184 : 146|11@0+ (0.1,-111.11) [-111.11|55.59] "mps" Vector__XXX
 SG_ S4_SRR_RL_Clu_SNR_184 : 167|7@0+ (0.5,0) [0|63.5] "dB" Vector__XXX
 SG_ S4_SRR_RL_Clu_RCS_184 : 160|5@0+ (2,-40) [-40|22] "" Vector__XXX
 SG_ S4_SRR_RL_Clu_DynProp_184 : 171|1@0+ (1,0) [0|1] "Unitless" Vector__XXX
 SG_ S4_SRR_RL_Clu_Locationvalid_184 : 170|1@0+ (1,0) [0|1] "" Vector__XXX
 SG_ S4_SRR_RL_Clu_ID_185 : 179|8@0+ (1,0) [0|199] "" Vector__XXX
 SG_ S4_SRR_RL_Clu_Theta_185 : 187|9@0+ (0.0062,-1.571) [-1.571|1.5972] "rad" Vector__XXX
 SG_ S4_SRR_RL_Clu_Dist_185 : 194|12@0+ (0.1,0.4) [0.4|300] "m" Vector__XXX
 SG_ S4_SRR_RL_Clu_Vel_185 : 214|11@0+ (0.1,-111.11) [-111.11|55.59] "mps" Vector__XXX
 SG_ S4_SRR_RL_Clu_SNR_185 : 219|7@0+ (0.5,0) [0|63.5] "dB" Vector__XXX
 SG_ S4_SRR_RL_Clu_RCS_185 : 228|5@0+ (2,-40) [-40|22] "" Vector__XXX
 SG_ S4_SRR_RL_Clu_DynProp_185 : 239|1@0+ (1,0) [0|1] "Unitless" Vector__XXX
 SG_ S4_SRR_RL_Clu_Locationvalid_185 : 238|1@0+ (1,0) [0|1] "" Vector__XXX
 SG_ S4_SRR_RL_Clu_ID_186 : 247|8@0+ (1,0) [0|199] "" Vector__XXX
 SG_ S4_SRR_RL_Clu_Theta_186 : 255|9@0+ (0.0062,-1.571) [-1.571|1.5972] "rad" Vector__XXX
 SG_ S4_SRR_RL_Clu_Dist_186 : 262|12@0+ (0.1,0.4) [0.4|300] "m" Vector__XXX
 SG_ S4_SRR_RL_Clu_Vel_186 : 266|11@0+ (0.1,-111.11) [-111.11|55.59] "mps" Vector__XXX
 SG_ S4_SRR_RL_Clu_SNR_186 : 287|7@0+ (0.5,0) [0|63.5] "dB" Vector__XXX
 SG_ S4_SRR_RL_Clu_RCS_186 : 280|5@0+ (2,-40) [-40|22] "" Vector__XXX
 SG_ S4_SRR_RL_Clu_DynProp_186 : 291|1@0+ (1,0) [0|1] "Unitless" Vector__XXX
 SG_ S4_SRR_RL_Clu_Locationvalid_186 : 290|1@0+ (1,0) [0|1] "" Vector__XXX
 SG_ S4_SRR_RL_Clu_ID_187 : 299|8@0+ (1,0) [0|199] "" Vector__XXX
 SG_ S4_SRR_RL_Clu_Theta_187 : 307|9@0+ (0.0062,-1.571) [-1.571|1.5972] "rad" Vector__XXX
 SG_ S4_SRR_RL_Clu_Dist_187 : 314|12@0+ (0.1,0.4) [0.4|300] "m" Vector__XXX
 SG_ S4_SRR_RL_Clu_Vel_187 : 334|11@0+ (0.1,-111.11) [-111.11|55.59] "mps" Vector__XXX
 SG_ S4_SRR_RL_Clu_SNR_187 : 339|7@0+ (0.5,0) [0|63.5] "dB" Vector__XXX
 SG_ S4_SRR_RL_Clu_RCS_187 : 348|5@0+ (2,-40) [-40|22] "" Vector__XXX
 SG_ S4_SRR_RL_Clu_DynProp_187 : 359|1@0+ (1,0) [0|1] "Unitless" Vector__XXX
 SG_ S4_SRR_RL_Clu_Locationvalid_187 : 358|1@0+ (1,0) [0|1] "" Vector__XXX
 SG_ S4_SRR_RL_Clu_ID_188 : 367|8@0+ (1,0) [0|199] "" Vector__XXX
 SG_ S4_SRR_RL_Clu_Theta_188 : 375|9@0+ (0.0062,-1.571) [-1.571|1.5972] "rad" Vector__XXX
 SG_ S4_SRR_RL_Clu_Dist_188 : 382|12@0+ (0.1,0.4) [0.4|300] "m" Vector__XXX
 SG_ S4_SRR_RL_Clu_Vel_188 : 386|11@0+ (0.1,-111.11) [-111.11|55.59] "mps" Vector__XXX
 SG_ S4_SRR_RL_Clu_SNR_188 : 407|7@0+ (0.5,0) [0|63.5] "dB" Vector__XXX
 SG_ S4_SRR_RL_Clu_RCS_188 : 400|5@0+ (2,-40) [-40|22] "" Vector__XXX
 SG_ S4_SRR_RL_Clu_DynProp_188 : 411|1@0+ (1,0) [0|1] "Unitless" Vector__XXX
 SG_ S4_SRR_RL_Clu_Locationvalid_188 : 410|1@0+ (1,0) [0|1] "" Vector__XXX
 SG_ S4_SRR_RL_Clu_Mes_26_blockcounter : 503|4@0+ (1,0) [0|15] "" Vector__XXX
 SG_ S4_SRR_RL_Clu_26_MsgCounter : 499|4@0+ (1,0) [0|14] "" Vector__XXX
 SG_ S4_SRR_RL_Clu_26_E2EChecksum : 511|8@0+ (1,0) [0|255] "" Vector__XXX

BO_ 613 S4_SRR_RL_Clu_Mes_27: 64 SRR_RL
 SG_ S4_SRR_RL_Clu_ID_189 : 7|8@0+ (1,0) [0|199] "" Vector__XXX
 SG_ S4_SRR_RL_Clu_Theta_189 : 15|9@0+ (0.0062,-1.571) [-1.571|1.5972] "rad" Vector__XXX
 SG_ S4_SRR_RL_Clu_Dist_189 : 22|12@0+ (0.1,0.4) [0.4|300] "m" Vector__XXX
 SG_ S4_SRR_RL_Clu_Vel_189 : 26|11@0+ (0.1,-111.11) [-111.11|55.59] "mps" Vector__XXX
 SG_ S4_SRR_RL_Clu_SNR_189 : 47|7@0+ (0.5,0) [0|63.5] "dB" Vector__XXX
 SG_ S4_SRR_RL_Clu_RCS_189 : 40|5@0+ (2,-40) [-40|22] "" Vector__XXX
 SG_ S4_SRR_RL_Clu_DynProp_189 : 51|1@0+ (1,0) [0|1] "Unitless" Vector__XXX
 SG_ S4_SRR_RL_Clu_Locationvalid_189 : 50|1@0+ (1,0) [0|1] "" Vector__XXX
 SG_ S4_SRR_RL_Clu_ID_190 : 59|8@0+ (1,0) [0|199] "" Vector__XXX
 SG_ S4_SRR_RL_Clu_Theta_190 : 67|9@0+ (0.0062,-1.571) [-1.571|1.5972] "rad" Vector__XXX
 SG_ S4_SRR_RL_Clu_Dist_190 : 74|12@0+ (0.1,0.4) [0.4|300] "m" Vector__XXX
 SG_ S4_SRR_RL_Clu_Vel_190 : 94|11@0+ (0.1,-111.11) [-111.11|55.59] "mps" Vector__XXX
 SG_ S4_SRR_RL_Clu_SNR_190 : 99|7@0+ (0.5,0) [0|63.5] "dB" Vector__XXX
 SG_ S4_SRR_RL_Clu_RCS_190 : 108|5@0+ (2,-40) [-40|22] "" Vector__XXX
 SG_ S4_SRR_RL_Clu_DynProp_190 : 119|1@0+ (1,0) [0|1] "Unitless" Vector__XXX
 SG_ S4_SRR_RL_Clu_Locationvalid_190 : 118|1@0+ (1,0) [0|1] "" Vector__XXX
 SG_ S4_SRR_RL_Clu_ID_191 : 127|8@0+ (1,0) [0|199] "" Vector__XXX
 SG_ S4_SRR_RL_Clu_Theta_191 : 135|9@0+ (0.0062,-1.571) [-1.571|1.5972] "rad" Vector__XXX
 SG_ S4_SRR_RL_Clu_Dist_191 : 142|12@0+ (0.1,0.4) [0.4|300] "m" Vector__XXX
 SG_ S4_SRR_RL_Clu_Vel_191 : 146|11@0+ (0.1,-111.11) [-111.11|55.59] "mps" Vector__XXX
 SG_ S4_SRR_RL_Clu_SNR_191 : 167|7@0+ (0.5,0) [0|63.5] "dB" Vector__XXX
 SG_ S4_SRR_RL_Clu_RCS_191 : 160|5@0+ (2,-40) [-40|22] "" Vector__XXX
 SG_ S4_SRR_RL_Clu_DynProp_191 : 171|1@0+ (1,0) [0|1] "Unitless" Vector__XXX
 SG_ S4_SRR_RL_Clu_Locationvalid_191 : 170|1@0+ (1,0) [0|1] "" Vector__XXX
 SG_ S4_SRR_RL_Clu_ID_192 : 179|8@0+ (1,0) [0|199] "" Vector__XXX
 SG_ S4_SRR_RL_Clu_Theta_192 : 187|9@0+ (0.0062,-1.571) [-1.571|1.5972] "rad" Vector__XXX
 SG_ S4_SRR_RL_Clu_Dist_192 : 194|12@0+ (0.1,0.4) [0.4|300] "m" Vector__XXX
 SG_ S4_SRR_RL_Clu_Vel_192 : 214|11@0+ (0.1,-111.11) [-111.11|55.59] "mps" Vector__XXX
 SG_ S4_SRR_RL_Clu_SNR_192 : 219|7@0+ (0.5,0) [0|63.5] "dB" Vector__XXX
 SG_ S4_SRR_RL_Clu_RCS_192 : 228|5@0+ (2,-40) [-40|22] "" Vector__XXX
 SG_ S4_SRR_RL_Clu_DynProp_192 : 239|1@0+ (1,0) [0|1] "Unitless" Vector__XXX
 SG_ S4_SRR_RL_Clu_Locationvalid_192 : 238|1@0+ (1,0) [0|1] "" Vector__XXX
 SG_ S4_SRR_RL_Clu_ID_193 : 247|8@0+ (1,0) [0|199] "" Vector__XXX
 SG_ S4_SRR_RL_Clu_Theta_193 : 255|9@0+ (0.0062,-1.571) [-1.571|1.5972] "rad" Vector__XXX
 SG_ S4_SRR_RL_Clu_Dist_193 : 262|12@0+ (0.1,0.4) [0.4|300] "m" Vector__XXX
 SG_ S4_SRR_RL_Clu_Vel_193 : 266|11@0+ (0.1,-111.11) [-111.11|55.59] "mps" Vector__XXX
 SG_ S4_SRR_RL_Clu_SNR_193 : 287|7@0+ (0.5,0) [0|63.5] "dB" Vector__XXX
 SG_ S4_SRR_RL_Clu_RCS_193 : 280|5@0+ (2,-40) [-40|22] "" Vector__XXX
 SG_ S4_SRR_RL_Clu_DynProp_193 : 291|1@0+ (1,0) [0|1] "Unitless" Vector__XXX
 SG_ S4_SRR_RL_Clu_Locationvalid_193 : 290|1@0+ (1,0) [0|1] "" Vector__XXX
 SG_ S4_SRR_RL_Clu_ID_194 : 299|8@0+ (1,0) [0|199] "" Vector__XXX
 SG_ S4_SRR_RL_Clu_Theta_194 : 307|9@0+ (0.0062,-1.571) [-1.571|1.5972] "rad" Vector__XXX
 SG_ S4_SRR_RL_Clu_Dist_194 : 314|12@0+ (0.1,0.4) [0.4|300] "m" Vector__XXX
 SG_ S4_SRR_RL_Clu_Vel_194 : 334|11@0+ (0.1,-111.11) [-111.11|55.59] "mps" Vector__XXX
 SG_ S4_SRR_RL_Clu_SNR_194 : 339|7@0+ (0.5,0) [0|63.5] "dB" Vector__XXX
 SG_ S4_SRR_RL_Clu_RCS_194 : 348|5@0+ (2,-40) [-40|22] "" Vector__XXX
 SG_ S4_SRR_RL_Clu_DynProp_194 : 359|1@0+ (1,0) [0|1] "Unitless" Vector__XXX
 SG_ S4_SRR_RL_Clu_Locationvalid_194 : 358|1@0+ (1,0) [0|1] "" Vector__XXX
 SG_ S4_SRR_RL_Clu_ID_195 : 367|8@0+ (1,0) [0|199] "" Vector__XXX
 SG_ S4_SRR_RL_Clu_Theta_195 : 375|9@0+ (0.0062,-1.571) [-1.571|1.5972] "rad" Vector__XXX
 SG_ S4_SRR_RL_Clu_Dist_195 : 382|12@0+ (0.1,0.4) [0.4|300] "m" Vector__XXX
 SG_ S4_SRR_RL_Clu_Vel_195 : 386|11@0+ (0.1,-111.11) [-111.11|55.59] "mps" Vector__XXX
 SG_ S4_SRR_RL_Clu_SNR_195 : 407|7@0+ (0.5,0) [0|63.5] "dB" Vector__XXX
 SG_ S4_SRR_RL_Clu_RCS_195 : 400|5@0+ (2,-40) [-40|22] "" Vector__XXX
 SG_ S4_SRR_RL_Clu_DynProp_195 : 411|1@0+ (1,0) [0|1] "Unitless" Vector__XXX
 SG_ S4_SRR_RL_Clu_Locationvalid_195 : 410|1@0+ (1,0) [0|1] "" Vector__XXX
 SG_ S4_SRR_RL_Clu_Mes_27_blockcounter : 503|4@0+ (1,0) [0|15] "" Vector__XXX
 SG_ S4_SRR_RL_Clu_27_MsgCounter : 499|4@0+ (1,0) [0|14] "" Vector__XXX
 SG_ S4_SRR_RL_Clu_27_E2EChecksum : 511|8@0+ (1,0) [0|255] "" Vector__XXX

BO_ 614 S4_SRR_RL_Clu_Mes_28: 48 SRR_RL
 SG_ S4_SRR_RL_Clu_ID_196 : 7|8@0+ (1,0) [0|199] "" Vector__XXX
 SG_ S4_SRR_RL_Clu_Theta_196 : 15|9@0+ (0.0062,-1.571) [-1.571|1.5972] "rad" Vector__XXX
 SG_ S4_SRR_RL_Clu_Dist_196 : 22|12@0+ (0.1,0.4) [0.4|300] "m" Vector__XXX
 SG_ S4_SRR_RL_Clu_Vel_196 : 26|11@0+ (0.1,-111.11) [-111.11|55.59] "mps" Vector__XXX
 SG_ S4_SRR_RL_Clu_SNR_196 : 47|7@0+ (0.5,0) [0|63.5] "dB" Vector__XXX
 SG_ S4_SRR_RL_Clu_RCS_196 : 40|5@0+ (2,-40) [-40|22] "" Vector__XXX
 SG_ S4_SRR_RL_Clu_DynProp_196 : 51|1@0+ (1,0) [0|1] "Unitless" Vector__XXX
 SG_ S4_SRR_RL_Clu_Locationvalid_196 : 50|1@0+ (1,0) [0|1] "" Vector__XXX
 SG_ S4_SRR_RL_Clu_ID_197 : 59|8@0+ (1,0) [0|199] "" Vector__XXX
 SG_ S4_SRR_RL_Clu_Theta_197 : 67|9@0+ (0.0062,-1.571) [-1.571|1.5972] "rad" Vector__XXX
 SG_ S4_SRR_RL_Clu_Dist_197 : 74|12@0+ (0.1,0.4) [0.4|300] "m" Vector__XXX
 SG_ S4_SRR_RL_Clu_Vel_197 : 94|11@0+ (0.1,-111.11) [-111.11|55.59] "mps" Vector__XXX
 SG_ S4_SRR_RL_Clu_SNR_197 : 99|7@0+ (0.5,0) [0|63.5] "dB" Vector__XXX
 SG_ S4_SRR_RL_Clu_RCS_197 : 108|5@0+ (2,-40) [-40|22] "" Vector__XXX
 SG_ S4_SRR_RL_Clu_DynProp_197 : 119|1@0+ (1,0) [0|1] "Unitless" Vector__XXX
 SG_ S4_SRR_RL_Clu_Locationvalid_197 : 118|1@0+ (1,0) [0|1] "" Vector__XXX
 SG_ S4_SRR_RL_Clu_ID_198 : 127|8@0+ (1,0) [0|199] "" Vector__XXX
 SG_ S4_SRR_RL_Clu_Theta_198 : 135|9@0+ (0.0062,-1.571) [-1.571|1.5972] "rad" Vector__XXX
 SG_ S4_SRR_RL_Clu_Dist_198 : 142|12@0+ (0.1,0.4) [0.4|300] "m" Vector__XXX
 SG_ S4_SRR_RL_Clu_Vel_198 : 146|11@0+ (0.1,-111.11) [-111.11|55.59] "mps" Vector__XXX
 SG_ S4_SRR_RL_Clu_SNR_198 : 167|7@0+ (0.5,0) [0|63.5] "dB" Vector__XXX
 SG_ S4_SRR_RL_Clu_RCS_198 : 160|5@0+ (2,-40) [-40|22] "" Vector__XXX
 SG_ S4_SRR_RL_Clu_DynProp_198 : 171|1@0+ (1,0) [0|1] "Unitless" Vector__XXX
 SG_ S4_SRR_RL_Clu_Locationvalid_198 : 170|1@0+ (1,0) [0|1] "" Vector__XXX
 SG_ S4_SRR_RL_Clu_ID_199 : 179|8@0+ (1,0) [0|199] "" Vector__XXX
 SG_ S4_SRR_RL_Clu_Theta_199 : 187|9@0+ (0.0062,-1.571) [-1.571|1.5972] "rad" Vector__XXX
 SG_ S4_SRR_RL_Clu_Dist_199 : 194|12@0+ (0.1,0.4) [0.4|300] "m" Vector__XXX
 SG_ S4_SRR_RL_Clu_Vel_199 : 214|11@0+ (0.1,-111.11) [-111.11|55.59] "mps" Vector__XXX
 SG_ S4_SRR_RL_Clu_SNR_199 : 219|7@0+ (0.5,0) [0|63.5] "dB" Vector__XXX
 SG_ S4_SRR_RL_Clu_RCS_199 : 228|5@0+ (2,-40) [-40|22] "" Vector__XXX
 SG_ S4_SRR_RL_Clu_DynProp_199 : 239|1@0+ (1,0) [0|1] "Unitless" Vector__XXX
 SG_ S4_SRR_RL_Clu_Locationvalid_199 : 238|1@0+ (1,0) [0|1] "" Vector__XXX
 SG_ S4_SRR_RL_Clu_Mes_28_blockcounter : 375|4@0+ (1,0) [0|15] "" Vector__XXX
 SG_ S4_SRR_RL_Clu_28_MsgCounter : 371|4@0+ (1,0) [0|14] "" Vector__XXX
 SG_ S4_SRR_RL_Clu_28_E2EChecksum : 383|8@0+ (1,0) [0|255] "" Vector__XXX

BO_ 615 S4_SRR_RL_Obj_Mes_0: 64 SRR_RL
 SG_ S4_SRR_RL_Obj_ID_0 : 7|7@0+ (1,0) [0|126] "" Vector__XXX
 SG_ S4_SRR_RL_Obj_DistX_0 : 0|13@0+ (0.0625,-255.9375) [-255.9375|255.9375] "m" Vector__XXX
 SG_ S4_SRR_RL_Obj_RelVelX_0 : 19|11@0+ (0.125,-128) [-128|127.875] "mps" Vector__XXX
 SG_ S4_SRR_RL_Obj_AccelX_0 : 24|10@0+ (0.125,-44.5) [-44.5|44.5] "mps2" Vector__XXX
 SG_ S4_SRR_RL_Obj_DistY_0 : 46|13@0+ (0.0625,-255.9375) [-255.9375|255.9375] "m" Vector__XXX
 SG_ S4_SRR_RL_Obj_RelVelY_0 : 49|11@0+ (0.125,-128) [-128|127.875] "mps" Vector__XXX
 SG_ S4_SRR_RL_Obj_AccelY_0 : 70|10@0+ (0.125,-44.5) [-44.5|44.5] "mps2" Vector__XXX
 SG_ S4_SRR_RL_Obj_DistXStd_0 : 76|8@0+ (0.05,0) [0|12.75] "m" Vector__XXX
 SG_ S4_SRR_RL_Obj_RelVelXStd_0 : 84|6@0+ (0.2,0) [0|12.6] "mps" Vector__XXX
 SG_ S4_SRR_RL_Obj_RAccelXStd_0 : 94|5@0+ (0.35,0) [0|10.85] "mps2" Vector__XXX
 SG_ S4_SRR_RL_Obj_DistYStd_0 : 89|8@0+ (0.1,0) [0|25.5] "m" Vector__XXX
 SG_ S4_SRR_RL_Obj_RelVelYStd_0 : 97|6@0+ (0.2,0) [0|12.6] "mps" Vector__XXX
 SG_ S4_SRR_RL_Obj_RAccelYStd_0 : 107|5@0+ (0.35,0) [0|10.85] "mps2" Vector__XXX
 SG_ S4_SRR_RL_Obj_ValidFlag_0 : 118|1@0+ (1,0) [0|1] "" Vector__XXX
 SG_ S4_SRR_RL_Obj_UpdateFlag_0 : 117|1@0+ (1,0) [0|1] "" Vector__XXX
 SG_ S4_SRR_RL_Obj_ExistProb_0 : 116|7@0+ (1,0) [0|100] "percent" Vector__XXX
 SG_ S4_SRR_RL_Obj_Type_0 : 125|4@0+ (1,0) [0|15] "" Vector__XXX
 SG_ S4_SRR_RL_Obj_EDynProp_0 : 121|4@0+ (1,0) [0|15] "" Vector__XXX
 SG_ S4_SRR_RL_Obj_UiLifeCycles_0 : 133|7@0+ (1,0) [0|127] "" Vector__XXX
 SG_ S4_SRR_RL_Obj_RCS_0 : 142|11@0+ (0.1,-100) [-100|100] "dBm" Vector__XXX
 SG_ S4_SRR_RL_Obj_ID_1 : 147|7@0+ (1,0) [0|126] "" Vector__XXX
 SG_ S4_SRR_RL_Obj_DistX_1 : 156|13@0+ (0.0625,-255.9375) [-255.9375|255.9375] "m" Vector__XXX
 SG_ S4_SRR_RL_Obj_RelVelX_1 : 175|11@0+ (0.125,-128) [-128|127.875] "mps" Vector__XXX
 SG_ S4_SRR_RL_Obj_AccelX_1 : 180|10@0+ (0.125,-44.5) [-44.5|44.5] "mps2" Vector__XXX
 SG_ S4_SRR_RL_Obj_DistY_1 : 186|13@0+ (0.0625,-255.9375) [-255.9375|255.9375] "m" Vector__XXX
 SG_ S4_SRR_RL_Obj_RelVelY_1 : 205|11@0+ (0.125,-128) [-128|127.875] "mps" Vector__XXX
 SG_ S4_SRR_RL_Obj_AccelY_1 : 210|10@0+ (0.125,-44.5) [-44.5|44.5] "mps2" Vector__XXX
 SG_ S4_SRR_RL_Obj_DistXStd_1 : 216|8@0+ (0.05,0) [0|12.75] "m" Vector__XXX
 SG_ S4_SRR_RL_Obj_RelVelXStd_1 : 224|6@0+ (0.2,0) [0|12.6] "mps" Vector__XXX
 SG_ S4_SRR_RL_Obj_RAccelXStd_1 : 234|5@0+ (0.35,0) [0|10.85] "mps2" Vector__XXX
 SG_ S4_SRR_RL_Obj_DistYStd_1 : 245|8@0+ (0.1,0) [0|25.5] "m" Vector__XXX
 SG_ S4_SRR_RL_Obj_RelVelYStd_1 : 253|6@0+ (0.2,0) [0|12.6] "mps" Vector__XXX
 SG_ S4_SRR_RL_Obj_RAccelYStd_1 : 263|5@0+ (0.35,0) [0|10.85] "mps2" Vector__XXX
 SG_ S4_SRR_RL_Obj_ValidFlag_1 : 258|1@0+ (1,0) [0|1] "" Vector__XXX
 SG_ S4_SRR_RL_Obj_UpdateFlag_1 : 257|1@0+ (1,0) [0|1] "" Vector__XXX
 SG_ S4_SRR_RL_Obj_ExistProb_1 : 256|7@0+ (1,0) [0|100] "percent" Vector__XXX
 SG_ S4_SRR_RL_Obj_Type_1 : 265|4@0+ (1,0) [0|15] "" Vector__XXX
 SG_ S4_SRR_RL_Obj_EDynProp_1 : 277|4@0+ (1,0) [0|15] "" Vector__XXX
 SG_ S4_SRR_RL_Obj_UiLifeCycles_1 : 273|7@0+ (1,0) [0|127] "" Vector__XXX
 SG_ S4_SRR_RL_Obj_RCS_1 : 282|11@0+ (0.1,-100) [-100|100] "dBm" Vector__XXX
 SG_ S4_SRR_RL_Obj_ID_2 : 303|7@0+ (1,0) [0|126] "" Vector__XXX
 SG_ S4_SRR_RL_Obj_DistX_2 : 296|13@0+ (0.0625,-255.9375) [-255.9375|255.9375] "m" Vector__XXX
 SG_ S4_SRR_RL_Obj_RelVelX_2 : 315|11@0+ (0.125,-128) [-128|127.875] "mps" Vector__XXX
 SG_ S4_SRR_RL_Obj_AccelX_2 : 320|10@0+ (0.125,-44.5) [-44.5|44.5] "mps2" Vector__XXX
 SG_ S4_SRR_RL_Obj_DistY_2 : 342|13@0+ (0.0625,-255.9375) [-255.9375|255.9375] "m" Vector__XXX
 SG_ S4_SRR_RL_Obj_RelVelY_2 : 345|11@0+ (0.125,-128) [-128|127.875] "mps" Vector__XXX
 SG_ S4_SRR_RL_Obj_AccelY_2 : 366|10@0+ (0.125,-44.5) [-44.5|44.5] "mps2" Vector__XXX
 SG_ S4_SRR_RL_Obj_DistXStd_2 : 372|8@0+ (0.05,0) [0|12.75] "m" Vector__XXX
 SG_ S4_SRR_RL_Obj_RelVelXStd_2 : 380|6@0+ (0.2,0) [0|12.6] "mps" Vector__XXX
 SG_ S4_SRR_RL_Obj_RAccelXStd_2 : 390|5@0+ (0.35,0) [0|10.85] "mps2" Vector__XXX
 SG_ S4_SRR_RL_Obj_DistYStd_2 : 385|8@0+ (0.1,0) [0|25.5] "m" Vector__XXX
 SG_ S4_SRR_RL_Obj_RelVelYStd_2 : 393|6@0+ (0.2,0) [0|12.6] "mps" Vector__XXX
 SG_ S4_SRR_RL_Obj_RAccelYStd_2 : 403|5@0+ (0.35,0) [0|10.85] "mps2" Vector__XXX
 SG_ S4_SRR_RL_Obj_ValidFlag_2 : 414|1@0+ (1,0) [0|1] "" Vector__XXX
 SG_ S4_SRR_RL_Obj_UpdateFlag_2 : 413|1@0+ (1,0) [0|1] "" Vector__XXX
 SG_ S4_SRR_RL_Obj_ExistProb_2 : 412|7@0+ (1,0) [0|100] "percent" Vector__XXX
 SG_ S4_SRR_RL_Obj_Type_2 : 421|4@0+ (1,0) [0|15] "" Vector__XXX
 SG_ S4_SRR_RL_Obj_EDynProp_2 : 417|4@0+ (1,0) [0|15] "" Vector__XXX
 SG_ S4_SRR_RL_Obj_UiLifeCycles_2 : 429|7@0+ (1,0) [0|127] "" Vector__XXX
 SG_ S4_SRR_RL_Obj_RCS_2 : 438|11@0+ (0.1,-100) [-100|100] "dBm" Vector__XXX
 SG_ S4_SRR_RL_Obj_Timestamps : 463|32@0+ (1,0) [0|4294967295] "ms" Vector__XXX
 SG_ S4_SRR_RL_Obj_Mes_0_blockcounter : 503|4@0+ (1,0) [0|15] "" Vector__XXX
 SG_ S4_SRR_RL_Obj_0_MsgCounter : 499|4@0+ (1,0) [0|14] "" Vector__XXX
 SG_ S4_SRR_RL_Obj_0_E2EChecksum : 511|8@0+ (1,0) [0|255] "" Vector__XXX

BO_ 616 S4_SRR_RL_Obj_Mes_1: 64 SRR_RL
 SG_ S4_SRR_RL_Obj_ID_3 : 7|7@0+ (1,0) [0|126] "" Vector__XXX
 SG_ S4_SRR_RL_Obj_DistX_3 : 0|13@0+ (0.0625,-255.9375) [-255.9375|255.9375] "m" Vector__XXX
 SG_ S4_SRR_RL_Obj_RelVelX_3 : 19|11@0+ (0.125,-128) [-128|127.875] "mps" Vector__XXX
 SG_ S4_SRR_RL_Obj_AccelX_3 : 24|10@0+ (0.125,-44.5) [-44.5|44.5] "mps2" Vector__XXX
 SG_ S4_SRR_RL_Obj_DistY_3 : 46|13@0+ (0.0625,-255.9375) [-255.9375|255.9375] "m" Vector__XXX
 SG_ S4_SRR_RL_Obj_RelVelY_3 : 49|11@0+ (0.125,-128) [-128|127.875] "mps" Vector__XXX
 SG_ S4_SRR_RL_Obj_AccelY_3 : 70|10@0+ (0.125,-44.5) [-44.5|44.5] "mps2" Vector__XXX
 SG_ S4_SRR_RL_Obj_DistXStd_3 : 76|8@0+ (0.05,0) [0|12.75] "m" Vector__XXX
 SG_ S4_SRR_RL_Obj_RelVelXStd_3 : 84|6@0+ (0.2,0) [0|12.6] "mps" Vector__XXX
 SG_ S4_SRR_RL_Obj_RAccelXStd_3 : 94|5@0+ (0.35,0) [0|10.85] "mps2" Vector__XXX
 SG_ S4_SRR_RL_Obj_DistYStd_3 : 89|8@0+ (0.1,0) [0|25.5] "m" Vector__XXX
 SG_ S4_SRR_RL_Obj_RelVelYStd_3 : 97|6@0+ (0.2,0) [0|12.6] "mps" Vector__XXX
 SG_ S4_SRR_RL_Obj_RAccelYStd_3 : 107|5@0+ (0.35,0) [0|10.85] "mps2" Vector__XXX
 SG_ S4_SRR_RL_Obj_ValidFlag_3 : 118|1@0+ (1,0) [0|1] "" Vector__XXX
 SG_ S4_SRR_RL_Obj_UpdateFlag_3 : 117|1@0+ (1,0) [0|1] "" Vector__XXX
 SG_ S4_SRR_RL_Obj_ExistProb_3 : 116|7@0+ (1,0) [0|100] "percent" Vector__XXX
 SG_ S4_SRR_RL_Obj_Type_3 : 125|4@0+ (1,0) [0|15] "" Vector__XXX
 SG_ S4_SRR_RL_Obj_EDynProp_3 : 121|4@0+ (1,0) [0|15] "" Vector__XXX
 SG_ S4_SRR_RL_Obj_UiLifeCycles_3 : 133|7@0+ (1,0) [0|127] "" Vector__XXX
 SG_ S4_SRR_RL_Obj_RCS_3 : 142|11@0+ (0.1,-100) [-100|100] "dBm" Vector__XXX
 SG_ S4_SRR_RL_Obj_ID_4 : 147|7@0+ (1,0) [0|126] "" Vector__XXX
 SG_ S4_SRR_RL_Obj_DistX_4 : 156|13@0+ (0.0625,-255.9375) [-255.9375|255.9375] "m" Vector__XXX
 SG_ S4_SRR_RL_Obj_RelVelX_4 : 175|11@0+ (0.125,-128) [-128|127.875] "mps" Vector__XXX
 SG_ S4_SRR_RL_Obj_AccelX_4 : 180|10@0+ (0.125,-44.5) [-44.5|44.5] "mps2" Vector__XXX
 SG_ S4_SRR_RL_Obj_DistY_4 : 186|13@0+ (0.0625,-255.9375) [-255.9375|255.9375] "m" Vector__XXX
 SG_ S4_SRR_RL_Obj_RelVelY_4 : 205|11@0+ (0.125,-128) [-128|127.875] "mps" Vector__XXX
 SG_ S4_SRR_RL_Obj_AccelY_4 : 210|10@0+ (0.125,-44.5) [-44.5|44.5] "mps2" Vector__XXX
 SG_ S4_SRR_RL_Obj_DistXStd_4 : 216|8@0+ (0.05,0) [0|12.75] "m" Vector__XXX
 SG_ S4_SRR_RL_Obj_RelVelXStd_4 : 224|6@0+ (0.2,0) [0|12.6] "mps" Vector__XXX
 SG_ S4_SRR_RL_Obj_RAccelXStd_4 : 234|5@0+ (0.35,0) [0|10.85] "mps2" Vector__XXX
 SG_ S4_SRR_RL_Obj_DistYStd_4 : 245|8@0+ (0.1,0) [0|25.5] "m" Vector__XXX
 SG_ S4_SRR_RL_Obj_RelVelYStd_4 : 253|6@0+ (0.2,0) [0|12.6] "mps" Vector__XXX
 SG_ S4_SRR_RL_Obj_RAccelYStd_4 : 263|5@0+ (0.35,0) [0|10.85] "mps2" Vector__XXX
 SG_ S4_SRR_RL_Obj_ValidFlag_4 : 258|1@0+ (1,0) [0|1] "" Vector__XXX
 SG_ S4_SRR_RL_Obj_UpdateFlag_4 : 257|1@0+ (1,0) [0|1] "" Vector__XXX
 SG_ S4_SRR_RL_Obj_ExistProb_4 : 256|7@0+ (1,0) [0|100] "percent" Vector__XXX
 SG_ S4_SRR_RL_Obj_Type_4 : 265|4@0+ (1,0) [0|15] "" Vector__XXX
 SG_ S4_SRR_RL_Obj_EDynProp_4 : 277|4@0+ (1,0) [0|15] "" Vector__XXX
 SG_ S4_SRR_RL_Obj_UiLifeCycles_4 : 273|7@0+ (1,0) [0|127] "" Vector__XXX
 SG_ S4_SRR_RL_Obj_RCS_4 : 282|11@0+ (0.1,-100) [-100|100] "dBm" Vector__XXX
 SG_ S4_SRR_RL_Obj_ID_5 : 303|7@0+ (1,0) [0|126] "" Vector__XXX
 SG_ S4_SRR_RL_Obj_DistX_5 : 296|13@0+ (0.0625,-255.9375) [-255.9375|255.9375] "m" Vector__XXX
 SG_ S4_SRR_RL_Obj_RelVelX_5 : 315|11@0+ (0.125,-128) [-128|127.875] "mps" Vector__XXX
 SG_ S4_SRR_RL_Obj_AccelX_5 : 320|10@0+ (0.125,-44.5) [-44.5|44.5] "mps2" Vector__XXX
 SG_ S4_SRR_RL_Obj_DistY_5 : 342|13@0+ (0.0625,-255.9375) [-255.9375|255.9375] "m" Vector__XXX
 SG_ S4_SRR_RL_Obj_RelVelY_5 : 345|11@0+ (0.125,-128) [-128|127.875] "mps" Vector__XXX
 SG_ S4_SRR_RL_Obj_AccelY_5 : 366|10@0+ (0.125,-44.5) [-44.5|44.5] "mps2" Vector__XXX
 SG_ S4_SRR_RL_Obj_DistXStd_5 : 372|8@0+ (0.05,0) [0|12.75] "m" Vector__XXX
 SG_ S4_SRR_RL_Obj_RelVelXStd_5 : 380|6@0+ (0.2,0) [0|12.6] "mps" Vector__XXX
 SG_ S4_SRR_RL_Obj_RAccelXStd_5 : 390|5@0+ (0.35,0) [0|10.85] "mps2" Vector__XXX
 SG_ S4_SRR_RL_Obj_DistYStd_5 : 385|8@0+ (0.1,0) [0|25.5] "m" Vector__XXX
 SG_ S4_SRR_RL_Obj_RelVelYStd_5 : 393|6@0+ (0.2,0) [0|12.6] "mps" Vector__XXX
 SG_ S4_SRR_RL_Obj_RAccelYStd_5 : 403|5@0+ (0.35,0) [0|10.85] "mps2" Vector__XXX
 SG_ S4_SRR_RL_Obj_ValidFlag_5 : 414|1@0+ (1,0) [0|1] "" Vector__XXX
 SG_ S4_SRR_RL_Obj_UpdateFlag_5 : 413|1@0+ (1,0) [0|1] "" Vector__XXX
 SG_ S4_SRR_RL_Obj_ExistProb_5 : 412|7@0+ (1,0) [0|100] "percent" Vector__XXX
 SG_ S4_SRR_RL_Obj_Type_5 : 421|4@0+ (1,0) [0|15] "" Vector__XXX
 SG_ S4_SRR_RL_Obj_EDynProp_5 : 417|4@0+ (1,0) [0|15] "" Vector__XXX
 SG_ S4_SRR_RL_Obj_UiLifeCycles_5 : 429|7@0+ (1,0) [0|127] "" Vector__XXX
 SG_ S4_SRR_RL_Obj_RCS_5 : 438|11@0+ (0.1,-100) [-100|100] "dBm" Vector__XXX
 SG_ S4_SRR_RL_Obj_Mes_1_blockcounter : 503|4@0+ (1,0) [0|15] "" Vector__XXX
 SG_ S4_SRR_RL_Obj_1_MsgCounter : 499|4@0+ (1,0) [0|14] "" Vector__XXX
 SG_ S4_SRR_RL_Obj_1_E2EChecksum : 511|8@0+ (1,0) [0|255] "" Vector__XXX

BO_ 617 S4_SRR_RL_Obj_Mes_2: 64 SRR_RL
 SG_ S4_SRR_RL_Obj_ID_6 : 7|7@0+ (1,0) [0|126] "" Vector__XXX
 SG_ S4_SRR_RL_Obj_DistX_6 : 0|13@0+ (0.0625,-255.9375) [-255.9375|255.9375] "m" Vector__XXX
 SG_ S4_SRR_RL_Obj_RelVelX_6 : 19|11@0+ (0.125,-128) [-128|127.875] "mps" Vector__XXX
 SG_ S4_SRR_RL_Obj_AccelX_6 : 24|10@0+ (0.125,-44.5) [-44.5|44.5] "mps2" Vector__XXX
 SG_ S4_SRR_RL_Obj_DistY_6 : 46|13@0+ (0.0625,-255.9375) [-255.9375|255.9375] "m" Vector__XXX
 SG_ S4_SRR_RL_Obj_RelVelY_6 : 49|11@0+ (0.125,-128) [-128|127.875] "mps" Vector__XXX
 SG_ S4_SRR_RL_Obj_AccelY_6 : 70|10@0+ (0.125,-44.5) [-44.5|44.5] "mps2" Vector__XXX
 SG_ S4_SRR_RL_Obj_DistXStd_6 : 76|8@0+ (0.05,0) [0|12.75] "m" Vector__XXX
 SG_ S4_SRR_RL_Obj_RelVelXStd_6 : 84|6@0+ (0.2,0) [0|12.6] "mps" Vector__XXX
 SG_ S4_SRR_RL_Obj_RAccelXStd_6 : 94|5@0+ (0.35,0) [0|10.85] "mps2" Vector__XXX
 SG_ S4_SRR_RL_Obj_DistYStd_6 : 89|8@0+ (0.1,0) [0|25.5] "m" Vector__XXX
 SG_ S4_SRR_RL_Obj_RelVelYStd_6 : 97|6@0+ (0.2,0) [0|12.6] "mps" Vector__XXX
 SG_ S4_SRR_RL_Obj_RAccelYStd_6 : 107|5@0+ (0.35,0) [0|10.85] "mps2" Vector__XXX
 SG_ S4_SRR_RL_Obj_ValidFlag_6 : 118|1@0+ (1,0) [0|1] "" Vector__XXX
 SG_ S4_SRR_RL_Obj_UpdateFlag_6 : 117|1@0+ (1,0) [0|1] "" Vector__XXX
 SG_ S4_SRR_RL_Obj_ExistProb_6 : 116|7@0+ (1,0) [0|100] "percent" Vector__XXX
 SG_ S4_SRR_RL_Obj_Type_6 : 125|4@0+ (1,0) [0|15] "" Vector__XXX
 SG_ S4_SRR_RL_Obj_EDynProp_6 : 121|4@0+ (1,0) [0|15] "" Vector__XXX
 SG_ S4_SRR_RL_Obj_UiLifeCycles_6 : 133|7@0+ (1,0) [0|127] "" Vector__XXX
 SG_ S4_SRR_RL_Obj_RCS_6 : 142|11@0+ (0.1,-100) [-100|100] "dBm" Vector__XXX
 SG_ S4_SRR_RL_Obj_ID_7 : 147|7@0+ (1,0) [0|126] "" Vector__XXX
 SG_ S4_SRR_RL_Obj_DistX_7 : 156|13@0+ (0.0625,-255.9375) [-255.9375|255.9375] "m" Vector__XXX
 SG_ S4_SRR_RL_Obj_RelVelX_7 : 175|11@0+ (0.125,-128) [-128|127.875] "mps" Vector__XXX
 SG_ S4_SRR_RL_Obj_AccelX_7 : 180|10@0+ (0.125,-44.5) [-44.5|44.5] "mps2" Vector__XXX
 SG_ S4_SRR_RL_Obj_DistY_7 : 186|13@0+ (0.0625,-255.9375) [-255.9375|255.9375] "m" Vector__XXX
 SG_ S4_SRR_RL_Obj_RelVelY_7 : 205|11@0+ (0.125,-128) [-128|127.875] "mps" Vector__XXX
 SG_ S4_SRR_RL_Obj_AccelY_7 : 210|10@0+ (0.125,-44.5) [-44.5|44.5] "mps2" Vector__XXX
 SG_ S4_SRR_RL_Obj_DistXStd_7 : 216|8@0+ (0.05,0) [0|12.75] "m" Vector__XXX
 SG_ S4_SRR_RL_Obj_RelVelXStd_7 : 224|6@0+ (0.2,0) [0|12.6] "mps" Vector__XXX
 SG_ S4_SRR_RL_Obj_RAccelXStd_7 : 234|5@0+ (0.35,0) [0|10.85] "mps2" Vector__XXX
 SG_ S4_SRR_RL_Obj_DistYStd_7 : 245|8@0+ (0.1,0) [0|25.5] "m" Vector__XXX
 SG_ S4_SRR_RL_Obj_RelVelYStd_7 : 253|6@0+ (0.2,0) [0|12.6] "mps" Vector__XXX
 SG_ S4_SRR_RL_Obj_RAccelYStd_7 : 263|5@0+ (0.35,0) [0|10.85] "mps2" Vector__XXX
 SG_ S4_SRR_RL_Obj_ValidFlag_7 : 258|1@0+ (1,0) [0|1] "" Vector__XXX
 SG_ S4_SRR_RL_Obj_UpdateFlag_7 : 257|1@0+ (1,0) [0|1] "" Vector__XXX
 SG_ S4_SRR_RL_Obj_ExistProb_7 : 256|7@0+ (1,0) [0|100] "percent" Vector__XXX
 SG_ S4_SRR_RL_Obj_Type_7 : 265|4@0+ (1,0) [0|15] "" Vector__XXX
 SG_ S4_SRR_RL_Obj_EDynProp_7 : 277|4@0+ (1,0) [0|15] "" Vector__XXX
 SG_ S4_SRR_RL_Obj_UiLifeCycles_7 : 273|7@0+ (1,0) [0|127] "" Vector__XXX
 SG_ S4_SRR_RL_Obj_RCS_7 : 282|11@0+ (0.1,-100) [-100|100] "dBm" Vector__XXX
 SG_ S4_SRR_RL_Obj_ID_8 : 303|7@0+ (1,0) [0|126] "" Vector__XXX
 SG_ S4_SRR_RL_Obj_DistX_8 : 296|13@0+ (0.0625,-255.9375) [-255.9375|255.9375] "m" Vector__XXX
 SG_ S4_SRR_RL_Obj_RelVelX_8 : 315|11@0+ (0.125,-128) [-128|127.875] "mps" Vector__XXX
 SG_ S4_SRR_RL_Obj_AccelX_8 : 320|10@0+ (0.125,-44.5) [-44.5|44.5] "mps2" Vector__XXX
 SG_ S4_SRR_RL_Obj_DistY_8 : 342|13@0+ (0.0625,-255.9375) [-255.9375|255.9375] "m" Vector__XXX
 SG_ S4_SRR_RL_Obj_RelVelY_8 : 345|11@0+ (0.125,-128) [-128|127.875] "mps" Vector__XXX
 SG_ S4_SRR_RL_Obj_AccelY_8 : 366|10@0+ (0.125,-44.5) [-44.5|44.5] "mps2" Vector__XXX
 SG_ S4_SRR_RL_Obj_DistXStd_8 : 372|8@0+ (0.05,0) [0|12.75] "m" Vector__XXX
 SG_ S4_SRR_RL_Obj_RelVelXStd_8 : 380|6@0+ (0.2,0) [0|12.6] "mps" Vector__XXX
 SG_ S4_SRR_RL_Obj_RAccelXStd_8 : 390|5@0+ (0.35,0) [0|10.85] "mps2" Vector__XXX
 SG_ S4_SRR_RL_Obj_DistYStd_8 : 385|8@0+ (0.1,0) [0|25.5] "m" Vector__XXX
 SG_ S4_SRR_RL_Obj_RelVelYStd_8 : 393|6@0+ (0.2,0) [0|12.6] "mps" Vector__XXX
 SG_ S4_SRR_RL_Obj_RAccelYStd_8 : 403|5@0+ (0.35,0) [0|10.85] "mps2" Vector__XXX
 SG_ S4_SRR_RL_Obj_ValidFlag_8 : 414|1@0+ (1,0) [0|1] "" Vector__XXX
 SG_ S4_SRR_RL_Obj_UpdateFlag_8 : 413|1@0+ (1,0) [0|1] "" Vector__XXX
 SG_ S4_SRR_RL_Obj_ExistProb_8 : 412|7@0+ (1,0) [0|100] "percent" Vector__XXX
 SG_ S4_SRR_RL_Obj_Type_8 : 421|4@0+ (1,0) [0|15] "" Vector__XXX
 SG_ S4_SRR_RL_Obj_EDynProp_8 : 417|4@0+ (1,0) [0|15] "" Vector__XXX
 SG_ S4_SRR_RL_Obj_UiLifeCycles_8 : 429|7@0+ (1,0) [0|127] "" Vector__XXX
 SG_ S4_SRR_RL_Obj_RCS_8 : 438|11@0+ (0.1,-100) [-100|100] "dBm" Vector__XXX
 SG_ S4_SRR_RL_Obj_Mes_2_blockcounter : 503|4@0+ (1,0) [0|15] "" Vector__XXX
 SG_ S4_SRR_RL_Obj_2_MsgCounter : 499|4@0+ (1,0) [0|14] "" Vector__XXX
 SG_ S4_SRR_RL_Obj_2_E2EChecksum : 511|8@0+ (1,0) [0|255] "" Vector__XXX

CM_ BO_ 601 "The sending period is unstable, ranging from 40 to 80ms
E2E Profile1 Message";
CM_ SG_ 601 S4_SRR_RL_Clu_ID_112 "E2E_Order1";
CM_ SG_ 601 S4_SRR_RL_Clu_Theta_112 "E2E_Order2";
CM_ SG_ 601 S4_SRR_RL_Clu_Dist_112 "E2E_Order3";
CM_ SG_ 601 S4_SRR_RL_Clu_Vel_112 "E2E_Order4";
CM_ SG_ 601 S4_SRR_RL_Clu_SNR_112 "E2E_Order5";
CM_ SG_ 601 S4_SRR_RL_Clu_RCS_112 "E2E_Order6";
CM_ SG_ 601 S4_SRR_RL_Clu_DynProp_112 "E2E_Order7";
CM_ SG_ 601 S4_SRR_RL_Clu_Locationvalid_112 "E2E_Order8";
CM_ SG_ 601 S4_SRR_RL_Clu_ID_113 "E2E_Order9";
CM_ SG_ 601 S4_SRR_RL_Clu_Theta_113 "E2E_Order10";
CM_ SG_ 601 S4_SRR_RL_Clu_Dist_113 "E2E_Order11";
CM_ SG_ 601 S4_SRR_RL_Clu_Vel_113 "E2E_Order12";
CM_ SG_ 601 S4_SRR_RL_Clu_SNR_113 "E2E_Order13";
CM_ SG_ 601 S4_SRR_RL_Clu_RCS_113 "E2E_Order14";
CM_ SG_ 601 S4_SRR_RL_Clu_DynProp_113 "E2E_Order15";
CM_ SG_ 601 S4_SRR_RL_Clu_Locationvalid_113 "E2E_Order16";
CM_ SG_ 601 S4_SRR_RL_Clu_ID_114 "E2E_Order17";
CM_ SG_ 601 S4_SRR_RL_Clu_Theta_114 "E2E_Order18";
CM_ SG_ 601 S4_SRR_RL_Clu_Dist_114 "E2E_Order19";
CM_ SG_ 601 S4_SRR_RL_Clu_Vel_114 "E2E_Order20";
CM_ SG_ 601 S4_SRR_RL_Clu_SNR_114 "E2E_Order21";
CM_ SG_ 601 S4_SRR_RL_Clu_RCS_114 "E2E_Order22";
CM_ SG_ 601 S4_SRR_RL_Clu_DynProp_114 "E2E_Order23";
CM_ SG_ 601 S4_SRR_RL_Clu_Locationvalid_114 "E2E_Order24";
CM_ SG_ 601 S4_SRR_RL_Clu_ID_115 "E2E_Order25";
CM_ SG_ 601 S4_SRR_RL_Clu_Theta_115 "E2E_Order26";
CM_ SG_ 601 S4_SRR_RL_Clu_Dist_115 "E2E_Order27";
CM_ SG_ 601 S4_SRR_RL_Clu_Vel_115 "E2E_Order28";
CM_ SG_ 601 S4_SRR_RL_Clu_SNR_115 "E2E_Order29";
CM_ SG_ 601 S4_SRR_RL_Clu_RCS_115 "E2E_Order30";
CM_ SG_ 601 S4_SRR_RL_Clu_DynProp_115 "E2E_Order31";
CM_ SG_ 601 S4_SRR_RL_Clu_Locationvalid_115 "E2E_Order32";
CM_ SG_ 601 S4_SRR_RL_Clu_ID_116 "E2E_Order33";
CM_ SG_ 601 S4_SRR_RL_Clu_Theta_116 "E2E_Order34";
CM_ SG_ 601 S4_SRR_RL_Clu_Dist_116 "E2E_Order35";
CM_ SG_ 601 S4_SRR_RL_Clu_Vel_116 "E2E_Order36";
CM_ SG_ 601 S4_SRR_RL_Clu_SNR_116 "E2E_Order37";
CM_ SG_ 601 S4_SRR_RL_Clu_RCS_116 "E2E_Order38";
CM_ SG_ 601 S4_SRR_RL_Clu_DynProp_116 "E2E_Order39";
CM_ SG_ 601 S4_SRR_RL_Clu_Locationvalid_116 "E2E_Order40";
CM_ SG_ 601 S4_SRR_RL_Clu_ID_117 "E2E_Order41";
CM_ SG_ 601 S4_SRR_RL_Clu_Theta_117 "E2E_Order42";
CM_ SG_ 601 S4_SRR_RL_Clu_Dist_117 "E2E_Order43";
CM_ SG_ 601 S4_SRR_RL_Clu_Vel_117 "E2E_Order44";
CM_ SG_ 601 S4_SRR_RL_Clu_SNR_117 "E2E_Order45";
CM_ SG_ 601 S4_SRR_RL_Clu_RCS_117 "E2E_Order46";
CM_ SG_ 601 S4_SRR_RL_Clu_DynProp_117 "E2E_Order47";
CM_ SG_ 601 S4_SRR_RL_Clu_Locationvalid_117 "E2E_Order48";
CM_ SG_ 601 S4_SRR_RL_Clu_ID_118 "E2E_Order49";
CM_ SG_ 601 S4_SRR_RL_Clu_Theta_118 "E2E_Order50";
CM_ SG_ 601 S4_SRR_RL_Clu_Dist_118 "E2E_Order51";
CM_ SG_ 601 S4_SRR_RL_Clu_Vel_118 "E2E_Order52";
CM_ SG_ 601 S4_SRR_RL_Clu_SNR_118 "E2E_Order53";
CM_ SG_ 601 S4_SRR_RL_Clu_RCS_118 "E2E_Order54";
CM_ SG_ 601 S4_SRR_RL_Clu_DynProp_118 "E2E_Order55";
CM_ SG_ 601 S4_SRR_RL_Clu_Locationvalid_118 "E2E_Order56";
CM_ SG_ 601 S4_SRR_RL_Clu_16_E2EChecksum "DataID = 0x952";
CM_ BO_ 603 "The sending period is unstable, ranging from 40 to 80ms
E2E Profile1 Message";
CM_ SG_ 603 S4_SRR_RL_Clu_ID_119 "E2E_Order1";
CM_ SG_ 603 S4_SRR_RL_Clu_Theta_119 "E2E_Order2";
CM_ SG_ 603 S4_SRR_RL_Clu_Dist_119 "E2E_Order3";
CM_ SG_ 603 S4_SRR_RL_Clu_Vel_119 "E2E_Order4";
CM_ SG_ 603 S4_SRR_RL_Clu_SNR_119 "E2E_Order5";
CM_ SG_ 603 S4_SRR_RL_Clu_RCS_119 "E2E_Order6";
CM_ SG_ 603 S4_SRR_RL_Clu_DynProp_119 "E2E_Order7";
CM_ SG_ 603 S4_SRR_RL_Clu_Locationvalid_119 "E2E_Order8";
CM_ SG_ 603 S4_SRR_RL_Clu_ID_120 "E2E_Order9";
CM_ SG_ 603 S4_SRR_RL_Clu_Theta_120 "E2E_Order10";
CM_ SG_ 603 S4_SRR_RL_Clu_Dist_120 "E2E_Order11";
CM_ SG_ 603 S4_SRR_RL_Clu_Vel_120 "E2E_Order12";
CM_ SG_ 603 S4_SRR_RL_Clu_SNR_120 "E2E_Order13";
CM_ SG_ 603 S4_SRR_RL_Clu_RCS_120 "E2E_Order14";
CM_ SG_ 603 S4_SRR_RL_Clu_DynProp_120 "E2E_Order15";
CM_ SG_ 603 S4_SRR_RL_Clu_Locationvalid_120 "E2E_Order16";
CM_ SG_ 603 S4_SRR_RL_Clu_ID_121 "E2E_Order17";
CM_ SG_ 603 S4_SRR_RL_Clu_Theta_121 "E2E_Order18";
CM_ SG_ 603 S4_SRR_RL_Clu_Dist_121 "E2E_Order19";
CM_ SG_ 603 S4_SRR_RL_Clu_Vel_121 "E2E_Order20";
CM_ SG_ 603 S4_SRR_RL_Clu_SNR_121 "E2E_Order21";
CM_ SG_ 603 S4_SRR_RL_Clu_RCS_121 "E2E_Order22";
CM_ SG_ 603 S4_SRR_RL_Clu_DynProp_121 "E2E_Order23";
CM_ SG_ 603 S4_SRR_RL_Clu_Locationvalid_121 "E2E_Order24";
CM_ SG_ 603 S4_SRR_RL_Clu_ID_122 "E2E_Order25";
CM_ SG_ 603 S4_SRR_RL_Clu_Theta_122 "E2E_Order26";
CM_ SG_ 603 S4_SRR_RL_Clu_Dist_122 "E2E_Order27";
CM_ SG_ 603 S4_SRR_RL_Clu_Vel_122 "E2E_Order28";
CM_ SG_ 603 S4_SRR_RL_Clu_SNR_122 "E2E_Order29";
CM_ SG_ 603 S4_SRR_RL_Clu_RCS_122 "E2E_Order30";
CM_ SG_ 603 S4_SRR_RL_Clu_DynProp_122 "E2E_Order31";
CM_ SG_ 603 S4_SRR_RL_Clu_Locationvalid_122 "E2E_Order32";
CM_ SG_ 603 S4_SRR_RL_Clu_ID_123 "E2E_Order33";
CM_ SG_ 603 S4_SRR_RL_Clu_Theta_123 "E2E_Order34";
CM_ SG_ 603 S4_SRR_RL_Clu_Dist_123 "E2E_Order35";
CM_ SG_ 603 S4_SRR_RL_Clu_Vel_123 "E2E_Order36";
CM_ SG_ 603 S4_SRR_RL_Clu_SNR_123 "E2E_Order37";
CM_ SG_ 603 S4_SRR_RL_Clu_RCS_123 "E2E_Order38";
CM_ SG_ 603 S4_SRR_RL_Clu_DynProp_123 "E2E_Order39";
CM_ SG_ 603 S4_SRR_RL_Clu_Locationvalid_123 "E2E_Order40";
CM_ SG_ 603 S4_SRR_RL_Clu_ID_124 "E2E_Order41";
CM_ SG_ 603 S4_SRR_RL_Clu_Theta_124 "E2E_Order42";
CM_ SG_ 603 S4_SRR_RL_Clu_Dist_124 "E2E_Order43";
CM_ SG_ 603 S4_SRR_RL_Clu_Vel_124 "E2E_Order44";
CM_ SG_ 603 S4_SRR_RL_Clu_SNR_124 "E2E_Order45";
CM_ SG_ 603 S4_SRR_RL_Clu_RCS_124 "E2E_Order46";
CM_ SG_ 603 S4_SRR_RL_Clu_DynProp_124 "E2E_Order47";
CM_ SG_ 603 S4_SRR_RL_Clu_Locationvalid_124 "E2E_Order48";
CM_ SG_ 603 S4_SRR_RL_Clu_ID_125 "E2E_Order49";
CM_ SG_ 603 S4_SRR_RL_Clu_Theta_125 "E2E_Order50";
CM_ SG_ 603 S4_SRR_RL_Clu_Dist_125 "E2E_Order51";
CM_ SG_ 603 S4_SRR_RL_Clu_Vel_125 "E2E_Order52";
CM_ SG_ 603 S4_SRR_RL_Clu_SNR_125 "E2E_Order53";
CM_ SG_ 603 S4_SRR_RL_Clu_RCS_125 "E2E_Order54";
CM_ SG_ 603 S4_SRR_RL_Clu_DynProp_125 "E2E_Order55";
CM_ SG_ 603 S4_SRR_RL_Clu_Locationvalid_125 "E2E_Order56";
CM_ SG_ 603 S4_SRR_RL_Clu_17_E2EChecksum "DataID = 0xB52";
CM_ BO_ 604 "The sending period is unstable, ranging from 40 to 80ms
E2E Profile1 Message";
CM_ SG_ 604 S4_SRR_RL_Clu_ID_126 "E2E_Order1";
CM_ SG_ 604 S4_SRR_RL_Clu_Theta_126 "E2E_Order2";
CM_ SG_ 604 S4_SRR_RL_Clu_Dist_126 "E2E_Order3";
CM_ SG_ 604 S4_SRR_RL_Clu_Vel_126 "E2E_Order4";
CM_ SG_ 604 S4_SRR_RL_Clu_SNR_126 "E2E_Order5";
CM_ SG_ 604 S4_SRR_RL_Clu_RCS_126 "E2E_Order6";
CM_ SG_ 604 S4_SRR_RL_Clu_DynProp_126 "E2E_Order7";
CM_ SG_ 604 S4_SRR_RL_Clu_Locationvalid_126 "E2E_Order8";
CM_ SG_ 604 S4_SRR_RL_Clu_ID_127 "E2E_Order9";
CM_ SG_ 604 S4_SRR_RL_Clu_Theta_127 "E2E_Order10";
CM_ SG_ 604 S4_SRR_RL_Clu_Dist_127 "E2E_Order11";
CM_ SG_ 604 S4_SRR_RL_Clu_Vel_127 "E2E_Order12";
CM_ SG_ 604 S4_SRR_RL_Clu_SNR_127 "E2E_Order13";
CM_ SG_ 604 S4_SRR_RL_Clu_RCS_127 "E2E_Order14";
CM_ SG_ 604 S4_SRR_RL_Clu_DynProp_127 "E2E_Order15";
CM_ SG_ 604 S4_SRR_RL_Clu_Locationvalid_127 "E2E_Order16";
CM_ SG_ 604 S4_SRR_RL_Clu_ID_128 "E2E_Order17";
CM_ SG_ 604 S4_SRR_RL_Clu_Theta_128 "E2E_Order18";
CM_ SG_ 604 S4_SRR_RL_Clu_Dist_128 "E2E_Order19";
CM_ SG_ 604 S4_SRR_RL_Clu_Vel_128 "E2E_Order20";
CM_ SG_ 604 S4_SRR_RL_Clu_SNR_128 "E2E_Order21";
CM_ SG_ 604 S4_SRR_RL_Clu_RCS_128 "E2E_Order22";
CM_ SG_ 604 S4_SRR_RL_Clu_DynProp_128 "E2E_Order23";
CM_ SG_ 604 S4_SRR_RL_Clu_Locationvalid_128 "E2E_Order24";
CM_ SG_ 604 S4_SRR_RL_Clu_ID_129 "E2E_Order25";
CM_ SG_ 604 S4_SRR_RL_Clu_Theta_129 "E2E_Order26";
CM_ SG_ 604 S4_SRR_RL_Clu_Dist_129 "E2E_Order27";
CM_ SG_ 604 S4_SRR_RL_Clu_Vel_129 "E2E_Order28";
CM_ SG_ 604 S4_SRR_RL_Clu_SNR_129 "E2E_Order29";
CM_ SG_ 604 S4_SRR_RL_Clu_RCS_129 "E2E_Order30";
CM_ SG_ 604 S4_SRR_RL_Clu_DynProp_129 "E2E_Order31";
CM_ SG_ 604 S4_SRR_RL_Clu_Locationvalid_129 "E2E_Order32";
CM_ SG_ 604 S4_SRR_RL_Clu_ID_130 "E2E_Order33";
CM_ SG_ 604 S4_SRR_RL_Clu_Theta_130 "E2E_Order34";
CM_ SG_ 604 S4_SRR_RL_Clu_Dist_130 "E2E_Order35";
CM_ SG_ 604 S4_SRR_RL_Clu_Vel_130 "E2E_Order36";
CM_ SG_ 604 S4_SRR_RL_Clu_SNR_130 "E2E_Order37";
CM_ SG_ 604 S4_SRR_RL_Clu_RCS_130 "E2E_Order38";
CM_ SG_ 604 S4_SRR_RL_Clu_DynProp_130 "E2E_Order39";
CM_ SG_ 604 S4_SRR_RL_Clu_Locationvalid_130 "E2E_Order40";
CM_ SG_ 604 S4_SRR_RL_Clu_ID_131 "E2E_Order41";
CM_ SG_ 604 S4_SRR_RL_Clu_Theta_131 "E2E_Order42";
CM_ SG_ 604 S4_SRR_RL_Clu_Dist_131 "E2E_Order43";
CM_ SG_ 604 S4_SRR_RL_Clu_Vel_131 "E2E_Order44";
CM_ SG_ 604 S4_SRR_RL_Clu_SNR_131 "E2E_Order45";
CM_ SG_ 604 S4_SRR_RL_Clu_RCS_131 "E2E_Order46";
CM_ SG_ 604 S4_SRR_RL_Clu_DynProp_131 "E2E_Order47";
CM_ SG_ 604 S4_SRR_RL_Clu_Locationvalid_131 "E2E_Order48";
CM_ SG_ 604 S4_SRR_RL_Clu_ID_132 "E2E_Order49";
CM_ SG_ 604 S4_SRR_RL_Clu_Theta_132 "E2E_Order50";
CM_ SG_ 604 S4_SRR_RL_Clu_Dist_132 "E2E_Order51";
CM_ SG_ 604 S4_SRR_RL_Clu_Vel_132 "E2E_Order52";
CM_ SG_ 604 S4_SRR_RL_Clu_SNR_132 "E2E_Order53";
CM_ SG_ 604 S4_SRR_RL_Clu_RCS_132 "E2E_Order54";
CM_ SG_ 604 S4_SRR_RL_Clu_DynProp_132 "E2E_Order55";
CM_ SG_ 604 S4_SRR_RL_Clu_Locationvalid_132 "E2E_Order56";
CM_ SG_ 604 S4_SRR_RL_Clu_18_E2EChecksum "DataID = 0xC52";
CM_ BO_ 605 "The sending period is unstable, ranging from 40 to 80ms
E2E Profile1 Message";
CM_ SG_ 605 S4_SRR_RL_Clu_ID_133 "E2E_Order1";
CM_ SG_ 605 S4_SRR_RL_Clu_Theta_133 "E2E_Order2";
CM_ SG_ 605 S4_SRR_RL_Clu_Dist_133 "E2E_Order3";
CM_ SG_ 605 S4_SRR_RL_Clu_Vel_133 "E2E_Order4";
CM_ SG_ 605 S4_SRR_RL_Clu_SNR_133 "E2E_Order5";
CM_ SG_ 605 S4_SRR_RL_Clu_RCS_133 "E2E_Order6";
CM_ SG_ 605 S4_SRR_RL_Clu_DynProp_133 "E2E_Order7";
CM_ SG_ 605 S4_SRR_RL_Clu_Locationvalid_133 "E2E_Order8";
CM_ SG_ 605 S4_SRR_RL_Clu_ID_134 "E2E_Order9";
CM_ SG_ 605 S4_SRR_RL_Clu_Theta_134 "E2E_Order10";
CM_ SG_ 605 S4_SRR_RL_Clu_Dist_134 "E2E_Order11";
CM_ SG_ 605 S4_SRR_RL_Clu_Vel_134 "E2E_Order12";
CM_ SG_ 605 S4_SRR_RL_Clu_SNR_134 "E2E_Order13";
CM_ SG_ 605 S4_SRR_RL_Clu_RCS_134 "E2E_Order14";
CM_ SG_ 605 S4_SRR_RL_Clu_DynProp_134 "E2E_Order15";
CM_ SG_ 605 S4_SRR_RL_Clu_Locationvalid_134 "E2E_Order16";
CM_ SG_ 605 S4_SRR_RL_Clu_ID_135 "E2E_Order17";
CM_ SG_ 605 S4_SRR_RL_Clu_Theta_135 "E2E_Order18";
CM_ SG_ 605 S4_SRR_RL_Clu_Dist_135 "E2E_Order19";
CM_ SG_ 605 S4_SRR_RL_Clu_Vel_135 "E2E_Order20";
CM_ SG_ 605 S4_SRR_RL_Clu_SNR_135 "E2E_Order21";
CM_ SG_ 605 S4_SRR_RL_Clu_RCS_135 "E2E_Order22";
CM_ SG_ 605 S4_SRR_RL_Clu_DynProp_135 "E2E_Order23";
CM_ SG_ 605 S4_SRR_RL_Clu_Locationvalid_135 "E2E_Order24";
CM_ SG_ 605 S4_SRR_RL_Clu_ID_136 "E2E_Order25";
CM_ SG_ 605 S4_SRR_RL_Clu_Theta_136 "E2E_Order26";
CM_ SG_ 605 S4_SRR_RL_Clu_Dist_136 "E2E_Order27";
CM_ SG_ 605 S4_SRR_RL_Clu_Vel_136 "E2E_Order28";
CM_ SG_ 605 S4_SRR_RL_Clu_SNR_136 "E2E_Order29";
CM_ SG_ 605 S4_SRR_RL_Clu_RCS_136 "E2E_Order30";
CM_ SG_ 605 S4_SRR_RL_Clu_DynProp_136 "E2E_Order31";
CM_ SG_ 605 S4_SRR_RL_Clu_Locationvalid_136 "E2E_Order32";
CM_ SG_ 605 S4_SRR_RL_Clu_ID_137 "E2E_Order33";
CM_ SG_ 605 S4_SRR_RL_Clu_Theta_137 "E2E_Order34";
CM_ SG_ 605 S4_SRR_RL_Clu_Dist_137 "E2E_Order35";
CM_ SG_ 605 S4_SRR_RL_Clu_Vel_137 "E2E_Order36";
CM_ SG_ 605 S4_SRR_RL_Clu_SNR_137 "E2E_Order37";
CM_ SG_ 605 S4_SRR_RL_Clu_RCS_137 "E2E_Order38";
CM_ SG_ 605 S4_SRR_RL_Clu_DynProp_137 "E2E_Order39";
CM_ SG_ 605 S4_SRR_RL_Clu_Locationvalid_137 "E2E_Order40";
CM_ SG_ 605 S4_SRR_RL_Clu_ID_138 "E2E_Order41";
CM_ SG_ 605 S4_SRR_RL_Clu_Theta_138 "E2E_Order42";
CM_ SG_ 605 S4_SRR_RL_Clu_Dist_138 "E2E_Order43";
CM_ SG_ 605 S4_SRR_RL_Clu_Vel_138 "E2E_Order44";
CM_ SG_ 605 S4_SRR_RL_Clu_SNR_138 "E2E_Order45";
CM_ SG_ 605 S4_SRR_RL_Clu_RCS_138 "E2E_Order46";
CM_ SG_ 605 S4_SRR_RL_Clu_DynProp_138 "E2E_Order47";
CM_ SG_ 605 S4_SRR_RL_Clu_Locationvalid_138 "E2E_Order48";
CM_ SG_ 605 S4_SRR_RL_Clu_ID_139 "E2E_Order49";
CM_ SG_ 605 S4_SRR_RL_Clu_Theta_139 "E2E_Order50";
CM_ SG_ 605 S4_SRR_RL_Clu_Dist_139 "E2E_Order51";
CM_ SG_ 605 S4_SRR_RL_Clu_Vel_139 "E2E_Order52";
CM_ SG_ 605 S4_SRR_RL_Clu_SNR_139 "E2E_Order53";
CM_ SG_ 605 S4_SRR_RL_Clu_RCS_139 "E2E_Order54";
CM_ SG_ 605 S4_SRR_RL_Clu_DynProp_139 "E2E_Order55";
CM_ SG_ 605 S4_SRR_RL_Clu_Locationvalid_139 "E2E_Order56";
CM_ SG_ 605 S4_SRR_RL_Clu_19_E2EChecksum "DataID = 0xD52";
CM_ BO_ 606 "The sending period is unstable, ranging from 40 to 80ms
E2E Profile1 Message";
CM_ SG_ 606 S4_SRR_RL_Clu_ID_140 "E2E_Order1";
CM_ SG_ 606 S4_SRR_RL_Clu_Theta_140 "E2E_Order2";
CM_ SG_ 606 S4_SRR_RL_Clu_Dist_140 "E2E_Order3";
CM_ SG_ 606 S4_SRR_RL_Clu_Vel_140 "E2E_Order4";
CM_ SG_ 606 S4_SRR_RL_Clu_SNR_140 "E2E_Order5";
CM_ SG_ 606 S4_SRR_RL_Clu_RCS_140 "E2E_Order6";
CM_ SG_ 606 S4_SRR_RL_Clu_DynProp_140 "E2E_Order7";
CM_ SG_ 606 S4_SRR_RL_Clu_Locationvalid_140 "E2E_Order8";
CM_ SG_ 606 S4_SRR_RL_Clu_ID_141 "E2E_Order9";
CM_ SG_ 606 S4_SRR_RL_Clu_Theta_141 "E2E_Order10";
CM_ SG_ 606 S4_SRR_RL_Clu_Dist_141 "E2E_Order11";
CM_ SG_ 606 S4_SRR_RL_Clu_Vel_141 "E2E_Order12";
CM_ SG_ 606 S4_SRR_RL_Clu_SNR_141 "E2E_Order13";
CM_ SG_ 606 S4_SRR_RL_Clu_RCS_141 "E2E_Order14";
CM_ SG_ 606 S4_SRR_RL_Clu_DynProp_141 "E2E_Order15";
CM_ SG_ 606 S4_SRR_RL_Clu_Locationvalid_141 "E2E_Order16";
CM_ SG_ 606 S4_SRR_RL_Clu_ID_142 "E2E_Order17";
CM_ SG_ 606 S4_SRR_RL_Clu_Theta_142 "E2E_Order18";
CM_ SG_ 606 S4_SRR_RL_Clu_Dist_142 "E2E_Order19";
CM_ SG_ 606 S4_SRR_RL_Clu_Vel_142 "E2E_Order20";
CM_ SG_ 606 S4_SRR_RL_Clu_SNR_142 "E2E_Order21";
CM_ SG_ 606 S4_SRR_RL_Clu_RCS_142 "E2E_Order22";
CM_ SG_ 606 S4_SRR_RL_Clu_DynProp_142 "E2E_Order23";
CM_ SG_ 606 S4_SRR_RL_Clu_Locationvalid_142 "E2E_Order24";
CM_ SG_ 606 S4_SRR_RL_Clu_ID_143 "E2E_Order25";
CM_ SG_ 606 S4_SRR_RL_Clu_Theta_143 "E2E_Order26";
CM_ SG_ 606 S4_SRR_RL_Clu_Dist_143 "E2E_Order27";
CM_ SG_ 606 S4_SRR_RL_Clu_Vel_143 "E2E_Order28";
CM_ SG_ 606 S4_SRR_RL_Clu_SNR_143 "E2E_Order29";
CM_ SG_ 606 S4_SRR_RL_Clu_RCS_143 "E2E_Order30";
CM_ SG_ 606 S4_SRR_RL_Clu_DynProp_143 "E2E_Order31";
CM_ SG_ 606 S4_SRR_RL_Clu_Locationvalid_143 "E2E_Order32";
CM_ SG_ 606 S4_SRR_RL_Clu_ID_144 "E2E_Order33";
CM_ SG_ 606 S4_SRR_RL_Clu_Theta_144 "E2E_Order34";
CM_ SG_ 606 S4_SRR_RL_Clu_Dist_144 "E2E_Order35";
CM_ SG_ 606 S4_SRR_RL_Clu_Vel_144 "E2E_Order36";
CM_ SG_ 606 S4_SRR_RL_Clu_SNR_144 "E2E_Order37";
CM_ SG_ 606 S4_SRR_RL_Clu_RCS_144 "E2E_Order38";
CM_ SG_ 606 S4_SRR_RL_Clu_DynProp_144 "E2E_Order39";
CM_ SG_ 606 S4_SRR_RL_Clu_Locationvalid_144 "E2E_Order40";
CM_ SG_ 606 S4_SRR_RL_Clu_ID_145 "E2E_Order41";
CM_ SG_ 606 S4_SRR_RL_Clu_Theta_145 "E2E_Order42";
CM_ SG_ 606 S4_SRR_RL_Clu_Dist_145 "E2E_Order43";
CM_ SG_ 606 S4_SRR_RL_Clu_Vel_145 "E2E_Order44";
CM_ SG_ 606 S4_SRR_RL_Clu_SNR_145 "E2E_Order45";
CM_ SG_ 606 S4_SRR_RL_Clu_RCS_145 "E2E_Order46";
CM_ SG_ 606 S4_SRR_RL_Clu_DynProp_145 "E2E_Order47";
CM_ SG_ 606 S4_SRR_RL_Clu_Locationvalid_145 "E2E_Order48";
CM_ SG_ 606 S4_SRR_RL_Clu_ID_146 "E2E_Order49";
CM_ SG_ 606 S4_SRR_RL_Clu_Theta_146 "E2E_Order50";
CM_ SG_ 606 S4_SRR_RL_Clu_Dist_146 "E2E_Order51";
CM_ SG_ 606 S4_SRR_RL_Clu_Vel_146 "E2E_Order52";
CM_ SG_ 606 S4_SRR_RL_Clu_SNR_146 "E2E_Order53";
CM_ SG_ 606 S4_SRR_RL_Clu_RCS_146 "E2E_Order54";
CM_ SG_ 606 S4_SRR_RL_Clu_DynProp_146 "E2E_Order55";
CM_ SG_ 606 S4_SRR_RL_Clu_Locationvalid_146 "E2E_Order56";
CM_ SG_ 606 S4_SRR_RL_Clu_20_E2EChecksum "DataID = 0xE52";
CM_ BO_ 607 "The sending period is unstable, ranging from 40 to 80ms
E2E Profile1 Message";
CM_ SG_ 607 S4_SRR_RL_Clu_ID_147 "E2E_Order1";
CM_ SG_ 607 S4_SRR_RL_Clu_Theta_147 "E2E_Order2";
CM_ SG_ 607 S4_SRR_RL_Clu_Dist_147 "E2E_Order3";
CM_ SG_ 607 S4_SRR_RL_Clu_Vel_147 "E2E_Order4";
CM_ SG_ 607 S4_SRR_RL_Clu_SNR_147 "E2E_Order5";
CM_ SG_ 607 S4_SRR_RL_Clu_RCS_147 "E2E_Order6";
CM_ SG_ 607 S4_SRR_RL_Clu_DynProp_147 "E2E_Order7";
CM_ SG_ 607 S4_SRR_RL_Clu_Locationvalid_147 "E2E_Order8";
CM_ SG_ 607 S4_SRR_RL_Clu_ID_148 "E2E_Order9";
CM_ SG_ 607 S4_SRR_RL_Clu_Theta_148 "E2E_Order10";
CM_ SG_ 607 S4_SRR_RL_Clu_Dist_148 "E2E_Order11";
CM_ SG_ 607 S4_SRR_RL_Clu_Vel_148 "E2E_Order12";
CM_ SG_ 607 S4_SRR_RL_Clu_SNR_148 "E2E_Order13";
CM_ SG_ 607 S4_SRR_RL_Clu_RCS_148 "E2E_Order14";
CM_ SG_ 607 S4_SRR_RL_Clu_DynProp_148 "E2E_Order15";
CM_ SG_ 607 S4_SRR_RL_Clu_Locationvalid_148 "E2E_Order16";
CM_ SG_ 607 S4_SRR_RL_Clu_ID_149 "E2E_Order17";
CM_ SG_ 607 S4_SRR_RL_Clu_Theta_149 "E2E_Order18";
CM_ SG_ 607 S4_SRR_RL_Clu_Dist_149 "E2E_Order19";
CM_ SG_ 607 S4_SRR_RL_Clu_Vel_149 "E2E_Order20";
CM_ SG_ 607 S4_SRR_RL_Clu_SNR_149 "E2E_Order21";
CM_ SG_ 607 S4_SRR_RL_Clu_RCS_149 "E2E_Order22";
CM_ SG_ 607 S4_SRR_RL_Clu_DynProp_149 "E2E_Order23";
CM_ SG_ 607 S4_SRR_RL_Clu_Locationvalid_149 "E2E_Order24";
CM_ SG_ 607 S4_SRR_RL_Clu_ID_150 "E2E_Order25";
CM_ SG_ 607 S4_SRR_RL_Clu_Theta_150 "E2E_Order26";
CM_ SG_ 607 S4_SRR_RL_Clu_Dist_150 "E2E_Order27";
CM_ SG_ 607 S4_SRR_RL_Clu_Vel_150 "E2E_Order28";
CM_ SG_ 607 S4_SRR_RL_Clu_SNR_150 "E2E_Order29";
CM_ SG_ 607 S4_SRR_RL_Clu_RCS_150 "E2E_Order30";
CM_ SG_ 607 S4_SRR_RL_Clu_DynProp_150 "E2E_Order31";
CM_ SG_ 607 S4_SRR_RL_Clu_Locationvalid_150 "E2E_Order32";
CM_ SG_ 607 S4_SRR_RL_Clu_ID_151 "E2E_Order33";
CM_ SG_ 607 S4_SRR_RL_Clu_Theta_151 "E2E_Order34";
CM_ SG_ 607 S4_SRR_RL_Clu_Dist_151 "E2E_Order35";
CM_ SG_ 607 S4_SRR_RL_Clu_Vel_151 "E2E_Order36";
CM_ SG_ 607 S4_SRR_RL_Clu_SNR_151 "E2E_Order37";
CM_ SG_ 607 S4_SRR_RL_Clu_RCS_151 "E2E_Order38";
CM_ SG_ 607 S4_SRR_RL_Clu_DynProp_151 "E2E_Order39";
CM_ SG_ 607 S4_SRR_RL_Clu_Locationvalid_151 "E2E_Order40";
CM_ SG_ 607 S4_SRR_RL_Clu_ID_152 "E2E_Order41";
CM_ SG_ 607 S4_SRR_RL_Clu_Theta_152 "E2E_Order42";
CM_ SG_ 607 S4_SRR_RL_Clu_Dist_152 "E2E_Order43";
CM_ SG_ 607 S4_SRR_RL_Clu_Vel_152 "E2E_Order44";
CM_ SG_ 607 S4_SRR_RL_Clu_SNR_152 "E2E_Order45";
CM_ SG_ 607 S4_SRR_RL_Clu_RCS_152 "E2E_Order46";
CM_ SG_ 607 S4_SRR_RL_Clu_DynProp_152 "E2E_Order47";
CM_ SG_ 607 S4_SRR_RL_Clu_Locationvalid_152 "E2E_Order48";
CM_ SG_ 607 S4_SRR_RL_Clu_ID_153 "E2E_Order49";
CM_ SG_ 607 S4_SRR_RL_Clu_Theta_153 "E2E_Order50";
CM_ SG_ 607 S4_SRR_RL_Clu_Dist_153 "E2E_Order51";
CM_ SG_ 607 S4_SRR_RL_Clu_Vel_153 "E2E_Order52";
CM_ SG_ 607 S4_SRR_RL_Clu_SNR_153 "E2E_Order53";
CM_ SG_ 607 S4_SRR_RL_Clu_RCS_153 "E2E_Order54";
CM_ SG_ 607 S4_SRR_RL_Clu_DynProp_153 "E2E_Order55";
CM_ SG_ 607 S4_SRR_RL_Clu_Locationvalid_153 "E2E_Order56";
CM_ SG_ 607 S4_SRR_RL_Clu_21_E2EChecksum "DataID = 0xF52";
CM_ BO_ 608 "The sending period is unstable, ranging from 40 to 80ms
E2E Profile1 Message";
CM_ SG_ 608 S4_SRR_RL_Clu_ID_154 "E2E_Order1";
CM_ SG_ 608 S4_SRR_RL_Clu_Theta_154 "E2E_Order2";
CM_ SG_ 608 S4_SRR_RL_Clu_Dist_154 "E2E_Order3";
CM_ SG_ 608 S4_SRR_RL_Clu_Vel_154 "E2E_Order4";
CM_ SG_ 608 S4_SRR_RL_Clu_SNR_154 "E2E_Order5";
CM_ SG_ 608 S4_SRR_RL_Clu_RCS_154 "E2E_Order6";
CM_ SG_ 608 S4_SRR_RL_Clu_DynProp_154 "E2E_Order7";
CM_ SG_ 608 S4_SRR_RL_Clu_Locationvalid_154 "E2E_Order8";
CM_ SG_ 608 S4_SRR_RL_Clu_ID_155 "E2E_Order9";
CM_ SG_ 608 S4_SRR_RL_Clu_Theta_155 "E2E_Order10";
CM_ SG_ 608 S4_SRR_RL_Clu_Dist_155 "E2E_Order11";
CM_ SG_ 608 S4_SRR_RL_Clu_Vel_155 "E2E_Order12";
CM_ SG_ 608 S4_SRR_RL_Clu_SNR_155 "E2E_Order13";
CM_ SG_ 608 S4_SRR_RL_Clu_RCS_155 "E2E_Order14";
CM_ SG_ 608 S4_SRR_RL_Clu_DynProp_155 "E2E_Order15";
CM_ SG_ 608 S4_SRR_RL_Clu_Locationvalid_155 "E2E_Order16";
CM_ SG_ 608 S4_SRR_RL_Clu_ID_156 "E2E_Order17";
CM_ SG_ 608 S4_SRR_RL_Clu_Theta_156 "E2E_Order18";
CM_ SG_ 608 S4_SRR_RL_Clu_Dist_156 "E2E_Order19";
CM_ SG_ 608 S4_SRR_RL_Clu_Vel_156 "E2E_Order20";
CM_ SG_ 608 S4_SRR_RL_Clu_SNR_156 "E2E_Order21";
CM_ SG_ 608 S4_SRR_RL_Clu_RCS_156 "E2E_Order22";
CM_ SG_ 608 S4_SRR_RL_Clu_DynProp_156 "E2E_Order23";
CM_ SG_ 608 S4_SRR_RL_Clu_Locationvalid_156 "E2E_Order24";
CM_ SG_ 608 S4_SRR_RL_Clu_ID_157 "E2E_Order25";
CM_ SG_ 608 S4_SRR_RL_Clu_Theta_157 "E2E_Order26";
CM_ SG_ 608 S4_SRR_RL_Clu_Dist_157 "E2E_Order27";
CM_ SG_ 608 S4_SRR_RL_Clu_Vel_157 "E2E_Order28";
CM_ SG_ 608 S4_SRR_RL_Clu_SNR_157 "E2E_Order29";
CM_ SG_ 608 S4_SRR_RL_Clu_RCS_157 "E2E_Order30";
CM_ SG_ 608 S4_SRR_RL_Clu_DynProp_157 "E2E_Order31";
CM_ SG_ 608 S4_SRR_RL_Clu_Locationvalid_157 "E2E_Order32";
CM_ SG_ 608 S4_SRR_RL_Clu_ID_158 "E2E_Order33";
CM_ SG_ 608 S4_SRR_RL_Clu_Theta_158 "E2E_Order34";
CM_ SG_ 608 S4_SRR_RL_Clu_Dist_158 "E2E_Order35";
CM_ SG_ 608 S4_SRR_RL_Clu_Vel_158 "E2E_Order36";
CM_ SG_ 608 S4_SRR_RL_Clu_SNR_158 "E2E_Order37";
CM_ SG_ 608 S4_SRR_RL_Clu_RCS_158 "E2E_Order38";
CM_ SG_ 608 S4_SRR_RL_Clu_DynProp_158 "E2E_Order39";
CM_ SG_ 608 S4_SRR_RL_Clu_Locationvalid_158 "E2E_Order40";
CM_ SG_ 608 S4_SRR_RL_Clu_ID_159 "E2E_Order41";
CM_ SG_ 608 S4_SRR_RL_Clu_Theta_159 "E2E_Order42";
CM_ SG_ 608 S4_SRR_RL_Clu_Dist_159 "E2E_Order43";
CM_ SG_ 608 S4_SRR_RL_Clu_Vel_159 "E2E_Order44";
CM_ SG_ 608 S4_SRR_RL_Clu_SNR_159 "E2E_Order45";
CM_ SG_ 608 S4_SRR_RL_Clu_RCS_159 "E2E_Order46";
CM_ SG_ 608 S4_SRR_RL_Clu_DynProp_159 "E2E_Order47";
CM_ SG_ 608 S4_SRR_RL_Clu_Locationvalid_159 "E2E_Order48";
CM_ SG_ 608 S4_SRR_RL_Clu_ID_160 "E2E_Order49";
CM_ SG_ 608 S4_SRR_RL_Clu_Theta_160 "E2E_Order50";
CM_ SG_ 608 S4_SRR_RL_Clu_Dist_160 "E2E_Order51";
CM_ SG_ 608 S4_SRR_RL_Clu_Vel_160 "E2E_Order52";
CM_ SG_ 608 S4_SRR_RL_Clu_SNR_160 "E2E_Order53";
CM_ SG_ 608 S4_SRR_RL_Clu_RCS_160 "E2E_Order54";
CM_ SG_ 608 S4_SRR_RL_Clu_DynProp_160 "E2E_Order55";
CM_ SG_ 608 S4_SRR_RL_Clu_Locationvalid_160 "E2E_Order56";
CM_ SG_ 608 S4_SRR_RL_Clu_22_E2EChecksum "DataID = 0x062";
CM_ BO_ 609 "The sending period is unstable, ranging from 40 to 80ms
E2E Profile1 Message";
CM_ SG_ 609 S4_SRR_RL_Clu_ID_161 "E2E_Order1";
CM_ SG_ 609 S4_SRR_RL_Clu_Theta_161 "E2E_Order2";
CM_ SG_ 609 S4_SRR_RL_Clu_Dist_161 "E2E_Order3";
CM_ SG_ 609 S4_SRR_RL_Clu_Vel_161 "E2E_Order4";
CM_ SG_ 609 S4_SRR_RL_Clu_SNR_161 "E2E_Order5";
CM_ SG_ 609 S4_SRR_RL_Clu_RCS_161 "E2E_Order6";
CM_ SG_ 609 S4_SRR_RL_Clu_DynProp_161 "E2E_Order7";
CM_ SG_ 609 S4_SRR_RL_Clu_Locationvalid_161 "E2E_Order8";
CM_ SG_ 609 S4_SRR_RL_Clu_ID_162 "E2E_Order9";
CM_ SG_ 609 S4_SRR_RL_Clu_Theta_162 "E2E_Order10";
CM_ SG_ 609 S4_SRR_RL_Clu_Dist_162 "E2E_Order11";
CM_ SG_ 609 S4_SRR_RL_Clu_Vel_162 "E2E_Order12";
CM_ SG_ 609 S4_SRR_RL_Clu_SNR_162 "E2E_Order13";
CM_ SG_ 609 S4_SRR_RL_Clu_RCS_162 "E2E_Order14";
CM_ SG_ 609 S4_SRR_RL_Clu_DynProp_162 "E2E_Order15";
CM_ SG_ 609 S4_SRR_RL_Clu_Locationvalid_162 "E2E_Order16";
CM_ SG_ 609 S4_SRR_RL_Clu_ID_163 "E2E_Order17";
CM_ SG_ 609 S4_SRR_RL_Clu_Theta_163 "E2E_Order18";
CM_ SG_ 609 S4_SRR_RL_Clu_Dist_163 "E2E_Order19";
CM_ SG_ 609 S4_SRR_RL_Clu_Vel_163 "E2E_Order20";
CM_ SG_ 609 S4_SRR_RL_Clu_SNR_163 "E2E_Order21";
CM_ SG_ 609 S4_SRR_RL_Clu_RCS_163 "E2E_Order22";
CM_ SG_ 609 S4_SRR_RL_Clu_DynProp_163 "E2E_Order23";
CM_ SG_ 609 S4_SRR_RL_Clu_Locationvalid_163 "E2E_Order24";
CM_ SG_ 609 S4_SRR_RL_Clu_ID_164 "E2E_Order25";
CM_ SG_ 609 S4_SRR_RL_Clu_Theta_164 "E2E_Order26";
CM_ SG_ 609 S4_SRR_RL_Clu_Dist_164 "E2E_Order27";
CM_ SG_ 609 S4_SRR_RL_Clu_Vel_164 "E2E_Order28";
CM_ SG_ 609 S4_SRR_RL_Clu_SNR_164 "E2E_Order29";
CM_ SG_ 609 S4_SRR_RL_Clu_RCS_164 "E2E_Order30";
CM_ SG_ 609 S4_SRR_RL_Clu_DynProp_164 "E2E_Order31";
CM_ SG_ 609 S4_SRR_RL_Clu_Locationvalid_164 "E2E_Order32";
CM_ SG_ 609 S4_SRR_RL_Clu_ID_165 "E2E_Order33";
CM_ SG_ 609 S4_SRR_RL_Clu_Theta_165 "E2E_Order34";
CM_ SG_ 609 S4_SRR_RL_Clu_Dist_165 "E2E_Order35";
CM_ SG_ 609 S4_SRR_RL_Clu_Vel_165 "E2E_Order36";
CM_ SG_ 609 S4_SRR_RL_Clu_SNR_165 "E2E_Order37";
CM_ SG_ 609 S4_SRR_RL_Clu_RCS_165 "E2E_Order38";
CM_ SG_ 609 S4_SRR_RL_Clu_DynProp_165 "E2E_Order39";
CM_ SG_ 609 S4_SRR_RL_Clu_Locationvalid_165 "E2E_Order40";
CM_ SG_ 609 S4_SRR_RL_Clu_ID_166 "E2E_Order41";
CM_ SG_ 609 S4_SRR_RL_Clu_Theta_166 "E2E_Order42";
CM_ SG_ 609 S4_SRR_RL_Clu_Dist_166 "E2E_Order43";
CM_ SG_ 609 S4_SRR_RL_Clu_Vel_166 "E2E_Order44";
CM_ SG_ 609 S4_SRR_RL_Clu_SNR_166 "E2E_Order45";
CM_ SG_ 609 S4_SRR_RL_Clu_RCS_166 "E2E_Order46";
CM_ SG_ 609 S4_SRR_RL_Clu_DynProp_166 "E2E_Order47";
CM_ SG_ 609 S4_SRR_RL_Clu_Locationvalid_166 "E2E_Order48";
CM_ SG_ 609 S4_SRR_RL_Clu_ID_167 "E2E_Order49";
CM_ SG_ 609 S4_SRR_RL_Clu_Theta_167 "E2E_Order50";
CM_ SG_ 609 S4_SRR_RL_Clu_Dist_167 "E2E_Order51";
CM_ SG_ 609 S4_SRR_RL_Clu_Vel_167 "E2E_Order52";
CM_ SG_ 609 S4_SRR_RL_Clu_SNR_167 "E2E_Order53";
CM_ SG_ 609 S4_SRR_RL_Clu_RCS_167 "E2E_Order54";
CM_ SG_ 609 S4_SRR_RL_Clu_DynProp_167 "E2E_Order55";
CM_ SG_ 609 S4_SRR_RL_Clu_Locationvalid_167 "E2E_Order56";
CM_ SG_ 609 S4_SRR_RL_Clu_23_E2EChecksum "DataID = 0x162";
CM_ BO_ 610 "The sending period is unstable, ranging from 40 to 80ms
E2E Profile1 Message";
CM_ SG_ 610 S4_SRR_RL_Clu_ID_168 "E2E_Order1";
CM_ SG_ 610 S4_SRR_RL_Clu_Theta_168 "E2E_Order2";
CM_ SG_ 610 S4_SRR_RL_Clu_Dist_168 "E2E_Order3";
CM_ SG_ 610 S4_SRR_RL_Clu_Vel_168 "E2E_Order4";
CM_ SG_ 610 S4_SRR_RL_Clu_SNR_168 "E2E_Order5";
CM_ SG_ 610 S4_SRR_RL_Clu_RCS_168 "E2E_Order6";
CM_ SG_ 610 S4_SRR_RL_Clu_DynProp_168 "E2E_Order7";
CM_ SG_ 610 S4_SRR_RL_Clu_Locationvalid_168 "E2E_Order8";
CM_ SG_ 610 S4_SRR_RL_Clu_ID_169 "E2E_Order9";
CM_ SG_ 610 S4_SRR_RL_Clu_Theta_169 "E2E_Order10";
CM_ SG_ 610 S4_SRR_RL_Clu_Dist_169 "E2E_Order11";
CM_ SG_ 610 S4_SRR_RL_Clu_Vel_169 "E2E_Order12";
CM_ SG_ 610 S4_SRR_RL_Clu_SNR_169 "E2E_Order13";
CM_ SG_ 610 S4_SRR_RL_Clu_RCS_169 "E2E_Order14";
CM_ SG_ 610 S4_SRR_RL_Clu_DynProp_169 "E2E_Order15";
CM_ SG_ 610 S4_SRR_RL_Clu_Locationvalid_169 "E2E_Order16";
CM_ SG_ 610 S4_SRR_RL_Clu_ID_170 "E2E_Order17";
CM_ SG_ 610 S4_SRR_RL_Clu_Theta_170 "E2E_Order18";
CM_ SG_ 610 S4_SRR_RL_Clu_Dist_170 "E2E_Order19";
CM_ SG_ 610 S4_SRR_RL_Clu_Vel_170 "E2E_Order20";
CM_ SG_ 610 S4_SRR_RL_Clu_SNR_170 "E2E_Order21";
CM_ SG_ 610 S4_SRR_RL_Clu_RCS_170 "E2E_Order22";
CM_ SG_ 610 S4_SRR_RL_Clu_DynProp_170 "E2E_Order23";
CM_ SG_ 610 S4_SRR_RL_Clu_Locationvalid_170 "E2E_Order24";
CM_ SG_ 610 S4_SRR_RL_Clu_ID_171 "E2E_Order25";
CM_ SG_ 610 S4_SRR_RL_Clu_Theta_171 "E2E_Order26";
CM_ SG_ 610 S4_SRR_RL_Clu_Dist_171 "E2E_Order27";
CM_ SG_ 610 S4_SRR_RL_Clu_Vel_171 "E2E_Order28";
CM_ SG_ 610 S4_SRR_RL_Clu_SNR_171 "E2E_Order29";
CM_ SG_ 610 S4_SRR_RL_Clu_RCS_171 "E2E_Order30";
CM_ SG_ 610 S4_SRR_RL_Clu_DynProp_171 "E2E_Order31";
CM_ SG_ 610 S4_SRR_RL_Clu_Locationvalid_171 "E2E_Order32";
CM_ SG_ 610 S4_SRR_RL_Clu_ID_172 "E2E_Order33";
CM_ SG_ 610 S4_SRR_RL_Clu_Theta_172 "E2E_Order34";
CM_ SG_ 610 S4_SRR_RL_Clu_Dist_172 "E2E_Order35";
CM_ SG_ 610 S4_SRR_RL_Clu_Vel_172 "E2E_Order36";
CM_ SG_ 610 S4_SRR_RL_Clu_SNR_172 "E2E_Order37";
CM_ SG_ 610 S4_SRR_RL_Clu_RCS_172 "E2E_Order38";
CM_ SG_ 610 S4_SRR_RL_Clu_DynProp_172 "E2E_Order39";
CM_ SG_ 610 S4_SRR_RL_Clu_Locationvalid_172 "E2E_Order40";
CM_ SG_ 610 S4_SRR_RL_Clu_ID_173 "E2E_Order41";
CM_ SG_ 610 S4_SRR_RL_Clu_Theta_173 "E2E_Order42";
CM_ SG_ 610 S4_SRR_RL_Clu_Dist_173 "E2E_Order43";
CM_ SG_ 610 S4_SRR_RL_Clu_Vel_173 "E2E_Order44";
CM_ SG_ 610 S4_SRR_RL_Clu_SNR_173 "E2E_Order45";
CM_ SG_ 610 S4_SRR_RL_Clu_RCS_173 "E2E_Order46";
CM_ SG_ 610 S4_SRR_RL_Clu_DynProp_173 "E2E_Order47";
CM_ SG_ 610 S4_SRR_RL_Clu_Locationvalid_173 "E2E_Order48";
CM_ SG_ 610 S4_SRR_RL_Clu_ID_174 "E2E_Order49";
CM_ SG_ 610 S4_SRR_RL_Clu_Theta_174 "E2E_Order50";
CM_ SG_ 610 S4_SRR_RL_Clu_Dist_174 "E2E_Order51";
CM_ SG_ 610 S4_SRR_RL_Clu_Vel_174 "E2E_Order52";
CM_ SG_ 610 S4_SRR_RL_Clu_SNR_174 "E2E_Order53";
CM_ SG_ 610 S4_SRR_RL_Clu_RCS_174 "E2E_Order54";
CM_ SG_ 610 S4_SRR_RL_Clu_DynProp_174 "E2E_Order55";
CM_ SG_ 610 S4_SRR_RL_Clu_Locationvalid_174 "E2E_Order56";
CM_ SG_ 610 S4_SRR_RL_Clu_24_E2EChecksum "DataID = 0x262";
CM_ BO_ 611 "The sending period is unstable, ranging from 40 to 80ms
E2E Profile1 Message";
CM_ SG_ 611 S4_SRR_RL_Clu_ID_175 "E2E_Order1";
CM_ SG_ 611 S4_SRR_RL_Clu_Theta_175 "E2E_Order2";
CM_ SG_ 611 S4_SRR_RL_Clu_Dist_175 "E2E_Order3";
CM_ SG_ 611 S4_SRR_RL_Clu_Vel_175 "E2E_Order4";
CM_ SG_ 611 S4_SRR_RL_Clu_SNR_175 "E2E_Order5";
CM_ SG_ 611 S4_SRR_RL_Clu_RCS_175 "E2E_Order6";
CM_ SG_ 611 S4_SRR_RL_Clu_DynProp_175 "E2E_Order7";
CM_ SG_ 611 S4_SRR_RL_Clu_Locationvalid_175 "E2E_Order8";
CM_ SG_ 611 S4_SRR_RL_Clu_ID_176 "E2E_Order9";
CM_ SG_ 611 S4_SRR_RL_Clu_Theta_176 "E2E_Order10";
CM_ SG_ 611 S4_SRR_RL_Clu_Dist_176 "E2E_Order11";
CM_ SG_ 611 S4_SRR_RL_Clu_Vel_176 "E2E_Order12";
CM_ SG_ 611 S4_SRR_RL_Clu_SNR_176 "E2E_Order13";
CM_ SG_ 611 S4_SRR_RL_Clu_RCS_176 "E2E_Order14";
CM_ SG_ 611 S4_SRR_RL_Clu_DynProp_176 "E2E_Order15";
CM_ SG_ 611 S4_SRR_RL_Clu_Locationvalid_176 "E2E_Order16";
CM_ SG_ 611 S4_SRR_RL_Clu_ID_177 "E2E_Order17";
CM_ SG_ 611 S4_SRR_RL_Clu_Theta_177 "E2E_Order18";
CM_ SG_ 611 S4_SRR_RL_Clu_Dist_177 "E2E_Order19";
CM_ SG_ 611 S4_SRR_RL_Clu_Vel_177 "E2E_Order20";
CM_ SG_ 611 S4_SRR_RL_Clu_SNR_177 "E2E_Order21";
CM_ SG_ 611 S4_SRR_RL_Clu_RCS_177 "E2E_Order22";
CM_ SG_ 611 S4_SRR_RL_Clu_DynProp_177 "E2E_Order23";
CM_ SG_ 611 S4_SRR_RL_Clu_Locationvalid_177 "E2E_Order24";
CM_ SG_ 611 S4_SRR_RL_Clu_ID_178 "E2E_Order25";
CM_ SG_ 611 S4_SRR_RL_Clu_Theta_178 "E2E_Order26";
CM_ SG_ 611 S4_SRR_RL_Clu_Dist_178 "E2E_Order27";
CM_ SG_ 611 S4_SRR_RL_Clu_Vel_178 "E2E_Order28";
CM_ SG_ 611 S4_SRR_RL_Clu_SNR_178 "E2E_Order29";
CM_ SG_ 611 S4_SRR_RL_Clu_RCS_178 "E2E_Order30";
CM_ SG_ 611 S4_SRR_RL_Clu_DynProp_178 "E2E_Order31";
CM_ SG_ 611 S4_SRR_RL_Clu_Locationvalid_178 "E2E_Order32";
CM_ SG_ 611 S4_SRR_RL_Clu_ID_179 "E2E_Order33";
CM_ SG_ 611 S4_SRR_RL_Clu_Theta_179 "E2E_Order34";
CM_ SG_ 611 S4_SRR_RL_Clu_Dist_179 "E2E_Order35";
CM_ SG_ 611 S4_SRR_RL_Clu_Vel_179 "E2E_Order36";
CM_ SG_ 611 S4_SRR_RL_Clu_SNR_179 "E2E_Order37";
CM_ SG_ 611 S4_SRR_RL_Clu_RCS_179 "E2E_Order38";
CM_ SG_ 611 S4_SRR_RL_Clu_DynProp_179 "E2E_Order39";
CM_ SG_ 611 S4_SRR_RL_Clu_Locationvalid_179 "E2E_Order40";
CM_ SG_ 611 S4_SRR_RL_Clu_ID_180 "E2E_Order41";
CM_ SG_ 611 S4_SRR_RL_Clu_Theta_180 "E2E_Order42";
CM_ SG_ 611 S4_SRR_RL_Clu_Dist_180 "E2E_Order43";
CM_ SG_ 611 S4_SRR_RL_Clu_Vel_180 "E2E_Order44";
CM_ SG_ 611 S4_SRR_RL_Clu_SNR_180 "E2E_Order45";
CM_ SG_ 611 S4_SRR_RL_Clu_RCS_180 "E2E_Order46";
CM_ SG_ 611 S4_SRR_RL_Clu_DynProp_180 "E2E_Order47";
CM_ SG_ 611 S4_SRR_RL_Clu_Locationvalid_180 "E2E_Order48";
CM_ SG_ 611 S4_SRR_RL_Clu_ID_181 "E2E_Order49";
CM_ SG_ 611 S4_SRR_RL_Clu_Theta_181 "E2E_Order50";
CM_ SG_ 611 S4_SRR_RL_Clu_Dist_181 "E2E_Order51";
CM_ SG_ 611 S4_SRR_RL_Clu_Vel_181 "E2E_Order52";
CM_ SG_ 611 S4_SRR_RL_Clu_SNR_181 "E2E_Order53";
CM_ SG_ 611 S4_SRR_RL_Clu_RCS_181 "E2E_Order54";
CM_ SG_ 611 S4_SRR_RL_Clu_DynProp_181 "E2E_Order55";
CM_ SG_ 611 S4_SRR_RL_Clu_Locationvalid_181 "E2E_Order56";
CM_ SG_ 611 S4_SRR_RL_Clu_25_E2EChecksum "DataID = 0x362";
CM_ BO_ 612 "The sending period is unstable, ranging from 40 to 80ms
E2E Profile1 Message";
CM_ SG_ 612 S4_SRR_RL_Clu_ID_182 "E2E_Order1";
CM_ SG_ 612 S4_SRR_RL_Clu_Theta_182 "E2E_Order2";
CM_ SG_ 612 S4_SRR_RL_Clu_Dist_182 "E2E_Order3";
CM_ SG_ 612 S4_SRR_RL_Clu_Vel_182 "E2E_Order4";
CM_ SG_ 612 S4_SRR_RL_Clu_SNR_182 "E2E_Order5";
CM_ SG_ 612 S4_SRR_RL_Clu_RCS_182 "E2E_Order6";
CM_ SG_ 612 S4_SRR_RL_Clu_DynProp_182 "E2E_Order7";
CM_ SG_ 612 S4_SRR_RL_Clu_Locationvalid_182 "E2E_Order8";
CM_ SG_ 612 S4_SRR_RL_Clu_ID_183 "E2E_Order9";
CM_ SG_ 612 S4_SRR_RL_Clu_Theta_183 "E2E_Order10";
CM_ SG_ 612 S4_SRR_RL_Clu_Dist_183 "E2E_Order11";
CM_ SG_ 612 S4_SRR_RL_Clu_Vel_183 "E2E_Order12";
CM_ SG_ 612 S4_SRR_RL_Clu_SNR_183 "E2E_Order13";
CM_ SG_ 612 S4_SRR_RL_Clu_RCS_183 "E2E_Order14";
CM_ SG_ 612 S4_SRR_RL_Clu_DynProp_183 "E2E_Order15";
CM_ SG_ 612 S4_SRR_RL_Clu_Locationvalid_183 "E2E_Order16";
CM_ SG_ 612 S4_SRR_RL_Clu_ID_184 "E2E_Order17";
CM_ SG_ 612 S4_SRR_RL_Clu_Theta_184 "E2E_Order18";
CM_ SG_ 612 S4_SRR_RL_Clu_Dist_184 "E2E_Order19";
CM_ SG_ 612 S4_SRR_RL_Clu_Vel_184 "E2E_Order20";
CM_ SG_ 612 S4_SRR_RL_Clu_SNR_184 "E2E_Order21";
CM_ SG_ 612 S4_SRR_RL_Clu_RCS_184 "E2E_Order22";
CM_ SG_ 612 S4_SRR_RL_Clu_DynProp_184 "E2E_Order23";
CM_ SG_ 612 S4_SRR_RL_Clu_Locationvalid_184 "E2E_Order24";
CM_ SG_ 612 S4_SRR_RL_Clu_ID_185 "E2E_Order25";
CM_ SG_ 612 S4_SRR_RL_Clu_Theta_185 "E2E_Order26";
CM_ SG_ 612 S4_SRR_RL_Clu_Dist_185 "E2E_Order27";
CM_ SG_ 612 S4_SRR_RL_Clu_Vel_185 "E2E_Order28";
CM_ SG_ 612 S4_SRR_RL_Clu_SNR_185 "E2E_Order29";
CM_ SG_ 612 S4_SRR_RL_Clu_RCS_185 "E2E_Order30";
CM_ SG_ 612 S4_SRR_RL_Clu_DynProp_185 "E2E_Order31";
CM_ SG_ 612 S4_SRR_RL_Clu_Locationvalid_185 "E2E_Order32";
CM_ SG_ 612 S4_SRR_RL_Clu_ID_186 "E2E_Order33";
CM_ SG_ 612 S4_SRR_RL_Clu_Theta_186 "E2E_Order34";
CM_ SG_ 612 S4_SRR_RL_Clu_Dist_186 "E2E_Order35";
CM_ SG_ 612 S4_SRR_RL_Clu_Vel_186 "E2E_Order36";
CM_ SG_ 612 S4_SRR_RL_Clu_SNR_186 "E2E_Order37";
CM_ SG_ 612 S4_SRR_RL_Clu_RCS_186 "E2E_Order38";
CM_ SG_ 612 S4_SRR_RL_Clu_DynProp_186 "E2E_Order39";
CM_ SG_ 612 S4_SRR_RL_Clu_Locationvalid_186 "E2E_Order40";
CM_ SG_ 612 S4_SRR_RL_Clu_ID_187 "E2E_Order41";
CM_ SG_ 612 S4_SRR_RL_Clu_Theta_187 "E2E_Order42";
CM_ SG_ 612 S4_SRR_RL_Clu_Dist_187 "E2E_Order43";
CM_ SG_ 612 S4_SRR_RL_Clu_Vel_187 "E2E_Order44";
CM_ SG_ 612 S4_SRR_RL_Clu_SNR_187 "E2E_Order45";
CM_ SG_ 612 S4_SRR_RL_Clu_RCS_187 "E2E_Order46";
CM_ SG_ 612 S4_SRR_RL_Clu_DynProp_187 "E2E_Order47";
CM_ SG_ 612 S4_SRR_RL_Clu_Locationvalid_187 "E2E_Order48";
CM_ SG_ 612 S4_SRR_RL_Clu_ID_188 "E2E_Order49";
CM_ SG_ 612 S4_SRR_RL_Clu_Theta_188 "E2E_Order50";
CM_ SG_ 612 S4_SRR_RL_Clu_Dist_188 "E2E_Order51";
CM_ SG_ 612 S4_SRR_RL_Clu_Vel_188 "E2E_Order52";
CM_ SG_ 612 S4_SRR_RL_Clu_SNR_188 "E2E_Order53";
CM_ SG_ 612 S4_SRR_RL_Clu_RCS_188 "E2E_Order54";
CM_ SG_ 612 S4_SRR_RL_Clu_DynProp_188 "E2E_Order55";
CM_ SG_ 612 S4_SRR_RL_Clu_Locationvalid_188 "E2E_Order56";
CM_ SG_ 612 S4_SRR_RL_Clu_26_E2EChecksum "DataID = 0x462";
CM_ BO_ 613 "The sending period is unstable, ranging from 40 to 80ms
E2E Profile1 Message";
CM_ SG_ 613 S4_SRR_RL_Clu_ID_189 "E2E_Order1";
CM_ SG_ 613 S4_SRR_RL_Clu_Theta_189 "E2E_Order2";
CM_ SG_ 613 S4_SRR_RL_Clu_Dist_189 "E2E_Order3";
CM_ SG_ 613 S4_SRR_RL_Clu_Vel_189 "E2E_Order4";
CM_ SG_ 613 S4_SRR_RL_Clu_SNR_189 "E2E_Order5";
CM_ SG_ 613 S4_SRR_RL_Clu_RCS_189 "E2E_Order6";
CM_ SG_ 613 S4_SRR_RL_Clu_DynProp_189 "E2E_Order7";
CM_ SG_ 613 S4_SRR_RL_Clu_Locationvalid_189 "E2E_Order8";
CM_ SG_ 613 S4_SRR_RL_Clu_ID_190 "E2E_Order9";
CM_ SG_ 613 S4_SRR_RL_Clu_Theta_190 "E2E_Order10";
CM_ SG_ 613 S4_SRR_RL_Clu_Dist_190 "E2E_Order11";
CM_ SG_ 613 S4_SRR_RL_Clu_Vel_190 "E2E_Order12";
CM_ SG_ 613 S4_SRR_RL_Clu_SNR_190 "E2E_Order13";
CM_ SG_ 613 S4_SRR_RL_Clu_RCS_190 "E2E_Order14";
CM_ SG_ 613 S4_SRR_RL_Clu_DynProp_190 "E2E_Order15";
CM_ SG_ 613 S4_SRR_RL_Clu_Locationvalid_190 "E2E_Order16";
CM_ SG_ 613 S4_SRR_RL_Clu_ID_191 "E2E_Order17";
CM_ SG_ 613 S4_SRR_RL_Clu_Theta_191 "E2E_Order18";
CM_ SG_ 613 S4_SRR_RL_Clu_Dist_191 "E2E_Order19";
CM_ SG_ 613 S4_SRR_RL_Clu_Vel_191 "E2E_Order20";
CM_ SG_ 613 S4_SRR_RL_Clu_SNR_191 "E2E_Order21";
CM_ SG_ 613 S4_SRR_RL_Clu_RCS_191 "E2E_Order22";
CM_ SG_ 613 S4_SRR_RL_Clu_DynProp_191 "E2E_Order23";
CM_ SG_ 613 S4_SRR_RL_Clu_Locationvalid_191 "E2E_Order24";
CM_ SG_ 613 S4_SRR_RL_Clu_ID_192 "E2E_Order25";
CM_ SG_ 613 S4_SRR_RL_Clu_Theta_192 "E2E_Order26";
CM_ SG_ 613 S4_SRR_RL_Clu_Dist_192 "E2E_Order27";
CM_ SG_ 613 S4_SRR_RL_Clu_Vel_192 "E2E_Order28";
CM_ SG_ 613 S4_SRR_RL_Clu_SNR_192 "E2E_Order29";
CM_ SG_ 613 S4_SRR_RL_Clu_RCS_192 "E2E_Order30";
CM_ SG_ 613 S4_SRR_RL_Clu_DynProp_192 "E2E_Order31";
CM_ SG_ 613 S4_SRR_RL_Clu_Locationvalid_192 "E2E_Order32";
CM_ SG_ 613 S4_SRR_RL_Clu_ID_193 "E2E_Order33";
CM_ SG_ 613 S4_SRR_RL_Clu_Theta_193 "E2E_Order34";
CM_ SG_ 613 S4_SRR_RL_Clu_Dist_193 "E2E_Order35";
CM_ SG_ 613 S4_SRR_RL_Clu_Vel_193 "E2E_Order36";
CM_ SG_ 613 S4_SRR_RL_Clu_SNR_193 "E2E_Order37";
CM_ SG_ 613 S4_SRR_RL_Clu_RCS_193 "E2E_Order38";
CM_ SG_ 613 S4_SRR_RL_Clu_DynProp_193 "E2E_Order39";
CM_ SG_ 613 S4_SRR_RL_Clu_Locationvalid_193 "E2E_Order40";
CM_ SG_ 613 S4_SRR_RL_Clu_ID_194 "E2E_Order41";
CM_ SG_ 613 S4_SRR_RL_Clu_Theta_194 "E2E_Order42";
CM_ SG_ 613 S4_SRR_RL_Clu_Dist_194 "E2E_Order43";
CM_ SG_ 613 S4_SRR_RL_Clu_Vel_194 "E2E_Order44";
CM_ SG_ 613 S4_SRR_RL_Clu_SNR_194 "E2E_Order45";
CM_ SG_ 613 S4_SRR_RL_Clu_RCS_194 "E2E_Order46";
CM_ SG_ 613 S4_SRR_RL_Clu_DynProp_194 "E2E_Order47";
CM_ SG_ 613 S4_SRR_RL_Clu_Locationvalid_194 "E2E_Order48";
CM_ SG_ 613 S4_SRR_RL_Clu_ID_195 "E2E_Order49";
CM_ SG_ 613 S4_SRR_RL_Clu_Theta_195 "E2E_Order50";
CM_ SG_ 613 S4_SRR_RL_Clu_Dist_195 "E2E_Order51";
CM_ SG_ 613 S4_SRR_RL_Clu_Vel_195 "E2E_Order52";
CM_ SG_ 613 S4_SRR_RL_Clu_SNR_195 "E2E_Order53";
CM_ SG_ 613 S4_SRR_RL_Clu_RCS_195 "E2E_Order54";
CM_ SG_ 613 S4_SRR_RL_Clu_DynProp_195 "E2E_Order55";
CM_ SG_ 613 S4_SRR_RL_Clu_Locationvalid_195 "E2E_Order56";
CM_ SG_ 613 S4_SRR_RL_Clu_27_E2EChecksum "DataID = 0x562";
CM_ BO_ 614 "The sending period is unstable, ranging from 40 to 80ms
E2E Profile1 Message";
CM_ SG_ 614 S4_SRR_RL_Clu_ID_196 "E2E_Order1";
CM_ SG_ 614 S4_SRR_RL_Clu_Theta_196 "E2E_Order2";
CM_ SG_ 614 S4_SRR_RL_Clu_Dist_196 "E2E_Order3";
CM_ SG_ 614 S4_SRR_RL_Clu_Vel_196 "E2E_Order4";
CM_ SG_ 614 S4_SRR_RL_Clu_SNR_196 "E2E_Order5";
CM_ SG_ 614 S4_SRR_RL_Clu_RCS_196 "E2E_Order6";
CM_ SG_ 614 S4_SRR_RL_Clu_DynProp_196 "E2E_Order7";
CM_ SG_ 614 S4_SRR_RL_Clu_Locationvalid_196 "E2E_Order8";
CM_ SG_ 614 S4_SRR_RL_Clu_ID_197 "E2E_Order9";
CM_ SG_ 614 S4_SRR_RL_Clu_Theta_197 "E2E_Order10";
CM_ SG_ 614 S4_SRR_RL_Clu_Dist_197 "E2E_Order11";
CM_ SG_ 614 S4_SRR_RL_Clu_Vel_197 "E2E_Order12";
CM_ SG_ 614 S4_SRR_RL_Clu_SNR_197 "E2E_Order13";
CM_ SG_ 614 S4_SRR_RL_Clu_RCS_197 "E2E_Order14";
CM_ SG_ 614 S4_SRR_RL_Clu_DynProp_197 "E2E_Order15";
CM_ SG_ 614 S4_SRR_RL_Clu_Locationvalid_197 "E2E_Order16";
CM_ SG_ 614 S4_SRR_RL_Clu_ID_198 "E2E_Order17";
CM_ SG_ 614 S4_SRR_RL_Clu_Theta_198 "E2E_Order18";
CM_ SG_ 614 S4_SRR_RL_Clu_Dist_198 "E2E_Order19";
CM_ SG_ 614 S4_SRR_RL_Clu_Vel_198 "E2E_Order20";
CM_ SG_ 614 S4_SRR_RL_Clu_SNR_198 "E2E_Order21";
CM_ SG_ 614 S4_SRR_RL_Clu_RCS_198 "E2E_Order22";
CM_ SG_ 614 S4_SRR_RL_Clu_DynProp_198 "E2E_Order23";
CM_ SG_ 614 S4_SRR_RL_Clu_Locationvalid_198 "E2E_Order24";
CM_ SG_ 614 S4_SRR_RL_Clu_ID_199 "E2E_Order25";
CM_ SG_ 614 S4_SRR_RL_Clu_Theta_199 "E2E_Order26";
CM_ SG_ 614 S4_SRR_RL_Clu_Dist_199 "E2E_Order27";
CM_ SG_ 614 S4_SRR_RL_Clu_Vel_199 "E2E_Order28";
CM_ SG_ 614 S4_SRR_RL_Clu_SNR_199 "E2E_Order29";
CM_ SG_ 614 S4_SRR_RL_Clu_RCS_199 "E2E_Order30";
CM_ SG_ 614 S4_SRR_RL_Clu_DynProp_199 "E2E_Order31";
CM_ SG_ 614 S4_SRR_RL_Clu_Locationvalid_199 "E2E_Order32";
CM_ SG_ 614 S4_SRR_RL_Clu_28_E2EChecksum "DataID = 0x662";
CM_ BO_ 615 "The sending period is unstable, ranging from 40 to 80ms
E2E Profile1 Message";
CM_ SG_ 615 S4_SRR_RL_Obj_ID_0 "E2E_Order1";
CM_ SG_ 615 S4_SRR_RL_Obj_DistX_0 "E2E_Order2";
CM_ SG_ 615 S4_SRR_RL_Obj_RelVelX_0 "E2E_Order3";
CM_ SG_ 615 S4_SRR_RL_Obj_AccelX_0 "E2E_Order4";
CM_ SG_ 615 S4_SRR_RL_Obj_DistY_0 "E2E_Order5";
CM_ SG_ 615 S4_SRR_RL_Obj_RelVelY_0 "E2E_Order6";
CM_ SG_ 615 S4_SRR_RL_Obj_AccelY_0 "E2E_Order7";
CM_ SG_ 615 S4_SRR_RL_Obj_DistXStd_0 "E2E_Order8";
CM_ SG_ 615 S4_SRR_RL_Obj_RelVelXStd_0 "E2E_Order9";
CM_ SG_ 615 S4_SRR_RL_Obj_RAccelXStd_0 "E2E_Order10";
CM_ SG_ 615 S4_SRR_RL_Obj_DistYStd_0 "E2E_Order11";
CM_ SG_ 615 S4_SRR_RL_Obj_RelVelYStd_0 "E2E_Order12";
CM_ SG_ 615 S4_SRR_RL_Obj_RAccelYStd_0 "E2E_Order13";
CM_ SG_ 615 S4_SRR_RL_Obj_ValidFlag_0 "E2E_Order14";
CM_ SG_ 615 S4_SRR_RL_Obj_UpdateFlag_0 "E2E_Order15";
CM_ SG_ 615 S4_SRR_RL_Obj_ExistProb_0 "E2E_Order16";
CM_ SG_ 615 S4_SRR_RL_Obj_Type_0 "E2E_Order17";
CM_ SG_ 615 S4_SRR_RL_Obj_EDynProp_0 "E2E_Order18";
CM_ SG_ 615 S4_SRR_RL_Obj_UiLifeCycles_0 "E2E_Order19";
CM_ SG_ 615 S4_SRR_RL_Obj_RCS_0 "E2E_Order20";
CM_ SG_ 615 S4_SRR_RL_Obj_ID_1 "E2E_Order21";
CM_ SG_ 615 S4_SRR_RL_Obj_DistX_1 "E2E_Order22";
CM_ SG_ 615 S4_SRR_RL_Obj_RelVelX_1 "E2E_Order23";
CM_ SG_ 615 S4_SRR_RL_Obj_AccelX_1 "E2E_Order24";
CM_ SG_ 615 S4_SRR_RL_Obj_DistY_1 "E2E_Order25";
CM_ SG_ 615 S4_SRR_RL_Obj_RelVelY_1 "E2E_Order26";
CM_ SG_ 615 S4_SRR_RL_Obj_AccelY_1 "E2E_Order27";
CM_ SG_ 615 S4_SRR_RL_Obj_DistXStd_1 "E2E_Order28";
CM_ SG_ 615 S4_SRR_RL_Obj_RelVelXStd_1 "E2E_Order29";
CM_ SG_ 615 S4_SRR_RL_Obj_RAccelXStd_1 "E2E_Order30";
CM_ SG_ 615 S4_SRR_RL_Obj_DistYStd_1 "E2E_Order31";
CM_ SG_ 615 S4_SRR_RL_Obj_RelVelYStd_1 "E2E_Order32";
CM_ SG_ 615 S4_SRR_RL_Obj_RAccelYStd_1 "E2E_Order33";
CM_ SG_ 615 S4_SRR_RL_Obj_ValidFlag_1 "E2E_Order34";
CM_ SG_ 615 S4_SRR_RL_Obj_UpdateFlag_1 "E2E_Order35";
CM_ SG_ 615 S4_SRR_RL_Obj_ExistProb_1 "E2E_Order36";
CM_ SG_ 615 S4_SRR_RL_Obj_Type_1 "E2E_Order37";
CM_ SG_ 615 S4_SRR_RL_Obj_EDynProp_1 "E2E_Order38";
CM_ SG_ 615 S4_SRR_RL_Obj_UiLifeCycles_1 "E2E_Order39";
CM_ SG_ 615 S4_SRR_RL_Obj_RCS_1 "E2E_Order40";
CM_ SG_ 615 S4_SRR_RL_Obj_ID_2 "E2E_Order41";
CM_ SG_ 615 S4_SRR_RL_Obj_DistX_2 "E2E_Order42";
CM_ SG_ 615 S4_SRR_RL_Obj_RelVelX_2 "E2E_Order43";
CM_ SG_ 615 S4_SRR_RL_Obj_AccelX_2 "E2E_Order44";
CM_ SG_ 615 S4_SRR_RL_Obj_DistY_2 "E2E_Order45";
CM_ SG_ 615 S4_SRR_RL_Obj_RelVelY_2 "E2E_Order46";
CM_ SG_ 615 S4_SRR_RL_Obj_AccelY_2 "E2E_Order47";
CM_ SG_ 615 S4_SRR_RL_Obj_DistXStd_2 "E2E_Order48";
CM_ SG_ 615 S4_SRR_RL_Obj_RelVelXStd_2 "E2E_Order49";
CM_ SG_ 615 S4_SRR_RL_Obj_RAccelXStd_2 "E2E_Order50";
CM_ SG_ 615 S4_SRR_RL_Obj_DistYStd_2 "E2E_Order51";
CM_ SG_ 615 S4_SRR_RL_Obj_RelVelYStd_2 "E2E_Order52";
CM_ SG_ 615 S4_SRR_RL_Obj_RAccelYStd_2 "E2E_Order53";
CM_ SG_ 615 S4_SRR_RL_Obj_ValidFlag_2 "E2E_Order54";
CM_ SG_ 615 S4_SRR_RL_Obj_UpdateFlag_2 "E2E_Order55";
CM_ SG_ 615 S4_SRR_RL_Obj_ExistProb_2 "E2E_Order56";
CM_ SG_ 615 S4_SRR_RL_Obj_Type_2 "E2E_Order57";
CM_ SG_ 615 S4_SRR_RL_Obj_EDynProp_2 "E2E_Order58";
CM_ SG_ 615 S4_SRR_RL_Obj_UiLifeCycles_2 "E2E_Order59";
CM_ SG_ 615 S4_SRR_RL_Obj_RCS_2 "E2E_Order60";
CM_ SG_ 615 S4_SRR_RL_Obj_Timestamps "E2E_Order61";
CM_ SG_ 615 S4_SRR_RL_Obj_0_E2EChecksum "DataID = 0x0762";
CM_ BO_ 616 "The sending period is unstable, ranging from 40 to 80ms
E2E Profile1 Message";
CM_ SG_ 616 S4_SRR_RL_Obj_ID_3 "E2E_Order1";
CM_ SG_ 616 S4_SRR_RL_Obj_DistX_3 "E2E_Order2";
CM_ SG_ 616 S4_SRR_RL_Obj_RelVelX_3 "E2E_Order3";
CM_ SG_ 616 S4_SRR_RL_Obj_AccelX_3 "E2E_Order4";
CM_ SG_ 616 S4_SRR_RL_Obj_DistY_3 "E2E_Order5";
CM_ SG_ 616 S4_SRR_RL_Obj_RelVelY_3 "E2E_Order6";
CM_ SG_ 616 S4_SRR_RL_Obj_AccelY_3 "E2E_Order7";
CM_ SG_ 616 S4_SRR_RL_Obj_DistXStd_3 "E2E_Order8";
CM_ SG_ 616 S4_SRR_RL_Obj_RelVelXStd_3 "E2E_Order9";
CM_ SG_ 616 S4_SRR_RL_Obj_RAccelXStd_3 "E2E_Order10";
CM_ SG_ 616 S4_SRR_RL_Obj_DistYStd_3 "E2E_Order11";
CM_ SG_ 616 S4_SRR_RL_Obj_RelVelYStd_3 "E2E_Order12";
CM_ SG_ 616 S4_SRR_RL_Obj_RAccelYStd_3 "E2E_Order13";
CM_ SG_ 616 S4_SRR_RL_Obj_ValidFlag_3 "E2E_Order14";
CM_ SG_ 616 S4_SRR_RL_Obj_UpdateFlag_3 "E2E_Order15";
CM_ SG_ 616 S4_SRR_RL_Obj_ExistProb_3 "E2E_Order16";
CM_ SG_ 616 S4_SRR_RL_Obj_Type_3 "E2E_Order17";
CM_ SG_ 616 S4_SRR_RL_Obj_EDynProp_3 "E2E_Order18";
CM_ SG_ 616 S4_SRR_RL_Obj_UiLifeCycles_3 "E2E_Order19";
CM_ SG_ 616 S4_SRR_RL_Obj_RCS_3 "E2E_Order20";
CM_ SG_ 616 S4_SRR_RL_Obj_ID_4 "E2E_Order21";
CM_ SG_ 616 S4_SRR_RL_Obj_DistX_4 "E2E_Order22";
CM_ SG_ 616 S4_SRR_RL_Obj_RelVelX_4 "E2E_Order23";
CM_ SG_ 616 S4_SRR_RL_Obj_AccelX_4 "E2E_Order24";
CM_ SG_ 616 S4_SRR_RL_Obj_DistY_4 "E2E_Order25";
CM_ SG_ 616 S4_SRR_RL_Obj_RelVelY_4 "E2E_Order26";
CM_ SG_ 616 S4_SRR_RL_Obj_AccelY_4 "E2E_Order27";
CM_ SG_ 616 S4_SRR_RL_Obj_DistXStd_4 "E2E_Order28";
CM_ SG_ 616 S4_SRR_RL_Obj_RelVelXStd_4 "E2E_Order29";
CM_ SG_ 616 S4_SRR_RL_Obj_RAccelXStd_4 "E2E_Order30";
CM_ SG_ 616 S4_SRR_RL_Obj_DistYStd_4 "E2E_Order31";
CM_ SG_ 616 S4_SRR_RL_Obj_RelVelYStd_4 "E2E_Order32";
CM_ SG_ 616 S4_SRR_RL_Obj_RAccelYStd_4 "E2E_Order33";
CM_ SG_ 616 S4_SRR_RL_Obj_ValidFlag_4 "E2E_Order34";
CM_ SG_ 616 S4_SRR_RL_Obj_UpdateFlag_4 "E2E_Order35";
CM_ SG_ 616 S4_SRR_RL_Obj_ExistProb_4 "E2E_Order36";
CM_ SG_ 616 S4_SRR_RL_Obj_Type_4 "E2E_Order37";
CM_ SG_ 616 S4_SRR_RL_Obj_EDynProp_4 "E2E_Order38";
CM_ SG_ 616 S4_SRR_RL_Obj_UiLifeCycles_4 "E2E_Order39";
CM_ SG_ 616 S4_SRR_RL_Obj_RCS_4 "E2E_Order40";
CM_ SG_ 616 S4_SRR_RL_Obj_ID_5 "E2E_Order41";
CM_ SG_ 616 S4_SRR_RL_Obj_DistX_5 "E2E_Order42";
CM_ SG_ 616 S4_SRR_RL_Obj_RelVelX_5 "E2E_Order43";
CM_ SG_ 616 S4_SRR_RL_Obj_AccelX_5 "E2E_Order44";
CM_ SG_ 616 S4_SRR_RL_Obj_DistY_5 "E2E_Order45";
CM_ SG_ 616 S4_SRR_RL_Obj_RelVelY_5 "E2E_Order46";
CM_ SG_ 616 S4_SRR_RL_Obj_AccelY_5 "E2E_Order47";
CM_ SG_ 616 S4_SRR_RL_Obj_DistXStd_5 "E2E_Order48";
CM_ SG_ 616 S4_SRR_RL_Obj_RelVelXStd_5 "E2E_Order49";
CM_ SG_ 616 S4_SRR_RL_Obj_RAccelXStd_5 "E2E_Order50";
CM_ SG_ 616 S4_SRR_RL_Obj_DistYStd_5 "E2E_Order51";
CM_ SG_ 616 S4_SRR_RL_Obj_RelVelYStd_5 "E2E_Order52";
CM_ SG_ 616 S4_SRR_RL_Obj_RAccelYStd_5 "E2E_Order53";
CM_ SG_ 616 S4_SRR_RL_Obj_ValidFlag_5 "E2E_Order54";
CM_ SG_ 616 S4_SRR_RL_Obj_UpdateFlag_5 "E2E_Order55";
CM_ SG_ 616 S4_SRR_RL_Obj_ExistProb_5 "E2E_Order56";
CM_ SG_ 616 S4_SRR_RL_Obj_Type_5 "E2E_Order57";
CM_ SG_ 616 S4_SRR_RL_Obj_EDynProp_5 "E2E_Order58";
CM_ SG_ 616 S4_SRR_RL_Obj_UiLifeCycles_5 "E2E_Order59";
CM_ SG_ 616 S4_SRR_RL_Obj_RCS_5 "E2E_Order60";
CM_ SG_ 616 S4_SRR_RL_Obj_1_E2EChecksum "DataID = 0x0862";
CM_ BO_ 617 "The sending period is unstable, ranging from 40 to 80ms
E2E Profile1 Message";
CM_ SG_ 617 S4_SRR_RL_Obj_ID_6 "E2E_Order1";
CM_ SG_ 617 S4_SRR_RL_Obj_DistX_6 "E2E_Order2";
CM_ SG_ 617 S4_SRR_RL_Obj_RelVelX_6 "E2E_Order3";
CM_ SG_ 617 S4_SRR_RL_Obj_AccelX_6 "E2E_Order4";
CM_ SG_ 617 S4_SRR_RL_Obj_DistY_6 "E2E_Order5";
CM_ SG_ 617 S4_SRR_RL_Obj_RelVelY_6 "E2E_Order6";
CM_ SG_ 617 S4_SRR_RL_Obj_AccelY_6 "E2E_Order7";
CM_ SG_ 617 S4_SRR_RL_Obj_DistXStd_6 "E2E_Order8";
CM_ SG_ 617 S4_SRR_RL_Obj_RelVelXStd_6 "E2E_Order9";
CM_ SG_ 617 S4_SRR_RL_Obj_RAccelXStd_6 "E2E_Order10";
CM_ SG_ 617 S4_SRR_RL_Obj_DistYStd_6 "E2E_Order11";
CM_ SG_ 617 S4_SRR_RL_Obj_RelVelYStd_6 "E2E_Order12";
CM_ SG_ 617 S4_SRR_RL_Obj_RAccelYStd_6 "E2E_Order13";
CM_ SG_ 617 S4_SRR_RL_Obj_ValidFlag_6 "E2E_Order14";
CM_ SG_ 617 S4_SRR_RL_Obj_UpdateFlag_6 "E2E_Order15";
CM_ SG_ 617 S4_SRR_RL_Obj_ExistProb_6 "E2E_Order16";
CM_ SG_ 617 S4_SRR_RL_Obj_Type_6 "E2E_Order17";
CM_ SG_ 617 S4_SRR_RL_Obj_EDynProp_6 "E2E_Order18";
CM_ SG_ 617 S4_SRR_RL_Obj_UiLifeCycles_6 "E2E_Order19";
CM_ SG_ 617 S4_SRR_RL_Obj_RCS_6 "E2E_Order20";
CM_ SG_ 617 S4_SRR_RL_Obj_ID_7 "E2E_Order21";
CM_ SG_ 617 S4_SRR_RL_Obj_DistX_7 "E2E_Order22";
CM_ SG_ 617 S4_SRR_RL_Obj_RelVelX_7 "E2E_Order23";
CM_ SG_ 617 S4_SRR_RL_Obj_AccelX_7 "E2E_Order24";
CM_ SG_ 617 S4_SRR_RL_Obj_DistY_7 "E2E_Order25";
CM_ SG_ 617 S4_SRR_RL_Obj_RelVelY_7 "E2E_Order26";
CM_ SG_ 617 S4_SRR_RL_Obj_AccelY_7 "E2E_Order27";
CM_ SG_ 617 S4_SRR_RL_Obj_DistXStd_7 "E2E_Order28";
CM_ SG_ 617 S4_SRR_RL_Obj_RelVelXStd_7 "E2E_Order29";
CM_ SG_ 617 S4_SRR_RL_Obj_RAccelXStd_7 "E2E_Order30";
CM_ SG_ 617 S4_SRR_RL_Obj_DistYStd_7 "E2E_Order31";
CM_ SG_ 617 S4_SRR_RL_Obj_RelVelYStd_7 "E2E_Order32";
CM_ SG_ 617 S4_SRR_RL_Obj_RAccelYStd_7 "E2E_Order33";
CM_ SG_ 617 S4_SRR_RL_Obj_ValidFlag_7 "E2E_Order34";
CM_ SG_ 617 S4_SRR_RL_Obj_UpdateFlag_7 "E2E_Order35";
CM_ SG_ 617 S4_SRR_RL_Obj_ExistProb_7 "E2E_Order36";
CM_ SG_ 617 S4_SRR_RL_Obj_Type_7 "E2E_Order37";
CM_ SG_ 617 S4_SRR_RL_Obj_EDynProp_7 "E2E_Order38";
CM_ SG_ 617 S4_SRR_RL_Obj_UiLifeCycles_7 "E2E_Order39";
CM_ SG_ 617 S4_SRR_RL_Obj_RCS_7 "E2E_Order40";
CM_ SG_ 617 S4_SRR_RL_Obj_ID_8 "E2E_Order41";
CM_ SG_ 617 S4_SRR_RL_Obj_DistX_8 "E2E_Order42";
CM_ SG_ 617 S4_SRR_RL_Obj_RelVelX_8 "E2E_Order43";
CM_ SG_ 617 S4_SRR_RL_Obj_AccelX_8 "E2E_Order44";
CM_ SG_ 617 S4_SRR_RL_Obj_DistY_8 "E2E_Order45";
CM_ SG_ 617 S4_SRR_RL_Obj_RelVelY_8 "E2E_Order46";
CM_ SG_ 617 S4_SRR_RL_Obj_AccelY_8 "E2E_Order47";
CM_ SG_ 617 S4_SRR_RL_Obj_DistXStd_8 "E2E_Order48";
CM_ SG_ 617 S4_SRR_RL_Obj_RelVelXStd_8 "E2E_Order49";
CM_ SG_ 617 S4_SRR_RL_Obj_RAccelXStd_8 "E2E_Order50";
CM_ SG_ 617 S4_SRR_RL_Obj_DistYStd_8 "E2E_Order51";
CM_ SG_ 617 S4_SRR_RL_Obj_RelVelYStd_8 "E2E_Order52";
CM_ SG_ 617 S4_SRR_RL_Obj_RAccelYStd_8 "E2E_Order53";
CM_ SG_ 617 S4_SRR_RL_Obj_ValidFlag_8 "E2E_Order54";
CM_ SG_ 617 S4_SRR_RL_Obj_UpdateFlag_8 "E2E_Order55";
CM_ SG_ 617 S4_SRR_RL_Obj_ExistProb_8 "E2E_Order56";
CM_ SG_ 617 S4_SRR_RL_Obj_Type_8 "E2E_Order57";
CM_ SG_ 617 S4_SRR_RL_Obj_EDynProp_8 "E2E_Order58";
CM_ SG_ 617 S4_SRR_RL_Obj_UiLifeCycles_8 "E2E_Order59";
CM_ SG_ 617 S4_SRR_RL_Obj_RCS_8 "E2E_Order60";
CM_ SG_ 617 S4_SRR_RL_Obj_2_E2EChecksum "DataID = 0x0962";

BA_DEF_ BO_  "AliveTimeout" INT 0 100000;
BA_DEF_ BO_  "DiagDCM" ENUM  "Yes","No";
BA_DEF_ SG_  "InvalidHex" STRING ;
BA_DEF_ SG_  "GenSigEnvVarType" ENUM  "int","float","undef";
BA_DEF_ SG_  "GenSigStartValue" FLOAT 0 100000000000;
BA_DEF_ SG_  "GenSigSendType" ENUM  "Cyclic","OnWrite","OnWriteWithRepetition","OnChange","OnChangeWithRepetition","IfActive","IfActiveWithRepetition","NoSigSendType";
BA_DEF_ BO_  "DiagRequest" ENUM  "No","Yes";
BA_DEF_ BO_  "DiagResponse" ENUM  "No","Yes";
BA_DEF_ BO_  "CANFD_BRS" ENUM  "0","1";
BA_DEF_ BO_  "GenMsgCycleTimeFast" INT 0 100000;
BA_DEF_ BO_  "GenMsgNrOfRepetition" INT 0 100;
BA_DEF_ BO_  "NmMessage" ENUM  "No","Yes";
BA_DEF_ BO_  "GenMsgILSupport" ENUM  "No","Yes";
BA_DEF_ BO_  "GenMsgCycleTime" INT 0 15000;
BA_DEF_ BO_  "GenMsgSendType" ENUM  "FixedPeriodic","Event","EnabledPeriodic","Enable","NotUsed","EventPeriodic","NotUsed","NotUsed","NoMsgSendType";
BA_DEF_ BO_  "VFrameFormat" ENUM  "StandardCAN","ExtendedCAN","reserved","reserved","reserved","reserved","reserved","reserved","reserved","reserved","reserved","reserved","reserved","reserved","StandardCAN_FD","ExtendedCAN_FD";
BA_DEF_DEF_  "AliveTimeout" 0;
BA_DEF_DEF_  "DiagDCM" "No";
BA_DEF_DEF_  "InvalidHex" "";
BA_DEF_DEF_  "GenSigEnvVarType" "undef";
BA_DEF_DEF_  "GenSigStartValue" 0;
BA_DEF_DEF_  "GenSigSendType" "Cyclic";
BA_DEF_DEF_  "DiagRequest" "No";
BA_DEF_DEF_  "DiagResponse" "No";
BA_DEF_DEF_  "CANFD_BRS" "1";
BA_DEF_DEF_  "GenMsgCycleTimeFast" 0;
BA_DEF_DEF_  "GenMsgNrOfRepetition" 3;
BA_DEF_DEF_  "NmMessage" "No";
BA_DEF_DEF_  "GenMsgILSupport" "Yes";
BA_DEF_DEF_  "GenMsgCycleTime" 0;
BA_DEF_DEF_  "GenMsgSendType" "NoMsgSendType";
BA_DEF_DEF_  "VFrameFormat" "StandardCAN";
BA_ "VFrameFormat" BO_ 601 14;
BA_ "GenMsgSendType" BO_ 601 0;
BA_ "GenMsgCycleTime" BO_ 601 50;
BA_ "InvalidHex" SG_ 601 S4_SRR_RL_Clu_ID_112 "0xFF";
BA_ "GenSigStartValue" SG_ 601 S4_SRR_RL_Clu_Theta_112 253;
BA_ "GenSigStartValue" SG_ 601 S4_SRR_RL_Clu_Vel_112 1111;
BA_ "GenSigStartValue" SG_ 601 S4_SRR_RL_Clu_RCS_112 30;
BA_ "GenSigStartValue" SG_ 601 S4_SRR_RL_Clu_Locationvalid_112 1;
BA_ "InvalidHex" SG_ 601 S4_SRR_RL_Clu_ID_113 "0xFF";
BA_ "GenSigStartValue" SG_ 601 S4_SRR_RL_Clu_Theta_113 253;
BA_ "GenSigStartValue" SG_ 601 S4_SRR_RL_Clu_Vel_113 1111;
BA_ "GenSigStartValue" SG_ 601 S4_SRR_RL_Clu_RCS_113 30;
BA_ "GenSigStartValue" SG_ 601 S4_SRR_RL_Clu_Locationvalid_113 1;
BA_ "InvalidHex" SG_ 601 S4_SRR_RL_Clu_ID_114 "0xFF";
BA_ "GenSigStartValue" SG_ 601 S4_SRR_RL_Clu_Theta_114 253;
BA_ "GenSigStartValue" SG_ 601 S4_SRR_RL_Clu_Vel_114 1111;
BA_ "GenSigStartValue" SG_ 601 S4_SRR_RL_Clu_RCS_114 30;
BA_ "GenSigStartValue" SG_ 601 S4_SRR_RL_Clu_Locationvalid_114 1;
BA_ "InvalidHex" SG_ 601 S4_SRR_RL_Clu_ID_115 "0xFF";
BA_ "GenSigStartValue" SG_ 601 S4_SRR_RL_Clu_Theta_115 253;
BA_ "GenSigStartValue" SG_ 601 S4_SRR_RL_Clu_Vel_115 1111;
BA_ "GenSigStartValue" SG_ 601 S4_SRR_RL_Clu_RCS_115 30;
BA_ "GenSigStartValue" SG_ 601 S4_SRR_RL_Clu_Locationvalid_115 1;
BA_ "InvalidHex" SG_ 601 S4_SRR_RL_Clu_ID_116 "0xFF";
BA_ "GenSigStartValue" SG_ 601 S4_SRR_RL_Clu_Theta_116 253;
BA_ "GenSigStartValue" SG_ 601 S4_SRR_RL_Clu_Vel_116 1111;
BA_ "GenSigStartValue" SG_ 601 S4_SRR_RL_Clu_RCS_116 30;
BA_ "GenSigStartValue" SG_ 601 S4_SRR_RL_Clu_Locationvalid_116 1;
BA_ "InvalidHex" SG_ 601 S4_SRR_RL_Clu_ID_117 "0xFF";
BA_ "GenSigStartValue" SG_ 601 S4_SRR_RL_Clu_Theta_117 253;
BA_ "GenSigStartValue" SG_ 601 S4_SRR_RL_Clu_Vel_117 1111;
BA_ "GenSigStartValue" SG_ 601 S4_SRR_RL_Clu_RCS_117 30;
BA_ "GenSigStartValue" SG_ 601 S4_SRR_RL_Clu_Locationvalid_117 1;
BA_ "InvalidHex" SG_ 601 S4_SRR_RL_Clu_ID_118 "0xFF";
BA_ "GenSigStartValue" SG_ 601 S4_SRR_RL_Clu_Theta_118 253;
BA_ "GenSigStartValue" SG_ 601 S4_SRR_RL_Clu_Vel_118 1111;
BA_ "GenSigStartValue" SG_ 601 S4_SRR_RL_Clu_RCS_118 30;
BA_ "GenSigStartValue" SG_ 601 S4_SRR_RL_Clu_Locationvalid_118 1;
BA_ "VFrameFormat" BO_ 603 14;
BA_ "GenMsgSendType" BO_ 603 0;
BA_ "GenMsgCycleTime" BO_ 603 50;
BA_ "InvalidHex" SG_ 603 S4_SRR_RL_Clu_ID_119 "0xFF";
BA_ "GenSigStartValue" SG_ 603 S4_SRR_RL_Clu_Theta_119 253;
BA_ "GenSigStartValue" SG_ 603 S4_SRR_RL_Clu_Vel_119 1111;
BA_ "GenSigStartValue" SG_ 603 S4_SRR_RL_Clu_RCS_119 30;
BA_ "GenSigStartValue" SG_ 603 S4_SRR_RL_Clu_Locationvalid_119 1;
BA_ "InvalidHex" SG_ 603 S4_SRR_RL_Clu_ID_120 "0xFF";
BA_ "GenSigStartValue" SG_ 603 S4_SRR_RL_Clu_Theta_120 253;
BA_ "GenSigStartValue" SG_ 603 S4_SRR_RL_Clu_Vel_120 1111;
BA_ "GenSigStartValue" SG_ 603 S4_SRR_RL_Clu_RCS_120 30;
BA_ "GenSigStartValue" SG_ 603 S4_SRR_RL_Clu_Locationvalid_120 1;
BA_ "InvalidHex" SG_ 603 S4_SRR_RL_Clu_ID_121 "0xFF";
BA_ "GenSigStartValue" SG_ 603 S4_SRR_RL_Clu_Theta_121 253;
BA_ "GenSigStartValue" SG_ 603 S4_SRR_RL_Clu_Vel_121 1111;
BA_ "GenSigStartValue" SG_ 603 S4_SRR_RL_Clu_RCS_121 30;
BA_ "GenSigStartValue" SG_ 603 S4_SRR_RL_Clu_Locationvalid_121 1;
BA_ "InvalidHex" SG_ 603 S4_SRR_RL_Clu_ID_122 "0xFF";
BA_ "GenSigStartValue" SG_ 603 S4_SRR_RL_Clu_Theta_122 253;
BA_ "GenSigStartValue" SG_ 603 S4_SRR_RL_Clu_Vel_122 1111;
BA_ "GenSigStartValue" SG_ 603 S4_SRR_RL_Clu_RCS_122 30;
BA_ "GenSigStartValue" SG_ 603 S4_SRR_RL_Clu_Locationvalid_122 1;
BA_ "InvalidHex" SG_ 603 S4_SRR_RL_Clu_ID_123 "0xFF";
BA_ "GenSigStartValue" SG_ 603 S4_SRR_RL_Clu_Theta_123 253;
BA_ "GenSigStartValue" SG_ 603 S4_SRR_RL_Clu_Vel_123 1111;
BA_ "GenSigStartValue" SG_ 603 S4_SRR_RL_Clu_RCS_123 30;
BA_ "GenSigStartValue" SG_ 603 S4_SRR_RL_Clu_Locationvalid_123 1;
BA_ "InvalidHex" SG_ 603 S4_SRR_RL_Clu_ID_124 "0xFF";
BA_ "GenSigStartValue" SG_ 603 S4_SRR_RL_Clu_Theta_124 253;
BA_ "GenSigStartValue" SG_ 603 S4_SRR_RL_Clu_Vel_124 1111;
BA_ "GenSigStartValue" SG_ 603 S4_SRR_RL_Clu_RCS_124 30;
BA_ "GenSigStartValue" SG_ 603 S4_SRR_RL_Clu_Locationvalid_124 1;
BA_ "InvalidHex" SG_ 603 S4_SRR_RL_Clu_ID_125 "0xFF";
BA_ "GenSigStartValue" SG_ 603 S4_SRR_RL_Clu_Theta_125 253;
BA_ "GenSigStartValue" SG_ 603 S4_SRR_RL_Clu_Vel_125 1111;
BA_ "GenSigStartValue" SG_ 603 S4_SRR_RL_Clu_RCS_125 30;
BA_ "GenSigStartValue" SG_ 603 S4_SRR_RL_Clu_Locationvalid_125 1;
BA_ "VFrameFormat" BO_ 604 14;
BA_ "GenMsgSendType" BO_ 604 0;
BA_ "GenMsgCycleTime" BO_ 604 50;
BA_ "InvalidHex" SG_ 604 S4_SRR_RL_Clu_ID_126 "0xFF";
BA_ "GenSigStartValue" SG_ 604 S4_SRR_RL_Clu_Theta_126 253;
BA_ "GenSigStartValue" SG_ 604 S4_SRR_RL_Clu_Vel_126 1111;
BA_ "GenSigStartValue" SG_ 604 S4_SRR_RL_Clu_RCS_126 30;
BA_ "GenSigStartValue" SG_ 604 S4_SRR_RL_Clu_Locationvalid_126 1;
BA_ "InvalidHex" SG_ 604 S4_SRR_RL_Clu_ID_127 "0xFF";
BA_ "GenSigStartValue" SG_ 604 S4_SRR_RL_Clu_Theta_127 253;
BA_ "GenSigStartValue" SG_ 604 S4_SRR_RL_Clu_Vel_127 1111;
BA_ "GenSigStartValue" SG_ 604 S4_SRR_RL_Clu_RCS_127 30;
BA_ "GenSigStartValue" SG_ 604 S4_SRR_RL_Clu_Locationvalid_127 1;
BA_ "InvalidHex" SG_ 604 S4_SRR_RL_Clu_ID_128 "0xFF";
BA_ "GenSigStartValue" SG_ 604 S4_SRR_RL_Clu_Theta_128 253;
BA_ "GenSigStartValue" SG_ 604 S4_SRR_RL_Clu_Vel_128 1111;
BA_ "GenSigStartValue" SG_ 604 S4_SRR_RL_Clu_RCS_128 30;
BA_ "GenSigStartValue" SG_ 604 S4_SRR_RL_Clu_Locationvalid_128 1;
BA_ "InvalidHex" SG_ 604 S4_SRR_RL_Clu_ID_129 "0xFF";
BA_ "GenSigStartValue" SG_ 604 S4_SRR_RL_Clu_Theta_129 253;
BA_ "GenSigStartValue" SG_ 604 S4_SRR_RL_Clu_Vel_129 1111;
BA_ "GenSigStartValue" SG_ 604 S4_SRR_RL_Clu_RCS_129 30;
BA_ "GenSigStartValue" SG_ 604 S4_SRR_RL_Clu_Locationvalid_129 1;
BA_ "InvalidHex" SG_ 604 S4_SRR_RL_Clu_ID_130 "0xFF";
BA_ "GenSigStartValue" SG_ 604 S4_SRR_RL_Clu_Theta_130 253;
BA_ "GenSigStartValue" SG_ 604 S4_SRR_RL_Clu_Vel_130 1111;
BA_ "GenSigStartValue" SG_ 604 S4_SRR_RL_Clu_RCS_130 30;
BA_ "GenSigStartValue" SG_ 604 S4_SRR_RL_Clu_Locationvalid_130 1;
BA_ "InvalidHex" SG_ 604 S4_SRR_RL_Clu_ID_131 "0xFF";
BA_ "GenSigStartValue" SG_ 604 S4_SRR_RL_Clu_Theta_131 253;
BA_ "GenSigStartValue" SG_ 604 S4_SRR_RL_Clu_Vel_131 1111;
BA_ "GenSigStartValue" SG_ 604 S4_SRR_RL_Clu_RCS_131 30;
BA_ "GenSigStartValue" SG_ 604 S4_SRR_RL_Clu_Locationvalid_131 1;
BA_ "InvalidHex" SG_ 604 S4_SRR_RL_Clu_ID_132 "0xFF";
BA_ "GenSigStartValue" SG_ 604 S4_SRR_RL_Clu_Theta_132 253;
BA_ "GenSigStartValue" SG_ 604 S4_SRR_RL_Clu_Vel_132 1111;
BA_ "GenSigStartValue" SG_ 604 S4_SRR_RL_Clu_RCS_132 30;
BA_ "GenSigStartValue" SG_ 604 S4_SRR_RL_Clu_Locationvalid_132 1;
BA_ "VFrameFormat" BO_ 605 14;
BA_ "GenMsgSendType" BO_ 605 0;
BA_ "GenMsgCycleTime" BO_ 605 50;
BA_ "InvalidHex" SG_ 605 S4_SRR_RL_Clu_ID_133 "0xFF";
BA_ "GenSigStartValue" SG_ 605 S4_SRR_RL_Clu_Theta_133 253;
BA_ "GenSigStartValue" SG_ 605 S4_SRR_RL_Clu_Vel_133 1111;
BA_ "GenSigStartValue" SG_ 605 S4_SRR_RL_Clu_RCS_133 30;
BA_ "GenSigStartValue" SG_ 605 S4_SRR_RL_Clu_Locationvalid_133 1;
BA_ "InvalidHex" SG_ 605 S4_SRR_RL_Clu_ID_134 "0xFF";
BA_ "GenSigStartValue" SG_ 605 S4_SRR_RL_Clu_Theta_134 253;
BA_ "GenSigStartValue" SG_ 605 S4_SRR_RL_Clu_Vel_134 1111;
BA_ "GenSigStartValue" SG_ 605 S4_SRR_RL_Clu_RCS_134 30;
BA_ "GenSigStartValue" SG_ 605 S4_SRR_RL_Clu_Locationvalid_134 1;
BA_ "InvalidHex" SG_ 605 S4_SRR_RL_Clu_ID_135 "0xFF";
BA_ "GenSigStartValue" SG_ 605 S4_SRR_RL_Clu_Theta_135 253;
BA_ "GenSigStartValue" SG_ 605 S4_SRR_RL_Clu_Vel_135 1111;
BA_ "GenSigStartValue" SG_ 605 S4_SRR_RL_Clu_RCS_135 30;
BA_ "GenSigStartValue" SG_ 605 S4_SRR_RL_Clu_Locationvalid_135 1;
BA_ "InvalidHex" SG_ 605 S4_SRR_RL_Clu_ID_136 "0xFF";
BA_ "GenSigStartValue" SG_ 605 S4_SRR_RL_Clu_Theta_136 253;
BA_ "GenSigStartValue" SG_ 605 S4_SRR_RL_Clu_Vel_136 1111;
BA_ "GenSigStartValue" SG_ 605 S4_SRR_RL_Clu_RCS_136 30;
BA_ "GenSigStartValue" SG_ 605 S4_SRR_RL_Clu_Locationvalid_136 1;
BA_ "InvalidHex" SG_ 605 S4_SRR_RL_Clu_ID_137 "0xFF";
BA_ "GenSigStartValue" SG_ 605 S4_SRR_RL_Clu_Theta_137 253;
BA_ "GenSigStartValue" SG_ 605 S4_SRR_RL_Clu_Vel_137 1111;
BA_ "GenSigStartValue" SG_ 605 S4_SRR_RL_Clu_RCS_137 30;
BA_ "GenSigStartValue" SG_ 605 S4_SRR_RL_Clu_Locationvalid_137 1;
BA_ "InvalidHex" SG_ 605 S4_SRR_RL_Clu_ID_138 "0xFF";
BA_ "GenSigStartValue" SG_ 605 S4_SRR_RL_Clu_Theta_138 253;
BA_ "GenSigStartValue" SG_ 605 S4_SRR_RL_Clu_Vel_138 1111;
BA_ "GenSigStartValue" SG_ 605 S4_SRR_RL_Clu_RCS_138 30;
BA_ "GenSigStartValue" SG_ 605 S4_SRR_RL_Clu_Locationvalid_138 1;
BA_ "InvalidHex" SG_ 605 S4_SRR_RL_Clu_ID_139 "0xFF";
BA_ "GenSigStartValue" SG_ 605 S4_SRR_RL_Clu_Theta_139 253;
BA_ "GenSigStartValue" SG_ 605 S4_SRR_RL_Clu_Vel_139 1111;
BA_ "GenSigStartValue" SG_ 605 S4_SRR_RL_Clu_RCS_139 30;
BA_ "GenSigStartValue" SG_ 605 S4_SRR_RL_Clu_Locationvalid_139 1;
BA_ "VFrameFormat" BO_ 606 14;
BA_ "GenMsgSendType" BO_ 606 0;
BA_ "GenMsgCycleTime" BO_ 606 50;
BA_ "InvalidHex" SG_ 606 S4_SRR_RL_Clu_ID_140 "0xFF";
BA_ "GenSigStartValue" SG_ 606 S4_SRR_RL_Clu_Theta_140 253;
BA_ "GenSigStartValue" SG_ 606 S4_SRR_RL_Clu_Vel_140 1111;
BA_ "GenSigStartValue" SG_ 606 S4_SRR_RL_Clu_RCS_140 30;
BA_ "GenSigStartValue" SG_ 606 S4_SRR_RL_Clu_Locationvalid_140 1;
BA_ "InvalidHex" SG_ 606 S4_SRR_RL_Clu_ID_141 "0xFF";
BA_ "GenSigStartValue" SG_ 606 S4_SRR_RL_Clu_Theta_141 253;
BA_ "GenSigStartValue" SG_ 606 S4_SRR_RL_Clu_Vel_141 1111;
BA_ "GenSigStartValue" SG_ 606 S4_SRR_RL_Clu_RCS_141 30;
BA_ "GenSigStartValue" SG_ 606 S4_SRR_RL_Clu_Locationvalid_141 1;
BA_ "InvalidHex" SG_ 606 S4_SRR_RL_Clu_ID_142 "0xFF";
BA_ "GenSigStartValue" SG_ 606 S4_SRR_RL_Clu_Theta_142 253;
BA_ "GenSigStartValue" SG_ 606 S4_SRR_RL_Clu_Vel_142 1111;
BA_ "GenSigStartValue" SG_ 606 S4_SRR_RL_Clu_RCS_142 30;
BA_ "GenSigStartValue" SG_ 606 S4_SRR_RL_Clu_Locationvalid_142 1;
BA_ "InvalidHex" SG_ 606 S4_SRR_RL_Clu_ID_143 "0xFF";
BA_ "GenSigStartValue" SG_ 606 S4_SRR_RL_Clu_Theta_143 253;
BA_ "GenSigStartValue" SG_ 606 S4_SRR_RL_Clu_Vel_143 1111;
BA_ "GenSigStartValue" SG_ 606 S4_SRR_RL_Clu_RCS_143 30;
BA_ "GenSigStartValue" SG_ 606 S4_SRR_RL_Clu_Locationvalid_143 1;
BA_ "InvalidHex" SG_ 606 S4_SRR_RL_Clu_ID_144 "0xFF";
BA_ "GenSigStartValue" SG_ 606 S4_SRR_RL_Clu_Theta_144 253;
BA_ "GenSigStartValue" SG_ 606 S4_SRR_RL_Clu_Vel_144 1111;
BA_ "GenSigStartValue" SG_ 606 S4_SRR_RL_Clu_RCS_144 30;
BA_ "GenSigStartValue" SG_ 606 S4_SRR_RL_Clu_Locationvalid_144 1;
BA_ "InvalidHex" SG_ 606 S4_SRR_RL_Clu_ID_145 "0xFF";
BA_ "GenSigStartValue" SG_ 606 S4_SRR_RL_Clu_Theta_145 253;
BA_ "GenSigStartValue" SG_ 606 S4_SRR_RL_Clu_Vel_145 1111;
BA_ "GenSigStartValue" SG_ 606 S4_SRR_RL_Clu_RCS_145 30;
BA_ "GenSigStartValue" SG_ 606 S4_SRR_RL_Clu_Locationvalid_145 1;
BA_ "InvalidHex" SG_ 606 S4_SRR_RL_Clu_ID_146 "0xFF";
BA_ "GenSigStartValue" SG_ 606 S4_SRR_RL_Clu_Theta_146 253;
BA_ "GenSigStartValue" SG_ 606 S4_SRR_RL_Clu_Vel_146 1111;
BA_ "GenSigStartValue" SG_ 606 S4_SRR_RL_Clu_RCS_146 30;
BA_ "GenSigStartValue" SG_ 606 S4_SRR_RL_Clu_Locationvalid_146 1;
BA_ "VFrameFormat" BO_ 607 14;
BA_ "GenMsgSendType" BO_ 607 0;
BA_ "GenMsgCycleTime" BO_ 607 50;
BA_ "InvalidHex" SG_ 607 S4_SRR_RL_Clu_ID_147 "0xFF";
BA_ "GenSigStartValue" SG_ 607 S4_SRR_RL_Clu_Theta_147 253;
BA_ "GenSigStartValue" SG_ 607 S4_SRR_RL_Clu_Vel_147 1111;
BA_ "GenSigStartValue" SG_ 607 S4_SRR_RL_Clu_RCS_147 30;
BA_ "GenSigStartValue" SG_ 607 S4_SRR_RL_Clu_Locationvalid_147 1;
BA_ "InvalidHex" SG_ 607 S4_SRR_RL_Clu_ID_148 "0xFF";
BA_ "GenSigStartValue" SG_ 607 S4_SRR_RL_Clu_Theta_148 253;
BA_ "GenSigStartValue" SG_ 607 S4_SRR_RL_Clu_Vel_148 1111;
BA_ "GenSigStartValue" SG_ 607 S4_SRR_RL_Clu_RCS_148 30;
BA_ "GenSigStartValue" SG_ 607 S4_SRR_RL_Clu_Locationvalid_148 1;
BA_ "InvalidHex" SG_ 607 S4_SRR_RL_Clu_ID_149 "0xFF";
BA_ "GenSigStartValue" SG_ 607 S4_SRR_RL_Clu_Theta_149 253;
BA_ "GenSigStartValue" SG_ 607 S4_SRR_RL_Clu_Vel_149 1111;
BA_ "GenSigStartValue" SG_ 607 S4_SRR_RL_Clu_RCS_149 30;
BA_ "GenSigStartValue" SG_ 607 S4_SRR_RL_Clu_Locationvalid_149 1;
BA_ "InvalidHex" SG_ 607 S4_SRR_RL_Clu_ID_150 "0xFF";
BA_ "GenSigStartValue" SG_ 607 S4_SRR_RL_Clu_Theta_150 253;
BA_ "GenSigStartValue" SG_ 607 S4_SRR_RL_Clu_Vel_150 1111;
BA_ "GenSigStartValue" SG_ 607 S4_SRR_RL_Clu_RCS_150 30;
BA_ "GenSigStartValue" SG_ 607 S4_SRR_RL_Clu_Locationvalid_150 1;
BA_ "InvalidHex" SG_ 607 S4_SRR_RL_Clu_ID_151 "0xFF";
BA_ "GenSigStartValue" SG_ 607 S4_SRR_RL_Clu_Theta_151 253;
BA_ "GenSigStartValue" SG_ 607 S4_SRR_RL_Clu_Vel_151 1111;
BA_ "GenSigStartValue" SG_ 607 S4_SRR_RL_Clu_RCS_151 30;
BA_ "GenSigStartValue" SG_ 607 S4_SRR_RL_Clu_Locationvalid_151 1;
BA_ "InvalidHex" SG_ 607 S4_SRR_RL_Clu_ID_152 "0xFF";
BA_ "GenSigStartValue" SG_ 607 S4_SRR_RL_Clu_Theta_152 253;
BA_ "GenSigStartValue" SG_ 607 S4_SRR_RL_Clu_Vel_152 1111;
BA_ "GenSigStartValue" SG_ 607 S4_SRR_RL_Clu_RCS_152 30;
BA_ "GenSigStartValue" SG_ 607 S4_SRR_RL_Clu_Locationvalid_152 1;
BA_ "InvalidHex" SG_ 607 S4_SRR_RL_Clu_ID_153 "0xFF";
BA_ "GenSigStartValue" SG_ 607 S4_SRR_RL_Clu_Theta_153 253;
BA_ "GenSigStartValue" SG_ 607 S4_SRR_RL_Clu_Vel_153 1111;
BA_ "GenSigStartValue" SG_ 607 S4_SRR_RL_Clu_RCS_153 30;
BA_ "GenSigStartValue" SG_ 607 S4_SRR_RL_Clu_Locationvalid_153 1;
BA_ "VFrameFormat" BO_ 608 14;
BA_ "GenMsgSendType" BO_ 608 0;
BA_ "GenMsgCycleTime" BO_ 608 50;
BA_ "InvalidHex" SG_ 608 S4_SRR_RL_Clu_ID_154 "0xFF";
BA_ "GenSigStartValue" SG_ 608 S4_SRR_RL_Clu_Theta_154 253;
BA_ "GenSigStartValue" SG_ 608 S4_SRR_RL_Clu_Vel_154 1111;
BA_ "GenSigStartValue" SG_ 608 S4_SRR_RL_Clu_RCS_154 30;
BA_ "GenSigStartValue" SG_ 608 S4_SRR_RL_Clu_Locationvalid_154 1;
BA_ "InvalidHex" SG_ 608 S4_SRR_RL_Clu_ID_155 "0xFF";
BA_ "GenSigStartValue" SG_ 608 S4_SRR_RL_Clu_Theta_155 253;
BA_ "GenSigStartValue" SG_ 608 S4_SRR_RL_Clu_Vel_155 1111;
BA_ "GenSigStartValue" SG_ 608 S4_SRR_RL_Clu_RCS_155 30;
BA_ "GenSigStartValue" SG_ 608 S4_SRR_RL_Clu_Locationvalid_155 1;
BA_ "InvalidHex" SG_ 608 S4_SRR_RL_Clu_ID_156 "0xFF";
BA_ "GenSigStartValue" SG_ 608 S4_SRR_RL_Clu_Theta_156 253;
BA_ "GenSigStartValue" SG_ 608 S4_SRR_RL_Clu_Vel_156 1111;
BA_ "GenSigStartValue" SG_ 608 S4_SRR_RL_Clu_RCS_156 30;
BA_ "GenSigStartValue" SG_ 608 S4_SRR_RL_Clu_Locationvalid_156 1;
BA_ "InvalidHex" SG_ 608 S4_SRR_RL_Clu_ID_157 "0xFF";
BA_ "GenSigStartValue" SG_ 608 S4_SRR_RL_Clu_Theta_157 253;
BA_ "GenSigStartValue" SG_ 608 S4_SRR_RL_Clu_Vel_157 1111;
BA_ "GenSigStartValue" SG_ 608 S4_SRR_RL_Clu_RCS_157 30;
BA_ "GenSigStartValue" SG_ 608 S4_SRR_RL_Clu_Locationvalid_157 1;
BA_ "InvalidHex" SG_ 608 S4_SRR_RL_Clu_ID_158 "0xFF";
BA_ "GenSigStartValue" SG_ 608 S4_SRR_RL_Clu_Theta_158 253;
BA_ "GenSigStartValue" SG_ 608 S4_SRR_RL_Clu_Vel_158 1111;
BA_ "GenSigStartValue" SG_ 608 S4_SRR_RL_Clu_RCS_158 30;
BA_ "GenSigStartValue" SG_ 608 S4_SRR_RL_Clu_Locationvalid_158 1;
BA_ "InvalidHex" SG_ 608 S4_SRR_RL_Clu_ID_159 "0xFF";
BA_ "GenSigStartValue" SG_ 608 S4_SRR_RL_Clu_Theta_159 253;
BA_ "GenSigStartValue" SG_ 608 S4_SRR_RL_Clu_Vel_159 1111;
BA_ "GenSigStartValue" SG_ 608 S4_SRR_RL_Clu_RCS_159 30;
BA_ "GenSigStartValue" SG_ 608 S4_SRR_RL_Clu_Locationvalid_159 1;
BA_ "InvalidHex" SG_ 608 S4_SRR_RL_Clu_ID_160 "0xFF";
BA_ "GenSigStartValue" SG_ 608 S4_SRR_RL_Clu_Theta_160 253;
BA_ "GenSigStartValue" SG_ 608 S4_SRR_RL_Clu_Vel_160 1111;
BA_ "GenSigStartValue" SG_ 608 S4_SRR_RL_Clu_RCS_160 30;
BA_ "GenSigStartValue" SG_ 608 S4_SRR_RL_Clu_Locationvalid_160 1;
BA_ "VFrameFormat" BO_ 609 14;
BA_ "GenMsgSendType" BO_ 609 0;
BA_ "GenMsgCycleTime" BO_ 609 50;
BA_ "InvalidHex" SG_ 609 S4_SRR_RL_Clu_ID_161 "0xFF";
BA_ "GenSigStartValue" SG_ 609 S4_SRR_RL_Clu_Theta_161 253;
BA_ "GenSigStartValue" SG_ 609 S4_SRR_RL_Clu_Vel_161 1111;
BA_ "GenSigStartValue" SG_ 609 S4_SRR_RL_Clu_RCS_161 30;
BA_ "GenSigStartValue" SG_ 609 S4_SRR_RL_Clu_Locationvalid_161 1;
BA_ "InvalidHex" SG_ 609 S4_SRR_RL_Clu_ID_162 "0xFF";
BA_ "GenSigStartValue" SG_ 609 S4_SRR_RL_Clu_Theta_162 253;
BA_ "GenSigStartValue" SG_ 609 S4_SRR_RL_Clu_Vel_162 1111;
BA_ "GenSigStartValue" SG_ 609 S4_SRR_RL_Clu_RCS_162 30;
BA_ "GenSigStartValue" SG_ 609 S4_SRR_RL_Clu_Locationvalid_162 1;
BA_ "InvalidHex" SG_ 609 S4_SRR_RL_Clu_ID_163 "0xFF";
BA_ "GenSigStartValue" SG_ 609 S4_SRR_RL_Clu_Theta_163 253;
BA_ "GenSigStartValue" SG_ 609 S4_SRR_RL_Clu_Vel_163 1111;
BA_ "GenSigStartValue" SG_ 609 S4_SRR_RL_Clu_RCS_163 30;
BA_ "GenSigStartValue" SG_ 609 S4_SRR_RL_Clu_Locationvalid_163 1;
BA_ "InvalidHex" SG_ 609 S4_SRR_RL_Clu_ID_164 "0xFF";
BA_ "GenSigStartValue" SG_ 609 S4_SRR_RL_Clu_Theta_164 253;
BA_ "GenSigStartValue" SG_ 609 S4_SRR_RL_Clu_Vel_164 1111;
BA_ "GenSigStartValue" SG_ 609 S4_SRR_RL_Clu_RCS_164 30;
BA_ "GenSigStartValue" SG_ 609 S4_SRR_RL_Clu_Locationvalid_164 1;
BA_ "InvalidHex" SG_ 609 S4_SRR_RL_Clu_ID_165 "0xFF";
BA_ "GenSigStartValue" SG_ 609 S4_SRR_RL_Clu_Theta_165 253;
BA_ "GenSigStartValue" SG_ 609 S4_SRR_RL_Clu_Vel_165 1111;
BA_ "GenSigStartValue" SG_ 609 S4_SRR_RL_Clu_RCS_165 30;
BA_ "GenSigStartValue" SG_ 609 S4_SRR_RL_Clu_Locationvalid_165 1;
BA_ "InvalidHex" SG_ 609 S4_SRR_RL_Clu_ID_166 "0xFF";
BA_ "GenSigStartValue" SG_ 609 S4_SRR_RL_Clu_Theta_166 253;
BA_ "GenSigStartValue" SG_ 609 S4_SRR_RL_Clu_Vel_166 1111;
BA_ "GenSigStartValue" SG_ 609 S4_SRR_RL_Clu_RCS_166 30;
BA_ "GenSigStartValue" SG_ 609 S4_SRR_RL_Clu_Locationvalid_166 1;
BA_ "InvalidHex" SG_ 609 S4_SRR_RL_Clu_ID_167 "0xFF";
BA_ "GenSigStartValue" SG_ 609 S4_SRR_RL_Clu_Theta_167 253;
BA_ "GenSigStartValue" SG_ 609 S4_SRR_RL_Clu_Vel_167 1111;
BA_ "GenSigStartValue" SG_ 609 S4_SRR_RL_Clu_RCS_167 30;
BA_ "GenSigStartValue" SG_ 609 S4_SRR_RL_Clu_Locationvalid_167 1;
BA_ "VFrameFormat" BO_ 610 14;
BA_ "GenMsgSendType" BO_ 610 0;
BA_ "GenMsgCycleTime" BO_ 610 50;
BA_ "InvalidHex" SG_ 610 S4_SRR_RL_Clu_ID_168 "0xFF";
BA_ "GenSigStartValue" SG_ 610 S4_SRR_RL_Clu_Theta_168 253;
BA_ "GenSigStartValue" SG_ 610 S4_SRR_RL_Clu_Vel_168 1111;
BA_ "GenSigStartValue" SG_ 610 S4_SRR_RL_Clu_RCS_168 30;
BA_ "GenSigStartValue" SG_ 610 S4_SRR_RL_Clu_Locationvalid_168 1;
BA_ "InvalidHex" SG_ 610 S4_SRR_RL_Clu_ID_169 "0xFF";
BA_ "GenSigStartValue" SG_ 610 S4_SRR_RL_Clu_Theta_169 253;
BA_ "GenSigStartValue" SG_ 610 S4_SRR_RL_Clu_Vel_169 1111;
BA_ "GenSigStartValue" SG_ 610 S4_SRR_RL_Clu_RCS_169 30;
BA_ "GenSigStartValue" SG_ 610 S4_SRR_RL_Clu_Locationvalid_169 1;
BA_ "InvalidHex" SG_ 610 S4_SRR_RL_Clu_ID_170 "0xFF";
BA_ "GenSigStartValue" SG_ 610 S4_SRR_RL_Clu_Theta_170 253;
BA_ "GenSigStartValue" SG_ 610 S4_SRR_RL_Clu_Vel_170 1111;
BA_ "GenSigStartValue" SG_ 610 S4_SRR_RL_Clu_RCS_170 30;
BA_ "GenSigStartValue" SG_ 610 S4_SRR_RL_Clu_Locationvalid_170 1;
BA_ "InvalidHex" SG_ 610 S4_SRR_RL_Clu_ID_171 "0xFF";
BA_ "GenSigStartValue" SG_ 610 S4_SRR_RL_Clu_Theta_171 253;
BA_ "GenSigStartValue" SG_ 610 S4_SRR_RL_Clu_Vel_171 1111;
BA_ "GenSigStartValue" SG_ 610 S4_SRR_RL_Clu_RCS_171 30;
BA_ "GenSigStartValue" SG_ 610 S4_SRR_RL_Clu_Locationvalid_171 1;
BA_ "InvalidHex" SG_ 610 S4_SRR_RL_Clu_ID_172 "0xFF";
BA_ "GenSigStartValue" SG_ 610 S4_SRR_RL_Clu_Theta_172 253;
BA_ "GenSigStartValue" SG_ 610 S4_SRR_RL_Clu_Vel_172 1111;
BA_ "GenSigStartValue" SG_ 610 S4_SRR_RL_Clu_RCS_172 30;
BA_ "GenSigStartValue" SG_ 610 S4_SRR_RL_Clu_Locationvalid_172 1;
BA_ "InvalidHex" SG_ 610 S4_SRR_RL_Clu_ID_173 "0xFF";
BA_ "GenSigStartValue" SG_ 610 S4_SRR_RL_Clu_Theta_173 253;
BA_ "GenSigStartValue" SG_ 610 S4_SRR_RL_Clu_Vel_173 1111;
BA_ "GenSigStartValue" SG_ 610 S4_SRR_RL_Clu_RCS_173 30;
BA_ "GenSigStartValue" SG_ 610 S4_SRR_RL_Clu_Locationvalid_173 1;
BA_ "InvalidHex" SG_ 610 S4_SRR_RL_Clu_ID_174 "0xFF";
BA_ "GenSigStartValue" SG_ 610 S4_SRR_RL_Clu_Theta_174 253;
BA_ "GenSigStartValue" SG_ 610 S4_SRR_RL_Clu_Vel_174 1111;
BA_ "GenSigStartValue" SG_ 610 S4_SRR_RL_Clu_RCS_174 30;
BA_ "GenSigStartValue" SG_ 610 S4_SRR_RL_Clu_Locationvalid_174 1;
BA_ "VFrameFormat" BO_ 611 14;
BA_ "GenMsgSendType" BO_ 611 0;
BA_ "GenMsgCycleTime" BO_ 611 50;
BA_ "InvalidHex" SG_ 611 S4_SRR_RL_Clu_ID_175 "0xFF";
BA_ "GenSigStartValue" SG_ 611 S4_SRR_RL_Clu_Theta_175 253;
BA_ "GenSigStartValue" SG_ 611 S4_SRR_RL_Clu_Vel_175 1111;
BA_ "GenSigStartValue" SG_ 611 S4_SRR_RL_Clu_RCS_175 30;
BA_ "GenSigStartValue" SG_ 611 S4_SRR_RL_Clu_Locationvalid_175 1;
BA_ "InvalidHex" SG_ 611 S4_SRR_RL_Clu_ID_176 "0xFF";
BA_ "GenSigStartValue" SG_ 611 S4_SRR_RL_Clu_Theta_176 253;
BA_ "GenSigStartValue" SG_ 611 S4_SRR_RL_Clu_Vel_176 1111;
BA_ "GenSigStartValue" SG_ 611 S4_SRR_RL_Clu_RCS_176 30;
BA_ "GenSigStartValue" SG_ 611 S4_SRR_RL_Clu_Locationvalid_176 1;
BA_ "InvalidHex" SG_ 611 S4_SRR_RL_Clu_ID_177 "0xFF";
BA_ "GenSigStartValue" SG_ 611 S4_SRR_RL_Clu_Theta_177 253;
BA_ "GenSigStartValue" SG_ 611 S4_SRR_RL_Clu_Vel_177 1111;
BA_ "GenSigStartValue" SG_ 611 S4_SRR_RL_Clu_RCS_177 30;
BA_ "GenSigStartValue" SG_ 611 S4_SRR_RL_Clu_Locationvalid_177 1;
BA_ "InvalidHex" SG_ 611 S4_SRR_RL_Clu_ID_178 "0xFF";
BA_ "GenSigStartValue" SG_ 611 S4_SRR_RL_Clu_Theta_178 253;
BA_ "GenSigStartValue" SG_ 611 S4_SRR_RL_Clu_Vel_178 1111;
BA_ "GenSigStartValue" SG_ 611 S4_SRR_RL_Clu_RCS_178 30;
BA_ "GenSigStartValue" SG_ 611 S4_SRR_RL_Clu_Locationvalid_178 1;
BA_ "InvalidHex" SG_ 611 S4_SRR_RL_Clu_ID_179 "0xFF";
BA_ "GenSigStartValue" SG_ 611 S4_SRR_RL_Clu_Theta_179 253;
BA_ "GenSigStartValue" SG_ 611 S4_SRR_RL_Clu_Vel_179 1111;
BA_ "GenSigStartValue" SG_ 611 S4_SRR_RL_Clu_RCS_179 30;
BA_ "GenSigStartValue" SG_ 611 S4_SRR_RL_Clu_Locationvalid_179 1;
BA_ "InvalidHex" SG_ 611 S4_SRR_RL_Clu_ID_180 "0xFF";
BA_ "GenSigStartValue" SG_ 611 S4_SRR_RL_Clu_Theta_180 253;
BA_ "GenSigStartValue" SG_ 611 S4_SRR_RL_Clu_Vel_180 1111;
BA_ "GenSigStartValue" SG_ 611 S4_SRR_RL_Clu_RCS_180 30;
BA_ "GenSigStartValue" SG_ 611 S4_SRR_RL_Clu_Locationvalid_180 1;
BA_ "InvalidHex" SG_ 611 S4_SRR_RL_Clu_ID_181 "0xFF";
BA_ "GenSigStartValue" SG_ 611 S4_SRR_RL_Clu_Theta_181 253;
BA_ "GenSigStartValue" SG_ 611 S4_SRR_RL_Clu_Vel_181 1111;
BA_ "GenSigStartValue" SG_ 611 S4_SRR_RL_Clu_RCS_181 30;
BA_ "GenSigStartValue" SG_ 611 S4_SRR_RL_Clu_Locationvalid_181 1;
BA_ "VFrameFormat" BO_ 612 14;
BA_ "GenMsgSendType" BO_ 612 0;
BA_ "GenMsgCycleTime" BO_ 612 50;
BA_ "InvalidHex" SG_ 612 S4_SRR_RL_Clu_ID_182 "0xFF";
BA_ "GenSigStartValue" SG_ 612 S4_SRR_RL_Clu_Theta_182 253;
BA_ "GenSigStartValue" SG_ 612 S4_SRR_RL_Clu_Vel_182 1111;
BA_ "GenSigStartValue" SG_ 612 S4_SRR_RL_Clu_RCS_182 30;
BA_ "GenSigStartValue" SG_ 612 S4_SRR_RL_Clu_Locationvalid_182 1;
BA_ "InvalidHex" SG_ 612 S4_SRR_RL_Clu_ID_183 "0xFF";
BA_ "GenSigStartValue" SG_ 612 S4_SRR_RL_Clu_Theta_183 253;
BA_ "GenSigStartValue" SG_ 612 S4_SRR_RL_Clu_Vel_183 1111;
BA_ "GenSigStartValue" SG_ 612 S4_SRR_RL_Clu_RCS_183 30;
BA_ "GenSigStartValue" SG_ 612 S4_SRR_RL_Clu_Locationvalid_183 1;
BA_ "InvalidHex" SG_ 612 S4_SRR_RL_Clu_ID_184 "0xFF";
BA_ "GenSigStartValue" SG_ 612 S4_SRR_RL_Clu_Theta_184 253;
BA_ "GenSigStartValue" SG_ 612 S4_SRR_RL_Clu_Vel_184 1111;
BA_ "GenSigStartValue" SG_ 612 S4_SRR_RL_Clu_RCS_184 30;
BA_ "GenSigStartValue" SG_ 612 S4_SRR_RL_Clu_Locationvalid_184 1;
BA_ "InvalidHex" SG_ 612 S4_SRR_RL_Clu_ID_185 "0xFF";
BA_ "GenSigStartValue" SG_ 612 S4_SRR_RL_Clu_Theta_185 253;
BA_ "GenSigStartValue" SG_ 612 S4_SRR_RL_Clu_Vel_185 1111;
BA_ "GenSigStartValue" SG_ 612 S4_SRR_RL_Clu_RCS_185 30;
BA_ "GenSigStartValue" SG_ 612 S4_SRR_RL_Clu_Locationvalid_185 1;
BA_ "InvalidHex" SG_ 612 S4_SRR_RL_Clu_ID_186 "0xFF";
BA_ "GenSigStartValue" SG_ 612 S4_SRR_RL_Clu_Theta_186 253;
BA_ "GenSigStartValue" SG_ 612 S4_SRR_RL_Clu_Vel_186 1111;
BA_ "GenSigStartValue" SG_ 612 S4_SRR_RL_Clu_RCS_186 30;
BA_ "GenSigStartValue" SG_ 612 S4_SRR_RL_Clu_Locationvalid_186 1;
BA_ "InvalidHex" SG_ 612 S4_SRR_RL_Clu_ID_187 "0xFF";
BA_ "GenSigStartValue" SG_ 612 S4_SRR_RL_Clu_Theta_187 253;
BA_ "GenSigStartValue" SG_ 612 S4_SRR_RL_Clu_Vel_187 1111;
BA_ "GenSigStartValue" SG_ 612 S4_SRR_RL_Clu_RCS_187 30;
BA_ "GenSigStartValue" SG_ 612 S4_SRR_RL_Clu_Locationvalid_187 1;
BA_ "InvalidHex" SG_ 612 S4_SRR_RL_Clu_ID_188 "0xFF";
BA_ "GenSigStartValue" SG_ 612 S4_SRR_RL_Clu_Theta_188 253;
BA_ "GenSigStartValue" SG_ 612 S4_SRR_RL_Clu_Vel_188 1111;
BA_ "GenSigStartValue" SG_ 612 S4_SRR_RL_Clu_RCS_188 30;
BA_ "GenSigStartValue" SG_ 612 S4_SRR_RL_Clu_Locationvalid_188 1;
BA_ "VFrameFormat" BO_ 613 14;
BA_ "GenMsgSendType" BO_ 613 0;
BA_ "GenMsgCycleTime" BO_ 613 50;
BA_ "InvalidHex" SG_ 613 S4_SRR_RL_Clu_ID_189 "0xFF";
BA_ "GenSigStartValue" SG_ 613 S4_SRR_RL_Clu_Theta_189 253;
BA_ "GenSigStartValue" SG_ 613 S4_SRR_RL_Clu_Vel_189 1111;
BA_ "GenSigStartValue" SG_ 613 S4_SRR_RL_Clu_RCS_189 30;
BA_ "GenSigStartValue" SG_ 613 S4_SRR_RL_Clu_Locationvalid_189 1;
BA_ "InvalidHex" SG_ 613 S4_SRR_RL_Clu_ID_190 "0xFF";
BA_ "GenSigStartValue" SG_ 613 S4_SRR_RL_Clu_Theta_190 253;
BA_ "GenSigStartValue" SG_ 613 S4_SRR_RL_Clu_Vel_190 1111;
BA_ "GenSigStartValue" SG_ 613 S4_SRR_RL_Clu_RCS_190 30;
BA_ "GenSigStartValue" SG_ 613 S4_SRR_RL_Clu_Locationvalid_190 1;
BA_ "InvalidHex" SG_ 613 S4_SRR_RL_Clu_ID_191 "0xFF";
BA_ "GenSigStartValue" SG_ 613 S4_SRR_RL_Clu_Theta_191 253;
BA_ "GenSigStartValue" SG_ 613 S4_SRR_RL_Clu_Vel_191 1111;
BA_ "GenSigStartValue" SG_ 613 S4_SRR_RL_Clu_RCS_191 30;
BA_ "GenSigStartValue" SG_ 613 S4_SRR_RL_Clu_Locationvalid_191 1;
BA_ "InvalidHex" SG_ 613 S4_SRR_RL_Clu_ID_192 "0xFF";
BA_ "GenSigStartValue" SG_ 613 S4_SRR_RL_Clu_Theta_192 253;
BA_ "GenSigStartValue" SG_ 613 S4_SRR_RL_Clu_Vel_192 1111;
BA_ "GenSigStartValue" SG_ 613 S4_SRR_RL_Clu_RCS_192 30;
BA_ "GenSigStartValue" SG_ 613 S4_SRR_RL_Clu_Locationvalid_192 1;
BA_ "InvalidHex" SG_ 613 S4_SRR_RL_Clu_ID_193 "0xFF";
BA_ "GenSigStartValue" SG_ 613 S4_SRR_RL_Clu_Theta_193 253;
BA_ "GenSigStartValue" SG_ 613 S4_SRR_RL_Clu_Vel_193 1111;
BA_ "GenSigStartValue" SG_ 613 S4_SRR_RL_Clu_RCS_193 30;
BA_ "GenSigStartValue" SG_ 613 S4_SRR_RL_Clu_Locationvalid_193 1;
BA_ "InvalidHex" SG_ 613 S4_SRR_RL_Clu_ID_194 "0xFF";
BA_ "GenSigStartValue" SG_ 613 S4_SRR_RL_Clu_Theta_194 253;
BA_ "GenSigStartValue" SG_ 613 S4_SRR_RL_Clu_Vel_194 1111;
BA_ "GenSigStartValue" SG_ 613 S4_SRR_RL_Clu_RCS_194 30;
BA_ "GenSigStartValue" SG_ 613 S4_SRR_RL_Clu_Locationvalid_194 1;
BA_ "InvalidHex" SG_ 613 S4_SRR_RL_Clu_ID_195 "0xFF";
BA_ "GenSigStartValue" SG_ 613 S4_SRR_RL_Clu_Theta_195 253;
BA_ "GenSigStartValue" SG_ 613 S4_SRR_RL_Clu_Vel_195 1111;
BA_ "GenSigStartValue" SG_ 613 S4_SRR_RL_Clu_RCS_195 30;
BA_ "GenSigStartValue" SG_ 613 S4_SRR_RL_Clu_Locationvalid_195 1;
BA_ "VFrameFormat" BO_ 614 14;
BA_ "GenMsgSendType" BO_ 614 0;
BA_ "GenMsgCycleTime" BO_ 614 50;
BA_ "InvalidHex" SG_ 614 S4_SRR_RL_Clu_ID_196 "0xFF";
BA_ "GenSigStartValue" SG_ 614 S4_SRR_RL_Clu_Theta_196 253;
BA_ "GenSigStartValue" SG_ 614 S4_SRR_RL_Clu_Vel_196 1111;
BA_ "GenSigStartValue" SG_ 614 S4_SRR_RL_Clu_RCS_196 30;
BA_ "GenSigStartValue" SG_ 614 S4_SRR_RL_Clu_Locationvalid_196 1;
BA_ "InvalidHex" SG_ 614 S4_SRR_RL_Clu_ID_197 "0xFF";
BA_ "GenSigStartValue" SG_ 614 S4_SRR_RL_Clu_Theta_197 253;
BA_ "GenSigStartValue" SG_ 614 S4_SRR_RL_Clu_Vel_197 1111;
BA_ "GenSigStartValue" SG_ 614 S4_SRR_RL_Clu_RCS_197 30;
BA_ "GenSigStartValue" SG_ 614 S4_SRR_RL_Clu_Locationvalid_197 1;
BA_ "InvalidHex" SG_ 614 S4_SRR_RL_Clu_ID_198 "0xFF";
BA_ "GenSigStartValue" SG_ 614 S4_SRR_RL_Clu_Theta_198 253;
BA_ "GenSigStartValue" SG_ 614 S4_SRR_RL_Clu_Vel_198 1111;
BA_ "GenSigStartValue" SG_ 614 S4_SRR_RL_Clu_RCS_198 30;
BA_ "GenSigStartValue" SG_ 614 S4_SRR_RL_Clu_Locationvalid_198 1;
BA_ "InvalidHex" SG_ 614 S4_SRR_RL_Clu_ID_199 "0xFF";
BA_ "GenSigStartValue" SG_ 614 S4_SRR_RL_Clu_Theta_199 253;
BA_ "GenSigStartValue" SG_ 614 S4_SRR_RL_Clu_Vel_199 1111;
BA_ "GenSigStartValue" SG_ 614 S4_SRR_RL_Clu_RCS_199 30;
BA_ "GenSigStartValue" SG_ 614 S4_SRR_RL_Clu_Locationvalid_199 1;
BA_ "VFrameFormat" BO_ 615 14;
BA_ "GenMsgSendType" BO_ 615 0;
BA_ "GenMsgCycleTime" BO_ 615 50;
BA_ "InvalidHex" SG_ 615 S4_SRR_RL_Obj_ID_0 "0x7F";
BA_ "GenSigStartValue" SG_ 615 S4_SRR_RL_Obj_DistX_0 15;
BA_ "GenSigStartValue" SG_ 615 S4_SRR_RL_Obj_DistY_0 15;
BA_ "GenSigStartValue" SG_ 615 S4_SRR_RL_Obj_ValidFlag_0 1;
BA_ "InvalidHex" SG_ 615 S4_SRR_RL_Obj_ID_1 "0x7F";
BA_ "GenSigStartValue" SG_ 615 S4_SRR_RL_Obj_DistX_1 15;
BA_ "GenSigStartValue" SG_ 615 S4_SRR_RL_Obj_DistY_1 15;
BA_ "GenSigStartValue" SG_ 615 S4_SRR_RL_Obj_ValidFlag_1 1;
BA_ "InvalidHex" SG_ 615 S4_SRR_RL_Obj_ID_2 "0x7F";
BA_ "GenSigStartValue" SG_ 615 S4_SRR_RL_Obj_DistX_2 15;
BA_ "GenSigStartValue" SG_ 615 S4_SRR_RL_Obj_DistY_2 15;
BA_ "GenSigStartValue" SG_ 615 S4_SRR_RL_Obj_ValidFlag_2 1;
BA_ "VFrameFormat" BO_ 616 14;
BA_ "GenMsgSendType" BO_ 616 0;
BA_ "GenMsgCycleTime" BO_ 616 50;
BA_ "InvalidHex" SG_ 616 S4_SRR_RL_Obj_ID_3 "0x7F";
BA_ "GenSigStartValue" SG_ 616 S4_SRR_RL_Obj_DistX_3 15;
BA_ "GenSigStartValue" SG_ 616 S4_SRR_RL_Obj_DistY_3 15;
BA_ "GenSigStartValue" SG_ 616 S4_SRR_RL_Obj_ValidFlag_3 1;
BA_ "InvalidHex" SG_ 616 S4_SRR_RL_Obj_ID_4 "0x7F";
BA_ "GenSigStartValue" SG_ 616 S4_SRR_RL_Obj_DistX_4 15;
BA_ "GenSigStartValue" SG_ 616 S4_SRR_RL_Obj_DistY_4 15;
BA_ "GenSigStartValue" SG_ 616 S4_SRR_RL_Obj_ValidFlag_4 1;
BA_ "InvalidHex" SG_ 616 S4_SRR_RL_Obj_ID_5 "0x7F";
BA_ "GenSigStartValue" SG_ 616 S4_SRR_RL_Obj_DistX_5 15;
BA_ "GenSigStartValue" SG_ 616 S4_SRR_RL_Obj_DistY_5 15;
BA_ "GenSigStartValue" SG_ 616 S4_SRR_RL_Obj_ValidFlag_5 1;
BA_ "VFrameFormat" BO_ 617 14;
BA_ "GenMsgSendType" BO_ 617 0;
BA_ "GenMsgCycleTime" BO_ 617 50;
BA_ "InvalidHex" SG_ 617 S4_SRR_RL_Obj_ID_6 "0x7F";
BA_ "GenSigStartValue" SG_ 617 S4_SRR_RL_Obj_DistX_6 15;
BA_ "GenSigStartValue" SG_ 617 S4_SRR_RL_Obj_DistY_6 15;
BA_ "GenSigStartValue" SG_ 617 S4_SRR_RL_Obj_ValidFlag_6 1;
BA_ "InvalidHex" SG_ 617 S4_SRR_RL_Obj_ID_7 "0x7F";
BA_ "GenSigStartValue" SG_ 617 S4_SRR_RL_Obj_DistX_7 15;
BA_ "GenSigStartValue" SG_ 617 S4_SRR_RL_Obj_DistY_7 15;
BA_ "GenSigStartValue" SG_ 617 S4_SRR_RL_Obj_ValidFlag_7 1;
BA_ "InvalidHex" SG_ 617 S4_SRR_RL_Obj_ID_8 "0x7F";
BA_ "GenSigStartValue" SG_ 617 S4_SRR_RL_Obj_DistX_8 15;
BA_ "GenSigStartValue" SG_ 617 S4_SRR_RL_Obj_DistY_8 15;
BA_ "GenSigStartValue" SG_ 617 S4_SRR_RL_Obj_ValidFlag_8 1;
VAL_ 601 S4_SRR_RL_Clu_DynProp_112 0 "Stationary" 1 "Moving" ;
VAL_ 601 S4_SRR_RL_Clu_Locationvalid_112 0 "valid" 1 "invalid" ;
VAL_ 601 S4_SRR_RL_Clu_DynProp_113 0 "Stationary" 1 "Moving" ;
VAL_ 601 S4_SRR_RL_Clu_Locationvalid_113 0 "valid" 1 "invalid" ;
VAL_ 601 S4_SRR_RL_Clu_DynProp_114 0 "Stationary" 1 "Moving" ;
VAL_ 601 S4_SRR_RL_Clu_Locationvalid_114 0 "valid" 1 "invalid" ;
VAL_ 601 S4_SRR_RL_Clu_DynProp_115 0 "Stationary" 1 "Moving" ;
VAL_ 601 S4_SRR_RL_Clu_Locationvalid_115 0 "valid" 1 "invalid" ;
VAL_ 601 S4_SRR_RL_Clu_DynProp_116 0 "Stationary" 1 "Moving" ;
VAL_ 601 S4_SRR_RL_Clu_Locationvalid_116 0 "valid" 1 "invalid" ;
VAL_ 601 S4_SRR_RL_Clu_DynProp_117 0 "Stationary" 1 "Moving" ;
VAL_ 601 S4_SRR_RL_Clu_Locationvalid_117 0 "valid" 1 "invalid" ;
VAL_ 601 S4_SRR_RL_Clu_DynProp_118 0 "Stationary" 1 "Moving" ;
VAL_ 601 S4_SRR_RL_Clu_Locationvalid_118 0 "valid" 1 "invalid" ;
VAL_ 603 S4_SRR_RL_Clu_DynProp_119 0 "Stationary" 1 "Moving" ;
VAL_ 603 S4_SRR_RL_Clu_Locationvalid_119 0 "valid" 1 "invalid" ;
VAL_ 603 S4_SRR_RL_Clu_DynProp_120 0 "Stationary" 1 "Moving" ;
VAL_ 603 S4_SRR_RL_Clu_Locationvalid_120 0 "valid" 1 "invalid" ;
VAL_ 603 S4_SRR_RL_Clu_DynProp_121 0 "Stationary" 1 "Moving" ;
VAL_ 603 S4_SRR_RL_Clu_Locationvalid_121 0 "valid" 1 "invalid" ;
VAL_ 603 S4_SRR_RL_Clu_DynProp_122 0 "Stationary" 1 "Moving" ;
VAL_ 603 S4_SRR_RL_Clu_Locationvalid_122 0 "valid" 1 "invalid" ;
VAL_ 603 S4_SRR_RL_Clu_DynProp_123 0 "Stationary" 1 "Moving" ;
VAL_ 603 S4_SRR_RL_Clu_Locationvalid_123 0 "valid" 1 "invalid" ;
VAL_ 603 S4_SRR_RL_Clu_DynProp_124 0 "Stationary" 1 "Moving" ;
VAL_ 603 S4_SRR_RL_Clu_Locationvalid_124 0 "valid" 1 "invalid" ;
VAL_ 603 S4_SRR_RL_Clu_DynProp_125 0 "Stationary" 1 "Moving" ;
VAL_ 603 S4_SRR_RL_Clu_Locationvalid_125 0 "valid" 1 "invalid" ;
VAL_ 604 S4_SRR_RL_Clu_DynProp_126 0 "Stationary" 1 "Moving" ;
VAL_ 604 S4_SRR_RL_Clu_Locationvalid_126 0 "valid" 1 "invalid" ;
VAL_ 604 S4_SRR_RL_Clu_DynProp_127 0 "Stationary" 1 "Moving" ;
VAL_ 604 S4_SRR_RL_Clu_Locationvalid_127 0 "valid" 1 "invalid" ;
VAL_ 604 S4_SRR_RL_Clu_DynProp_128 0 "Stationary" 1 "Moving" ;
VAL_ 604 S4_SRR_RL_Clu_Locationvalid_128 0 "valid" 1 "invalid" ;
VAL_ 604 S4_SRR_RL_Clu_DynProp_129 0 "Stationary" 1 "Moving" ;
VAL_ 604 S4_SRR_RL_Clu_Locationvalid_129 0 "valid" 1 "invalid" ;
VAL_ 604 S4_SRR_RL_Clu_DynProp_130 0 "Stationary" 1 "Moving" ;
VAL_ 604 S4_SRR_RL_Clu_Locationvalid_130 0 "valid" 1 "invalid" ;
VAL_ 604 S4_SRR_RL_Clu_DynProp_131 0 "Stationary" 1 "Moving" ;
VAL_ 604 S4_SRR_RL_Clu_Locationvalid_131 0 "valid" 1 "invalid" ;
VAL_ 604 S4_SRR_RL_Clu_DynProp_132 0 "Stationary" 1 "Moving" ;
VAL_ 604 S4_SRR_RL_Clu_Locationvalid_132 0 "valid" 1 "invalid" ;
VAL_ 605 S4_SRR_RL_Clu_DynProp_133 0 "Stationary" 1 "Moving" ;
VAL_ 605 S4_SRR_RL_Clu_Locationvalid_133 0 "valid" 1 "invalid" ;
VAL_ 605 S4_SRR_RL_Clu_DynProp_134 0 "Stationary" 1 "Moving" ;
VAL_ 605 S4_SRR_RL_Clu_Locationvalid_134 0 "valid" 1 "invalid" ;
VAL_ 605 S4_SRR_RL_Clu_DynProp_135 0 "Stationary" 1 "Moving" ;
VAL_ 605 S4_SRR_RL_Clu_Locationvalid_135 0 "valid" 1 "invalid" ;
VAL_ 605 S4_SRR_RL_Clu_DynProp_136 0 "Stationary" 1 "Moving" ;
VAL_ 605 S4_SRR_RL_Clu_Locationvalid_136 0 "valid" 1 "invalid" ;
VAL_ 605 S4_SRR_RL_Clu_DynProp_137 0 "Stationary" 1 "Moving" ;
VAL_ 605 S4_SRR_RL_Clu_Locationvalid_137 0 "valid" 1 "invalid" ;
VAL_ 605 S4_SRR_RL_Clu_DynProp_138 0 "Stationary" 1 "Moving" ;
VAL_ 605 S4_SRR_RL_Clu_Locationvalid_138 0 "valid" 1 "invalid" ;
VAL_ 605 S4_SRR_RL_Clu_DynProp_139 0 "Stationary" 1 "Moving" ;
VAL_ 605 S4_SRR_RL_Clu_Locationvalid_139 0 "valid" 1 "invalid" ;
VAL_ 606 S4_SRR_RL_Clu_DynProp_140 0 "Stationary" 1 "Moving" ;
VAL_ 606 S4_SRR_RL_Clu_Locationvalid_140 0 "valid" 1 "invalid" ;
VAL_ 606 S4_SRR_RL_Clu_DynProp_141 0 "Stationary" 1 "Moving" ;
VAL_ 606 S4_SRR_RL_Clu_Locationvalid_141 0 "valid" 1 "invalid" ;
VAL_ 606 S4_SRR_RL_Clu_DynProp_142 0 "Stationary" 1 "Moving" ;
VAL_ 606 S4_SRR_RL_Clu_Locationvalid_142 0 "valid" 1 "invalid" ;
VAL_ 606 S4_SRR_RL_Clu_DynProp_143 0 "Stationary" 1 "Moving" ;
VAL_ 606 S4_SRR_RL_Clu_Locationvalid_143 0 "valid" 1 "invalid" ;
VAL_ 606 S4_SRR_RL_Clu_DynProp_144 0 "Stationary" 1 "Moving" ;
VAL_ 606 S4_SRR_RL_Clu_Locationvalid_144 0 "valid" 1 "invalid" ;
VAL_ 606 S4_SRR_RL_Clu_DynProp_145 0 "Stationary" 1 "Moving" ;
VAL_ 606 S4_SRR_RL_Clu_Locationvalid_145 0 "valid" 1 "invalid" ;
VAL_ 606 S4_SRR_RL_Clu_DynProp_146 0 "Stationary" 1 "Moving" ;
VAL_ 606 S4_SRR_RL_Clu_Locationvalid_146 0 "valid" 1 "invalid" ;
VAL_ 607 S4_SRR_RL_Clu_DynProp_147 0 "Stationary" 1 "Moving" ;
VAL_ 607 S4_SRR_RL_Clu_Locationvalid_147 0 "valid" 1 "invalid" ;
VAL_ 607 S4_SRR_RL_Clu_DynProp_148 0 "Stationary" 1 "Moving" ;
VAL_ 607 S4_SRR_RL_Clu_Locationvalid_148 0 "valid" 1 "invalid" ;
VAL_ 607 S4_SRR_RL_Clu_DynProp_149 0 "Stationary" 1 "Moving" ;
VAL_ 607 S4_SRR_RL_Clu_Locationvalid_149 0 "valid" 1 "invalid" ;
VAL_ 607 S4_SRR_RL_Clu_DynProp_150 0 "Stationary" 1 "Moving" ;
VAL_ 607 S4_SRR_RL_Clu_Locationvalid_150 0 "valid" 1 "invalid" ;
VAL_ 607 S4_SRR_RL_Clu_DynProp_151 0 "Stationary" 1 "Moving" ;
VAL_ 607 S4_SRR_RL_Clu_Locationvalid_151 0 "valid" 1 "invalid" ;
VAL_ 607 S4_SRR_RL_Clu_DynProp_152 0 "Stationary" 1 "Moving" ;
VAL_ 607 S4_SRR_RL_Clu_Locationvalid_152 0 "valid" 1 "invalid" ;
VAL_ 607 S4_SRR_RL_Clu_DynProp_153 0 "Stationary" 1 "Moving" ;
VAL_ 607 S4_SRR_RL_Clu_Locationvalid_153 0 "valid" 1 "invalid" ;
VAL_ 608 S4_SRR_RL_Clu_DynProp_154 0 "Stationary" 1 "Moving" ;
VAL_ 608 S4_SRR_RL_Clu_Locationvalid_154 0 "valid" 1 "invalid" ;
VAL_ 608 S4_SRR_RL_Clu_DynProp_155 0 "Stationary" 1 "Moving" ;
VAL_ 608 S4_SRR_RL_Clu_Locationvalid_155 0 "valid" 1 "invalid" ;
VAL_ 608 S4_SRR_RL_Clu_DynProp_156 0 "Stationary" 1 "Moving" ;
VAL_ 608 S4_SRR_RL_Clu_Locationvalid_156 0 "valid" 1 "invalid" ;
VAL_ 608 S4_SRR_RL_Clu_DynProp_157 0 "Stationary" 1 "Moving" ;
VAL_ 608 S4_SRR_RL_Clu_Locationvalid_157 0 "valid" 1 "invalid" ;
VAL_ 608 S4_SRR_RL_Clu_DynProp_158 0 "Stationary" 1 "Moving" ;
VAL_ 608 S4_SRR_RL_Clu_Locationvalid_158 0 "valid" 1 "invalid" ;
VAL_ 608 S4_SRR_RL_Clu_DynProp_159 0 "Stationary" 1 "Moving" ;
VAL_ 608 S4_SRR_RL_Clu_Locationvalid_159 0 "valid" 1 "invalid" ;
VAL_ 608 S4_SRR_RL_Clu_DynProp_160 0 "Stationary" 1 "Moving" ;
VAL_ 608 S4_SRR_RL_Clu_Locationvalid_160 0 "valid" 1 "invalid" ;
VAL_ 609 S4_SRR_RL_Clu_DynProp_161 0 "Stationary" 1 "Moving" ;
VAL_ 609 S4_SRR_RL_Clu_Locationvalid_161 0 "valid" 1 "invalid" ;
VAL_ 609 S4_SRR_RL_Clu_DynProp_162 0 "Stationary" 1 "Moving" ;
VAL_ 609 S4_SRR_RL_Clu_Locationvalid_162 0 "valid" 1 "invalid" ;
VAL_ 609 S4_SRR_RL_Clu_DynProp_163 0 "Stationary" 1 "Moving" ;
VAL_ 609 S4_SRR_RL_Clu_Locationvalid_163 0 "valid" 1 "invalid" ;
VAL_ 609 S4_SRR_RL_Clu_DynProp_164 0 "Stationary" 1 "Moving" ;
VAL_ 609 S4_SRR_RL_Clu_Locationvalid_164 0 "valid" 1 "invalid" ;
VAL_ 609 S4_SRR_RL_Clu_DynProp_165 0 "Stationary" 1 "Moving" ;
VAL_ 609 S4_SRR_RL_Clu_Locationvalid_165 0 "valid" 1 "invalid" ;
VAL_ 609 S4_SRR_RL_Clu_DynProp_166 0 "Stationary" 1 "Moving" ;
VAL_ 609 S4_SRR_RL_Clu_Locationvalid_166 0 "valid" 1 "invalid" ;
VAL_ 609 S4_SRR_RL_Clu_DynProp_167 0 "Stationary" 1 "Moving" ;
VAL_ 609 S4_SRR_RL_Clu_Locationvalid_167 0 "valid" 1 "invalid" ;
VAL_ 610 S4_SRR_RL_Clu_DynProp_168 0 "Stationary" 1 "Moving" ;
VAL_ 610 S4_SRR_RL_Clu_Locationvalid_168 0 "valid" 1 "invalid" ;
VAL_ 610 S4_SRR_RL_Clu_DynProp_169 0 "Stationary" 1 "Moving" ;
VAL_ 610 S4_SRR_RL_Clu_Locationvalid_169 0 "valid" 1 "invalid" ;
VAL_ 610 S4_SRR_RL_Clu_DynProp_170 0 "Stationary" 1 "Moving" ;
VAL_ 610 S4_SRR_RL_Clu_Locationvalid_170 0 "valid" 1 "invalid" ;
VAL_ 610 S4_SRR_RL_Clu_DynProp_171 0 "Stationary" 1 "Moving" ;
VAL_ 610 S4_SRR_RL_Clu_Locationvalid_171 0 "valid" 1 "invalid" ;
VAL_ 610 S4_SRR_RL_Clu_DynProp_172 0 "Stationary" 1 "Moving" ;
VAL_ 610 S4_SRR_RL_Clu_Locationvalid_172 0 "valid" 1 "invalid" ;
VAL_ 610 S4_SRR_RL_Clu_DynProp_173 0 "Stationary" 1 "Moving" ;
VAL_ 610 S4_SRR_RL_Clu_Locationvalid_173 0 "valid" 1 "invalid" ;
VAL_ 610 S4_SRR_RL_Clu_DynProp_174 0 "Stationary" 1 "Moving" ;
VAL_ 610 S4_SRR_RL_Clu_Locationvalid_174 0 "valid" 1 "invalid" ;
VAL_ 611 S4_SRR_RL_Clu_DynProp_175 0 "Stationary" 1 "Moving" ;
VAL_ 611 S4_SRR_RL_Clu_Locationvalid_175 0 "valid" 1 "invalid" ;
VAL_ 611 S4_SRR_RL_Clu_DynProp_176 0 "Stationary" 1 "Moving" ;
VAL_ 611 S4_SRR_RL_Clu_Locationvalid_176 0 "valid" 1 "invalid" ;
VAL_ 611 S4_SRR_RL_Clu_DynProp_177 0 "Stationary" 1 "Moving" ;
VAL_ 611 S4_SRR_RL_Clu_Locationvalid_177 0 "valid" 1 "invalid" ;
VAL_ 611 S4_SRR_RL_Clu_DynProp_178 0 "Stationary" 1 "Moving" ;
VAL_ 611 S4_SRR_RL_Clu_Locationvalid_178 0 "valid" 1 "invalid" ;
VAL_ 611 S4_SRR_RL_Clu_DynProp_179 0 "Stationary" 1 "Moving" ;
VAL_ 611 S4_SRR_RL_Clu_Locationvalid_179 0 "valid" 1 "invalid" ;
VAL_ 611 S4_SRR_RL_Clu_DynProp_180 0 "Stationary" 1 "Moving" ;
VAL_ 611 S4_SRR_RL_Clu_Locationvalid_180 0 "valid" 1 "invalid" ;
VAL_ 611 S4_SRR_RL_Clu_DynProp_181 0 "Stationary" 1 "Moving" ;
VAL_ 611 S4_SRR_RL_Clu_Locationvalid_181 0 "valid" 1 "invalid" ;
VAL_ 612 S4_SRR_RL_Clu_DynProp_182 0 "Stationary" 1 "Moving" ;
VAL_ 612 S4_SRR_RL_Clu_Locationvalid_182 0 "valid" 1 "invalid" ;
VAL_ 612 S4_SRR_RL_Clu_DynProp_183 0 "Stationary" 1 "Moving" ;
VAL_ 612 S4_SRR_RL_Clu_Locationvalid_183 0 "valid" 1 "invalid" ;
VAL_ 612 S4_SRR_RL_Clu_DynProp_184 0 "Stationary" 1 "Moving" ;
VAL_ 612 S4_SRR_RL_Clu_Locationvalid_184 0 "valid" 1 "invalid" ;
VAL_ 612 S4_SRR_RL_Clu_DynProp_185 0 "Stationary" 1 "Moving" ;
VAL_ 612 S4_SRR_RL_Clu_Locationvalid_185 0 "valid" 1 "invalid" ;
VAL_ 612 S4_SRR_RL_Clu_DynProp_186 0 "Stationary" 1 "Moving" ;
VAL_ 612 S4_SRR_RL_Clu_Locationvalid_186 0 "valid" 1 "invalid" ;
VAL_ 612 S4_SRR_RL_Clu_DynProp_187 0 "Stationary" 1 "Moving" ;
VAL_ 612 S4_SRR_RL_Clu_Locationvalid_187 0 "valid" 1 "invalid" ;
VAL_ 612 S4_SRR_RL_Clu_DynProp_188 0 "Stationary" 1 "Moving" ;
VAL_ 612 S4_SRR_RL_Clu_Locationvalid_188 0 "valid" 1 "invalid" ;
VAL_ 613 S4_SRR_RL_Clu_DynProp_189 0 "Stationary" 1 "Moving" ;
VAL_ 613 S4_SRR_RL_Clu_Locationvalid_189 0 "valid" 1 "invalid" ;
VAL_ 613 S4_SRR_RL_Clu_DynProp_190 0 "Stationary" 1 "Moving" ;
VAL_ 613 S4_SRR_RL_Clu_Locationvalid_190 0 "valid" 1 "invalid" ;
VAL_ 613 S4_SRR_RL_Clu_DynProp_191 0 "Stationary" 1 "Moving" ;
VAL_ 613 S4_SRR_RL_Clu_Locationvalid_191 0 "valid" 1 "invalid" ;
VAL_ 613 S4_SRR_RL_Clu_DynProp_192 0 "Stationary" 1 "Moving" ;
VAL_ 613 S4_SRR_RL_Clu_Locationvalid_192 0 "valid" 1 "invalid" ;
VAL_ 613 S4_SRR_RL_Clu_DynProp_193 0 "Stationary" 1 "Moving" ;
VAL_ 613 S4_SRR_RL_Clu_Locationvalid_193 0 "valid" 1 "invalid" ;
VAL_ 613 S4_SRR_RL_Clu_DynProp_194 0 "Stationary" 1 "Moving" ;
VAL_ 613 S4_SRR_RL_Clu_Locationvalid_194 0 "valid" 1 "invalid" ;
VAL_ 613 S4_SRR_RL_Clu_DynProp_195 0 "Stationary" 1 "Moving" ;
VAL_ 613 S4_SRR_RL_Clu_Locationvalid_195 0 "valid" 1 "invalid" ;
VAL_ 614 S4_SRR_RL_Clu_DynProp_196 0 "Stationary" 1 "Moving" ;
VAL_ 614 S4_SRR_RL_Clu_Locationvalid_196 0 "valid" 1 "invalid" ;
VAL_ 614 S4_SRR_RL_Clu_DynProp_197 0 "Stationary" 1 "Moving" ;
VAL_ 614 S4_SRR_RL_Clu_Locationvalid_197 0 "valid" 1 "invalid" ;
VAL_ 614 S4_SRR_RL_Clu_DynProp_198 0 "Stationary" 1 "Moving" ;
VAL_ 614 S4_SRR_RL_Clu_Locationvalid_198 0 "valid" 1 "invalid" ;
VAL_ 614 S4_SRR_RL_Clu_DynProp_199 0 "Stationary" 1 "Moving" ;
VAL_ 614 S4_SRR_RL_Clu_Locationvalid_199 0 "valid" 1 "invalid" ;
VAL_ 615 S4_SRR_RL_Obj_ValidFlag_0 0 "valid" 1 "invalid" ;
VAL_ 615 S4_SRR_RL_Obj_UpdateFlag_0 0 "Measured" 1 "New" ;
VAL_ 615 S4_SRR_RL_Obj_Type_0 0 "OBJ_CLASS_POINT" 1 "OBJ_CLASS_CAR" 2 "OBJ_CLASS_TRUCK" 3 "OBJ_CLASS_PEDESTRIAN" 4 "OBJ_CLASS_MOTORCYCLE" 5 "OBJ_CLASS_BICYCLE" 6 "OBJ_CLASS_WIDE" 7 "OBJ_CLASS_UNCLASSIFIED" 8 "OBJ_CLASS_OTHER_VEHICLE" 9 "OBJ_CLASS_MAX_DIFF_TYPES" ;
VAL_ 615 S4_SRR_RL_Obj_EDynProp_0 0 "MOVING_DYNAMICPROPERTY" 1 "STATIONARY_DYNAMICPROPERTY" 2 "ONCOMING_DYNAMICPROPERTY" 3 "CROSSING_LEFT_TO_RIGHT_DYNAMICPR" 4 "CROSSING_RIGHT_TO_LEFT_DYNAMICPR" 5 "UNKNOWN_DYNAMICPROPERTY" 6 "STOPPED_DYNAMICPROPERTY" 7 "RESERVED" ;
VAL_ 615 S4_SRR_RL_Obj_UiLifeCycles_0 126 "MAX_CYCLE_OBJ_LIFECYCLE" 127 "INVALID_OBJ_LIFECYCLE" ;
VAL_ 615 S4_SRR_RL_Obj_ValidFlag_1 0 "valid" 1 "invalid" ;
VAL_ 615 S4_SRR_RL_Obj_UpdateFlag_1 0 "Measured" 1 "New" ;
VAL_ 615 S4_SRR_RL_Obj_Type_1 0 "OBJ_CLASS_POINT" 1 "OBJ_CLASS_CAR" 2 "OBJ_CLASS_TRUCK" 3 "OBJ_CLASS_PEDESTRIAN" 4 "OBJ_CLASS_MOTORCYCLE" 5 "OBJ_CLASS_BICYCLE" 6 "OBJ_CLASS_WIDE" 7 "OBJ_CLASS_UNCLASSIFIED" 8 "OBJ_CLASS_OTHER_VEHICLE" 9 "OBJ_CLASS_MAX_DIFF_TYPES" ;
VAL_ 615 S4_SRR_RL_Obj_EDynProp_1 0 "MOVING_DYNAMICPROPERTY" 1 "STATIONARY_DYNAMICPROPERTY" 2 "ONCOMING_DYNAMICPROPERTY" 3 "CROSSING_LEFT_TO_RIGHT_DYNAMICPR" 4 "CROSSING_RIGHT_TO_LEFT_DYNAMICPR" 5 "UNKNOWN_DYNAMICPROPERTY" 6 "STOPPED_DYNAMICPROPERTY" 7 "RESERVED" ;
VAL_ 615 S4_SRR_RL_Obj_UiLifeCycles_1 126 "MAX_CYCLE_OBJ_LIFECYCLE" 127 "INVALID_OBJ_LIFECYCLE" ;
VAL_ 615 S4_SRR_RL_Obj_ValidFlag_2 0 "valid" 1 "invalid" ;
VAL_ 615 S4_SRR_RL_Obj_UpdateFlag_2 0 "Measured" 1 "New" ;
VAL_ 615 S4_SRR_RL_Obj_Type_2 0 "OBJ_CLASS_POINT" 1 "OBJ_CLASS_CAR" 2 "OBJ_CLASS_TRUCK" 3 "OBJ_CLASS_PEDESTRIAN" 4 "OBJ_CLASS_MOTORCYCLE" 5 "OBJ_CLASS_BICYCLE" 6 "OBJ_CLASS_WIDE" 7 "OBJ_CLASS_UNCLASSIFIED" 8 "OBJ_CLASS_OTHER_VEHICLE" 9 "OBJ_CLASS_MAX_DIFF_TYPES" ;
VAL_ 615 S4_SRR_RL_Obj_EDynProp_2 0 "MOVING_DYNAMICPROPERTY" 1 "STATIONARY_DYNAMICPROPERTY" 2 "ONCOMING_DYNAMICPROPERTY" 3 "CROSSING_LEFT_TO_RIGHT_DYNAMICPR" 4 "CROSSING_RIGHT_TO_LEFT_DYNAMICPR" 5 "UNKNOWN_DYNAMICPROPERTY" 6 "STOPPED_DYNAMICPROPERTY" 7 "RESERVED" ;
VAL_ 615 S4_SRR_RL_Obj_UiLifeCycles_2 126 "MAX_CYCLE_OBJ_LIFECYCLE" 127 "INVALID_OBJ_LIFECYCLE" ;
VAL_ 616 S4_SRR_RL_Obj_ValidFlag_3 0 "valid" 1 "invalid" ;
VAL_ 616 S4_SRR_RL_Obj_UpdateFlag_3 0 "Measured" 1 "New" ;
VAL_ 616 S4_SRR_RL_Obj_Type_3 0 "OBJ_CLASS_POINT" 1 "OBJ_CLASS_CAR" 2 "OBJ_CLASS_TRUCK" 3 "OBJ_CLASS_PEDESTRIAN" 4 "OBJ_CLASS_MOTORCYCLE" 5 "OBJ_CLASS_BICYCLE" 6 "OBJ_CLASS_WIDE" 7 "OBJ_CLASS_UNCLASSIFIED" 8 "OBJ_CLASS_OTHER_VEHICLE" 9 "OBJ_CLASS_MAX_DIFF_TYPES" ;
VAL_ 616 S4_SRR_RL_Obj_EDynProp_3 0 "MOVING_DYNAMICPROPERTY" 1 "STATIONARY_DYNAMICPROPERTY" 2 "ONCOMING_DYNAMICPROPERTY" 3 "CROSSING_LEFT_TO_RIGHT_DYNAMICPR" 4 "CROSSING_RIGHT_TO_LEFT_DYNAMICPR" 5 "UNKNOWN_DYNAMICPROPERTY" 6 "STOPPED_DYNAMICPROPERTY" 7 "RESERVED" ;
VAL_ 616 S4_SRR_RL_Obj_UiLifeCycles_3 126 "MAX_CYCLE_OBJ_LIFECYCLE" 127 "INVALID_OBJ_LIFECYCLE" ;
VAL_ 616 S4_SRR_RL_Obj_ValidFlag_4 0 "valid" 1 "invalid" ;
VAL_ 616 S4_SRR_RL_Obj_UpdateFlag_4 0 "Measured" 1 "New" ;
VAL_ 616 S4_SRR_RL_Obj_Type_4 0 "OBJ_CLASS_POINT" 1 "OBJ_CLASS_CAR" 2 "OBJ_CLASS_TRUCK" 3 "OBJ_CLASS_PEDESTRIAN" 4 "OBJ_CLASS_MOTORCYCLE" 5 "OBJ_CLASS_BICYCLE" 6 "OBJ_CLASS_WIDE" 7 "OBJ_CLASS_UNCLASSIFIED" 8 "OBJ_CLASS_OTHER_VEHICLE" 9 "OBJ_CLASS_MAX_DIFF_TYPES" ;
VAL_ 616 S4_SRR_RL_Obj_EDynProp_4 0 "MOVING_DYNAMICPROPERTY" 1 "STATIONARY_DYNAMICPROPERTY" 2 "ONCOMING_DYNAMICPROPERTY" 3 "CROSSING_LEFT_TO_RIGHT_DYNAMICPR" 4 "CROSSING_RIGHT_TO_LEFT_DYNAMICPR" 5 "UNKNOWN_DYNAMICPROPERTY" 6 "STOPPED_DYNAMICPROPERTY" 7 "RESERVED" ;
VAL_ 616 S4_SRR_RL_Obj_UiLifeCycles_4 126 "MAX_CYCLE_OBJ_LIFECYCLE" 127 "INVALID_OBJ_LIFECYCLE" ;
VAL_ 616 S4_SRR_RL_Obj_ValidFlag_5 0 "valid" 1 "invalid" ;
VAL_ 616 S4_SRR_RL_Obj_UpdateFlag_5 0 "Measured" 1 "New" ;
VAL_ 616 S4_SRR_RL_Obj_Type_5 0 "OBJ_CLASS_POINT" 1 "OBJ_CLASS_CAR" 2 "OBJ_CLASS_TRUCK" 3 "OBJ_CLASS_PEDESTRIAN" 4 "OBJ_CLASS_MOTORCYCLE" 5 "OBJ_CLASS_BICYCLE" 6 "OBJ_CLASS_WIDE" 7 "OBJ_CLASS_UNCLASSIFIED" 8 "OBJ_CLASS_OTHER_VEHICLE" 9 "OBJ_CLASS_MAX_DIFF_TYPES" ;
VAL_ 616 S4_SRR_RL_Obj_EDynProp_5 0 "MOVING_DYNAMICPROPERTY" 1 "STATIONARY_DYNAMICPROPERTY" 2 "ONCOMING_DYNAMICPROPERTY" 3 "CROSSING_LEFT_TO_RIGHT_DYNAMICPR" 4 "CROSSING_RIGHT_TO_LEFT_DYNAMICPR" 5 "UNKNOWN_DYNAMICPROPERTY" 6 "STOPPED_DYNAMICPROPERTY" 7 "RESERVED" ;
VAL_ 616 S4_SRR_RL_Obj_UiLifeCycles_5 126 "MAX_CYCLE_OBJ_LIFECYCLE" 127 "INVALID_OBJ_LIFECYCLE" ;
VAL_ 617 S4_SRR_RL_Obj_ValidFlag_6 0 "valid" 1 "invalid" ;
VAL_ 617 S4_SRR_RL_Obj_UpdateFlag_6 0 "Measured" 1 "New" ;
VAL_ 617 S4_SRR_RL_Obj_Type_6 0 "OBJ_CLASS_POINT" 1 "OBJ_CLASS_CAR" 2 "OBJ_CLASS_TRUCK" 3 "OBJ_CLASS_PEDESTRIAN" 4 "OBJ_CLASS_MOTORCYCLE" 5 "OBJ_CLASS_BICYCLE" 6 "OBJ_CLASS_WIDE" 7 "OBJ_CLASS_UNCLASSIFIED" 8 "OBJ_CLASS_OTHER_VEHICLE" 9 "OBJ_CLASS_MAX_DIFF_TYPES" ;
VAL_ 617 S4_SRR_RL_Obj_EDynProp_6 0 "MOVING_DYNAMICPROPERTY" 1 "STATIONARY_DYNAMICPROPERTY" 2 "ONCOMING_DYNAMICPROPERTY" 3 "CROSSING_LEFT_TO_RIGHT_DYNAMICPR" 4 "CROSSING_RIGHT_TO_LEFT_DYNAMICPR" 5 "UNKNOWN_DYNAMICPROPERTY" 6 "STOPPED_DYNAMICPROPERTY" 7 "RESERVED" ;
VAL_ 617 S4_SRR_RL_Obj_UiLifeCycles_6 126 "MAX_CYCLE_OBJ_LIFECYCLE" 127 "INVALID_OBJ_LIFECYCLE" ;
VAL_ 617 S4_SRR_RL_Obj_ValidFlag_7 0 "valid" 1 "invalid" ;
VAL_ 617 S4_SRR_RL_Obj_UpdateFlag_7 0 "Measured" 1 "New" ;
VAL_ 617 S4_SRR_RL_Obj_Type_7 0 "OBJ_CLASS_POINT" 1 "OBJ_CLASS_CAR" 2 "OBJ_CLASS_TRUCK" 3 "OBJ_CLASS_PEDESTRIAN" 4 "OBJ_CLASS_MOTORCYCLE" 5 "OBJ_CLASS_BICYCLE" 6 "OBJ_CLASS_WIDE" 7 "OBJ_CLASS_UNCLASSIFIED" 8 "OBJ_CLASS_OTHER_VEHICLE" 9 "OBJ_CLASS_MAX_DIFF_TYPES" ;
VAL_ 617 S4_SRR_RL_Obj_EDynProp_7 0 "MOVING_DYNAMICPROPERTY" 1 "STATIONARY_DYNAMICPROPERTY" 2 "ONCOMING_DYNAMICPROPERTY" 3 "CROSSING_LEFT_TO_RIGHT_DYNAMICPR" 4 "CROSSING_RIGHT_TO_LEFT_DYNAMICPR" 5 "UNKNOWN_DYNAMICPROPERTY" 6 "STOPPED_DYNAMICPROPERTY" 7 "RESERVED" ;
VAL_ 617 S4_SRR_RL_Obj_UiLifeCycles_7 126 "MAX_CYCLE_OBJ_LIFECYCLE" 127 "INVALID_OBJ_LIFECYCLE" ;
VAL_ 617 S4_SRR_RL_Obj_ValidFlag_8 0 "valid" 1 "invalid" ;
VAL_ 617 S4_SRR_RL_Obj_UpdateFlag_8 0 "Measured" 1 "New" ;
VAL_ 617 S4_SRR_RL_Obj_Type_8 0 "OBJ_CLASS_POINT" 1 "OBJ_CLASS_CAR" 2 "OBJ_CLASS_TRUCK" 3 "OBJ_CLASS_PEDESTRIAN" 4 "OBJ_CLASS_MOTORCYCLE" 5 "OBJ_CLASS_BICYCLE" 6 "OBJ_CLASS_WIDE" 7 "OBJ_CLASS_UNCLASSIFIED" 8 "OBJ_CLASS_OTHER_VEHICLE" 9 "OBJ_CLASS_MAX_DIFF_TYPES" ;
VAL_ 617 S4_SRR_RL_Obj_EDynProp_8 0 "MOVING_DYNAMICPROPERTY" 1 "STATIONARY_DYNAMICPROPERTY" 2 "ONCOMING_DYNAMICPROPERTY" 3 "CROSSING_LEFT_TO_RIGHT_DYNAMICPR" 4 "CROSSING_RIGHT_TO_LEFT_DYNAMICPR" 5 "UNKNOWN_DYNAMICPROPERTY" 6 "STOPPED_DYNAMICPROPERTY" 7 "RESERVED" ;
VAL_ 617 S4_SRR_RL_Obj_UiLifeCycles_8 126 "MAX_CYCLE_OBJ_LIFECYCLE" 127 "INVALID_OBJ_LIFECYCLE" ;
