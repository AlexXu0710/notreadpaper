VERSION "2023_6_12_103836"

NS_ :

BS_:

BU_: XPU SRR_RL Tester

BO_ 576 S4_SRR_RL_Clu_Mes_0: 64 SRR_RL
 SG_ S4_SRR_RL_Clu_ID_0 : 7|8@0+ (1,0) [0|199] "" Vector__XXX
 SG_ S4_SRR_RL_Clu_Theta_0 : 15|9@0+ (0.0062,-1.571) [-1.571|1.5972] "rad" Vector__XXX
 SG_ S4_SRR_RL_Clu_Dist_0 : 22|12@0+ (0.1,0.4) [0.4|300] "m" Vector__XXX
 SG_ S4_SRR_RL_Clu_Vel_0 : 26|11@0+ (0.1,-111.11) [-111.11|55.59] "mps" Vector__XXX
 SG_ S4_SRR_RL_Clu_SNR_0 : 47|7@0+ (0.5,0) [0|63.5] "dB" Vector__XXX
 SG_ S4_SRR_RL_Clu_RCS_0 : 40|5@0+ (2,-40) [-40|22] "" Vector__XXX
 SG_ S4_SRR_RL_Clu_DynProp_0 : 51|1@0+ (1,0) [0|1] "Unitless" Vector__XXX
 SG_ S4_SRR_RL_Clu_Locationvalid_0 : 50|1@0+ (1,0) [0|1] "" Vector__XXX
 SG_ S4_SRR_RL_Clu_ID_1 : 59|8@0+ (1,0) [0|199] "" Vector__XXX
 SG_ S4_SRR_RL_Clu_Theta_1 : 67|9@0+ (0.0062,-1.571) [-1.571|1.5972] "rad" Vector__XXX
 SG_ S4_SRR_RL_Clu_Dist_1 : 74|12@0+ (0.1,0.4) [0.4|300] "m" Vector__XXX
 SG_ S4_SRR_RL_Clu_Vel_1 : 94|11@0+ (0.1,-111.11) [-111.11|55.59] "mps" Vector__XXX
 SG_ S4_SRR_RL_Clu_SNR_1 : 99|7@0+ (0.5,0) [0|63.5] "dB" Vector__XXX
 SG_ S4_SRR_RL_Clu_RCS_1 : 108|5@0+ (2,-40) [-40|22] "" Vector__XXX
 SG_ S4_SRR_RL_Clu_DynProp_1 : 119|1@0+ (1,0) [0|1] "Unitless" Vector__XXX
 SG_ S4_SRR_RL_Clu_Locationvalid_1 : 118|1@0+ (1,0) [0|1] "" Vector__XXX
 SG_ S4_SRR_RL_Clu_ID_2 : 127|8@0+ (1,0) [0|199] "" Vector__XXX
 SG_ S4_SRR_RL_Clu_Theta_2 : 135|9@0+ (0.0062,-1.571) [-1.571|1.5972] "rad" Vector__XXX
 SG_ S4_SRR_RL_Clu_Dist_2 : 142|12@0+ (0.1,0.4) [0.4|300] "m" Vector__XXX
 SG_ S4_SRR_RL_Clu_Vel_2 : 146|11@0+ (0.1,-111.11) [-111.11|55.59] "mps" Vector__XXX
 SG_ S4_SRR_RL_Clu_SNR_2 : 167|7@0+ (0.5,0) [0|63.5] "dB" Vector__XXX
 SG_ S4_SRR_RL_Clu_RCS_2 : 160|5@0+ (2,-40) [-40|22] "" Vector__XXX
 SG_ S4_SRR_RL_Clu_DynProp_2 : 171|1@0+ (1,0) [0|1] "Unitless" Vector__XXX
 SG_ S4_SRR_RL_Clu_Locationvalid_2 : 170|1@0+ (1,0) [0|1] "" Vector__XXX
 SG_ S4_SRR_RL_Clu_ID_3 : 179|8@0+ (1,0) [0|199] "" Vector__XXX
 SG_ S4_SRR_RL_Clu_Theta_3 : 187|9@0+ (0.0062,-1.571) [-1.571|1.5972] "rad" Vector__XXX
 SG_ S4_SRR_RL_Clu_Dist_3 : 194|12@0+ (0.1,0.4) [0.4|300] "m" Vector__XXX
 SG_ S4_SRR_RL_Clu_Vel_3 : 214|11@0+ (0.1,-111.11) [-111.11|55.59] "mps" Vector__XXX
 SG_ S4_SRR_RL_Clu_SNR_3 : 219|7@0+ (0.5,0) [0|63.5] "dB" Vector__XXX
 SG_ S4_SRR_RL_Clu_RCS_3 : 228|5@0+ (2,-40) [-40|22] "" Vector__XXX
 SG_ S4_SRR_RL_Clu_DynProp_3 : 239|1@0+ (1,0) [0|1] "Unitless" Vector__XXX
 SG_ S4_SRR_RL_Clu_Locationvalid_3 : 238|1@0+ (1,0) [0|1] "" Vector__XXX
 SG_ S4_SRR_RL_Clu_ID_4 : 247|8@0+ (1,0) [0|199] "" Vector__XXX
 SG_ S4_SRR_RL_Clu_Theta_4 : 255|9@0+ (0.0062,-1.571) [-1.571|1.5972] "rad" Vector__XXX
 SG_ S4_SRR_RL_Clu_Dist_4 : 262|12@0+ (0.1,0.4) [0.4|300] "m" Vector__XXX
 SG_ S4_SRR_RL_Clu_Vel_4 : 266|11@0+ (0.1,-111.11) [-111.11|55.59] "mps" Vector__XXX
 SG_ S4_SRR_RL_Clu_SNR_4 : 287|7@0+ (0.5,0) [0|63.5] "dB" Vector__XXX
 SG_ S4_SRR_RL_Clu_RCS_4 : 280|5@0+ (2,-40) [-40|22] "" Vector__XXX
 SG_ S4_SRR_RL_Clu_DynProp_4 : 291|1@0+ (1,0) [0|1] "Unitless" Vector__XXX
 SG_ S4_SRR_RL_Clu_Locationvalid_4 : 290|1@0+ (1,0) [0|1] "" Vector__XXX
 SG_ S4_SRR_RL_Clu_ID_5 : 299|8@0+ (1,0) [0|199] "" Vector__XXX
 SG_ S4_SRR_RL_Clu_Theta_5 : 307|9@0+ (0.0062,-1.571) [-1.571|1.5972] "rad" Vector__XXX
 SG_ S4_SRR_RL_Clu_Dist_5 : 314|12@0+ (0.1,0.4) [0.4|300] "m" Vector__XXX
 SG_ S4_SRR_RL_Clu_Vel_5 : 334|11@0+ (0.1,-111.11) [-111.11|55.59] "mps" Vector__XXX
 SG_ S4_SRR_RL_Clu_SNR_5 : 339|7@0+ (0.5,0) [0|63.5] "dB" Vector__XXX
 SG_ S4_SRR_RL_Clu_RCS_5 : 348|5@0+ (2,-40) [-40|22] "" Vector__XXX
 SG_ S4_SRR_RL_Clu_DynProp_5 : 359|1@0+ (1,0) [0|1] "Unitless" Vector__XXX
 SG_ S4_SRR_RL_Clu_Locationvalid_5 : 358|1@0+ (1,0) [0|1] "" Vector__XXX
 SG_ S4_SRR_RL_Clu_ID_6 : 367|8@0+ (1,0) [0|199] "" Vector__XXX
 SG_ S4_SRR_RL_Clu_Theta_6 : 375|9@0+ (0.0062,-1.571) [-1.571|1.5972] "rad" Vector__XXX
 SG_ S4_SRR_RL_Clu_Dist_6 : 382|12@0+ (0.1,0.4) [0.4|300] "m" Vector__XXX
 SG_ S4_SRR_RL_Clu_Vel_6 : 386|11@0+ (0.1,-111.11) [-111.11|55.59] "mps" Vector__XXX
 SG_ S4_SRR_RL_Clu_SNR_6 : 407|7@0+ (0.5,0) [0|63.5] "dB" Vector__XXX
 SG_ S4_SRR_RL_Clu_RCS_6 : 400|5@0+ (2,-40) [-40|22] "" Vector__XXX
 SG_ S4_SRR_RL_Clu_DynProp_6 : 411|1@0+ (1,0) [0|1] "Unitless" Vector__XXX
 SG_ S4_SRR_RL_Clu_Locationvalid_6 : 410|1@0+ (1,0) [0|1] "" Vector__XXX
 SG_ S4_SRR_RL_Clu_Timestamps : 463|32@0+ (1,0) [0|4294967295] "ms" Vector__XXX
 SG_ S4_SRR_RL_Clu_Mes_0_blockcounter : 503|4@0+ (1,0) [0|15] "" Vector__XXX
 SG_ S4_SRR_RL_Clu_0_MsgCounter : 499|4@0+ (1,0) [0|14] "" Vector__XXX
 SG_ S4_SRR_RL_Clu_0_E2EChecksum : 511|8@0+ (1,0) [0|255] "" Vector__XXX

BO_ 577 S4_SRR_RL_Clu_Mes_1: 64 SRR_RL
 SG_ S4_SRR_RL_Clu_ID_7 : 7|8@0+ (1,0) [0|199] "" Vector__XXX
 SG_ S4_SRR_RL_Clu_Theta_7 : 15|9@0+ (0.0062,-1.571) [-1.571|1.5972] "rad" Vector__XXX
 SG_ S4_SRR_RL_Clu_Dist_7 : 22|12@0+ (0.1,0.4) [0.4|300] "m" Vector__XXX
 SG_ S4_SRR_RL_Clu_Vel_7 : 26|11@0+ (0.1,-111.11) [-111.11|55.59] "mps" Vector__XXX
 SG_ S4_SRR_RL_Clu_SNR_7 : 47|7@0+ (0.5,0) [0|63.5] "dB" Vector__XXX
 SG_ S4_SRR_RL_Clu_RCS_7 : 40|5@0+ (2,-40) [-40|22] "" Vector__XXX
 SG_ S4_SRR_RL_Clu_DynProp_7 : 51|1@0+ (1,0) [0|1] "Unitless" Vector__XXX
 SG_ S4_SRR_RL_Clu_Locationvalid_7 : 50|1@0+ (1,0) [0|1] "" Vector__XXX
 SG_ S4_SRR_RL_Clu_ID_8 : 59|8@0+ (1,0) [0|199] "" Vector__XXX
 SG_ S4_SRR_RL_Clu_Theta_8 : 67|9@0+ (0.0062,-1.571) [-1.571|1.5972] "rad" Vector__XXX
 SG_ S4_SRR_RL_Clu_Dist_8 : 74|12@0+ (0.1,0.4) [0.4|300] "m" Vector__XXX
 SG_ S4_SRR_RL_Clu_Vel_8 : 94|11@0+ (0.1,-111.11) [-111.11|55.59] "mps" Vector__XXX
 SG_ S4_SRR_RL_Clu_SNR_8 : 99|7@0+ (0.5,0) [0|63.5] "dB" Vector__XXX
 SG_ S4_SRR_RL_Clu_RCS_8 : 108|5@0+ (2,-40) [-40|22] "" Vector__XXX
 SG_ S4_SRR_RL_Clu_DynProp_8 : 119|1@0+ (1,0) [0|1] "Unitless" Vector__XXX
 SG_ S4_SRR_RL_Clu_Locationvalid_8 : 118|1@0+ (1,0) [0|1] "" Vector__XXX
 SG_ S4_SRR_RL_Clu_ID_9 : 127|8@0+ (1,0) [0|199] "" Vector__XXX
 SG_ S4_SRR_RL_Clu_Theta_9 : 135|9@0+ (0.0062,-1.571) [-1.571|1.5972] "rad" Vector__XXX
 SG_ S4_SRR_RL_Clu_Dist_9 : 142|12@0+ (0.1,0.4) [0.4|300] "m" Vector__XXX
 SG_ S4_SRR_RL_Clu_Vel_9 : 146|11@0+ (0.1,-111.11) [-111.11|55.59] "mps" Vector__XXX
 SG_ S4_SRR_RL_Clu_SNR_9 : 167|7@0+ (0.5,0) [0|63.5] "dB" Vector__XXX
 SG_ S4_SRR_RL_Clu_RCS_9 : 160|5@0+ (2,-40) [-40|22] "" Vector__XXX
 SG_ S4_SRR_RL_Clu_DynProp_9 : 171|1@0+ (1,0) [0|1] "Unitless" Vector__XXX
 SG_ S4_SRR_RL_Clu_Locationvalid_9 : 170|1@0+ (1,0) [0|1] "" Vector__XXX
 SG_ S4_SRR_RL_Clu_ID_10 : 179|8@0+ (1,0) [0|199] "" Vector__XXX
 SG_ S4_SRR_RL_Clu_Theta_10 : 187|9@0+ (0.0062,-1.571) [-1.571|1.5972] "rad" Vector__XXX
 SG_ S4_SRR_RL_Clu_Dist_10 : 194|12@0+ (0.1,0.4) [0.4|300] "m" Vector__XXX
 SG_ S4_SRR_RL_Clu_Vel_10 : 214|11@0+ (0.1,-111.11) [-111.11|55.59] "mps" Vector__XXX
 SG_ S4_SRR_RL_Clu_SNR_10 : 219|7@0+ (0.5,0) [0|63.5] "dB" Vector__XXX
 SG_ S4_SRR_RL_Clu_RCS_10 : 228|5@0+ (2,-40) [-40|22] "" Vector__XXX
 SG_ S4_SRR_RL_Clu_DynProp_10 : 239|1@0+ (1,0) [0|1] "Unitless" Vector__XXX
 SG_ S4_SRR_RL_Clu_Locationvalid_10 : 238|1@0+ (1,0) [0|1] "" Vector__XXX
 SG_ S4_SRR_RL_Clu_ID_11 : 247|8@0+ (1,0) [0|199] "" Vector__XXX
 SG_ S4_SRR_RL_Clu_Theta_11 : 255|9@0+ (0.0062,-1.571) [-1.571|1.5972] "rad" Vector__XXX
 SG_ S4_SRR_RL_Clu_Dist_11 : 262|12@0+ (0.1,0.4) [0.4|300] "m" Vector__XXX
 SG_ S4_SRR_RL_Clu_Vel_11 : 266|11@0+ (0.1,-111.11) [-111.11|55.59] "mps" Vector__XXX
 SG_ S4_SRR_RL_Clu_SNR_11 : 287|7@0+ (0.5,0) [0|63.5] "dB" Vector__XXX
 SG_ S4_SRR_RL_Clu_RCS_11 : 280|5@0+ (2,-40) [-40|22] "" Vector__XXX
 SG_ S4_SRR_RL_Clu_DynProp_11 : 291|1@0+ (1,0) [0|1] "Unitless" Vector__XXX
 SG_ S4_SRR_RL_Clu_Locationvalid_11 : 290|1@0+ (1,0) [0|1] "" Vector__XXX
 SG_ S4_SRR_RL_Clu_ID_12 : 299|8@0+ (1,0) [0|199] "" Vector__XXX
 SG_ S4_SRR_RL_Clu_Theta_12 : 307|9@0+ (0.0062,-1.571) [-1.571|1.5972] "rad" Vector__XXX
 SG_ S4_SRR_RL_Clu_Dist_12 : 314|12@0+ (0.1,0.4) [0.4|300] "m" Vector__XXX
 SG_ S4_SRR_RL_Clu_Vel_12 : 334|11@0+ (0.1,-111.11) [-111.11|55.59] "mps" Vector__XXX
 SG_ S4_SRR_RL_Clu_SNR_12 : 339|7@0+ (0.5,0) [0|63.5] "dB" Vector__XXX
 SG_ S4_SRR_RL_Clu_RCS_12 : 348|5@0+ (2,-40) [-40|22] "" Vector__XXX
 SG_ S4_SRR_RL_Clu_DynProp_12 : 359|1@0+ (1,0) [0|1] "Unitless" Vector__XXX
 SG_ S4_SRR_RL_Clu_Locationvalid_12 : 358|1@0+ (1,0) [0|1] "" Vector__XXX
 SG_ S4_SRR_RL_Clu_ID_13 : 367|8@0+ (1,0) [0|199] "" Vector__XXX
 SG_ S4_SRR_RL_Clu_Theta_13 : 375|9@0+ (0.0062,-1.571) [-1.571|1.5972] "rad" Vector__XXX
 SG_ S4_SRR_RL_Clu_Dist_13 : 382|12@0+ (0.1,0.4) [0.4|300] "m" Vector__XXX
 SG_ S4_SRR_RL_Clu_Vel_13 : 386|11@0+ (0.1,-111.11) [-111.11|55.59] "mps" Vector__XXX
 SG_ S4_SRR_RL_Clu_SNR_13 : 407|7@0+ (0.5,0) [0|63.5] "dB" Vector__XXX
 SG_ S4_SRR_RL_Clu_RCS_13 : 400|5@0+ (2,-40) [-40|22] "" Vector__XXX
 SG_ S4_SRR_RL_Clu_DynProp_13 : 411|1@0+ (1,0) [0|1] "Unitless" Vector__XXX
 SG_ S4_SRR_RL_Clu_Locationvalid_13 : 410|1@0+ (1,0) [0|1] "" Vector__XXX
 SG_ S4_SRR_RL_Clu_Mes_1_blockcounter : 503|4@0+ (1,0) [0|15] "" Vector__XXX
 SG_ S4_SRR_RL_Clu_1_MsgCounter : 499|4@0+ (1,0) [0|14] "" Vector__XXX
 SG_ S4_SRR_RL_Clu_1_E2EChecksum : 511|8@0+ (1,0) [0|255] "" Vector__XXX

BO_ 587 S4_SRR_RL_Clu_Mes_2: 64 SRR_RL
 SG_ S4_SRR_RL_Clu_ID_14 : 7|8@0+ (1,0) [0|199] "" Vector__XXX
 SG_ S4_SRR_RL_Clu_Theta_14 : 15|9@0+ (0.0062,-1.571) [-1.571|1.5972] "rad" Vector__XXX
 SG_ S4_SRR_RL_Clu_Dist_14 : 22|12@0+ (0.1,0.4) [0.4|300] "m" Vector__XXX
 SG_ S4_SRR_RL_Clu_Vel_14 : 26|11@0+ (0.1,-111.11) [-111.11|55.59] "mps" Vector__XXX
 SG_ S4_SRR_RL_Clu_SNR_14 : 47|7@0+ (0.5,0) [0|63.5] "dB" Vector__XXX
 SG_ S4_SRR_RL_Clu_RCS_14 : 40|5@0+ (2,-40) [-40|22] "" Vector__XXX
 SG_ S4_SRR_RL_Clu_DynProp_14 : 51|1@0+ (1,0) [0|1] "Unitless" Vector__XXX
 SG_ S4_SRR_RL_Clu_Locationvalid_14 : 50|1@0+ (1,0) [0|1] "" Vector__XXX
 SG_ S4_SRR_RL_Clu_ID_15 : 59|8@0+ (1,0) [0|199] "" Vector__XXX
 SG_ S4_SRR_RL_Clu_Theta_15 : 67|9@0+ (0.0062,-1.571) [-1.571|1.5972] "rad" Vector__XXX
 SG_ S4_SRR_RL_Clu_Dist_15 : 74|12@0+ (0.1,0.4) [0.4|300] "m" Vector__XXX
 SG_ S4_SRR_RL_Clu_Vel_15 : 94|11@0+ (0.1,-111.11) [-111.11|55.59] "mps" Vector__XXX
 SG_ S4_SRR_RL_Clu_SNR_15 : 99|7@0+ (0.5,0) [0|63.5] "dB" Vector__XXX
 SG_ S4_SRR_RL_Clu_RCS_15 : 108|5@0+ (2,-40) [-40|22] "" Vector__XXX
 SG_ S4_SRR_RL_Clu_DynProp_15 : 119|1@0+ (1,0) [0|1] "Unitless" Vector__XXX
 SG_ S4_SRR_RL_Clu_Locationvalid_15 : 118|1@0+ (1,0) [0|1] "" Vector__XXX
 SG_ S4_SRR_RL_Clu_ID_16 : 127|8@0+ (1,0) [0|199] "" Vector__XXX
 SG_ S4_SRR_RL_Clu_Theta_16 : 135|9@0+ (0.0062,-1.571) [-1.571|1.5972] "rad" Vector__XXX
 SG_ S4_SRR_RL_Clu_Dist_16 : 142|12@0+ (0.1,0.4) [0.4|300] "m" Vector__XXX
 SG_ S4_SRR_RL_Clu_Vel_16 : 146|11@0+ (0.1,-111.11) [-111.11|55.59] "mps" Vector__XXX
 SG_ S4_SRR_RL_Clu_SNR_16 : 167|7@0+ (0.5,0) [0|63.5] "dB" Vector__XXX
 SG_ S4_SRR_RL_Clu_RCS_16 : 160|5@0+ (2,-40) [-40|22] "" Vector__XXX
 SG_ S4_SRR_RL_Clu_DynProp_16 : 171|1@0+ (1,0) [0|1] "Unitless" Vector__XXX
 SG_ S4_SRR_RL_Clu_Locationvalid_16 : 170|1@0+ (1,0) [0|1] "" Vector__XXX
 SG_ S4_SRR_RL_Clu_ID_17 : 179|8@0+ (1,0) [0|199] "" Vector__XXX
 SG_ S4_SRR_RL_Clu_Theta_17 : 187|9@0+ (0.0062,-1.571) [-1.571|1.5972] "rad" Vector__XXX
 SG_ S4_SRR_RL_Clu_Dist_17 : 194|12@0+ (0.1,0.4) [0.4|300] "m" Vector__XXX
 SG_ S4_SRR_RL_Clu_Vel_17 : 214|11@0+ (0.1,-111.11) [-111.11|55.59] "mps" Vector__XXX
 SG_ S4_SRR_RL_Clu_SNR_17 : 219|7@0+ (0.5,0) [0|63.5] "dB" Vector__XXX
 SG_ S4_SRR_RL_Clu_RCS_17 : 228|5@0+ (2,-40) [-40|22] "" Vector__XXX
 SG_ S4_SRR_RL_Clu_DynProp_17 : 239|1@0+ (1,0) [0|1] "Unitless" Vector__XXX
 SG_ S4_SRR_RL_Clu_Locationvalid_17 : 238|1@0+ (1,0) [0|1] "" Vector__XXX
 SG_ S4_SRR_RL_Clu_ID_18 : 247|8@0+ (1,0) [0|199] "" Vector__XXX
 SG_ S4_SRR_RL_Clu_Theta_18 : 255|9@0+ (0.0062,-1.571) [-1.571|1.5972] "rad" Vector__XXX
 SG_ S4_SRR_RL_Clu_Dist_18 : 262|12@0+ (0.1,0.4) [0.4|300] "m" Vector__XXX
 SG_ S4_SRR_RL_Clu_Vel_18 : 266|11@0+ (0.1,-111.11) [-111.11|55.59] "mps" Vector__XXX
 SG_ S4_SRR_RL_Clu_SNR_18 : 287|7@0+ (0.5,0) [0|63.5] "dB" Vector__XXX
 SG_ S4_SRR_RL_Clu_RCS_18 : 280|5@0+ (2,-40) [-40|22] "" Vector__XXX
 SG_ S4_SRR_RL_Clu_DynProp_18 : 291|1@0+ (1,0) [0|1] "Unitless" Vector__XXX
 SG_ S4_SRR_RL_Clu_Locationvalid_18 : 290|1@0+ (1,0) [0|1] "" Vector__XXX
 SG_ S4_SRR_RL_Clu_ID_19 : 299|8@0+ (1,0) [0|199] "" Vector__XXX
 SG_ S4_SRR_RL_Clu_Theta_19 : 307|9@0+ (0.0062,-1.571) [-1.571|1.5972] "rad" Vector__XXX
 SG_ S4_SRR_RL_Clu_Dist_19 : 314|12@0+ (0.1,0.4) [0.4|300] "m" Vector__XXX
 SG_ S4_SRR_RL_Clu_Vel_19 : 334|11@0+ (0.1,-111.11) [-111.11|55.59] "mps" Vector__XXX
 SG_ S4_SRR_RL_Clu_SNR_19 : 339|7@0+ (0.5,0) [0|63.5] "dB" Vector__XXX
 SG_ S4_SRR_RL_Clu_RCS_19 : 348|5@0+ (2,-40) [-40|22] "" Vector__XXX
 SG_ S4_SRR_RL_Clu_DynProp_19 : 359|1@0+ (1,0) [0|1] "Unitless" Vector__XXX
 SG_ S4_SRR_RL_Clu_Locationvalid_19 : 358|1@0+ (1,0) [0|1] "" Vector__XXX
 SG_ S4_SRR_RL_Clu_ID_20 : 367|8@0+ (1,0) [0|199] "" Vector__XXX
 SG_ S4_SRR_RL_Clu_Theta_20 : 375|9@0+ (0.0062,-1.571) [-1.571|1.5972] "rad" Vector__XXX
 SG_ S4_SRR_RL_Clu_Dist_20 : 382|12@0+ (0.1,0.4) [0.4|300] "m" Vector__XXX
 SG_ S4_SRR_RL_Clu_Vel_20 : 386|11@0+ (0.1,-111.11) [-111.11|55.59] "mps" Vector__XXX
 SG_ S4_SRR_RL_Clu_SNR_20 : 407|7@0+ (0.5,0) [0|63.5] "dB" Vector__XXX
 SG_ S4_SRR_RL_Clu_RCS_20 : 400|5@0+ (2,-40) [-40|22] "" Vector__XXX
 SG_ S4_SRR_RL_Clu_DynProp_20 : 411|1@0+ (1,0) [0|1] "Unitless" Vector__XXX
 SG_ S4_SRR_RL_Clu_Locationvalid_20 : 410|1@0+ (1,0) [0|1] "" Vector__XXX
 SG_ S4_SRR_RL_Clu_Mes_2_blockcounter : 503|4@0+ (1,0) [0|15] "" Vector__XXX
 SG_ S4_SRR_RL_Clu_2_MsgCounter : 499|4@0+ (1,0) [0|14] "" Vector__XXX
 SG_ S4_SRR_RL_Clu_2_E2EChecksum : 511|8@0+ (1,0) [0|255] "" Vector__XXX

BO_ 588 S4_SRR_RL_Clu_Mes_3: 64 SRR_RL
 SG_ S4_SRR_RL_Clu_ID_21 : 7|8@0+ (1,0) [0|199] "" Vector__XXX
 SG_ S4_SRR_RL_Clu_Theta_21 : 15|9@0+ (0.0062,-1.571) [-1.571|1.5972] "rad" Vector__XXX
 SG_ S4_SRR_RL_Clu_Dist_21 : 22|12@0+ (0.1,0.4) [0.4|300] "m" Vector__XXX
 SG_ S4_SRR_RL_Clu_Vel_21 : 26|11@0+ (0.1,-111.11) [-111.11|55.59] "mps" Vector__XXX
 SG_ S4_SRR_RL_Clu_SNR_21 : 47|7@0+ (0.5,0) [0|63.5] "dB" Vector__XXX
 SG_ S4_SRR_RL_Clu_RCS_21 : 40|5@0+ (2,-40) [-40|22] "" Vector__XXX
 SG_ S4_SRR_RL_Clu_DynProp_21 : 51|1@0+ (1,0) [0|1] "Unitless" Vector__XXX
 SG_ S4_SRR_RL_Clu_Locationvalid_21 : 50|1@0+ (1,0) [0|1] "" Vector__XXX
 SG_ S4_SRR_RL_Clu_ID_22 : 59|8@0+ (1,0) [0|199] "" Vector__XXX
 SG_ S4_SRR_RL_Clu_Theta_22 : 67|9@0+ (0.0062,-1.571) [-1.571|1.5972] "rad" Vector__XXX
 SG_ S4_SRR_RL_Clu_Dist_22 : 74|12@0+ (0.1,0.4) [0.4|300] "m" Vector__XXX
 SG_ S4_SRR_RL_Clu_Vel_22 : 94|11@0+ (0.1,-111.11) [-111.11|55.59] "mps" Vector__XXX
 SG_ S4_SRR_RL_Clu_SNR_22 : 99|7@0+ (0.5,0) [0|63.5] "dB" Vector__XXX
 SG_ S4_SRR_RL_Clu_RCS_22 : 108|5@0+ (2,-40) [-40|22] "" Vector__XXX
 SG_ S4_SRR_RL_Clu_DynProp_22 : 119|1@0+ (1,0) [0|1] "Unitless" Vector__XXX
 SG_ S4_SRR_RL_Clu_Locationvalid_22 : 118|1@0+ (1,0) [0|1] "" Vector__XXX
 SG_ S4_SRR_RL_Clu_ID_23 : 127|8@0+ (1,0) [0|199] "" Vector__XXX
 SG_ S4_SRR_RL_Clu_Theta_23 : 135|9@0+ (0.0062,-1.571) [-1.571|1.5972] "rad" Vector__XXX
 SG_ S4_SRR_RL_Clu_Dist_23 : 142|12@0+ (0.1,0.4) [0.4|300] "m" Vector__XXX
 SG_ S4_SRR_RL_Clu_Vel_23 : 146|11@0+ (0.1,-111.11) [-111.11|55.59] "mps" Vector__XXX
 SG_ S4_SRR_RL_Clu_SNR_23 : 167|7@0+ (0.5,0) [0|63.5] "dB" Vector__XXX
 SG_ S4_SRR_RL_Clu_RCS_23 : 160|5@0+ (2,-40) [-40|22] "" Vector__XXX
 SG_ S4_SRR_RL_Clu_DynProp_23 : 171|1@0+ (1,0) [0|1] "Unitless" Vector__XXX
 SG_ S4_SRR_RL_Clu_Locationvalid_23 : 170|1@0+ (1,0) [0|1] "" Vector__XXX
 SG_ S4_SRR_RL_Clu_ID_24 : 179|8@0+ (1,0) [0|199] "" Vector__XXX
 SG_ S4_SRR_RL_Clu_Theta_24 : 187|9@0+ (0.0062,-1.571) [-1.571|1.5972] "rad" Vector__XXX
 SG_ S4_SRR_RL_Clu_Dist_24 : 194|12@0+ (0.1,0.4) [0.4|300] "m" Vector__XXX
 SG_ S4_SRR_RL_Clu_Vel_24 : 214|11@0+ (0.1,-111.11) [-111.11|55.59] "mps" Vector__XXX
 SG_ S4_SRR_RL_Clu_SNR_24 : 219|7@0+ (0.5,0) [0|63.5] "dB" Vector__XXX
 SG_ S4_SRR_RL_Clu_RCS_24 : 228|5@0+ (2,-40) [-40|22] "" Vector__XXX
 SG_ S4_SRR_RL_Clu_DynProp_24 : 239|1@0+ (1,0) [0|1] "Unitless" Vector__XXX
 SG_ S4_SRR_RL_Clu_Locationvalid_24 : 238|1@0+ (1,0) [0|1] "" Vector__XXX
 SG_ S4_SRR_RL_Clu_ID_25 : 247|8@0+ (1,0) [0|199] "" Vector__XXX
 SG_ S4_SRR_RL_Clu_Theta_25 : 255|9@0+ (0.0062,-1.571) [-1.571|1.5972] "rad" Vector__XXX
 SG_ S4_SRR_RL_Clu_Dist_25 : 262|12@0+ (0.1,0.4) [0.4|300] "m" Vector__XXX
 SG_ S4_SRR_RL_Clu_Vel_25 : 266|11@0+ (0.1,-111.11) [-111.11|55.59] "mps" Vector__XXX
 SG_ S4_SRR_RL_Clu_SNR_25 : 287|7@0+ (0.5,0) [0|63.5] "dB" Vector__XXX
 SG_ S4_SRR_RL_Clu_RCS_25 : 280|5@0+ (2,-40) [-40|22] "" Vector__XXX
 SG_ S4_SRR_RL_Clu_DynProp_25 : 291|1@0+ (1,0) [0|1] "Unitless" Vector__XXX
 SG_ S4_SRR_RL_Clu_Locationvalid_25 : 290|1@0+ (1,0) [0|1] "" Vector__XXX
 SG_ S4_SRR_RL_Clu_ID_26 : 299|8@0+ (1,0) [0|199] "" Vector__XXX
 SG_ S4_SRR_RL_Clu_Theta_26 : 307|9@0+ (0.0062,-1.571) [-1.571|1.5972] "rad" Vector__XXX
 SG_ S4_SRR_RL_Clu_Dist_26 : 314|12@0+ (0.1,0.4) [0.4|300] "m" Vector__XXX
 SG_ S4_SRR_RL_Clu_Vel_26 : 334|11@0+ (0.1,-111.11) [-111.11|55.59] "mps" Vector__XXX
 SG_ S4_SRR_RL_Clu_SNR_26 : 339|7@0+ (0.5,0) [0|63.5] "dB" Vector__XXX
 SG_ S4_SRR_RL_Clu_RCS_26 : 348|5@0+ (2,-40) [-40|22] "" Vector__XXX
 SG_ S4_SRR_RL_Clu_DynProp_26 : 359|1@0+ (1,0) [0|1] "Unitless" Vector__XXX
 SG_ S4_SRR_RL_Clu_Locationvalid_26 : 358|1@0+ (1,0) [0|1] "" Vector__XXX
 SG_ S4_SRR_RL_Clu_ID_27 : 367|8@0+ (1,0) [0|199] "" Vector__XXX
 SG_ S4_SRR_RL_Clu_Theta_27 : 375|9@0+ (0.0062,-1.571) [-1.571|1.5972] "rad" Vector__XXX
 SG_ S4_SRR_RL_Clu_Dist_27 : 382|12@0+ (0.1,0.4) [0.4|300] "m" Vector__XXX
 SG_ S4_SRR_RL_Clu_Vel_27 : 386|11@0+ (0.1,-111.11) [-111.11|55.59] "mps" Vector__XXX
 SG_ S4_SRR_RL_Clu_SNR_27 : 407|7@0+ (0.5,0) [0|63.5] "dB" Vector__XXX
 SG_ S4_SRR_RL_Clu_RCS_27 : 400|5@0+ (2,-40) [-40|22] "" Vector__XXX
 SG_ S4_SRR_RL_Clu_DynProp_27 : 411|1@0+ (1,0) [0|1] "Unitless" Vector__XXX
 SG_ S4_SRR_RL_Clu_Locationvalid_27 : 410|1@0+ (1,0) [0|1] "" Vector__XXX
 SG_ S4_SRR_RL_Clu_Mes_3_blockcounter : 503|4@0+ (1,0) [0|15] "" Vector__XXX
 SG_ S4_SRR_RL_Clu_3_MsgCounter : 499|4@0+ (1,0) [0|14] "" Vector__XXX
 SG_ S4_SRR_RL_Clu_3_E2EChecksum : 511|8@0+ (1,0) [0|255] "" Vector__XXX

BO_ 589 S4_SRR_RL_Clu_Mes_4: 64 SRR_RL
 SG_ S4_SRR_RL_Clu_ID_28 : 7|8@0+ (1,0) [0|199] "" Vector__XXX
 SG_ S4_SRR_RL_Clu_Theta_28 : 15|9@0+ (0.0062,-1.571) [-1.571|1.5972] "rad" Vector__XXX
 SG_ S4_SRR_RL_Clu_Dist_28 : 22|12@0+ (0.1,0.4) [0.4|300] "m" Vector__XXX
 SG_ S4_SRR_RL_Clu_Vel_28 : 26|11@0+ (0.1,-111.11) [-111.11|55.59] "mps" Vector__XXX
 SG_ S4_SRR_RL_Clu_SNR_28 : 47|7@0+ (0.5,0) [0|63.5] "dB" Vector__XXX
 SG_ S4_SRR_RL_Clu_RCS_28 : 40|5@0+ (2,-40) [-40|22] "" Vector__XXX
 SG_ S4_SRR_RL_Clu_DynProp_28 : 51|1@0+ (1,0) [0|1] "Unitless" Vector__XXX
 SG_ S4_SRR_RL_Clu_Locationvalid_28 : 50|1@0+ (1,0) [0|1] "" Vector__XXX
 SG_ S4_SRR_RL_Clu_ID_29 : 59|8@0+ (1,0) [0|199] "" Vector__XXX
 SG_ S4_SRR_RL_Clu_Theta_29 : 67|9@0+ (0.0062,-1.571) [-1.571|1.5972] "rad" Vector__XXX
 SG_ S4_SRR_RL_Clu_Dist_29 : 74|12@0+ (0.1,0.4) [0.4|300] "m" Vector__XXX
 SG_ S4_SRR_RL_Clu_Vel_29 : 94|11@0+ (0.1,-111.11) [-111.11|55.59] "mps" Vector__XXX
 SG_ S4_SRR_RL_Clu_SNR_29 : 99|7@0+ (0.5,0) [0|63.5] "dB" Vector__XXX
 SG_ S4_SRR_RL_Clu_RCS_29 : 108|5@0+ (2,-40) [-40|22] "" Vector__XXX
 SG_ S4_SRR_RL_Clu_DynProp_29 : 119|1@0+ (1,0) [0|1] "Unitless" Vector__XXX
 SG_ S4_SRR_RL_Clu_Locationvalid_29 : 118|1@0+ (1,0) [0|1] "" Vector__XXX
 SG_ S4_SRR_RL_Clu_ID_30 : 127|8@0+ (1,0) [0|199] "" Vector__XXX
 SG_ S4_SRR_RL_Clu_Theta_30 : 135|9@0+ (0.0062,-1.571) [-1.571|1.5972] "rad" Vector__XXX
 SG_ S4_SRR_RL_Clu_Dist_30 : 142|12@0+ (0.1,0.4) [0.4|300] "m" Vector__XXX
 SG_ S4_SRR_RL_Clu_Vel_30 : 146|11@0+ (0.1,-111.11) [-111.11|55.59] "mps" Vector__XXX
 SG_ S4_SRR_RL_Clu_SNR_30 : 167|7@0+ (0.5,0) [0|63.5] "dB" Vector__XXX
 SG_ S4_SRR_RL_Clu_RCS_30 : 160|5@0+ (2,-40) [-40|22] "" Vector__XXX
 SG_ S4_SRR_RL_Clu_DynProp_30 : 171|1@0+ (1,0) [0|1] "Unitless" Vector__XXX
 SG_ S4_SRR_RL_Clu_Locationvalid_30 : 170|1@0+ (1,0) [0|1] "" Vector__XXX
 SG_ S4_SRR_RL_Clu_ID_31 : 179|8@0+ (1,0) [0|199] "" Vector__XXX
 SG_ S4_SRR_RL_Clu_Theta_31 : 187|9@0+ (0.0062,-1.571) [-1.571|1.5972] "rad" Vector__XXX
 SG_ S4_SRR_RL_Clu_Dist_31 : 194|12@0+ (0.1,0.4) [0.4|300] "m" Vector__XXX
 SG_ S4_SRR_RL_Clu_Vel_31 : 214|11@0+ (0.1,-111.11) [-111.11|55.59] "mps" Vector__XXX
 SG_ S4_SRR_RL_Clu_SNR_31 : 219|7@0+ (0.5,0) [0|63.5] "dB" Vector__XXX
 SG_ S4_SRR_RL_Clu_RCS_31 : 228|5@0+ (2,-40) [-40|22] "" Vector__XXX
 SG_ S4_SRR_RL_Clu_DynProp_31 : 239|1@0+ (1,0) [0|1] "Unitless" Vector__XXX
 SG_ S4_SRR_RL_Clu_Locationvalid_31 : 238|1@0+ (1,0) [0|1] "" Vector__XXX
 SG_ S4_SRR_RL_Clu_ID_32 : 247|8@0+ (1,0) [0|199] "" Vector__XXX
 SG_ S4_SRR_RL_Clu_Theta_32 : 255|9@0+ (0.0062,-1.571) [-1.571|1.5972] "rad" Vector__XXX
 SG_ S4_SRR_RL_Clu_Dist_32 : 262|12@0+ (0.1,0.4) [0.4|300] "m" Vector__XXX
 SG_ S4_SRR_RL_Clu_Vel_32 : 266|11@0+ (0.1,-111.11) [-111.11|55.59] "mps" Vector__XXX
 SG_ S4_SRR_RL_Clu_SNR_32 : 287|7@0+ (0.5,0) [0|63.5] "dB" Vector__XXX
 SG_ S4_SRR_RL_Clu_RCS_32 : 280|5@0+ (2,-40) [-40|22] "" Vector__XXX
 SG_ S4_SRR_RL_Clu_DynProp_32 : 291|1@0+ (1,0) [0|1] "Unitless" Vector__XXX
 SG_ S4_SRR_RL_Clu_Locationvalid_32 : 290|1@0+ (1,0) [0|1] "" Vector__XXX
 SG_ S4_SRR_RL_Clu_ID_33 : 299|8@0+ (1,0) [0|199] "" Vector__XXX
 SG_ S4_SRR_RL_Clu_Theta_33 : 307|9@0+ (0.0062,-1.571) [-1.571|1.5972] "rad" Vector__XXX
 SG_ S4_SRR_RL_Clu_Dist_33 : 314|12@0+ (0.1,0.4) [0.4|300] "m" Vector__XXX
 SG_ S4_SRR_RL_Clu_Vel_33 : 334|11@0+ (0.1,-111.11) [-111.11|55.59] "mps" Vector__XXX
 SG_ S4_SRR_RL_Clu_SNR_33 : 339|7@0+ (0.5,0) [0|63.5] "dB" Vector__XXX
 SG_ S4_SRR_RL_Clu_RCS_33 : 348|5@0+ (2,-40) [-40|22] "" Vector__XXX
 SG_ S4_SRR_RL_Clu_DynProp_33 : 359|1@0+ (1,0) [0|1] "Unitless" Vector__XXX
 SG_ S4_SRR_RL_Clu_Locationvalid_33 : 358|1@0+ (1,0) [0|1] "" Vector__XXX
 SG_ S4_SRR_RL_Clu_ID_34 : 367|8@0+ (1,0) [0|199] "" Vector__XXX
 SG_ S4_SRR_RL_Clu_Theta_34 : 375|9@0+ (0.0062,-1.571) [-1.571|1.5972] "rad" Vector__XXX
 SG_ S4_SRR_RL_Clu_Dist_34 : 382|12@0+ (0.1,0.4) [0.4|300] "m" Vector__XXX
 SG_ S4_SRR_RL_Clu_Vel_34 : 386|11@0+ (0.1,-111.11) [-111.11|55.59] "mps" Vector__XXX
 SG_ S4_SRR_RL_Clu_SNR_34 : 407|7@0+ (0.5,0) [0|63.5] "dB" Vector__XXX
 SG_ S4_SRR_RL_Clu_RCS_34 : 400|5@0+ (2,-40) [-40|22] "" Vector__XXX
 SG_ S4_SRR_RL_Clu_DynProp_34 : 411|1@0+ (1,0) [0|1] "Unitless" Vector__XXX
 SG_ S4_SRR_RL_Clu_Locationvalid_34 : 410|1@0+ (1,0) [0|1] "" Vector__XXX
 SG_ S4_SRR_RL_Clu_Mes_4_blockcounter : 503|4@0+ (1,0) [0|15] "" Vector__XXX
 SG_ S4_SRR_RL_Clu_4_MsgCounter : 499|4@0+ (1,0) [0|14] "" Vector__XXX
 SG_ S4_SRR_RL_Clu_4_E2EChecksum : 511|8@0+ (1,0) [0|255] "" Vector__XXX

BO_ 590 S4_SRR_RL_Clu_Mes_5: 64 SRR_RL
 SG_ S4_SRR_RL_Clu_ID_35 : 7|8@0+ (1,0) [0|199] "" Vector__XXX
 SG_ S4_SRR_RL_Clu_Theta_35 : 15|9@0+ (0.0062,-1.571) [-1.571|1.5972] "rad" Vector__XXX
 SG_ S4_SRR_RL_Clu_Dist_35 : 22|12@0+ (0.1,0.4) [0.4|300] "m" Vector__XXX
 SG_ S4_SRR_RL_Clu_Vel_35 : 26|11@0+ (0.1,-111.11) [-111.11|55.59] "mps" Vector__XXX
 SG_ S4_SRR_RL_Clu_SNR_35 : 47|7@0+ (0.5,0) [0|63.5] "dB" Vector__XXX
 SG_ S4_SRR_RL_Clu_RCS_35 : 40|5@0+ (2,-40) [-40|22] "" Vector__XXX
 SG_ S4_SRR_RL_Clu_DynProp_35 : 51|1@0+ (1,0) [0|1] "Unitless" Vector__XXX
 SG_ S4_SRR_RL_Clu_Locationvalid_35 : 50|1@0+ (1,0) [0|1] "" Vector__XXX
 SG_ S4_SRR_RL_Clu_ID_36 : 59|8@0+ (1,0) [0|199] "" Vector__XXX
 SG_ S4_SRR_RL_Clu_Theta_36 : 67|9@0+ (0.0062,-1.571) [-1.571|1.5972] "rad" Vector__XXX
 SG_ S4_SRR_RL_Clu_Dist_36 : 74|12@0+ (0.1,0.4) [0.4|300] "m" Vector__XXX
 SG_ S4_SRR_RL_Clu_Vel_36 : 94|11@0+ (0.1,-111.11) [-111.11|55.59] "mps" Vector__XXX
 SG_ S4_SRR_RL_Clu_SNR_36 : 99|7@0+ (0.5,0) [0|63.5] "dB" Vector__XXX
 SG_ S4_SRR_RL_Clu_RCS_36 : 108|5@0+ (2,-40) [-40|22] "" Vector__XXX
 SG_ S4_SRR_RL_Clu_DynProp_36 : 119|1@0+ (1,0) [0|1] "Unitless" Vector__XXX
 SG_ S4_SRR_RL_Clu_Locationvalid_36 : 118|1@0+ (1,0) [0|1] "" Vector__XXX
 SG_ S4_SRR_RL_Clu_ID_37 : 127|8@0+ (1,0) [0|199] "" Vector__XXX
 SG_ S4_SRR_RL_Clu_Theta_37 : 135|9@0+ (0.0062,-1.571) [-1.571|1.5972] "rad" Vector__XXX
 SG_ S4_SRR_RL_Clu_Dist_37 : 142|12@0+ (0.1,0.4) [0.4|300] "m" Vector__XXX
 SG_ S4_SRR_RL_Clu_Vel_37 : 146|11@0+ (0.1,-111.11) [-111.11|55.59] "mps" Vector__XXX
 SG_ S4_SRR_RL_Clu_SNR_37 : 167|7@0+ (0.5,0) [0|63.5] "dB" Vector__XXX
 SG_ S4_SRR_RL_Clu_RCS_37 : 160|5@0+ (2,-40) [-40|22] "" Vector__XXX
 SG_ S4_SRR_RL_Clu_DynProp_37 : 171|1@0+ (1,0) [0|1] "Unitless" Vector__XXX
 SG_ S4_SRR_RL_Clu_Locationvalid_37 : 170|1@0+ (1,0) [0|1] "" Vector__XXX
 SG_ S4_SRR_RL_Clu_ID_38 : 179|8@0+ (1,0) [0|199] "" Vector__XXX
 SG_ S4_SRR_RL_Clu_Theta_38 : 187|9@0+ (0.0062,-1.571) [-1.571|1.5972] "rad" Vector__XXX
 SG_ S4_SRR_RL_Clu_Dist_38 : 194|12@0+ (0.1,0.4) [0.4|300] "m" Vector__XXX
 SG_ S4_SRR_RL_Clu_Vel_38 : 214|11@0+ (0.1,-111.11) [-111.11|55.59] "mps" Vector__XXX
 SG_ S4_SRR_RL_Clu_SNR_38 : 219|7@0+ (0.5,0) [0|63.5] "dB" Vector__XXX
 SG_ S4_SRR_RL_Clu_RCS_38 : 228|5@0+ (2,-40) [-40|22] "" Vector__XXX
 SG_ S4_SRR_RL_Clu_DynProp_38 : 239|1@0+ (1,0) [0|1] "Unitless" Vector__XXX
 SG_ S4_SRR_RL_Clu_Locationvalid_38 : 238|1@0+ (1,0) [0|1] "" Vector__XXX
 SG_ S4_SRR_RL_Clu_ID_39 : 247|8@0+ (1,0) [0|199] "" Vector__XXX
 SG_ S4_SRR_RL_Clu_Theta_39 : 255|9@0+ (0.0062,-1.571) [-1.571|1.5972] "rad" Vector__XXX
 SG_ S4_SRR_RL_Clu_Dist_39 : 262|12@0+ (0.1,0.4) [0.4|300] "m" Vector__XXX
 SG_ S4_SRR_RL_Clu_Vel_39 : 266|11@0+ (0.1,-111.11) [-111.11|55.59] "mps" Vector__XXX
 SG_ S4_SRR_RL_Clu_SNR_39 : 287|7@0+ (0.5,0) [0|63.5] "dB" Vector__XXX
 SG_ S4_SRR_RL_Clu_RCS_39 : 280|5@0+ (2,-40) [-40|22] "" Vector__XXX
 SG_ S4_SRR_RL_Clu_DynProp_39 : 291|1@0+ (1,0) [0|1] "Unitless" Vector__XXX
 SG_ S4_SRR_RL_Clu_Locationvalid_39 : 290|1@0+ (1,0) [0|1] "" Vector__XXX
 SG_ S4_SRR_RL_Clu_ID_40 : 299|8@0+ (1,0) [0|199] "" Vector__XXX
 SG_ S4_SRR_RL_Clu_Theta_40 : 307|9@0+ (0.0062,-1.571) [-1.571|1.5972] "rad" Vector__XXX
 SG_ S4_SRR_RL_Clu_Dist_40 : 314|12@0+ (0.1,0.4) [0.4|300] "m" Vector__XXX
 SG_ S4_SRR_RL_Clu_Vel_40 : 334|11@0+ (0.1,-111.11) [-111.11|55.59] "mps" Vector__XXX
 SG_ S4_SRR_RL_Clu_SNR_40 : 339|7@0+ (0.5,0) [0|63.5] "dB" Vector__XXX
 SG_ S4_SRR_RL_Clu_RCS_40 : 348|5@0+ (2,-40) [-40|22] "" Vector__XXX
 SG_ S4_SRR_RL_Clu_DynProp_40 : 359|1@0+ (1,0) [0|1] "Unitless" Vector__XXX
 SG_ S4_SRR_RL_Clu_Locationvalid_40 : 358|1@0+ (1,0) [0|1] "" Vector__XXX
 SG_ S4_SRR_RL_Clu_ID_41 : 367|8@0+ (1,0) [0|199] "" Vector__XXX
 SG_ S4_SRR_RL_Clu_Theta_41 : 375|9@0+ (0.0062,-1.571) [-1.571|1.5972] "rad" Vector__XXX
 SG_ S4_SRR_RL_Clu_Dist_41 : 382|12@0+ (0.1,0.4) [0.4|300] "m" Vector__XXX
 SG_ S4_SRR_RL_Clu_Vel_41 : 386|11@0+ (0.1,-111.11) [-111.11|55.59] "mps" Vector__XXX
 SG_ S4_SRR_RL_Clu_SNR_41 : 407|7@0+ (0.5,0) [0|63.5] "dB" Vector__XXX
 SG_ S4_SRR_RL_Clu_RCS_41 : 400|5@0+ (2,-40) [-40|22] "" Vector__XXX
 SG_ S4_SRR_RL_Clu_DynProp_41 : 411|1@0+ (1,0) [0|1] "Unitless" Vector__XXX
 SG_ S4_SRR_RL_Clu_Locationvalid_41 : 410|1@0+ (1,0) [0|1] "" Vector__XXX
 SG_ S4_SRR_RL_Clu_Mes_5_blockcounter : 503|4@0+ (1,0) [0|15] "" Vector__XXX
 SG_ S4_SRR_RL_Clu_5_MsgCounter : 499|4@0+ (1,0) [0|14] "" Vector__XXX
 SG_ S4_SRR_RL_Clu_5_E2EChecksum : 511|8@0+ (1,0) [0|255] "" Vector__XXX

BO_ 591 S4_SRR_RL_Clu_Mes_6: 64 SRR_RL
 SG_ S4_SRR_RL_Clu_ID_42 : 7|8@0+ (1,0) [0|199] "" Vector__XXX
 SG_ S4_SRR_RL_Clu_Theta_42 : 15|9@0+ (0.0062,-1.571) [-1.571|1.5972] "rad" Vector__XXX
 SG_ S4_SRR_RL_Clu_Dist_42 : 22|12@0+ (0.1,0.4) [0.4|300] "m" Vector__XXX
 SG_ S4_SRR_RL_Clu_Vel_42 : 26|11@0+ (0.1,-111.11) [-111.11|55.59] "mps" Vector__XXX
 SG_ S4_SRR_RL_Clu_SNR_42 : 47|7@0+ (0.5,0) [0|63.5] "dB" Vector__XXX
 SG_ S4_SRR_RL_Clu_RCS_42 : 40|5@0+ (2,-40) [-40|22] "" Vector__XXX
 SG_ S4_SRR_RL_Clu_DynProp_42 : 51|1@0+ (1,0) [0|1] "Unitless" Vector__XXX
 SG_ S4_SRR_RL_Clu_Locationvalid_42 : 50|1@0+ (1,0) [0|1] "" Vector__XXX
 SG_ S4_SRR_RL_Clu_ID_43 : 59|8@0+ (1,0) [0|199] "" Vector__XXX
 SG_ S4_SRR_RL_Clu_Theta_43 : 67|9@0+ (0.0062,-1.571) [-1.571|1.5972] "rad" Vector__XXX
 SG_ S4_SRR_RL_Clu_Dist_43 : 74|12@0+ (0.1,0.4) [0.4|300] "m" Vector__XXX
 SG_ S4_SRR_RL_Clu_Vel_43 : 94|11@0+ (0.1,-111.11) [-111.11|55.59] "mps" Vector__XXX
 SG_ S4_SRR_RL_Clu_SNR_43 : 99|7@0+ (0.5,0) [0|63.5] "dB" Vector__XXX
 SG_ S4_SRR_RL_Clu_RCS_43 : 108|5@0+ (2,-40) [-40|22] "" Vector__XXX
 SG_ S4_SRR_RL_Clu_DynProp_43 : 119|1@0+ (1,0) [0|1] "Unitless" Vector__XXX
 SG_ S4_SRR_RL_Clu_Locationvalid_43 : 118|1@0+ (1,0) [0|1] "" Vector__XXX
 SG_ S4_SRR_RL_Clu_ID_44 : 127|8@0+ (1,0) [0|199] "" Vector__XXX
 SG_ S4_SRR_RL_Clu_Theta_44 : 135|9@0+ (0.0062,-1.571) [-1.571|1.5972] "rad" Vector__XXX
 SG_ S4_SRR_RL_Clu_Dist_44 : 142|12@0+ (0.1,0.4) [0.4|300] "m" Vector__XXX
 SG_ S4_SRR_RL_Clu_Vel_44 : 146|11@0+ (0.1,-111.11) [-111.11|55.59] "mps" Vector__XXX
 SG_ S4_SRR_RL_Clu_SNR_44 : 167|7@0+ (0.5,0) [0|63.5] "dB" Vector__XXX
 SG_ S4_SRR_RL_Clu_RCS_44 : 160|5@0+ (2,-40) [-40|22] "" Vector__XXX
 SG_ S4_SRR_RL_Clu_DynProp_44 : 171|1@0+ (1,0) [0|1] "Unitless" Vector__XXX
 SG_ S4_SRR_RL_Clu_Locationvalid_44 : 170|1@0+ (1,0) [0|1] "" Vector__XXX
 SG_ S4_SRR_RL_Clu_ID_45 : 179|8@0+ (1,0) [0|199] "" Vector__XXX
 SG_ S4_SRR_RL_Clu_Theta_45 : 187|9@0+ (0.0062,-1.571) [-1.571|1.5972] "rad" Vector__XXX
 SG_ S4_SRR_RL_Clu_Dist_45 : 194|12@0+ (0.1,0.4) [0.4|300] "m" Vector__XXX
 SG_ S4_SRR_RL_Clu_Vel_45 : 214|11@0+ (0.1,-111.11) [-111.11|55.59] "mps" Vector__XXX
 SG_ S4_SRR_RL_Clu_SNR_45 : 219|7@0+ (0.5,0) [0|63.5] "dB" Vector__XXX
 SG_ S4_SRR_RL_Clu_RCS_45 : 228|5@0+ (2,-40) [-40|22] "" Vector__XXX
 SG_ S4_SRR_RL_Clu_DynProp_45 : 239|1@0+ (1,0) [0|1] "Unitless" Vector__XXX
 SG_ S4_SRR_RL_Clu_Locationvalid_45 : 238|1@0+ (1,0) [0|1] "" Vector__XXX
 SG_ S4_SRR_RL_Clu_ID_46 : 247|8@0+ (1,0) [0|199] "" Vector__XXX
 SG_ S4_SRR_RL_Clu_Theta_46 : 255|9@0+ (0.0062,-1.571) [-1.571|1.5972] "rad" Vector__XXX
 SG_ S4_SRR_RL_Clu_Dist_46 : 262|12@0+ (0.1,0.4) [0.4|300] "m" Vector__XXX
 SG_ S4_SRR_RL_Clu_Vel_46 : 266|11@0+ (0.1,-111.11) [-111.11|55.59] "mps" Vector__XXX
 SG_ S4_SRR_RL_Clu_SNR_46 : 287|7@0+ (0.5,0) [0|63.5] "dB" Vector__XXX
 SG_ S4_SRR_RL_Clu_RCS_46 : 280|5@0+ (2,-40) [-40|22] "" Vector__XXX
 SG_ S4_SRR_RL_Clu_DynProp_46 : 291|1@0+ (1,0) [0|1] "Unitless" Vector__XXX
 SG_ S4_SRR_RL_Clu_Locationvalid_46 : 290|1@0+ (1,0) [0|1] "" Vector__XXX
 SG_ S4_SRR_RL_Clu_ID_47 : 299|8@0+ (1,0) [0|199] "" Vector__XXX
 SG_ S4_SRR_RL_Clu_Theta_47 : 307|9@0+ (0.0062,-1.571) [-1.571|1.5972] "rad" Vector__XXX
 SG_ S4_SRR_RL_Clu_Dist_47 : 314|12@0+ (0.1,0.4) [0.4|300] "m" Vector__XXX
 SG_ S4_SRR_RL_Clu_Vel_47 : 334|11@0+ (0.1,-111.11) [-111.11|55.59] "mps" Vector__XXX
 SG_ S4_SRR_RL_Clu_SNR_47 : 339|7@0+ (0.5,0) [0|63.5] "dB" Vector__XXX
 SG_ S4_SRR_RL_Clu_RCS_47 : 348|5@0+ (2,-40) [-40|22] "" Vector__XXX
 SG_ S4_SRR_RL_Clu_DynProp_47 : 359|1@0+ (1,0) [0|1] "Unitless" Vector__XXX
 SG_ S4_SRR_RL_Clu_Locationvalid_47 : 358|1@0+ (1,0) [0|1] "" Vector__XXX
 SG_ S4_SRR_RL_Clu_ID_48 : 367|8@0+ (1,0) [0|199] "" Vector__XXX
 SG_ S4_SRR_RL_Clu_Theta_48 : 375|9@0+ (0.0062,-1.571) [-1.571|1.5972] "rad" Vector__XXX
 SG_ S4_SRR_RL_Clu_Dist_48 : 382|12@0+ (0.1,0.4) [0.4|300] "m" Vector__XXX
 SG_ S4_SRR_RL_Clu_Vel_48 : 386|11@0+ (0.1,-111.11) [-111.11|55.59] "mps" Vector__XXX
 SG_ S4_SRR_RL_Clu_SNR_48 : 407|7@0+ (0.5,0) [0|63.5] "dB" Vector__XXX
 SG_ S4_SRR_RL_Clu_RCS_48 : 400|5@0+ (2,-40) [-40|22] "" Vector__XXX
 SG_ S4_SRR_RL_Clu_DynProp_48 : 411|1@0+ (1,0) [0|1] "Unitless" Vector__XXX
 SG_ S4_SRR_RL_Clu_Locationvalid_48 : 410|1@0+ (1,0) [0|1] "" Vector__XXX
 SG_ S4_SRR_RL_Clu_Mes_6_blockcounter : 503|4@0+ (1,0) [0|15] "" Vector__XXX
 SG_ S4_SRR_RL_Clu_6_MsgCounter : 499|4@0+ (1,0) [0|14] "" Vector__XXX
 SG_ S4_SRR_RL_Clu_6_E2EChecksum : 511|8@0+ (1,0) [0|255] "" Vector__XXX

BO_ 592 S4_SRR_RL_Clu_Mes_7: 64 SRR_RL
 SG_ S4_SRR_RL_Clu_ID_49 : 7|8@0+ (1,0) [0|199] "" Vector__XXX
 SG_ S4_SRR_RL_Clu_Theta_49 : 15|9@0+ (0.0062,-1.571) [-1.571|1.5972] "rad" Vector__XXX
 SG_ S4_SRR_RL_Clu_Dist_49 : 22|12@0+ (0.1,0.4) [0.4|300] "m" Vector__XXX
 SG_ S4_SRR_RL_Clu_Vel_49 : 26|11@0+ (0.1,-111.11) [-111.11|55.59] "mps" Vector__XXX
 SG_ S4_SRR_RL_Clu_SNR_49 : 47|7@0+ (0.5,0) [0|63.5] "dB" Vector__XXX
 SG_ S4_SRR_RL_Clu_RCS_49 : 40|5@0+ (2,-40) [-40|22] "" Vector__XXX
 SG_ S4_SRR_RL_Clu_DynProp_49 : 51|1@0+ (1,0) [0|1] "Unitless" Vector__XXX
 SG_ S4_SRR_RL_Clu_Locationvalid_49 : 50|1@0+ (1,0) [0|1] "" Vector__XXX
 SG_ S4_SRR_RL_Clu_ID_50 : 59|8@0+ (1,0) [0|199] "" Vector__XXX
 SG_ S4_SRR_RL_Clu_Theta_50 : 67|9@0+ (0.0062,-1.571) [-1.571|1.5972] "rad" Vector__XXX
 SG_ S4_SRR_RL_Clu_Dist_50 : 74|12@0+ (0.1,0.4) [0.4|300] "m" Vector__XXX
 SG_ S4_SRR_RL_Clu_Vel_50 : 94|11@0+ (0.1,-111.11) [-111.11|55.59] "mps" Vector__XXX
 SG_ S4_SRR_RL_Clu_SNR_50 : 99|7@0+ (0.5,0) [0|63.5] "dB" Vector__XXX
 SG_ S4_SRR_RL_Clu_RCS_50 : 108|5@0+ (2,-40) [-40|22] "" Vector__XXX
 SG_ S4_SRR_RL_Clu_DynProp_50 : 119|1@0+ (1,0) [0|1] "Unitless" Vector__XXX
 SG_ S4_SRR_RL_Clu_Locationvalid_50 : 118|1@0+ (1,0) [0|1] "" Vector__XXX
 SG_ S4_SRR_RL_Clu_ID_51 : 127|8@0+ (1,0) [0|199] "" Vector__XXX
 SG_ S4_SRR_RL_Clu_Theta_51 : 135|9@0+ (0.0062,-1.571) [-1.571|1.5972] "rad" Vector__XXX
 SG_ S4_SRR_RL_Clu_Dist_51 : 142|12@0+ (0.1,0.4) [0.4|300] "m" Vector__XXX
 SG_ S4_SRR_RL_Clu_Vel_51 : 146|11@0+ (0.1,-111.11) [-111.11|55.59] "mps" Vector__XXX
 SG_ S4_SRR_RL_Clu_SNR_51 : 167|7@0+ (0.5,0) [0|63.5] "dB" Vector__XXX
 SG_ S4_SRR_RL_Clu_RCS_51 : 160|5@0+ (2,-40) [-40|22] "" Vector__XXX
 SG_ S4_SRR_RL_Clu_DynProp_51 : 171|1@0+ (1,0) [0|1] "Unitless" Vector__XXX
 SG_ S4_SRR_RL_Clu_Locationvalid_51 : 170|1@0+ (1,0) [0|1] "" Vector__XXX
 SG_ S4_SRR_RL_Clu_ID_52 : 179|8@0+ (1,0) [0|199] "" Vector__XXX
 SG_ S4_SRR_RL_Clu_Theta_52 : 187|9@0+ (0.0062,-1.571) [-1.571|1.5972] "rad" Vector__XXX
 SG_ S4_SRR_RL_Clu_Dist_52 : 194|12@0+ (0.1,0.4) [0.4|300] "m" Vector__XXX
 SG_ S4_SRR_RL_Clu_Vel_52 : 214|11@0+ (0.1,-111.11) [-111.11|55.59] "mps" Vector__XXX
 SG_ S4_SRR_RL_Clu_SNR_52 : 219|7@0+ (0.5,0) [0|63.5] "dB" Vector__XXX
 SG_ S4_SRR_RL_Clu_RCS_52 : 228|5@0+ (2,-40) [-40|22] "" Vector__XXX
 SG_ S4_SRR_RL_Clu_DynProp_52 : 239|1@0+ (1,0) [0|1] "Unitless" Vector__XXX
 SG_ S4_SRR_RL_Clu_Locationvalid_52 : 238|1@0+ (1,0) [0|1] "" Vector__XXX
 SG_ S4_SRR_RL_Clu_ID_53 : 247|8@0+ (1,0) [0|199] "" Vector__XXX
 SG_ S4_SRR_RL_Clu_Theta_53 : 255|9@0+ (0.0062,-1.571) [-1.571|1.5972] "rad" Vector__XXX
 SG_ S4_SRR_RL_Clu_Dist_53 : 262|12@0+ (0.1,0.4) [0.4|300] "m" Vector__XXX
 SG_ S4_SRR_RL_Clu_Vel_53 : 266|11@0+ (0.1,-111.11) [-111.11|55.59] "mps" Vector__XXX
 SG_ S4_SRR_RL_Clu_SNR_53 : 287|7@0+ (0.5,0) [0|63.5] "dB" Vector__XXX
 SG_ S4_SRR_RL_Clu_RCS_53 : 280|5@0+ (2,-40) [-40|22] "" Vector__XXX
 SG_ S4_SRR_RL_Clu_DynProp_53 : 291|1@0+ (1,0) [0|1] "Unitless" Vector__XXX
 SG_ S4_SRR_RL_Clu_Locationvalid_53 : 290|1@0+ (1,0) [0|1] "" Vector__XXX
 SG_ S4_SRR_RL_Clu_ID_54 : 299|8@0+ (1,0) [0|199] "" Vector__XXX
 SG_ S4_SRR_RL_Clu_Theta_54 : 307|9@0+ (0.0062,-1.571) [-1.571|1.5972] "rad" Vector__XXX
 SG_ S4_SRR_RL_Clu_Dist_54 : 314|12@0+ (0.1,0.4) [0.4|300] "m" Vector__XXX
 SG_ S4_SRR_RL_Clu_Vel_54 : 334|11@0+ (0.1,-111.11) [-111.11|55.59] "mps" Vector__XXX
 SG_ S4_SRR_RL_Clu_SNR_54 : 339|7@0+ (0.5,0) [0|63.5] "dB" Vector__XXX
 SG_ S4_SRR_RL_Clu_RCS_54 : 348|5@0+ (2,-40) [-40|22] "" Vector__XXX
 SG_ S4_SRR_RL_Clu_DynProp_54 : 359|1@0+ (1,0) [0|1] "Unitless" Vector__XXX
 SG_ S4_SRR_RL_Clu_Locationvalid_54 : 358|1@0+ (1,0) [0|1] "" Vector__XXX
 SG_ S4_SRR_RL_Clu_ID_55 : 367|8@0+ (1,0) [0|199] "" Vector__XXX
 SG_ S4_SRR_RL_Clu_Theta_55 : 375|9@0+ (0.0062,-1.571) [-1.571|1.5972] "rad" Vector__XXX
 SG_ S4_SRR_RL_Clu_Dist_55 : 382|12@0+ (0.1,0.4) [0.4|300] "m" Vector__XXX
 SG_ S4_SRR_RL_Clu_Vel_55 : 386|11@0+ (0.1,-111.11) [-111.11|55.59] "mps" Vector__XXX
 SG_ S4_SRR_RL_Clu_SNR_55 : 407|7@0+ (0.5,0) [0|63.5] "dB" Vector__XXX
 SG_ S4_SRR_RL_Clu_RCS_55 : 400|5@0+ (2,-40) [-40|22] "" Vector__XXX
 SG_ S4_SRR_RL_Clu_DynProp_55 : 411|1@0+ (1,0) [0|1] "Unitless" Vector__XXX
 SG_ S4_SRR_RL_Clu_Locationvalid_55 : 410|1@0+ (1,0) [0|1] "" Vector__XXX
 SG_ S4_SRR_RL_Clu_Mes_7_blockcounter : 503|4@0+ (1,0) [0|15] "" Vector__XXX
 SG_ S4_SRR_RL_Clu_7_MsgCounter : 499|4@0+ (1,0) [0|14] "" Vector__XXX
 SG_ S4_SRR_RL_Clu_7_E2EChecksum : 511|8@0+ (1,0) [0|255] "" Vector__XXX

BO_ 593 S4_SRR_RL_Clu_Mes_8: 64 SRR_RL
 SG_ S4_SRR_RL_Clu_ID_56 : 7|8@0+ (1,0) [0|199] "" Vector__XXX
 SG_ S4_SRR_RL_Clu_Theta_56 : 15|9@0+ (0.0062,-1.571) [-1.571|1.5972] "rad" Vector__XXX
 SG_ S4_SRR_RL_Clu_Dist_56 : 22|12@0+ (0.1,0.4) [0.4|300] "m" Vector__XXX
 SG_ S4_SRR_RL_Clu_Vel_56 : 26|11@0+ (0.1,-111.11) [-111.11|55.59] "mps" Vector__XXX
 SG_ S4_SRR_RL_Clu_SNR_56 : 47|7@0+ (0.5,0) [0|63.5] "dB" Vector__XXX
 SG_ S4_SRR_RL_Clu_RCS_56 : 40|5@0+ (2,-40) [-40|22] "" Vector__XXX
 SG_ S4_SRR_RL_Clu_DynProp_56 : 51|1@0+ (1,0) [0|1] "Unitless" Vector__XXX
 SG_ S4_SRR_RL_Clu_Locationvalid_56 : 50|1@0+ (1,0) [0|1] "" Vector__XXX
 SG_ S4_SRR_RL_Clu_ID_57 : 59|8@0+ (1,0) [0|199] "" Vector__XXX
 SG_ S4_SRR_RL_Clu_Theta_57 : 67|9@0+ (0.0062,-1.571) [-1.571|1.5972] "rad" Vector__XXX
 SG_ S4_SRR_RL_Clu_Dist_57 : 74|12@0+ (0.1,0.4) [0.4|300] "m" Vector__XXX
 SG_ S4_SRR_RL_Clu_Vel_57 : 94|11@0+ (0.1,-111.11) [-111.11|55.59] "mps" Vector__XXX
 SG_ S4_SRR_RL_Clu_SNR_57 : 99|7@0+ (0.5,0) [0|63.5] "dB" Vector__XXX
 SG_ S4_SRR_RL_Clu_RCS_57 : 108|5@0+ (2,-40) [-40|22] "" Vector__XXX
 SG_ S4_SRR_RL_Clu_DynProp_57 : 119|1@0+ (1,0) [0|1] "Unitless" Vector__XXX
 SG_ S4_SRR_RL_Clu_Locationvalid_57 : 118|1@0+ (1,0) [0|1] "" Vector__XXX
 SG_ S4_SRR_RL_Clu_ID_58 : 127|8@0+ (1,0) [0|199] "" Vector__XXX
 SG_ S4_SRR_RL_Clu_Theta_58 : 135|9@0+ (0.0062,-1.571) [-1.571|1.5972] "rad" Vector__XXX
 SG_ S4_SRR_RL_Clu_Dist_58 : 142|12@0+ (0.1,0.4) [0.4|300] "m" Vector__XXX
 SG_ S4_SRR_RL_Clu_Vel_58 : 146|11@0+ (0.1,-111.11) [-111.11|55.59] "mps" Vector__XXX
 SG_ S4_SRR_RL_Clu_SNR_58 : 167|7@0+ (0.5,0) [0|63.5] "dB" Vector__XXX
 SG_ S4_SRR_RL_Clu_RCS_58 : 160|5@0+ (2,-40) [-40|22] "" Vector__XXX
 SG_ S4_SRR_RL_Clu_DynProp_58 : 171|1@0+ (1,0) [0|1] "Unitless" Vector__XXX
 SG_ S4_SRR_RL_Clu_Locationvalid_58 : 170|1@0+ (1,0) [0|1] "" Vector__XXX
 SG_ S4_SRR_RL_Clu_ID_59 : 179|8@0+ (1,0) [0|199] "" Vector__XXX
 SG_ S4_SRR_RL_Clu_Theta_59 : 187|9@0+ (0.0062,-1.571) [-1.571|1.5972] "rad" Vector__XXX
 SG_ S4_SRR_RL_Clu_Dist_59 : 194|12@0+ (0.1,0.4) [0.4|300] "m" Vector__XXX
 SG_ S4_SRR_RL_Clu_Vel_59 : 214|11@0+ (0.1,-111.11) [-111.11|55.59] "mps" Vector__XXX
 SG_ S4_SRR_RL_Clu_SNR_59 : 219|7@0+ (0.5,0) [0|63.5] "dB" Vector__XXX
 SG_ S4_SRR_RL_Clu_RCS_59 : 228|5@0+ (2,-40) [-40|22] "" Vector__XXX
 SG_ S4_SRR_RL_Clu_DynProp_59 : 239|1@0+ (1,0) [0|1] "Unitless" Vector__XXX
 SG_ S4_SRR_RL_Clu_Locationvalid_59 : 238|1@0+ (1,0) [0|1] "" Vector__XXX
 SG_ S4_SRR_RL_Clu_ID_60 : 247|8@0+ (1,0) [0|199] "" Vector__XXX
 SG_ S4_SRR_RL_Clu_Theta_60 : 255|9@0+ (0.0062,-1.571) [-1.571|1.5972] "rad" Vector__XXX
 SG_ S4_SRR_RL_Clu_Dist_60 : 262|12@0+ (0.1,0.4) [0.4|300] "m" Vector__XXX
 SG_ S4_SRR_RL_Clu_Vel_60 : 266|11@0+ (0.1,-111.11) [-111.11|55.59] "mps" Vector__XXX
 SG_ S4_SRR_RL_Clu_SNR_60 : 287|7@0+ (0.5,0) [0|63.5] "dB" Vector__XXX
 SG_ S4_SRR_RL_Clu_RCS_60 : 280|5@0+ (2,-40) [-40|22] "" Vector__XXX
 SG_ S4_SRR_RL_Clu_DynProp_60 : 291|1@0+ (1,0) [0|1] "Unitless" Vector__XXX
 SG_ S4_SRR_RL_Clu_Locationvalid_60 : 290|1@0+ (1,0) [0|1] "" Vector__XXX
 SG_ S4_SRR_RL_Clu_ID_61 : 299|8@0+ (1,0) [0|199] "" Vector__XXX
 SG_ S4_SRR_RL_Clu_Theta_61 : 307|9@0+ (0.0062,-1.571) [-1.571|1.5972] "rad" Vector__XXX
 SG_ S4_SRR_RL_Clu_Dist_61 : 314|12@0+ (0.1,0.4) [0.4|300] "m" Vector__XXX
 SG_ S4_SRR_RL_Clu_Vel_61 : 334|11@0+ (0.1,-111.11) [-111.11|55.59] "mps" Vector__XXX
 SG_ S4_SRR_RL_Clu_SNR_61 : 339|7@0+ (0.5,0) [0|63.5] "dB" Vector__XXX
 SG_ S4_SRR_RL_Clu_RCS_61 : 348|5@0+ (2,-40) [-40|22] "" Vector__XXX
 SG_ S4_SRR_RL_Clu_DynProp_61 : 359|1@0+ (1,0) [0|1] "Unitless" Vector__XXX
 SG_ S4_SRR_RL_Clu_Locationvalid_61 : 358|1@0+ (1,0) [0|1] "" Vector__XXX
 SG_ S4_SRR_RL_Clu_ID_62 : 367|8@0+ (1,0) [0|199] "" Vector__XXX
 SG_ S4_SRR_RL_Clu_Theta_62 : 375|9@0+ (0.0062,-1.571) [-1.571|1.5972] "rad" Vector__XXX
 SG_ S4_SRR_RL_Clu_Dist_62 : 382|12@0+ (0.1,0.4) [0.4|300] "m" Vector__XXX
 SG_ S4_SRR_RL_Clu_Vel_62 : 386|11@0+ (0.1,-111.11) [-111.11|55.59] "mps" Vector__XXX
 SG_ S4_SRR_RL_Clu_SNR_62 : 407|7@0+ (0.5,0) [0|63.5] "dB" Vector__XXX
 SG_ S4_SRR_RL_Clu_RCS_62 : 400|5@0+ (2,-40) [-40|22] "" Vector__XXX
 SG_ S4_SRR_RL_Clu_DynProp_62 : 411|1@0+ (1,0) [0|1] "Unitless" Vector__XXX
 SG_ S4_SRR_RL_Clu_Locationvalid_62 : 410|1@0+ (1,0) [0|1] "" Vector__XXX
 SG_ S4_SRR_RL_Clu_Mes_8_blockcounter : 503|4@0+ (1,0) [0|15] "" Vector__XXX
 SG_ S4_SRR_RL_Clu_8_MsgCounter : 499|4@0+ (1,0) [0|14] "" Vector__XXX
 SG_ S4_SRR_RL_Clu_8_E2EChecksum : 511|8@0+ (1,0) [0|255] "" Vector__XXX

BO_ 594 S4_SRR_RL_Clu_Mes_9: 64 SRR_RL
 SG_ S4_SRR_RL_Clu_ID_63 : 7|8@0+ (1,0) [0|199] "" Vector__XXX
 SG_ S4_SRR_RL_Clu_Theta_63 : 15|9@0+ (0.0062,-1.571) [-1.571|1.5972] "rad" Vector__XXX
 SG_ S4_SRR_RL_Clu_Dist_63 : 22|12@0+ (0.1,0.4) [0.4|300] "m" Vector__XXX
 SG_ S4_SRR_RL_Clu_Vel_63 : 26|11@0+ (0.1,-111.11) [-111.11|55.59] "mps" Vector__XXX
 SG_ S4_SRR_RL_Clu_SNR_63 : 47|7@0+ (0.5,0) [0|63.5] "dB" Vector__XXX
 SG_ S4_SRR_RL_Clu_RCS_63 : 40|5@0+ (2,-40) [-40|22] "" Vector__XXX
 SG_ S4_SRR_RL_Clu_DynProp_63 : 51|1@0+ (1,0) [0|1] "Unitless" Vector__XXX
 SG_ S4_SRR_RL_Clu_Locationvalid_63 : 50|1@0+ (1,0) [0|1] "" Vector__XXX
 SG_ S4_SRR_RL_Clu_ID_64 : 59|8@0+ (1,0) [0|199] "" Vector__XXX
 SG_ S4_SRR_RL_Clu_Theta_64 : 67|9@0+ (0.0062,-1.571) [-1.571|1.5972] "rad" Vector__XXX
 SG_ S4_SRR_RL_Clu_Dist_64 : 74|12@0+ (0.1,0.4) [0.4|300] "m" Vector__XXX
 SG_ S4_SRR_RL_Clu_Vel_64 : 94|11@0+ (0.1,-111.11) [-111.11|55.59] "mps" Vector__XXX
 SG_ S4_SRR_RL_Clu_SNR_64 : 99|7@0+ (0.5,0) [0|63.5] "dB" Vector__XXX
 SG_ S4_SRR_RL_Clu_RCS_64 : 108|5@0+ (2,-40) [-40|22] "" Vector__XXX
 SG_ S4_SRR_RL_Clu_DynProp_64 : 119|1@0+ (1,0) [0|1] "Unitless" Vector__XXX
 SG_ S4_SRR_RL_Clu_Locationvalid_64 : 118|1@0+ (1,0) [0|1] "" Vector__XXX
 SG_ S4_SRR_RL_Clu_ID_65 : 127|8@0+ (1,0) [0|199] "" Vector__XXX
 SG_ S4_SRR_RL_Clu_Theta_65 : 135|9@0+ (0.0062,-1.571) [-1.571|1.5972] "rad" Vector__XXX
 SG_ S4_SRR_RL_Clu_Dist_65 : 142|12@0+ (0.1,0.4) [0.4|300] "m" Vector__XXX
 SG_ S4_SRR_RL_Clu_Vel_65 : 146|11@0+ (0.1,-111.11) [-111.11|55.59] "mps" Vector__XXX
 SG_ S4_SRR_RL_Clu_SNR_65 : 167|7@0+ (0.5,0) [0|63.5] "dB" Vector__XXX
 SG_ S4_SRR_RL_Clu_RCS_65 : 160|5@0+ (2,-40) [-40|22] "" Vector__XXX
 SG_ S4_SRR_RL_Clu_DynProp_65 : 171|1@0+ (1,0) [0|1] "Unitless" Vector__XXX
 SG_ S4_SRR_RL_Clu_Locationvalid_65 : 170|1@0+ (1,0) [0|1] "" Vector__XXX
 SG_ S4_SRR_RL_Clu_ID_66 : 179|8@0+ (1,0) [0|199] "" Vector__XXX
 SG_ S4_SRR_RL_Clu_Theta_66 : 187|9@0+ (0.0062,-1.571) [-1.571|1.5972] "rad" Vector__XXX
 SG_ S4_SRR_RL_Clu_Dist_66 : 194|12@0+ (0.1,0.4) [0.4|300] "m" Vector__XXX
 SG_ S4_SRR_RL_Clu_Vel_66 : 214|11@0+ (0.1,-111.11) [-111.11|55.59] "mps" Vector__XXX
 SG_ S4_SRR_RL_Clu_SNR_66 : 219|7@0+ (0.5,0) [0|63.5] "dB" Vector__XXX
 SG_ S4_SRR_RL_Clu_RCS_66 : 228|5@0+ (2,-40) [-40|22] "" Vector__XXX
 SG_ S4_SRR_RL_Clu_DynProp_66 : 239|1@0+ (1,0) [0|1] "Unitless" Vector__XXX
 SG_ S4_SRR_RL_Clu_Locationvalid_66 : 238|1@0+ (1,0) [0|1] "" Vector__XXX
 SG_ S4_SRR_RL_Clu_ID_67 : 247|8@0+ (1,0) [0|199] "" Vector__XXX
 SG_ S4_SRR_RL_Clu_Theta_67 : 255|9@0+ (0.0062,-1.571) [-1.571|1.5972] "rad" Vector__XXX
 SG_ S4_SRR_RL_Clu_Dist_67 : 262|12@0+ (0.1,0.4) [0.4|300] "m" Vector__XXX
 SG_ S4_SRR_RL_Clu_Vel_67 : 266|11@0+ (0.1,-111.11) [-111.11|55.59] "mps" Vector__XXX
 SG_ S4_SRR_RL_Clu_SNR_67 : 287|7@0+ (0.5,0) [0|63.5] "dB" Vector__XXX
 SG_ S4_SRR_RL_Clu_RCS_67 : 280|5@0+ (2,-40) [-40|22] "" Vector__XXX
 SG_ S4_SRR_RL_Clu_DynProp_67 : 291|1@0+ (1,0) [0|1] "Unitless" Vector__XXX
 SG_ S4_SRR_RL_Clu_Locationvalid_67 : 290|1@0+ (1,0) [0|1] "" Vector__XXX
 SG_ S4_SRR_RL_Clu_ID_68 : 299|8@0+ (1,0) [0|199] "" Vector__XXX
 SG_ S4_SRR_RL_Clu_Theta_68 : 307|9@0+ (0.0062,-1.571) [-1.571|1.5972] "rad" Vector__XXX
 SG_ S4_SRR_RL_Clu_Dist_68 : 314|12@0+ (0.1,0.4) [0.4|300] "m" Vector__XXX
 SG_ S4_SRR_RL_Clu_Vel_68 : 334|11@0+ (0.1,-111.11) [-111.11|55.59] "mps" Vector__XXX
 SG_ S4_SRR_RL_Clu_SNR_68 : 339|7@0+ (0.5,0) [0|63.5] "dB" Vector__XXX
 SG_ S4_SRR_RL_Clu_RCS_68 : 348|5@0+ (2,-40) [-40|22] "" Vector__XXX
 SG_ S4_SRR_RL_Clu_DynProp_68 : 359|1@0+ (1,0) [0|1] "Unitless" Vector__XXX
 SG_ S4_SRR_RL_Clu_Locationvalid_68 : 358|1@0+ (1,0) [0|1] "" Vector__XXX
 SG_ S4_SRR_RL_Clu_ID_69 : 367|8@0+ (1,0) [0|199] "" Vector__XXX
 SG_ S4_SRR_RL_Clu_Theta_69 : 375|9@0+ (0.0062,-1.571) [-1.571|1.5972] "rad" Vector__XXX
 SG_ S4_SRR_RL_Clu_Dist_69 : 382|12@0+ (0.1,0.4) [0.4|300] "m" Vector__XXX
 SG_ S4_SRR_RL_Clu_Vel_69 : 386|11@0+ (0.1,-111.11) [-111.11|55.59] "mps" Vector__XXX
 SG_ S4_SRR_RL_Clu_SNR_69 : 407|7@0+ (0.5,0) [0|63.5] "dB" Vector__XXX
 SG_ S4_SRR_RL_Clu_RCS_69 : 400|5@0+ (2,-40) [-40|22] "" Vector__XXX
 SG_ S4_SRR_RL_Clu_DynProp_69 : 411|1@0+ (1,0) [0|1] "Unitless" Vector__XXX
 SG_ S4_SRR_RL_Clu_Locationvalid_69 : 410|1@0+ (1,0) [0|1] "" Vector__XXX
 SG_ S4_SRR_RL_Clu_Mes_9_blockcounter : 503|4@0+ (1,0) [0|15] "" Vector__XXX
 SG_ S4_SRR_RL_Clu_9_MsgCounter : 499|4@0+ (1,0) [0|14] "" Vector__XXX
 SG_ S4_SRR_RL_Clu_9_E2EChecksum : 511|8@0+ (1,0) [0|255] "" Vector__XXX

BO_ 595 S4_SRR_RL_Clu_Mes_10: 64 SRR_RL
 SG_ S4_SRR_RL_Clu_ID_70 : 7|8@0+ (1,0) [0|199] "" Vector__XXX
 SG_ S4_SRR_RL_Clu_Theta_70 : 15|9@0+ (0.0062,-1.571) [-1.571|1.5972] "rad" Vector__XXX
 SG_ S4_SRR_RL_Clu_Dist_70 : 22|12@0+ (0.1,0.4) [0.4|300] "m" Vector__XXX
 SG_ S4_SRR_RL_Clu_Vel_70 : 26|11@0+ (0.1,-111.11) [-111.11|55.59] "mps" Vector__XXX
 SG_ S4_SRR_RL_Clu_SNR_70 : 47|7@0+ (0.5,0) [0|63.5] "dB" Vector__XXX
 SG_ S4_SRR_RL_Clu_RCS_70 : 40|5@0+ (2,-40) [-40|22] "" Vector__XXX
 SG_ S4_SRR_RL_Clu_DynProp_70 : 51|1@0+ (1,0) [0|1] "Unitless" Vector__XXX
 SG_ S4_SRR_RL_Clu_Locationvalid_70 : 50|1@0+ (1,0) [0|1] "" Vector__XXX
 SG_ S4_SRR_RL_Clu_ID_71 : 59|8@0+ (1,0) [0|199] "" Vector__XXX
 SG_ S4_SRR_RL_Clu_Theta_71 : 67|9@0+ (0.0062,-1.571) [-1.571|1.5972] "rad" Vector__XXX
 SG_ S4_SRR_RL_Clu_Dist_71 : 74|12@0+ (0.1,0.4) [0.4|300] "m" Vector__XXX
 SG_ S4_SRR_RL_Clu_Vel_71 : 94|11@0+ (0.1,-111.11) [-111.11|55.59] "mps" Vector__XXX
 SG_ S4_SRR_RL_Clu_SNR_71 : 99|7@0+ (0.5,0) [0|63.5] "dB" Vector__XXX
 SG_ S4_SRR_RL_Clu_RCS_71 : 108|5@0+ (2,-40) [-40|22] "" Vector__XXX
 SG_ S4_SRR_RL_Clu_DynProp_71 : 119|1@0+ (1,0) [0|1] "Unitless" Vector__XXX
 SG_ S4_SRR_RL_Clu_Locationvalid_71 : 118|1@0+ (1,0) [0|1] "" Vector__XXX
 SG_ S4_SRR_RL_Clu_ID_72 : 127|8@0+ (1,0) [0|199] "" Vector__XXX
 SG_ S4_SRR_RL_Clu_Theta_72 : 135|9@0+ (0.0062,-1.571) [-1.571|1.5972] "rad" Vector__XXX
 SG_ S4_SRR_RL_Clu_Dist_72 : 142|12@0+ (0.1,0.4) [0.4|300] "m" Vector__XXX
 SG_ S4_SRR_RL_Clu_Vel_72 : 146|11@0+ (0.1,-111.11) [-111.11|55.59] "mps" Vector__XXX
 SG_ S4_SRR_RL_Clu_SNR_72 : 167|7@0+ (0.5,0) [0|63.5] "dB" Vector__XXX
 SG_ S4_SRR_RL_Clu_RCS_72 : 160|5@0+ (2,-40) [-40|22] "" Vector__XXX
 SG_ S4_SRR_RL_Clu_DynProp_72 : 171|1@0+ (1,0) [0|1] "Unitless" Vector__XXX
 SG_ S4_SRR_RL_Clu_Locationvalid_72 : 170|1@0+ (1,0) [0|1] "" Vector__XXX
 SG_ S4_SRR_RL_Clu_ID_73 : 179|8@0+ (1,0) [0|199] "" Vector__XXX
 SG_ S4_SRR_RL_Clu_Theta_73 : 187|9@0+ (0.0062,-1.571) [-1.571|1.5972] "rad" Vector__XXX
 SG_ S4_SRR_RL_Clu_Dist_73 : 194|12@0+ (0.1,0.4) [0.4|300] "m" Vector__XXX
 SG_ S4_SRR_RL_Clu_Vel_73 : 214|11@0+ (0.1,-111.11) [-111.11|55.59] "mps" Vector__XXX
 SG_ S4_SRR_RL_Clu_SNR_73 : 219|7@0+ (0.5,0) [0|63.5] "dB" Vector__XXX
 SG_ S4_SRR_RL_Clu_RCS_73 : 228|5@0+ (2,-40) [-40|22] "" Vector__XXX
 SG_ S4_SRR_RL_Clu_DynProp_73 : 239|1@0+ (1,0) [0|1] "Unitless" Vector__XXX
 SG_ S4_SRR_RL_Clu_Locationvalid_73 : 238|1@0+ (1,0) [0|1] "" Vector__XXX
 SG_ S4_SRR_RL_Clu_ID_74 : 247|8@0+ (1,0) [0|199] "" Vector__XXX
 SG_ S4_SRR_RL_Clu_Theta_74 : 255|9@0+ (0.0062,-1.571) [-1.571|1.5972] "rad" Vector__XXX
 SG_ S4_SRR_RL_Clu_Dist_74 : 262|12@0+ (0.1,0.4) [0.4|300] "m" Vector__XXX
 SG_ S4_SRR_RL_Clu_Vel_74 : 266|11@0+ (0.1,-111.11) [-111.11|55.59] "mps" Vector__XXX
 SG_ S4_SRR_RL_Clu_SNR_74 : 287|7@0+ (0.5,0) [0|63.5] "dB" Vector__XXX
 SG_ S4_SRR_RL_Clu_RCS_74 : 280|5@0+ (2,-40) [-40|22] "" Vector__XXX
 SG_ S4_SRR_RL_Clu_DynProp_74 : 291|1@0+ (1,0) [0|1] "Unitless" Vector__XXX
 SG_ S4_SRR_RL_Clu_Locationvalid_74 : 290|1@0+ (1,0) [0|1] "" Vector__XXX
 SG_ S4_SRR_RL_Clu_ID_75 : 299|8@0+ (1,0) [0|199] "" Vector__XXX
 SG_ S4_SRR_RL_Clu_Theta_75 : 307|9@0+ (0.0062,-1.571) [-1.571|1.5972] "rad" Vector__XXX
 SG_ S4_SRR_RL_Clu_Dist_75 : 314|12@0+ (0.1,0.4) [0.4|300] "m" Vector__XXX
 SG_ S4_SRR_RL_Clu_Vel_75 : 334|11@0+ (0.1,-111.11) [-111.11|55.59] "mps" Vector__XXX
 SG_ S4_SRR_RL_Clu_SNR_75 : 339|7@0+ (0.5,0) [0|63.5] "dB" Vector__XXX
 SG_ S4_SRR_RL_Clu_RCS_75 : 348|5@0+ (2,-40) [-40|22] "" Vector__XXX
 SG_ S4_SRR_RL_Clu_DynProp_75 : 359|1@0+ (1,0) [0|1] "Unitless" Vector__XXX
 SG_ S4_SRR_RL_Clu_Locationvalid_75 : 358|1@0+ (1,0) [0|1] "" Vector__XXX
 SG_ S4_SRR_RL_Clu_ID_76 : 367|8@0+ (1,0) [0|199] "" Vector__XXX
 SG_ S4_SRR_RL_Clu_Theta_76 : 375|9@0+ (0.0062,-1.571) [-1.571|1.5972] "rad" Vector__XXX
 SG_ S4_SRR_RL_Clu_Dist_76 : 382|12@0+ (0.1,0.4) [0.4|300] "m" Vector__XXX
 SG_ S4_SRR_RL_Clu_Vel_76 : 386|11@0+ (0.1,-111.11) [-111.11|55.59] "mps" Vector__XXX
 SG_ S4_SRR_RL_Clu_SNR_76 : 407|7@0+ (0.5,0) [0|63.5] "dB" Vector__XXX
 SG_ S4_SRR_RL_Clu_RCS_76 : 400|5@0+ (2,-40) [-40|22] "" Vector__XXX
 SG_ S4_SRR_RL_Clu_DynProp_76 : 411|1@0+ (1,0) [0|1] "Unitless" Vector__XXX
 SG_ S4_SRR_RL_Clu_Locationvalid_76 : 410|1@0+ (1,0) [0|1] "" Vector__XXX
 SG_ S4_SRR_RL_Clu_Mes_10_blockcounter : 503|4@0+ (1,0) [0|15] "" Vector__XXX
 SG_ S4_SRR_RL_Clu_10_MsgCounter : 499|4@0+ (1,0) [0|14] "" Vector__XXX
 SG_ S4_SRR_RL_Clu_10_E2EChecksum : 511|8@0+ (1,0) [0|255] "" Vector__XXX

BO_ 596 S4_SRR_RL_Clu_Mes_11: 64 SRR_RL
 SG_ S4_SRR_RL_Clu_ID_77 : 7|8@0+ (1,0) [0|199] "" Vector__XXX
 SG_ S4_SRR_RL_Clu_Theta_77 : 15|9@0+ (0.0062,-1.571) [-1.571|1.5972] "rad" Vector__XXX
 SG_ S4_SRR_RL_Clu_Dist_77 : 22|12@0+ (0.1,0.4) [0.4|300] "m" Vector__XXX
 SG_ S4_SRR_RL_Clu_Vel_77 : 26|11@0+ (0.1,-111.11) [-111.11|55.59] "mps" Vector__XXX
 SG_ S4_SRR_RL_Clu_SNR_77 : 47|7@0+ (0.5,0) [0|63.5] "dB" Vector__XXX
 SG_ S4_SRR_RL_Clu_RCS_77 : 40|5@0+ (2,-40) [-40|22] "" Vector__XXX
 SG_ S4_SRR_RL_Clu_DynProp_77 : 51|1@0+ (1,0) [0|1] "Unitless" Vector__XXX
 SG_ S4_SRR_RL_Clu_Locationvalid_77 : 50|1@0+ (1,0) [0|1] "" Vector__XXX
 SG_ S4_SRR_RL_Clu_ID_78 : 59|8@0+ (1,0) [0|199] "" Vector__XXX
 SG_ S4_SRR_RL_Clu_Theta_78 : 67|9@0+ (0.0062,-1.571) [-1.571|1.5972] "rad" Vector__XXX
 SG_ S4_SRR_RL_Clu_Dist_78 : 74|12@0+ (0.1,0.4) [0.4|300] "m" Vector__XXX
 SG_ S4_SRR_RL_Clu_Vel_78 : 94|11@0+ (0.1,-111.11) [-111.11|55.59] "mps" Vector__XXX
 SG_ S4_SRR_RL_Clu_SNR_78 : 99|7@0+ (0.5,0) [0|63.5] "dB" Vector__XXX
 SG_ S4_SRR_RL_Clu_RCS_78 : 108|5@0+ (2,-40) [-40|22] "" Vector__XXX
 SG_ S4_SRR_RL_Clu_DynProp_78 : 119|1@0+ (1,0) [0|1] "Unitless" Vector__XXX
 SG_ S4_SRR_RL_Clu_Locationvalid_78 : 118|1@0+ (1,0) [0|1] "" Vector__XXX
 SG_ S4_SRR_RL_Clu_ID_79 : 127|8@0+ (1,0) [0|199] "" Vector__XXX
 SG_ S4_SRR_RL_Clu_Theta_79 : 135|9@0+ (0.0062,-1.571) [-1.571|1.5972] "rad" Vector__XXX
 SG_ S4_SRR_RL_Clu_Dist_79 : 142|12@0+ (0.1,0.4) [0.4|300] "m" Vector__XXX
 SG_ S4_SRR_RL_Clu_Vel_79 : 146|11@0+ (0.1,-111.11) [-111.11|55.59] "mps" Vector__XXX
 SG_ S4_SRR_RL_Clu_SNR_79 : 167|7@0+ (0.5,0) [0|63.5] "dB" Vector__XXX
 SG_ S4_SRR_RL_Clu_RCS_79 : 160|5@0+ (2,-40) [-40|22] "" Vector__XXX
 SG_ S4_SRR_RL_Clu_DynProp_79 : 171|1@0+ (1,0) [0|1] "Unitless" Vector__XXX
 SG_ S4_SRR_RL_Clu_Locationvalid_79 : 170|1@0+ (1,0) [0|1] "" Vector__XXX
 SG_ S4_SRR_RL_Clu_ID_80 : 179|8@0+ (1,0) [0|199] "" Vector__XXX
 SG_ S4_SRR_RL_Clu_Theta_80 : 187|9@0+ (0.0062,-1.571) [-1.571|1.5972] "rad" Vector__XXX
 SG_ S4_SRR_RL_Clu_Dist_80 : 194|12@0+ (0.1,0.4) [0.4|300] "m" Vector__XXX
 SG_ S4_SRR_RL_Clu_Vel_80 : 214|11@0+ (0.1,-111.11) [-111.11|55.59] "mps" Vector__XXX
 SG_ S4_SRR_RL_Clu_SNR_80 : 219|7@0+ (0.5,0) [0|63.5] "dB" Vector__XXX
 SG_ S4_SRR_RL_Clu_RCS_80 : 228|5@0+ (2,-40) [-40|22] "" Vector__XXX
 SG_ S4_SRR_RL_Clu_DynProp_80 : 239|1@0+ (1,0) [0|1] "Unitless" Vector__XXX
 SG_ S4_SRR_RL_Clu_Locationvalid_80 : 238|1@0+ (1,0) [0|1] "" Vector__XXX
 SG_ S4_SRR_RL_Clu_ID_81 : 247|8@0+ (1,0) [0|199] "" Vector__XXX
 SG_ S4_SRR_RL_Clu_Theta_81 : 255|9@0+ (0.0062,-1.571) [-1.571|1.5972] "rad" Vector__XXX
 SG_ S4_SRR_RL_Clu_Dist_81 : 262|12@0+ (0.1,0.4) [0.4|300] "m" Vector__XXX
 SG_ S4_SRR_RL_Clu_Vel_81 : 266|11@0+ (0.1,-111.11) [-111.11|55.59] "mps" Vector__XXX
 SG_ S4_SRR_RL_Clu_SNR_81 : 287|7@0+ (0.5,0) [0|63.5] "dB" Vector__XXX
 SG_ S4_SRR_RL_Clu_RCS_81 : 280|5@0+ (2,-40) [-40|22] "" Vector__XXX
 SG_ S4_SRR_RL_Clu_DynProp_81 : 291|1@0+ (1,0) [0|1] "Unitless" Vector__XXX
 SG_ S4_SRR_RL_Clu_Locationvalid_81 : 290|1@0+ (1,0) [0|1] "" Vector__XXX
 SG_ S4_SRR_RL_Clu_ID_82 : 299|8@0+ (1,0) [0|199] "" Vector__XXX
 SG_ S4_SRR_RL_Clu_Theta_82 : 307|9@0+ (0.0062,-1.571) [-1.571|1.5972] "rad" Vector__XXX
 SG_ S4_SRR_RL_Clu_Dist_82 : 314|12@0+ (0.1,0.4) [0.4|300] "m" Vector__XXX
 SG_ S4_SRR_RL_Clu_Vel_82 : 334|11@0+ (0.1,-111.11) [-111.11|55.59] "mps" Vector__XXX
 SG_ S4_SRR_RL_Clu_SNR_82 : 339|7@0+ (0.5,0) [0|63.5] "dB" Vector__XXX
 SG_ S4_SRR_RL_Clu_RCS_82 : 348|5@0+ (2,-40) [-40|22] "" Vector__XXX
 SG_ S4_SRR_RL_Clu_DynProp_82 : 359|1@0+ (1,0) [0|1] "Unitless" Vector__XXX
 SG_ S4_SRR_RL_Clu_Locationvalid_82 : 358|1@0+ (1,0) [0|1] "" Vector__XXX
 SG_ S4_SRR_RL_Clu_ID_83 : 367|8@0+ (1,0) [0|199] "" Vector__XXX
 SG_ S4_SRR_RL_Clu_Theta_83 : 375|9@0+ (0.0062,-1.571) [-1.571|1.5972] "rad" Vector__XXX
 SG_ S4_SRR_RL_Clu_Dist_83 : 382|12@0+ (0.1,0.4) [0.4|300] "m" Vector__XXX
 SG_ S4_SRR_RL_Clu_Vel_83 : 386|11@0+ (0.1,-111.11) [-111.11|55.59] "mps" Vector__XXX
 SG_ S4_SRR_RL_Clu_SNR_83 : 407|7@0+ (0.5,0) [0|63.5] "dB" Vector__XXX
 SG_ S4_SRR_RL_Clu_RCS_83 : 400|5@0+ (2,-40) [-40|22] "" Vector__XXX
 SG_ S4_SRR_RL_Clu_DynProp_83 : 411|1@0+ (1,0) [0|1] "Unitless" Vector__XXX
 SG_ S4_SRR_RL_Clu_Locationvalid_83 : 410|1@0+ (1,0) [0|1] "" Vector__XXX
 SG_ S4_SRR_RL_Clu_Mes_11_blockcounter : 503|4@0+ (1,0) [0|15] "" Vector__XXX
 SG_ S4_SRR_RL_Clu_11_MsgCounter : 499|4@0+ (1,0) [0|14] "" Vector__XXX
 SG_ S4_SRR_RL_Clu_11_E2EChecksum : 511|8@0+ (1,0) [0|255] "" Vector__XXX

BO_ 597 S4_SRR_RL_Clu_Mes_12: 64 SRR_RL
 SG_ S4_SRR_RL_Clu_ID_84 : 7|8@0+ (1,0) [0|199] "" Vector__XXX
 SG_ S4_SRR_RL_Clu_Theta_84 : 15|9@0+ (0.0062,-1.571) [-1.571|1.5972] "rad" Vector__XXX
 SG_ S4_SRR_RL_Clu_Dist_84 : 22|12@0+ (0.1,0.4) [0.4|300] "m" Vector__XXX
 SG_ S4_SRR_RL_Clu_Vel_84 : 26|11@0+ (0.1,-111.11) [-111.11|55.59] "mps" Vector__XXX
 SG_ S4_SRR_RL_Clu_SNR_84 : 47|7@0+ (0.5,0) [0|63.5] "dB" Vector__XXX
 SG_ S4_SRR_RL_Clu_RCS_84 : 40|5@0+ (2,-40) [-40|22] "" Vector__XXX
 SG_ S4_SRR_RL_Clu_DynProp_84 : 51|1@0+ (1,0) [0|1] "Unitless" Vector__XXX
 SG_ S4_SRR_RL_Clu_Locationvalid_84 : 50|1@0+ (1,0) [0|1] "" Vector__XXX
 SG_ S4_SRR_RL_Clu_ID_85 : 59|8@0+ (1,0) [0|199] "" Vector__XXX
 SG_ S4_SRR_RL_Clu_Theta_85 : 67|9@0+ (0.0062,-1.571) [-1.571|1.5972] "rad" Vector__XXX
 SG_ S4_SRR_RL_Clu_Dist_85 : 74|12@0+ (0.1,0.4) [0.4|300] "m" Vector__XXX
 SG_ S4_SRR_RL_Clu_Vel_85 : 94|11@0+ (0.1,-111.11) [-111.11|55.59] "mps" Vector__XXX
 SG_ S4_SRR_RL_Clu_SNR_85 : 99|7@0+ (0.5,0) [0|63.5] "dB" Vector__XXX
 SG_ S4_SRR_RL_Clu_RCS_85 : 108|5@0+ (2,-40) [-40|22] "" Vector__XXX
 SG_ S4_SRR_RL_Clu_DynProp_85 : 119|1@0+ (1,0) [0|1] "Unitless" Vector__XXX
 SG_ S4_SRR_RL_Clu_Locationvalid_85 : 118|1@0+ (1,0) [0|1] "" Vector__XXX
 SG_ S4_SRR_RL_Clu_ID_86 : 127|8@0+ (1,0) [0|199] "" Vector__XXX
 SG_ S4_SRR_RL_Clu_Theta_86 : 135|9@0+ (0.0062,-1.571) [-1.571|1.5972] "rad" Vector__XXX
 SG_ S4_SRR_RL_Clu_Dist_86 : 142|12@0+ (0.1,0.4) [0.4|300] "m" Vector__XXX
 SG_ S4_SRR_RL_Clu_Vel_86 : 146|11@0+ (0.1,-111.11) [-111.11|55.59] "mps" Vector__XXX
 SG_ S4_SRR_RL_Clu_SNR_86 : 167|7@0+ (0.5,0) [0|63.5] "dB" Vector__XXX
 SG_ S4_SRR_RL_Clu_RCS_86 : 160|5@0+ (2,-40) [-40|22] "" Vector__XXX
 SG_ S4_SRR_RL_Clu_DynProp_86 : 171|1@0+ (1,0) [0|1] "Unitless" Vector__XXX
 SG_ S4_SRR_RL_Clu_Locationvalid_86 : 170|1@0+ (1,0) [0|1] "" Vector__XXX
 SG_ S4_SRR_RL_Clu_ID_87 : 179|8@0+ (1,0) [0|199] "" Vector__XXX
 SG_ S4_SRR_RL_Clu_Theta_87 : 187|9@0+ (0.0062,-1.571) [-1.571|1.5972] "rad" Vector__XXX
 SG_ S4_SRR_RL_Clu_Dist_87 : 194|12@0+ (0.1,0.4) [0.4|300] "m" Vector__XXX
 SG_ S4_SRR_RL_Clu_Vel_87 : 214|11@0+ (0.1,-111.11) [-111.11|55.59] "mps" Vector__XXX
 SG_ S4_SRR_RL_Clu_SNR_87 : 219|7@0+ (0.5,0) [0|63.5] "dB" Vector__XXX
 SG_ S4_SRR_RL_Clu_RCS_87 : 228|5@0+ (2,-40) [-40|22] "" Vector__XXX
 SG_ S4_SRR_RL_Clu_DynProp_87 : 239|1@0+ (1,0) [0|1] "Unitless" Vector__XXX
 SG_ S4_SRR_RL_Clu_Locationvalid_87 : 238|1@0+ (1,0) [0|1] "" Vector__XXX
 SG_ S4_SRR_RL_Clu_ID_88 : 247|8@0+ (1,0) [0|199] "" Vector__XXX
 SG_ S4_SRR_RL_Clu_Theta_88 : 255|9@0+ (0.0062,-1.571) [-1.571|1.5972] "rad" Vector__XXX
 SG_ S4_SRR_RL_Clu_Dist_88 : 262|12@0+ (0.1,0.4) [0.4|300] "m" Vector__XXX
 SG_ S4_SRR_RL_Clu_Vel_88 : 266|11@0+ (0.1,-111.11) [-111.11|55.59] "mps" Vector__XXX
 SG_ S4_SRR_RL_Clu_SNR_88 : 287|7@0+ (0.5,0) [0|63.5] "dB" Vector__XXX
 SG_ S4_SRR_RL_Clu_RCS_88 : 280|5@0+ (2,-40) [-40|22] "" Vector__XXX
 SG_ S4_SRR_RL_Clu_DynProp_88 : 291|1@0+ (1,0) [0|1] "Unitless" Vector__XXX
 SG_ S4_SRR_RL_Clu_Locationvalid_88 : 290|1@0+ (1,0) [0|1] "" Vector__XXX
 SG_ S4_SRR_RL_Clu_ID_89 : 299|8@0+ (1,0) [0|199] "" Vector__XXX
 SG_ S4_SRR_RL_Clu_Theta_89 : 307|9@0+ (0.0062,-1.571) [-1.571|1.5972] "rad" Vector__XXX
 SG_ S4_SRR_RL_Clu_Dist_89 : 314|12@0+ (0.1,0.4) [0.4|300] "m" Vector__XXX
 SG_ S4_SRR_RL_Clu_Vel_89 : 334|11@0+ (0.1,-111.11) [-111.11|55.59] "mps" Vector__XXX
 SG_ S4_SRR_RL_Clu_SNR_89 : 339|7@0+ (0.5,0) [0|63.5] "dB" Vector__XXX
 SG_ S4_SRR_RL_Clu_RCS_89 : 348|5@0+ (2,-40) [-40|22] "" Vector__XXX
 SG_ S4_SRR_RL_Clu_DynProp_89 : 359|1@0+ (1,0) [0|1] "Unitless" Vector__XXX
 SG_ S4_SRR_RL_Clu_Locationvalid_89 : 358|1@0+ (1,0) [0|1] "" Vector__XXX
 SG_ S4_SRR_RL_Clu_ID_90 : 367|8@0+ (1,0) [0|199] "" Vector__XXX
 SG_ S4_SRR_RL_Clu_Theta_90 : 375|9@0+ (0.0062,-1.571) [-1.571|1.5972] "rad" Vector__XXX
 SG_ S4_SRR_RL_Clu_Dist_90 : 382|12@0+ (0.1,0.4) [0.4|300] "m" Vector__XXX
 SG_ S4_SRR_RL_Clu_Vel_90 : 386|11@0+ (0.1,-111.11) [-111.11|55.59] "mps" Vector__XXX
 SG_ S4_SRR_RL_Clu_SNR_90 : 407|7@0+ (0.5,0) [0|63.5] "dB" Vector__XXX
 SG_ S4_SRR_RL_Clu_RCS_90 : 400|5@0+ (2,-40) [-40|22] "" Vector__XXX
 SG_ S4_SRR_RL_Clu_DynProp_90 : 411|1@0+ (1,0) [0|1] "Unitless" Vector__XXX
 SG_ S4_SRR_RL_Clu_Locationvalid_90 : 410|1@0+ (1,0) [0|1] "" Vector__XXX
 SG_ S4_SRR_RL_Clu_Mes_12_blockcounter : 503|4@0+ (1,0) [0|15] "" Vector__XXX
 SG_ S4_SRR_RL_Clu_12_MsgCounter : 499|4@0+ (1,0) [0|14] "" Vector__XXX
 SG_ S4_SRR_RL_Clu_12_E2EChecksum : 511|8@0+ (1,0) [0|255] "" Vector__XXX

BO_ 598 S4_SRR_RL_Clu_Mes_13: 64 SRR_RL
 SG_ S4_SRR_RL_Clu_ID_91 : 7|8@0+ (1,0) [0|199] "" Vector__XXX
 SG_ S4_SRR_RL_Clu_Theta_91 : 15|9@0+ (0.0062,-1.571) [-1.571|1.5972] "rad" Vector__XXX
 SG_ S4_SRR_RL_Clu_Dist_91 : 22|12@0+ (0.1,0.4) [0.4|300] "m" Vector__XXX
 SG_ S4_SRR_RL_Clu_Vel_91 : 26|11@0+ (0.1,-111.11) [-111.11|55.59] "mps" Vector__XXX
 SG_ S4_SRR_RL_Clu_SNR_91 : 47|7@0+ (0.5,0) [0|63.5] "dB" Vector__XXX
 SG_ S4_SRR_RL_Clu_RCS_91 : 40|5@0+ (2,-40) [-40|22] "" Vector__XXX
 SG_ S4_SRR_RL_Clu_DynProp_91 : 51|1@0+ (1,0) [0|1] "Unitless" Vector__XXX
 SG_ S4_SRR_RL_Clu_Locationvalid_91 : 50|1@0+ (1,0) [0|1] "" Vector__XXX
 SG_ S4_SRR_RL_Clu_ID_92 : 59|8@0+ (1,0) [0|199] "" Vector__XXX
 SG_ S4_SRR_RL_Clu_Theta_92 : 67|9@0+ (0.0062,-1.571) [-1.571|1.5972] "rad" Vector__XXX
 SG_ S4_SRR_RL_Clu_Dist_92 : 74|12@0+ (0.1,0.4) [0.4|300] "m" Vector__XXX
 SG_ S4_SRR_RL_Clu_Vel_92 : 94|11@0+ (0.1,-111.11) [-111.11|55.59] "mps" Vector__XXX
 SG_ S4_SRR_RL_Clu_SNR_92 : 99|7@0+ (0.5,0) [0|63.5] "dB" Vector__XXX
 SG_ S4_SRR_RL_Clu_RCS_92 : 108|5@0+ (2,-40) [-40|22] "" Vector__XXX
 SG_ S4_SRR_RL_Clu_DynProp_92 : 119|1@0+ (1,0) [0|1] "Unitless" Vector__XXX
 SG_ S4_SRR_RL_Clu_Locationvalid_92 : 118|1@0+ (1,0) [0|1] "" Vector__XXX
 SG_ S4_SRR_RL_Clu_ID_93 : 127|8@0+ (1,0) [0|199] "" Vector__XXX
 SG_ S4_SRR_RL_Clu_Theta_93 : 135|9@0+ (0.0062,-1.571) [-1.571|1.5972] "rad" Vector__XXX
 SG_ S4_SRR_RL_Clu_Dist_93 : 142|12@0+ (0.1,0.4) [0.4|300] "m" Vector__XXX
 SG_ S4_SRR_RL_Clu_Vel_93 : 146|11@0+ (0.1,-111.11) [-111.11|55.59] "mps" Vector__XXX
 SG_ S4_SRR_RL_Clu_SNR_93 : 167|7@0+ (0.5,0) [0|63.5] "dB" Vector__XXX
 SG_ S4_SRR_RL_Clu_RCS_93 : 160|5@0+ (2,-40) [-40|22] "" Vector__XXX
 SG_ S4_SRR_RL_Clu_DynProp_93 : 171|1@0+ (1,0) [0|1] "Unitless" Vector__XXX
 SG_ S4_SRR_RL_Clu_Locationvalid_93 : 170|1@0+ (1,0) [0|1] "" Vector__XXX
 SG_ S4_SRR_RL_Clu_ID_94 : 179|8@0+ (1,0) [0|199] "" Vector__XXX
 SG_ S4_SRR_RL_Clu_Theta_94 : 187|9@0+ (0.0062,-1.571) [-1.571|1.5972] "rad" Vector__XXX
 SG_ S4_SRR_RL_Clu_Dist_94 : 194|12@0+ (0.1,0.4) [0.4|300] "m" Vector__XXX
 SG_ S4_SRR_RL_Clu_Vel_94 : 214|11@0+ (0.1,-111.11) [-111.11|55.59] "mps" Vector__XXX
 SG_ S4_SRR_RL_Clu_SNR_94 : 219|7@0+ (0.5,0) [0|63.5] "dB" Vector__XXX
 SG_ S4_SRR_RL_Clu_RCS_94 : 228|5@0+ (2,-40) [-40|22] "" Vector__XXX
 SG_ S4_SRR_RL_Clu_DynProp_94 : 239|1@0+ (1,0) [0|1] "Unitless" Vector__XXX
 SG_ S4_SRR_RL_Clu_Locationvalid_94 : 238|1@0+ (1,0) [0|1] "" Vector__XXX
 SG_ S4_SRR_RL_Clu_ID_95 : 247|8@0+ (1,0) [0|199] "" Vector__XXX
 SG_ S4_SRR_RL_Clu_Theta_95 : 255|9@0+ (0.0062,-1.571) [-1.571|1.5972] "rad" Vector__XXX
 SG_ S4_SRR_RL_Clu_Dist_95 : 262|12@0+ (0.1,0.4) [0.4|300] "m" Vector__XXX
 SG_ S4_SRR_RL_Clu_Vel_95 : 266|11@0+ (0.1,-111.11) [-111.11|55.59] "mps" Vector__XXX
 SG_ S4_SRR_RL_Clu_SNR_95 : 287|7@0+ (0.5,0) [0|63.5] "dB" Vector__XXX
 SG_ S4_SRR_RL_Clu_RCS_95 : 280|5@0+ (2,-40) [-40|22] "" Vector__XXX
 SG_ S4_SRR_RL_Clu_DynProp_95 : 291|1@0+ (1,0) [0|1] "Unitless" Vector__XXX
 SG_ S4_SRR_RL_Clu_Locationvalid_95 : 290|1@0+ (1,0) [0|1] "" Vector__XXX
 SG_ S4_SRR_RL_Clu_ID_96 : 299|8@0+ (1,0) [0|199] "" Vector__XXX
 SG_ S4_SRR_RL_Clu_Theta_96 : 307|9@0+ (0.0062,-1.571) [-1.571|1.5972] "rad" Vector__XXX
 SG_ S4_SRR_RL_Clu_Dist_96 : 314|12@0+ (0.1,0.4) [0.4|300] "m" Vector__XXX
 SG_ S4_SRR_RL_Clu_Vel_96 : 334|11@0+ (0.1,-111.11) [-111.11|55.59] "mps" Vector__XXX
 SG_ S4_SRR_RL_Clu_SNR_96 : 339|7@0+ (0.5,0) [0|63.5] "dB" Vector__XXX
 SG_ S4_SRR_RL_Clu_RCS_96 : 348|5@0+ (2,-40) [-40|22] "" Vector__XXX
 SG_ S4_SRR_RL_Clu_DynProp_96 : 359|1@0+ (1,0) [0|1] "Unitless" Vector__XXX
 SG_ S4_SRR_RL_Clu_Locationvalid_96 : 358|1@0+ (1,0) [0|1] "" Vector__XXX
 SG_ S4_SRR_RL_Clu_ID_97 : 367|8@0+ (1,0) [0|199] "" Vector__XXX
 SG_ S4_SRR_RL_Clu_Theta_97 : 375|9@0+ (0.0062,-1.571) [-1.571|1.5972] "rad" Vector__XXX
 SG_ S4_SRR_RL_Clu_Dist_97 : 382|12@0+ (0.1,0.4) [0.4|300] "m" Vector__XXX
 SG_ S4_SRR_RL_Clu_Vel_97 : 386|11@0+ (0.1,-111.11) [-111.11|55.59] "mps" Vector__XXX
 SG_ S4_SRR_RL_Clu_SNR_97 : 407|7@0+ (0.5,0) [0|63.5] "dB" Vector__XXX
 SG_ S4_SRR_RL_Clu_RCS_97 : 400|5@0+ (2,-40) [-40|22] "" Vector__XXX
 SG_ S4_SRR_RL_Clu_DynProp_97 : 411|1@0+ (1,0) [0|1] "Unitless" Vector__XXX
 SG_ S4_SRR_RL_Clu_Locationvalid_97 : 410|1@0+ (1,0) [0|1] "" Vector__XXX
 SG_ S4_SRR_RL_Clu_Mes_13_blockcounter : 503|4@0+ (1,0) [0|15] "" Vector__XXX
 SG_ S4_SRR_RL_Clu_13_MsgCounter : 499|4@0+ (1,0) [0|14] "" Vector__XXX
 SG_ S4_SRR_RL_Clu_13_E2EChecksum : 511|8@0+ (1,0) [0|255] "" Vector__XXX

BO_ 599 S4_SRR_RL_Clu_Mes_14: 64 SRR_RL
 SG_ S4_SRR_RL_Clu_ID_98 : 7|8@0+ (1,0) [0|199] "" Vector__XXX
 SG_ S4_SRR_RL_Clu_Theta_98 : 15|9@0+ (0.0062,-1.571) [-1.571|1.5972] "rad" Vector__XXX
 SG_ S4_SRR_RL_Clu_Dist_98 : 22|12@0+ (0.1,0.4) [0.4|300] "m" Vector__XXX
 SG_ S4_SRR_RL_Clu_Vel_98 : 26|11@0+ (0.1,-111.11) [-111.11|55.59] "mps" Vector__XXX
 SG_ S4_SRR_RL_Clu_SNR_98 : 47|7@0+ (0.5,0) [0|63.5] "dB" Vector__XXX
 SG_ S4_SRR_RL_Clu_RCS_98 : 40|5@0+ (2,-40) [-40|22] "" Vector__XXX
 SG_ S4_SRR_RL_Clu_DynProp_98 : 51|1@0+ (1,0) [0|1] "Unitless" Vector__XXX
 SG_ S4_SRR_RL_Clu_Locationvalid_98 : 50|1@0+ (1,0) [0|1] "" Vector__XXX
 SG_ S4_SRR_RL_Clu_ID_99 : 59|8@0+ (1,0) [0|199] "" Vector__XXX
 SG_ S4_SRR_RL_Clu_Theta_99 : 67|9@0+ (0.0062,-1.571) [-1.571|1.5972] "rad" Vector__XXX
 SG_ S4_SRR_RL_Clu_Dist_99 : 74|12@0+ (0.1,0.4) [0.4|300] "m" Vector__XXX
 SG_ S4_SRR_RL_Clu_Vel_99 : 94|11@0+ (0.1,-111.11) [-111.11|55.59] "mps" Vector__XXX
 SG_ S4_SRR_RL_Clu_SNR_99 : 99|7@0+ (0.5,0) [0|63.5] "dB" Vector__XXX
 SG_ S4_SRR_RL_Clu_RCS_99 : 108|5@0+ (2,-40) [-40|22] "" Vector__XXX
 SG_ S4_SRR_RL_Clu_DynProp_99 : 119|1@0+ (1,0) [0|1] "Unitless" Vector__XXX
 SG_ S4_SRR_RL_Clu_Locationvalid_99 : 118|1@0+ (1,0) [0|1] "" Vector__XXX
 SG_ S4_SRR_RL_Clu_ID_100 : 127|8@0+ (1,0) [0|199] "" Vector__XXX
 SG_ S4_SRR_RL_Clu_Theta_100 : 135|9@0+ (0.0062,-1.571) [-1.571|1.5972] "rad" Vector__XXX
 SG_ S4_SRR_RL_Clu_Dist_100 : 142|12@0+ (0.1,0.4) [0.4|300] "m" Vector__XXX
 SG_ S4_SRR_RL_Clu_Vel_100 : 146|11@0+ (0.1,-111.11) [-111.11|55.59] "mps" Vector__XXX
 SG_ S4_SRR_RL_Clu_SNR_100 : 167|7@0+ (0.5,0) [0|63.5] "dB" Vector__XXX
 SG_ S4_SRR_RL_Clu_RCS_100 : 160|5@0+ (2,-40) [-40|22] "" Vector__XXX
 SG_ S4_SRR_RL_Clu_DynProp_100 : 171|1@0+ (1,0) [0|1] "Unitless" Vector__XXX
 SG_ S4_SRR_RL_Clu_Locationvalid_100 : 170|1@0+ (1,0) [0|1] "" Vector__XXX
 SG_ S4_SRR_RL_Clu_ID_101 : 179|8@0+ (1,0) [0|199] "" Vector__XXX
 SG_ S4_SRR_RL_Clu_Theta_101 : 187|9@0+ (0.0062,-1.571) [-1.571|1.5972] "rad" Vector__XXX
 SG_ S4_SRR_RL_Clu_Dist_101 : 194|12@0+ (0.1,0.4) [0.4|300] "m" Vector__XXX
 SG_ S4_SRR_RL_Clu_Vel_101 : 214|11@0+ (0.1,-111.11) [-111.11|55.59] "mps" Vector__XXX
 SG_ S4_SRR_RL_Clu_SNR_101 : 219|7@0+ (0.5,0) [0|63.5] "dB" Vector__XXX
 SG_ S4_SRR_RL_Clu_RCS_101 : 228|5@0+ (2,-40) [-40|22] "" Vector__XXX
 SG_ S4_SRR_RL_Clu_DynProp_101 : 239|1@0+ (1,0) [0|1] "Unitless" Vector__XXX
 SG_ S4_SRR_RL_Clu_Locationvalid_101 : 238|1@0+ (1,0) [0|1] "" Vector__XXX
 SG_ S4_SRR_RL_Clu_ID_102 : 247|8@0+ (1,0) [0|199] "" Vector__XXX
 SG_ S4_SRR_RL_Clu_Theta_102 : 255|9@0+ (0.0062,-1.571) [-1.571|1.5972] "rad" Vector__XXX
 SG_ S4_SRR_RL_Clu_Dist_102 : 262|12@0+ (0.1,0.4) [0.4|300] "m" Vector__XXX
 SG_ S4_SRR_RL_Clu_Vel_102 : 266|11@0+ (0.1,-111.11) [-111.11|55.59] "mps" Vector__XXX
 SG_ S4_SRR_RL_Clu_SNR_102 : 287|7@0+ (0.5,0) [0|63.5] "dB" Vector__XXX
 SG_ S4_SRR_RL_Clu_RCS_102 : 280|5@0+ (2,-40) [-40|22] "" Vector__XXX
 SG_ S4_SRR_RL_Clu_DynProp_102 : 291|1@0+ (1,0) [0|1] "Unitless" Vector__XXX
 SG_ S4_SRR_RL_Clu_Locationvalid_102 : 290|1@0+ (1,0) [0|1] "" Vector__XXX
 SG_ S4_SRR_RL_Clu_ID_103 : 299|8@0+ (1,0) [0|199] "" Vector__XXX
 SG_ S4_SRR_RL_Clu_Theta_103 : 307|9@0+ (0.0062,-1.571) [-1.571|1.5972] "rad" Vector__XXX
 SG_ S4_SRR_RL_Clu_Dist_103 : 314|12@0+ (0.1,0.4) [0.4|300] "m" Vector__XXX
 SG_ S4_SRR_RL_Clu_Vel_103 : 334|11@0+ (0.1,-111.11) [-111.11|55.59] "mps" Vector__XXX
 SG_ S4_SRR_RL_Clu_SNR_103 : 339|7@0+ (0.5,0) [0|63.5] "dB" Vector__XXX
 SG_ S4_SRR_RL_Clu_RCS_103 : 348|5@0+ (2,-40) [-40|22] "" Vector__XXX
 SG_ S4_SRR_RL_Clu_DynProp_103 : 359|1@0+ (1,0) [0|1] "Unitless" Vector__XXX
 SG_ S4_SRR_RL_Clu_Locationvalid_103 : 358|1@0+ (1,0) [0|1] "" Vector__XXX
 SG_ S4_SRR_RL_Clu_ID_104 : 367|8@0+ (1,0) [0|199] "" Vector__XXX
 SG_ S4_SRR_RL_Clu_Theta_104 : 375|9@0+ (0.0062,-1.571) [-1.571|1.5972] "rad" Vector__XXX
 SG_ S4_SRR_RL_Clu_Dist_104 : 382|12@0+ (0.1,0.4) [0.4|300] "m" Vector__XXX
 SG_ S4_SRR_RL_Clu_Vel_104 : 386|11@0+ (0.1,-111.11) [-111.11|55.59] "mps" Vector__XXX
 SG_ S4_SRR_RL_Clu_SNR_104 : 407|7@0+ (0.5,0) [0|63.5] "dB" Vector__XXX
 SG_ S4_SRR_RL_Clu_RCS_104 : 400|5@0+ (2,-40) [-40|22] "" Vector__XXX
 SG_ S4_SRR_RL_Clu_DynProp_104 : 411|1@0+ (1,0) [0|1] "Unitless" Vector__XXX
 SG_ S4_SRR_RL_Clu_Locationvalid_104 : 410|1@0+ (1,0) [0|1] "" Vector__XXX
 SG_ S4_SRR_RL_Clu_Mes_14_blockcounter : 503|4@0+ (1,0) [0|15] "" Vector__XXX
 SG_ S4_SRR_RL_Clu_14_MsgCounter : 499|4@0+ (1,0) [0|14] "" Vector__XXX
 SG_ S4_SRR_RL_Clu_14_E2EChecksum : 511|8@0+ (1,0) [0|255] "" Vector__XXX

BO_ 600 S4_SRR_RL_Clu_Mes_15: 64 SRR_RL
 SG_ S4_SRR_RL_Clu_ID_105 : 7|8@0+ (1,0) [0|199] "" Vector__XXX
 SG_ S4_SRR_RL_Clu_Theta_105 : 15|9@0+ (0.0062,-1.571) [-1.571|1.5972] "rad" Vector__XXX
 SG_ S4_SRR_RL_Clu_Dist_105 : 22|12@0+ (0.1,0.4) [0.4|300] "m" Vector__XXX
 SG_ S4_SRR_RL_Clu_Vel_105 : 26|11@0+ (0.1,-111.11) [-111.11|55.59] "mps" Vector__XXX
 SG_ S4_SRR_RL_Clu_SNR_105 : 47|7@0+ (0.5,0) [0|63.5] "dB" Vector__XXX
 SG_ S4_SRR_RL_Clu_RCS_105 : 40|5@0+ (2,-40) [-40|22] "" Vector__XXX
 SG_ S4_SRR_RL_Clu_DynProp_105 : 51|1@0+ (1,0) [0|1] "Unitless" Vector__XXX
 SG_ S4_SRR_RL_Clu_Locationvalid_105 : 50|1@0+ (1,0) [0|1] "" Vector__XXX
 SG_ S4_SRR_RL_Clu_ID_106 : 59|8@0+ (1,0) [0|199] "" Vector__XXX
 SG_ S4_SRR_RL_Clu_Theta_106 : 67|9@0+ (0.0062,-1.571) [-1.571|1.5972] "rad" Vector__XXX
 SG_ S4_SRR_RL_Clu_Dist_106 : 74|12@0+ (0.1,0.4) [0.4|300] "m" Vector__XXX
 SG_ S4_SRR_RL_Clu_Vel_106 : 94|11@0+ (0.1,-111.11) [-111.11|55.59] "mps" Vector__XXX
 SG_ S4_SRR_RL_Clu_SNR_106 : 99|7@0+ (0.5,0) [0|63.5] "dB" Vector__XXX
 SG_ S4_SRR_RL_Clu_RCS_106 : 108|5@0+ (2,-40) [-40|22] "" Vector__XXX
 SG_ S4_SRR_RL_Clu_DynProp_106 : 119|1@0+ (1,0) [0|1] "Unitless" Vector__XXX
 SG_ S4_SRR_RL_Clu_Locationvalid_106 : 118|1@0+ (1,0) [0|1] "" Vector__XXX
 SG_ S4_SRR_RL_Clu_ID_107 : 127|8@0+ (1,0) [0|199] "" Vector__XXX
 SG_ S4_SRR_RL_Clu_Theta_107 : 135|9@0+ (0.0062,-1.571) [-1.571|1.5972] "rad" Vector__XXX
 SG_ S4_SRR_RL_Clu_Dist_107 : 142|12@0+ (0.1,0.4) [0.4|300] "m" Vector__XXX
 SG_ S4_SRR_RL_Clu_Vel_107 : 146|11@0+ (0.1,-111.11) [-111.11|55.59] "mps" Vector__XXX
 SG_ S4_SRR_RL_Clu_SNR_107 : 167|7@0+ (0.5,0) [0|63.5] "dB" Vector__XXX
 SG_ S4_SRR_RL_Clu_RCS_107 : 160|5@0+ (2,-40) [-40|22] "" Vector__XXX
 SG_ S4_SRR_RL_Clu_DynProp_107 : 171|1@0+ (1,0) [0|1] "Unitless" Vector__XXX
 SG_ S4_SRR_RL_Clu_Locationvalid_107 : 170|1@0+ (1,0) [0|1] "" Vector__XXX
 SG_ S4_SRR_RL_Clu_ID_108 : 179|8@0+ (1,0) [0|199] "" Vector__XXX
 SG_ S4_SRR_RL_Clu_Theta_108 : 187|9@0+ (0.0062,-1.571) [-1.571|1.5972] "rad" Vector__XXX
 SG_ S4_SRR_RL_Clu_Dist_108 : 194|12@0+ (0.1,0.4) [0.4|300] "m" Vector__XXX
 SG_ S4_SRR_RL_Clu_Vel_108 : 214|11@0+ (0.1,-111.11) [-111.11|55.59] "mps" Vector__XXX
 SG_ S4_SRR_RL_Clu_SNR_108 : 219|7@0+ (0.5,0) [0|63.5] "dB" Vector__XXX
 SG_ S4_SRR_RL_Clu_RCS_108 : 228|5@0+ (2,-40) [-40|22] "" Vector__XXX
 SG_ S4_SRR_RL_Clu_DynProp_108 : 239|1@0+ (1,0) [0|1] "Unitless" Vector__XXX
 SG_ S4_SRR_RL_Clu_Locationvalid_108 : 238|1@0+ (1,0) [0|1] "" Vector__XXX
 SG_ S4_SRR_RL_Clu_ID_109 : 247|8@0+ (1,0) [0|199] "" Vector__XXX
 SG_ S4_SRR_RL_Clu_Theta_109 : 255|9@0+ (0.0062,-1.571) [-1.571|1.5972] "rad" Vector__XXX
 SG_ S4_SRR_RL_Clu_Dist_109 : 262|12@0+ (0.1,0.4) [0.4|300] "m" Vector__XXX
 SG_ S4_SRR_RL_Clu_Vel_109 : 266|11@0+ (0.1,-111.11) [-111.11|55.59] "mps" Vector__XXX
 SG_ S4_SRR_RL_Clu_SNR_109 : 287|7@0+ (0.5,0) [0|63.5] "dB" Vector__XXX
 SG_ S4_SRR_RL_Clu_RCS_109 : 280|5@0+ (2,-40) [-40|22] "" Vector__XXX
 SG_ S4_SRR_RL_Clu_DynProp_109 : 291|1@0+ (1,0) [0|1] "Unitless" Vector__XXX
 SG_ S4_SRR_RL_Clu_Locationvalid_109 : 290|1@0+ (1,0) [0|1] "" Vector__XXX
 SG_ S4_SRR_RL_Clu_ID_110 : 299|8@0+ (1,0) [0|199] "" Vector__XXX
 SG_ S4_SRR_RL_Clu_Theta_110 : 307|9@0+ (0.0062,-1.571) [-1.571|1.5972] "rad" Vector__XXX
 SG_ S4_SRR_RL_Clu_Dist_110 : 314|12@0+ (0.1,0.4) [0.4|300] "m" Vector__XXX
 SG_ S4_SRR_RL_Clu_Vel_110 : 334|11@0+ (0.1,-111.11) [-111.11|55.59] "mps" Vector__XXX
 SG_ S4_SRR_RL_Clu_SNR_110 : 339|7@0+ (0.5,0) [0|63.5] "dB" Vector__XXX
 SG_ S4_SRR_RL_Clu_RCS_110 : 348|5@0+ (2,-40) [-40|22] "" Vector__XXX
 SG_ S4_SRR_RL_Clu_DynProp_110 : 359|1@0+ (1,0) [0|1] "Unitless" Vector__XXX
 SG_ S4_SRR_RL_Clu_Locationvalid_110 : 358|1@0+ (1,0) [0|1] "" Vector__XXX
 SG_ S4_SRR_RL_Clu_ID_111 : 367|8@0+ (1,0) [0|199] "" Vector__XXX
 SG_ S4_SRR_RL_Clu_Theta_111 : 375|9@0+ (0.0062,-1.571) [-1.571|1.5972] "rad" Vector__XXX
 SG_ S4_SRR_RL_Clu_Dist_111 : 382|12@0+ (0.1,0.4) [0.4|300] "m" Vector__XXX
 SG_ S4_SRR_RL_Clu_Vel_111 : 386|11@0+ (0.1,-111.11) [-111.11|55.59] "mps" Vector__XXX
 SG_ S4_SRR_RL_Clu_SNR_111 : 407|7@0+ (0.5,0) [0|63.5] "dB" Vector__XXX
 SG_ S4_SRR_RL_Clu_RCS_111 : 400|5@0+ (2,-40) [-40|22] "" Vector__XXX
 SG_ S4_SRR_RL_Clu_DynProp_111 : 411|1@0+ (1,0) [0|1] "Unitless" Vector__XXX
 SG_ S4_SRR_RL_Clu_Locationvalid_111 : 410|1@0+ (1,0) [0|1] "" Vector__XXX
 SG_ S4_SRR_RL_Clu_Mes_15_blockcounter : 503|4@0+ (1,0) [0|15] "" Vector__XXX
 SG_ S4_SRR_RL_Clu_15_MsgCounter : 499|4@0+ (1,0) [0|14] "" Vector__XXX
 SG_ S4_SRR_RL_Clu_15_E2EChecksum : 511|8@0+ (1,0) [0|255] "" Vector__XXX

CM_ BO_ 576 "The sending period is unstable, ranging from 40 to 80ms
E2E Profile1 Message";
CM_ SG_ 576 S4_SRR_RL_Clu_ID_0 "E2E_Order1";
CM_ SG_ 576 S4_SRR_RL_Clu_Theta_0 "E2E_Order2";
CM_ SG_ 576 S4_SRR_RL_Clu_Dist_0 "E2E_Order3";
CM_ SG_ 576 S4_SRR_RL_Clu_Vel_0 "E2E_Order4";
CM_ SG_ 576 S4_SRR_RL_Clu_SNR_0 "E2E_Order5";
CM_ SG_ 576 S4_SRR_RL_Clu_RCS_0 "E2E_Order6";
CM_ SG_ 576 S4_SRR_RL_Clu_DynProp_0 "E2E_Order7";
CM_ SG_ 576 S4_SRR_RL_Clu_Locationvalid_0 "E2E_Order8";
CM_ SG_ 576 S4_SRR_RL_Clu_ID_1 "E2E_Order9";
CM_ SG_ 576 S4_SRR_RL_Clu_Theta_1 "E2E_Order10";
CM_ SG_ 576 S4_SRR_RL_Clu_Dist_1 "E2E_Order11";
CM_ SG_ 576 S4_SRR_RL_Clu_Vel_1 "E2E_Order12";
CM_ SG_ 576 S4_SRR_RL_Clu_SNR_1 "E2E_Order13";
CM_ SG_ 576 S4_SRR_RL_Clu_RCS_1 "E2E_Order14";
CM_ SG_ 576 S4_SRR_RL_Clu_DynProp_1 "E2E_Order15";
CM_ SG_ 576 S4_SRR_RL_Clu_Locationvalid_1 "E2E_Order16";
CM_ SG_ 576 S4_SRR_RL_Clu_ID_2 "E2E_Order17";
CM_ SG_ 576 S4_SRR_RL_Clu_Theta_2 "E2E_Order18";
CM_ SG_ 576 S4_SRR_RL_Clu_Dist_2 "E2E_Order19";
CM_ SG_ 576 S4_SRR_RL_Clu_Vel_2 "E2E_Order20";
CM_ SG_ 576 S4_SRR_RL_Clu_SNR_2 "E2E_Order21";
CM_ SG_ 576 S4_SRR_RL_Clu_RCS_2 "E2E_Order22";
CM_ SG_ 576 S4_SRR_RL_Clu_DynProp_2 "E2E_Order23";
CM_ SG_ 576 S4_SRR_RL_Clu_Locationvalid_2 "E2E_Order24";
CM_ SG_ 576 S4_SRR_RL_Clu_ID_3 "E2E_Order25";
CM_ SG_ 576 S4_SRR_RL_Clu_Theta_3 "E2E_Order26";
CM_ SG_ 576 S4_SRR_RL_Clu_Dist_3 "E2E_Order27";
CM_ SG_ 576 S4_SRR_RL_Clu_Vel_3 "E2E_Order28";
CM_ SG_ 576 S4_SRR_RL_Clu_SNR_3 "E2E_Order29";
CM_ SG_ 576 S4_SRR_RL_Clu_RCS_3 "E2E_Order30";
CM_ SG_ 576 S4_SRR_RL_Clu_DynProp_3 "E2E_Order31";
CM_ SG_ 576 S4_SRR_RL_Clu_Locationvalid_3 "E2E_Order32";
CM_ SG_ 576 S4_SRR_RL_Clu_ID_4 "E2E_Order33";
CM_ SG_ 576 S4_SRR_RL_Clu_Theta_4 "E2E_Order34";
CM_ SG_ 576 S4_SRR_RL_Clu_Dist_4 "E2E_Order35";
CM_ SG_ 576 S4_SRR_RL_Clu_Vel_4 "E2E_Order36";
CM_ SG_ 576 S4_SRR_RL_Clu_SNR_4 "E2E_Order37";
CM_ SG_ 576 S4_SRR_RL_Clu_RCS_4 "E2E_Order38";
CM_ SG_ 576 S4_SRR_RL_Clu_DynProp_4 "E2E_Order39";
CM_ SG_ 576 S4_SRR_RL_Clu_Locationvalid_4 "E2E_Order40";
CM_ SG_ 576 S4_SRR_RL_Clu_ID_5 "E2E_Order41";
CM_ SG_ 576 S4_SRR_RL_Clu_Theta_5 "E2E_Order42";
CM_ SG_ 576 S4_SRR_RL_Clu_Dist_5 "E2E_Order43";
CM_ SG_ 576 S4_SRR_RL_Clu_Vel_5 "E2E_Order44";
CM_ SG_ 576 S4_SRR_RL_Clu_SNR_5 "E2E_Order45";
CM_ SG_ 576 S4_SRR_RL_Clu_RCS_5 "E2E_Order46";
CM_ SG_ 576 S4_SRR_RL_Clu_DynProp_5 "E2E_Order47";
CM_ SG_ 576 S4_SRR_RL_Clu_Locationvalid_5 "E2E_Order48";
CM_ SG_ 576 S4_SRR_RL_Clu_ID_6 "E2E_Order49";
CM_ SG_ 576 S4_SRR_RL_Clu_Theta_6 "E2E_Order50";
CM_ SG_ 576 S4_SRR_RL_Clu_Dist_6 "E2E_Order51";
CM_ SG_ 576 S4_SRR_RL_Clu_Vel_6 "E2E_Order52";
CM_ SG_ 576 S4_SRR_RL_Clu_SNR_6 "E2E_Order53";
CM_ SG_ 576 S4_SRR_RL_Clu_RCS_6 "E2E_Order54";
CM_ SG_ 576 S4_SRR_RL_Clu_DynProp_6 "E2E_Order55";
CM_ SG_ 576 S4_SRR_RL_Clu_Locationvalid_6 "E2E_Order56";
CM_ SG_ 576 S4_SRR_RL_Clu_Timestamps "E2E_Order57";
CM_ SG_ 576 S4_SRR_RL_Clu_0_E2EChecksum "DataID = 0x0042";
CM_ BO_ 577 "The sending period is unstable, ranging from 40 to 80ms
E2E Profile1 Message";
CM_ SG_ 577 S4_SRR_RL_Clu_ID_7 "E2E_Order1";
CM_ SG_ 577 S4_SRR_RL_Clu_Theta_7 "E2E_Order2";
CM_ SG_ 577 S4_SRR_RL_Clu_Dist_7 "E2E_Order3";
CM_ SG_ 577 S4_SRR_RL_Clu_Vel_7 "E2E_Order4";
CM_ SG_ 577 S4_SRR_RL_Clu_SNR_7 "E2E_Order5";
CM_ SG_ 577 S4_SRR_RL_Clu_RCS_7 "E2E_Order6";
CM_ SG_ 577 S4_SRR_RL_Clu_DynProp_7 "E2E_Order7";
CM_ SG_ 577 S4_SRR_RL_Clu_Locationvalid_7 "E2E_Order8";
CM_ SG_ 577 S4_SRR_RL_Clu_ID_8 "E2E_Order9";
CM_ SG_ 577 S4_SRR_RL_Clu_Theta_8 "E2E_Order10";
CM_ SG_ 577 S4_SRR_RL_Clu_Dist_8 "E2E_Order11";
CM_ SG_ 577 S4_SRR_RL_Clu_Vel_8 "E2E_Order12";
CM_ SG_ 577 S4_SRR_RL_Clu_SNR_8 "E2E_Order13";
CM_ SG_ 577 S4_SRR_RL_Clu_RCS_8 "E2E_Order14";
CM_ SG_ 577 S4_SRR_RL_Clu_DynProp_8 "E2E_Order15";
CM_ SG_ 577 S4_SRR_RL_Clu_Locationvalid_8 "E2E_Order16";
CM_ SG_ 577 S4_SRR_RL_Clu_ID_9 "E2E_Order17";
CM_ SG_ 577 S4_SRR_RL_Clu_Theta_9 "E2E_Order18";
CM_ SG_ 577 S4_SRR_RL_Clu_Dist_9 "E2E_Order19";
CM_ SG_ 577 S4_SRR_RL_Clu_Vel_9 "E2E_Order20";
CM_ SG_ 577 S4_SRR_RL_Clu_SNR_9 "E2E_Order21";
CM_ SG_ 577 S4_SRR_RL_Clu_RCS_9 "E2E_Order22";
CM_ SG_ 577 S4_SRR_RL_Clu_DynProp_9 "E2E_Order23";
CM_ SG_ 577 S4_SRR_RL_Clu_Locationvalid_9 "E2E_Order24";
CM_ SG_ 577 S4_SRR_RL_Clu_ID_10 "E2E_Order25";
CM_ SG_ 577 S4_SRR_RL_Clu_Theta_10 "E2E_Order26";
CM_ SG_ 577 S4_SRR_RL_Clu_Dist_10 "E2E_Order27";
CM_ SG_ 577 S4_SRR_RL_Clu_Vel_10 "E2E_Order28";
CM_ SG_ 577 S4_SRR_RL_Clu_SNR_10 "E2E_Order29";
CM_ SG_ 577 S4_SRR_RL_Clu_RCS_10 "E2E_Order30";
CM_ SG_ 577 S4_SRR_RL_Clu_DynProp_10 "E2E_Order31";
CM_ SG_ 577 S4_SRR_RL_Clu_Locationvalid_10 "E2E_Order32";
CM_ SG_ 577 S4_SRR_RL_Clu_ID_11 "E2E_Order33";
CM_ SG_ 577 S4_SRR_RL_Clu_Theta_11 "E2E_Order34";
CM_ SG_ 577 S4_SRR_RL_Clu_Dist_11 "E2E_Order35";
CM_ SG_ 577 S4_SRR_RL_Clu_Vel_11 "E2E_Order36";
CM_ SG_ 577 S4_SRR_RL_Clu_SNR_11 "E2E_Order37";
CM_ SG_ 577 S4_SRR_RL_Clu_RCS_11 "E2E_Order38";
CM_ SG_ 577 S4_SRR_RL_Clu_DynProp_11 "E2E_Order39";
CM_ SG_ 577 S4_SRR_RL_Clu_Locationvalid_11 "E2E_Order40";
CM_ SG_ 577 S4_SRR_RL_Clu_ID_12 "E2E_Order41";
CM_ SG_ 577 S4_SRR_RL_Clu_Theta_12 "E2E_Order42";
CM_ SG_ 577 S4_SRR_RL_Clu_Dist_12 "E2E_Order43";
CM_ SG_ 577 S4_SRR_RL_Clu_Vel_12 "E2E_Order44";
CM_ SG_ 577 S4_SRR_RL_Clu_SNR_12 "E2E_Order45";
CM_ SG_ 577 S4_SRR_RL_Clu_RCS_12 "E2E_Order46";
CM_ SG_ 577 S4_SRR_RL_Clu_DynProp_12 "E2E_Order47";
CM_ SG_ 577 S4_SRR_RL_Clu_Locationvalid_12 "E2E_Order48";
CM_ SG_ 577 S4_SRR_RL_Clu_ID_13 "E2E_Order49";
CM_ SG_ 577 S4_SRR_RL_Clu_Theta_13 "E2E_Order50";
CM_ SG_ 577 S4_SRR_RL_Clu_Dist_13 "E2E_Order51";
CM_ SG_ 577 S4_SRR_RL_Clu_Vel_13 "E2E_Order52";
CM_ SG_ 577 S4_SRR_RL_Clu_SNR_13 "E2E_Order53";
CM_ SG_ 577 S4_SRR_RL_Clu_RCS_13 "E2E_Order54";
CM_ SG_ 577 S4_SRR_RL_Clu_DynProp_13 "E2E_Order55";
CM_ SG_ 577 S4_SRR_RL_Clu_Locationvalid_13 "E2E_Order56";
CM_ SG_ 577 S4_SRR_RL_Clu_1_E2EChecksum "DataID = 0x142";
CM_ BO_ 587 "The sending period is unstable, ranging from 40 to 80ms
E2E Profile1 Message";
CM_ SG_ 587 S4_SRR_RL_Clu_ID_14 "E2E_Order1";
CM_ SG_ 587 S4_SRR_RL_Clu_Theta_14 "E2E_Order2";
CM_ SG_ 587 S4_SRR_RL_Clu_Dist_14 "E2E_Order3";
CM_ SG_ 587 S4_SRR_RL_Clu_Vel_14 "E2E_Order4";
CM_ SG_ 587 S4_SRR_RL_Clu_SNR_14 "E2E_Order5";
CM_ SG_ 587 S4_SRR_RL_Clu_RCS_14 "E2E_Order6";
CM_ SG_ 587 S4_SRR_RL_Clu_DynProp_14 "E2E_Order7";
CM_ SG_ 587 S4_SRR_RL_Clu_Locationvalid_14 "E2E_Order8";
CM_ SG_ 587 S4_SRR_RL_Clu_ID_15 "E2E_Order9";
CM_ SG_ 587 S4_SRR_RL_Clu_Theta_15 "E2E_Order10";
CM_ SG_ 587 S4_SRR_RL_Clu_Dist_15 "E2E_Order11";
CM_ SG_ 587 S4_SRR_RL_Clu_Vel_15 "E2E_Order12";
CM_ SG_ 587 S4_SRR_RL_Clu_SNR_15 "E2E_Order13";
CM_ SG_ 587 S4_SRR_RL_Clu_RCS_15 "E2E_Order14";
CM_ SG_ 587 S4_SRR_RL_Clu_DynProp_15 "E2E_Order15";
CM_ SG_ 587 S4_SRR_RL_Clu_Locationvalid_15 "E2E_Order16";
CM_ SG_ 587 S4_SRR_RL_Clu_ID_16 "E2E_Order17";
CM_ SG_ 587 S4_SRR_RL_Clu_Theta_16 "E2E_Order18";
CM_ SG_ 587 S4_SRR_RL_Clu_Dist_16 "E2E_Order19";
CM_ SG_ 587 S4_SRR_RL_Clu_Vel_16 "E2E_Order20";
CM_ SG_ 587 S4_SRR_RL_Clu_SNR_16 "E2E_Order21";
CM_ SG_ 587 S4_SRR_RL_Clu_RCS_16 "E2E_Order22";
CM_ SG_ 587 S4_SRR_RL_Clu_DynProp_16 "E2E_Order23";
CM_ SG_ 587 S4_SRR_RL_Clu_Locationvalid_16 "E2E_Order24";
CM_ SG_ 587 S4_SRR_RL_Clu_ID_17 "E2E_Order25";
CM_ SG_ 587 S4_SRR_RL_Clu_Theta_17 "E2E_Order26";
CM_ SG_ 587 S4_SRR_RL_Clu_Dist_17 "E2E_Order27";
CM_ SG_ 587 S4_SRR_RL_Clu_Vel_17 "E2E_Order28";
CM_ SG_ 587 S4_SRR_RL_Clu_SNR_17 "E2E_Order29";
CM_ SG_ 587 S4_SRR_RL_Clu_RCS_17 "E2E_Order30";
CM_ SG_ 587 S4_SRR_RL_Clu_DynProp_17 "E2E_Order31";
CM_ SG_ 587 S4_SRR_RL_Clu_Locationvalid_17 "E2E_Order32";
CM_ SG_ 587 S4_SRR_RL_Clu_ID_18 "E2E_Order33";
CM_ SG_ 587 S4_SRR_RL_Clu_Theta_18 "E2E_Order34";
CM_ SG_ 587 S4_SRR_RL_Clu_Dist_18 "E2E_Order35";
CM_ SG_ 587 S4_SRR_RL_Clu_Vel_18 "E2E_Order36";
CM_ SG_ 587 S4_SRR_RL_Clu_SNR_18 "E2E_Order37";
CM_ SG_ 587 S4_SRR_RL_Clu_RCS_18 "E2E_Order38";
CM_ SG_ 587 S4_SRR_RL_Clu_DynProp_18 "E2E_Order39";
CM_ SG_ 587 S4_SRR_RL_Clu_Locationvalid_18 "E2E_Order40";
CM_ SG_ 587 S4_SRR_RL_Clu_ID_19 "E2E_Order41";
CM_ SG_ 587 S4_SRR_RL_Clu_Theta_19 "E2E_Order42";
CM_ SG_ 587 S4_SRR_RL_Clu_Dist_19 "E2E_Order43";
CM_ SG_ 587 S4_SRR_RL_Clu_Vel_19 "E2E_Order44";
CM_ SG_ 587 S4_SRR_RL_Clu_SNR_19 "E2E_Order45";
CM_ SG_ 587 S4_SRR_RL_Clu_RCS_19 "E2E_Order46";
CM_ SG_ 587 S4_SRR_RL_Clu_DynProp_19 "E2E_Order47";
CM_ SG_ 587 S4_SRR_RL_Clu_Locationvalid_19 "E2E_Order48";
CM_ SG_ 587 S4_SRR_RL_Clu_ID_20 "E2E_Order49";
CM_ SG_ 587 S4_SRR_RL_Clu_Theta_20 "E2E_Order50";
CM_ SG_ 587 S4_SRR_RL_Clu_Dist_20 "E2E_Order51";
CM_ SG_ 587 S4_SRR_RL_Clu_Vel_20 "E2E_Order52";
CM_ SG_ 587 S4_SRR_RL_Clu_SNR_20 "E2E_Order53";
CM_ SG_ 587 S4_SRR_RL_Clu_RCS_20 "E2E_Order54";
CM_ SG_ 587 S4_SRR_RL_Clu_DynProp_20 "E2E_Order55";
CM_ SG_ 587 S4_SRR_RL_Clu_Locationvalid_20 "E2E_Order56";
CM_ SG_ 587 S4_SRR_RL_Clu_2_E2EChecksum "DataID = 0xB42";
CM_ BO_ 588 "The sending period is unstable, ranging from 40 to 80ms
E2E Profile1 Message";
CM_ SG_ 588 S4_SRR_RL_Clu_ID_21 "E2E_Order1";
CM_ SG_ 588 S4_SRR_RL_Clu_Theta_21 "E2E_Order2";
CM_ SG_ 588 S4_SRR_RL_Clu_Dist_21 "E2E_Order3";
CM_ SG_ 588 S4_SRR_RL_Clu_Vel_21 "E2E_Order4";
CM_ SG_ 588 S4_SRR_RL_Clu_SNR_21 "E2E_Order5";
CM_ SG_ 588 S4_SRR_RL_Clu_RCS_21 "E2E_Order6";
CM_ SG_ 588 S4_SRR_RL_Clu_DynProp_21 "E2E_Order7";
CM_ SG_ 588 S4_SRR_RL_Clu_Locationvalid_21 "E2E_Order8";
CM_ SG_ 588 S4_SRR_RL_Clu_ID_22 "E2E_Order9";
CM_ SG_ 588 S4_SRR_RL_Clu_Theta_22 "E2E_Order10";
CM_ SG_ 588 S4_SRR_RL_Clu_Dist_22 "E2E_Order11";
CM_ SG_ 588 S4_SRR_RL_Clu_Vel_22 "E2E_Order12";
CM_ SG_ 588 S4_SRR_RL_Clu_SNR_22 "E2E_Order13";
CM_ SG_ 588 S4_SRR_RL_Clu_RCS_22 "E2E_Order14";
CM_ SG_ 588 S4_SRR_RL_Clu_DynProp_22 "E2E_Order15";
CM_ SG_ 588 S4_SRR_RL_Clu_Locationvalid_22 "E2E_Order16";
CM_ SG_ 588 S4_SRR_RL_Clu_ID_23 "E2E_Order17";
CM_ SG_ 588 S4_SRR_RL_Clu_Theta_23 "E2E_Order18";
CM_ SG_ 588 S4_SRR_RL_Clu_Dist_23 "E2E_Order19";
CM_ SG_ 588 S4_SRR_RL_Clu_Vel_23 "E2E_Order20";
CM_ SG_ 588 S4_SRR_RL_Clu_SNR_23 "E2E_Order21";
CM_ SG_ 588 S4_SRR_RL_Clu_RCS_23 "E2E_Order22";
CM_ SG_ 588 S4_SRR_RL_Clu_DynProp_23 "E2E_Order23";
CM_ SG_ 588 S4_SRR_RL_Clu_Locationvalid_23 "E2E_Order24";
CM_ SG_ 588 S4_SRR_RL_Clu_ID_24 "E2E_Order25";
CM_ SG_ 588 S4_SRR_RL_Clu_Theta_24 "E2E_Order26";
CM_ SG_ 588 S4_SRR_RL_Clu_Dist_24 "E2E_Order27";
CM_ SG_ 588 S4_SRR_RL_Clu_Vel_24 "E2E_Order28";
CM_ SG_ 588 S4_SRR_RL_Clu_SNR_24 "E2E_Order29";
CM_ SG_ 588 S4_SRR_RL_Clu_RCS_24 "E2E_Order30";
CM_ SG_ 588 S4_SRR_RL_Clu_DynProp_24 "E2E_Order31";
CM_ SG_ 588 S4_SRR_RL_Clu_Locationvalid_24 "E2E_Order32";
CM_ SG_ 588 S4_SRR_RL_Clu_ID_25 "E2E_Order33";
CM_ SG_ 588 S4_SRR_RL_Clu_Theta_25 "E2E_Order34";
CM_ SG_ 588 S4_SRR_RL_Clu_Dist_25 "E2E_Order35";
CM_ SG_ 588 S4_SRR_RL_Clu_Vel_25 "E2E_Order36";
CM_ SG_ 588 S4_SRR_RL_Clu_SNR_25 "E2E_Order37";
CM_ SG_ 588 S4_SRR_RL_Clu_RCS_25 "E2E_Order38";
CM_ SG_ 588 S4_SRR_RL_Clu_DynProp_25 "E2E_Order39";
CM_ SG_ 588 S4_SRR_RL_Clu_Locationvalid_25 "E2E_Order40";
CM_ SG_ 588 S4_SRR_RL_Clu_ID_26 "E2E_Order41";
CM_ SG_ 588 S4_SRR_RL_Clu_Theta_26 "E2E_Order42";
CM_ SG_ 588 S4_SRR_RL_Clu_Dist_26 "E2E_Order43";
CM_ SG_ 588 S4_SRR_RL_Clu_Vel_26 "E2E_Order44";
CM_ SG_ 588 S4_SRR_RL_Clu_SNR_26 "E2E_Order45";
CM_ SG_ 588 S4_SRR_RL_Clu_RCS_26 "E2E_Order46";
CM_ SG_ 588 S4_SRR_RL_Clu_DynProp_26 "E2E_Order47";
CM_ SG_ 588 S4_SRR_RL_Clu_Locationvalid_26 "E2E_Order48";
CM_ SG_ 588 S4_SRR_RL_Clu_ID_27 "E2E_Order49";
CM_ SG_ 588 S4_SRR_RL_Clu_Theta_27 "E2E_Order50";
CM_ SG_ 588 S4_SRR_RL_Clu_Dist_27 "E2E_Order51";
CM_ SG_ 588 S4_SRR_RL_Clu_Vel_27 "E2E_Order52";
CM_ SG_ 588 S4_SRR_RL_Clu_SNR_27 "E2E_Order53";
CM_ SG_ 588 S4_SRR_RL_Clu_RCS_27 "E2E_Order54";
CM_ SG_ 588 S4_SRR_RL_Clu_DynProp_27 "E2E_Order55";
CM_ SG_ 588 S4_SRR_RL_Clu_Locationvalid_27 "E2E_Order56";
CM_ SG_ 588 S4_SRR_RL_Clu_3_E2EChecksum "DataID = 0xC42";
CM_ BO_ 589 "The sending period is unstable, ranging from 40 to 80ms
E2E Profile1 Message";
CM_ SG_ 589 S4_SRR_RL_Clu_ID_28 "E2E_Order1";
CM_ SG_ 589 S4_SRR_RL_Clu_Theta_28 "E2E_Order2";
CM_ SG_ 589 S4_SRR_RL_Clu_Dist_28 "E2E_Order3";
CM_ SG_ 589 S4_SRR_RL_Clu_Vel_28 "E2E_Order4";
CM_ SG_ 589 S4_SRR_RL_Clu_SNR_28 "E2E_Order5";
CM_ SG_ 589 S4_SRR_RL_Clu_RCS_28 "E2E_Order6";
CM_ SG_ 589 S4_SRR_RL_Clu_DynProp_28 "E2E_Order7";
CM_ SG_ 589 S4_SRR_RL_Clu_Locationvalid_28 "E2E_Order8";
CM_ SG_ 589 S4_SRR_RL_Clu_ID_29 "E2E_Order9";
CM_ SG_ 589 S4_SRR_RL_Clu_Theta_29 "E2E_Order10";
CM_ SG_ 589 S4_SRR_RL_Clu_Dist_29 "E2E_Order11";
CM_ SG_ 589 S4_SRR_RL_Clu_Vel_29 "E2E_Order12";
CM_ SG_ 589 S4_SRR_RL_Clu_SNR_29 "E2E_Order13";
CM_ SG_ 589 S4_SRR_RL_Clu_RCS_29 "E2E_Order14";
CM_ SG_ 589 S4_SRR_RL_Clu_DynProp_29 "E2E_Order15";
CM_ SG_ 589 S4_SRR_RL_Clu_Locationvalid_29 "E2E_Order16";
CM_ SG_ 589 S4_SRR_RL_Clu_ID_30 "E2E_Order17";
CM_ SG_ 589 S4_SRR_RL_Clu_Theta_30 "E2E_Order18";
CM_ SG_ 589 S4_SRR_RL_Clu_Dist_30 "E2E_Order19";
CM_ SG_ 589 S4_SRR_RL_Clu_Vel_30 "E2E_Order20";
CM_ SG_ 589 S4_SRR_RL_Clu_SNR_30 "E2E_Order21";
CM_ SG_ 589 S4_SRR_RL_Clu_RCS_30 "E2E_Order22";
CM_ SG_ 589 S4_SRR_RL_Clu_DynProp_30 "E2E_Order23";
CM_ SG_ 589 S4_SRR_RL_Clu_Locationvalid_30 "E2E_Order24";
CM_ SG_ 589 S4_SRR_RL_Clu_ID_31 "E2E_Order25";
CM_ SG_ 589 S4_SRR_RL_Clu_Theta_31 "E2E_Order26";
CM_ SG_ 589 S4_SRR_RL_Clu_Dist_31 "E2E_Order27";
CM_ SG_ 589 S4_SRR_RL_Clu_Vel_31 "E2E_Order28";
CM_ SG_ 589 S4_SRR_RL_Clu_SNR_31 "E2E_Order29";
CM_ SG_ 589 S4_SRR_RL_Clu_RCS_31 "E2E_Order30";
CM_ SG_ 589 S4_SRR_RL_Clu_DynProp_31 "E2E_Order31";
CM_ SG_ 589 S4_SRR_RL_Clu_Locationvalid_31 "E2E_Order32";
CM_ SG_ 589 S4_SRR_RL_Clu_ID_32 "E2E_Order33";
CM_ SG_ 589 S4_SRR_RL_Clu_Theta_32 "E2E_Order34";
CM_ SG_ 589 S4_SRR_RL_Clu_Dist_32 "E2E_Order35";
CM_ SG_ 589 S4_SRR_RL_Clu_Vel_32 "E2E_Order36";
CM_ SG_ 589 S4_SRR_RL_Clu_SNR_32 "E2E_Order37";
CM_ SG_ 589 S4_SRR_RL_Clu_RCS_32 "E2E_Order38";
CM_ SG_ 589 S4_SRR_RL_Clu_DynProp_32 "E2E_Order39";
CM_ SG_ 589 S4_SRR_RL_Clu_Locationvalid_32 "E2E_Order40";
CM_ SG_ 589 S4_SRR_RL_Clu_ID_33 "E2E_Order41";
CM_ SG_ 589 S4_SRR_RL_Clu_Theta_33 "E2E_Order42";
CM_ SG_ 589 S4_SRR_RL_Clu_Dist_33 "E2E_Order43";
CM_ SG_ 589 S4_SRR_RL_Clu_Vel_33 "E2E_Order44";
CM_ SG_ 589 S4_SRR_RL_Clu_SNR_33 "E2E_Order45";
CM_ SG_ 589 S4_SRR_RL_Clu_RCS_33 "E2E_Order46";
CM_ SG_ 589 S4_SRR_RL_Clu_DynProp_33 "E2E_Order47";
CM_ SG_ 589 S4_SRR_RL_Clu_Locationvalid_33 "E2E_Order48";
CM_ SG_ 589 S4_SRR_RL_Clu_ID_34 "E2E_Order49";
CM_ SG_ 589 S4_SRR_RL_Clu_Theta_34 "E2E_Order50";
CM_ SG_ 589 S4_SRR_RL_Clu_Dist_34 "E2E_Order51";
CM_ SG_ 589 S4_SRR_RL_Clu_Vel_34 "E2E_Order52";
CM_ SG_ 589 S4_SRR_RL_Clu_SNR_34 "E2E_Order53";
CM_ SG_ 589 S4_SRR_RL_Clu_RCS_34 "E2E_Order54";
CM_ SG_ 589 S4_SRR_RL_Clu_DynProp_34 "E2E_Order55";
CM_ SG_ 589 S4_SRR_RL_Clu_Locationvalid_34 "E2E_Order56";
CM_ SG_ 589 S4_SRR_RL_Clu_4_E2EChecksum "DataID = 0xD42";
CM_ BO_ 590 "The sending period is unstable, ranging from 40 to 80ms
E2E Profile1 Message";
CM_ SG_ 590 S4_SRR_RL_Clu_ID_35 "E2E_Order1";
CM_ SG_ 590 S4_SRR_RL_Clu_Theta_35 "E2E_Order2";
CM_ SG_ 590 S4_SRR_RL_Clu_Dist_35 "E2E_Order3";
CM_ SG_ 590 S4_SRR_RL_Clu_Vel_35 "E2E_Order4";
CM_ SG_ 590 S4_SRR_RL_Clu_SNR_35 "E2E_Order5";
CM_ SG_ 590 S4_SRR_RL_Clu_RCS_35 "E2E_Order6";
CM_ SG_ 590 S4_SRR_RL_Clu_DynProp_35 "E2E_Order7";
CM_ SG_ 590 S4_SRR_RL_Clu_Locationvalid_35 "E2E_Order8";
CM_ SG_ 590 S4_SRR_RL_Clu_ID_36 "E2E_Order9";
CM_ SG_ 590 S4_SRR_RL_Clu_Theta_36 "E2E_Order10";
CM_ SG_ 590 S4_SRR_RL_Clu_Dist_36 "E2E_Order11";
CM_ SG_ 590 S4_SRR_RL_Clu_Vel_36 "E2E_Order12";
CM_ SG_ 590 S4_SRR_RL_Clu_SNR_36 "E2E_Order13";
CM_ SG_ 590 S4_SRR_RL_Clu_RCS_36 "E2E_Order14";
CM_ SG_ 590 S4_SRR_RL_Clu_DynProp_36 "E2E_Order15";
CM_ SG_ 590 S4_SRR_RL_Clu_Locationvalid_36 "E2E_Order16";
CM_ SG_ 590 S4_SRR_RL_Clu_ID_37 "E2E_Order17";
CM_ SG_ 590 S4_SRR_RL_Clu_Theta_37 "E2E_Order18";
CM_ SG_ 590 S4_SRR_RL_Clu_Dist_37 "E2E_Order19";
CM_ SG_ 590 S4_SRR_RL_Clu_Vel_37 "E2E_Order20";
CM_ SG_ 590 S4_SRR_RL_Clu_SNR_37 "E2E_Order21";
CM_ SG_ 590 S4_SRR_RL_Clu_RCS_37 "E2E_Order22";
CM_ SG_ 590 S4_SRR_RL_Clu_DynProp_37 "E2E_Order23";
CM_ SG_ 590 S4_SRR_RL_Clu_Locationvalid_37 "E2E_Order24";
CM_ SG_ 590 S4_SRR_RL_Clu_ID_38 "E2E_Order25";
CM_ SG_ 590 S4_SRR_RL_Clu_Theta_38 "E2E_Order26";
CM_ SG_ 590 S4_SRR_RL_Clu_Dist_38 "E2E_Order27";
CM_ SG_ 590 S4_SRR_RL_Clu_Vel_38 "E2E_Order28";
CM_ SG_ 590 S4_SRR_RL_Clu_SNR_38 "E2E_Order29";
CM_ SG_ 590 S4_SRR_RL_Clu_RCS_38 "E2E_Order30";
CM_ SG_ 590 S4_SRR_RL_Clu_DynProp_38 "E2E_Order31";
CM_ SG_ 590 S4_SRR_RL_Clu_Locationvalid_38 "E2E_Order32";
CM_ SG_ 590 S4_SRR_RL_Clu_ID_39 "E2E_Order33";
CM_ SG_ 590 S4_SRR_RL_Clu_Theta_39 "E2E_Order34";
CM_ SG_ 590 S4_SRR_RL_Clu_Dist_39 "E2E_Order35";
CM_ SG_ 590 S4_SRR_RL_Clu_Vel_39 "E2E_Order36";
CM_ SG_ 590 S4_SRR_RL_Clu_SNR_39 "E2E_Order37";
CM_ SG_ 590 S4_SRR_RL_Clu_RCS_39 "E2E_Order38";
CM_ SG_ 590 S4_SRR_RL_Clu_DynProp_39 "E2E_Order39";
CM_ SG_ 590 S4_SRR_RL_Clu_Locationvalid_39 "E2E_Order40";
CM_ SG_ 590 S4_SRR_RL_Clu_ID_40 "E2E_Order41";
CM_ SG_ 590 S4_SRR_RL_Clu_Theta_40 "E2E_Order42";
CM_ SG_ 590 S4_SRR_RL_Clu_Dist_40 "E2E_Order43";
CM_ SG_ 590 S4_SRR_RL_Clu_Vel_40 "E2E_Order44";
CM_ SG_ 590 S4_SRR_RL_Clu_SNR_40 "E2E_Order45";
CM_ SG_ 590 S4_SRR_RL_Clu_RCS_40 "E2E_Order46";
CM_ SG_ 590 S4_SRR_RL_Clu_DynProp_40 "E2E_Order47";
CM_ SG_ 590 S4_SRR_RL_Clu_Locationvalid_40 "E2E_Order48";
CM_ SG_ 590 S4_SRR_RL_Clu_ID_41 "E2E_Order49";
CM_ SG_ 590 S4_SRR_RL_Clu_Theta_41 "E2E_Order50";
CM_ SG_ 590 S4_SRR_RL_Clu_Dist_41 "E2E_Order51";
CM_ SG_ 590 S4_SRR_RL_Clu_Vel_41 "E2E_Order52";
CM_ SG_ 590 S4_SRR_RL_Clu_SNR_41 "E2E_Order53";
CM_ SG_ 590 S4_SRR_RL_Clu_RCS_41 "E2E_Order54";
CM_ SG_ 590 S4_SRR_RL_Clu_DynProp_41 "E2E_Order55";
CM_ SG_ 590 S4_SRR_RL_Clu_Locationvalid_41 "E2E_Order56";
CM_ SG_ 590 S4_SRR_RL_Clu_5_E2EChecksum "DataID = 0xE42";
CM_ BO_ 591 "The sending period is unstable, ranging from 40 to 80ms
E2E Profile1 Message";
CM_ SG_ 591 S4_SRR_RL_Clu_ID_42 "E2E_Order1";
CM_ SG_ 591 S4_SRR_RL_Clu_Theta_42 "E2E_Order2";
CM_ SG_ 591 S4_SRR_RL_Clu_Dist_42 "E2E_Order3";
CM_ SG_ 591 S4_SRR_RL_Clu_Vel_42 "E2E_Order4";
CM_ SG_ 591 S4_SRR_RL_Clu_SNR_42 "E2E_Order5";
CM_ SG_ 591 S4_SRR_RL_Clu_RCS_42 "E2E_Order6";
CM_ SG_ 591 S4_SRR_RL_Clu_DynProp_42 "E2E_Order7";
CM_ SG_ 591 S4_SRR_RL_Clu_Locationvalid_42 "E2E_Order8";
CM_ SG_ 591 S4_SRR_RL_Clu_ID_43 "E2E_Order9";
CM_ SG_ 591 S4_SRR_RL_Clu_Theta_43 "E2E_Order10";
CM_ SG_ 591 S4_SRR_RL_Clu_Dist_43 "E2E_Order11";
CM_ SG_ 591 S4_SRR_RL_Clu_Vel_43 "E2E_Order12";
CM_ SG_ 591 S4_SRR_RL_Clu_SNR_43 "E2E_Order13";
CM_ SG_ 591 S4_SRR_RL_Clu_RCS_43 "E2E_Order14";
CM_ SG_ 591 S4_SRR_RL_Clu_DynProp_43 "E2E_Order15";
CM_ SG_ 591 S4_SRR_RL_Clu_Locationvalid_43 "E2E_Order16";
CM_ SG_ 591 S4_SRR_RL_Clu_ID_44 "E2E_Order17";
CM_ SG_ 591 S4_SRR_RL_Clu_Theta_44 "E2E_Order18";
CM_ SG_ 591 S4_SRR_RL_Clu_Dist_44 "E2E_Order19";
CM_ SG_ 591 S4_SRR_RL_Clu_Vel_44 "E2E_Order20";
CM_ SG_ 591 S4_SRR_RL_Clu_SNR_44 "E2E_Order21";
CM_ SG_ 591 S4_SRR_RL_Clu_RCS_44 "E2E_Order22";
CM_ SG_ 591 S4_SRR_RL_Clu_DynProp_44 "E2E_Order23";
CM_ SG_ 591 S4_SRR_RL_Clu_Locationvalid_44 "E2E_Order24";
CM_ SG_ 591 S4_SRR_RL_Clu_ID_45 "E2E_Order25";
CM_ SG_ 591 S4_SRR_RL_Clu_Theta_45 "E2E_Order26";
CM_ SG_ 591 S4_SRR_RL_Clu_Dist_45 "E2E_Order27";
CM_ SG_ 591 S4_SRR_RL_Clu_Vel_45 "E2E_Order28";
CM_ SG_ 591 S4_SRR_RL_Clu_SNR_45 "E2E_Order29";
CM_ SG_ 591 S4_SRR_RL_Clu_RCS_45 "E2E_Order30";
CM_ SG_ 591 S4_SRR_RL_Clu_DynProp_45 "E2E_Order31";
CM_ SG_ 591 S4_SRR_RL_Clu_Locationvalid_45 "E2E_Order32";
CM_ SG_ 591 S4_SRR_RL_Clu_ID_46 "E2E_Order33";
CM_ SG_ 591 S4_SRR_RL_Clu_Theta_46 "E2E_Order34";
CM_ SG_ 591 S4_SRR_RL_Clu_Dist_46 "E2E_Order35";
CM_ SG_ 591 S4_SRR_RL_Clu_Vel_46 "E2E_Order36";
CM_ SG_ 591 S4_SRR_RL_Clu_SNR_46 "E2E_Order37";
CM_ SG_ 591 S4_SRR_RL_Clu_RCS_46 "E2E_Order38";
CM_ SG_ 591 S4_SRR_RL_Clu_DynProp_46 "E2E_Order39";
CM_ SG_ 591 S4_SRR_RL_Clu_Locationvalid_46 "E2E_Order40";
CM_ SG_ 591 S4_SRR_RL_Clu_ID_47 "E2E_Order41";
CM_ SG_ 591 S4_SRR_RL_Clu_Theta_47 "E2E_Order42";
CM_ SG_ 591 S4_SRR_RL_Clu_Dist_47 "E2E_Order43";
CM_ SG_ 591 S4_SRR_RL_Clu_Vel_47 "E2E_Order44";
CM_ SG_ 591 S4_SRR_RL_Clu_SNR_47 "E2E_Order45";
CM_ SG_ 591 S4_SRR_RL_Clu_RCS_47 "E2E_Order46";
CM_ SG_ 591 S4_SRR_RL_Clu_DynProp_47 "E2E_Order47";
CM_ SG_ 591 S4_SRR_RL_Clu_Locationvalid_47 "E2E_Order48";
CM_ SG_ 591 S4_SRR_RL_Clu_ID_48 "E2E_Order49";
CM_ SG_ 591 S4_SRR_RL_Clu_Theta_48 "E2E_Order50";
CM_ SG_ 591 S4_SRR_RL_Clu_Dist_48 "E2E_Order51";
CM_ SG_ 591 S4_SRR_RL_Clu_Vel_48 "E2E_Order52";
CM_ SG_ 591 S4_SRR_RL_Clu_SNR_48 "E2E_Order53";
CM_ SG_ 591 S4_SRR_RL_Clu_RCS_48 "E2E_Order54";
CM_ SG_ 591 S4_SRR_RL_Clu_DynProp_48 "E2E_Order55";
CM_ SG_ 591 S4_SRR_RL_Clu_Locationvalid_48 "E2E_Order56";
CM_ SG_ 591 S4_SRR_RL_Clu_6_E2EChecksum "DataID = 0xF42";
CM_ BO_ 592 "The sending period is unstable, ranging from 40 to 80ms
E2E Profile1 Message";
CM_ SG_ 592 S4_SRR_RL_Clu_ID_49 "E2E_Order1";
CM_ SG_ 592 S4_SRR_RL_Clu_Theta_49 "E2E_Order2";
CM_ SG_ 592 S4_SRR_RL_Clu_Dist_49 "E2E_Order3";
CM_ SG_ 592 S4_SRR_RL_Clu_Vel_49 "E2E_Order4";
CM_ SG_ 592 S4_SRR_RL_Clu_SNR_49 "E2E_Order5";
CM_ SG_ 592 S4_SRR_RL_Clu_RCS_49 "E2E_Order6";
CM_ SG_ 592 S4_SRR_RL_Clu_DynProp_49 "E2E_Order7";
CM_ SG_ 592 S4_SRR_RL_Clu_Locationvalid_49 "E2E_Order8";
CM_ SG_ 592 S4_SRR_RL_Clu_ID_50 "E2E_Order9";
CM_ SG_ 592 S4_SRR_RL_Clu_Theta_50 "E2E_Order10";
CM_ SG_ 592 S4_SRR_RL_Clu_Dist_50 "E2E_Order11";
CM_ SG_ 592 S4_SRR_RL_Clu_Vel_50 "E2E_Order12";
CM_ SG_ 592 S4_SRR_RL_Clu_SNR_50 "E2E_Order13";
CM_ SG_ 592 S4_SRR_RL_Clu_RCS_50 "E2E_Order14";
CM_ SG_ 592 S4_SRR_RL_Clu_DynProp_50 "E2E_Order15";
CM_ SG_ 592 S4_SRR_RL_Clu_Locationvalid_50 "E2E_Order16";
CM_ SG_ 592 S4_SRR_RL_Clu_ID_51 "E2E_Order17";
CM_ SG_ 592 S4_SRR_RL_Clu_Theta_51 "E2E_Order18";
CM_ SG_ 592 S4_SRR_RL_Clu_Dist_51 "E2E_Order19";
CM_ SG_ 592 S4_SRR_RL_Clu_Vel_51 "E2E_Order20";
CM_ SG_ 592 S4_SRR_RL_Clu_SNR_51 "E2E_Order21";
CM_ SG_ 592 S4_SRR_RL_Clu_RCS_51 "E2E_Order22";
CM_ SG_ 592 S4_SRR_RL_Clu_DynProp_51 "E2E_Order23";
CM_ SG_ 592 S4_SRR_RL_Clu_Locationvalid_51 "E2E_Order24";
CM_ SG_ 592 S4_SRR_RL_Clu_ID_52 "E2E_Order25";
CM_ SG_ 592 S4_SRR_RL_Clu_Theta_52 "E2E_Order26";
CM_ SG_ 592 S4_SRR_RL_Clu_Dist_52 "E2E_Order27";
CM_ SG_ 592 S4_SRR_RL_Clu_Vel_52 "E2E_Order28";
CM_ SG_ 592 S4_SRR_RL_Clu_SNR_52 "E2E_Order29";
CM_ SG_ 592 S4_SRR_RL_Clu_RCS_52 "E2E_Order30";
CM_ SG_ 592 S4_SRR_RL_Clu_DynProp_52 "E2E_Order31";
CM_ SG_ 592 S4_SRR_RL_Clu_Locationvalid_52 "E2E_Order32";
CM_ SG_ 592 S4_SRR_RL_Clu_ID_53 "E2E_Order33";
CM_ SG_ 592 S4_SRR_RL_Clu_Theta_53 "E2E_Order34";
CM_ SG_ 592 S4_SRR_RL_Clu_Dist_53 "E2E_Order35";
CM_ SG_ 592 S4_SRR_RL_Clu_Vel_53 "E2E_Order36";
CM_ SG_ 592 S4_SRR_RL_Clu_SNR_53 "E2E_Order37";
CM_ SG_ 592 S4_SRR_RL_Clu_RCS_53 "E2E_Order38";
CM_ SG_ 592 S4_SRR_RL_Clu_DynProp_53 "E2E_Order39";
CM_ SG_ 592 S4_SRR_RL_Clu_Locationvalid_53 "E2E_Order40";
CM_ SG_ 592 S4_SRR_RL_Clu_ID_54 "E2E_Order41";
CM_ SG_ 592 S4_SRR_RL_Clu_Theta_54 "E2E_Order42";
CM_ SG_ 592 S4_SRR_RL_Clu_Dist_54 "E2E_Order43";
CM_ SG_ 592 S4_SRR_RL_Clu_Vel_54 "E2E_Order44";
CM_ SG_ 592 S4_SRR_RL_Clu_SNR_54 "E2E_Order45";
CM_ SG_ 592 S4_SRR_RL_Clu_RCS_54 "E2E_Order46";
CM_ SG_ 592 S4_SRR_RL_Clu_DynProp_54 "E2E_Order47";
CM_ SG_ 592 S4_SRR_RL_Clu_Locationvalid_54 "E2E_Order48";
CM_ SG_ 592 S4_SRR_RL_Clu_ID_55 "E2E_Order49";
CM_ SG_ 592 S4_SRR_RL_Clu_Theta_55 "E2E_Order50";
CM_ SG_ 592 S4_SRR_RL_Clu_Dist_55 "E2E_Order51";
CM_ SG_ 592 S4_SRR_RL_Clu_Vel_55 "E2E_Order52";
CM_ SG_ 592 S4_SRR_RL_Clu_SNR_55 "E2E_Order53";
CM_ SG_ 592 S4_SRR_RL_Clu_RCS_55 "E2E_Order54";
CM_ SG_ 592 S4_SRR_RL_Clu_DynProp_55 "E2E_Order55";
CM_ SG_ 592 S4_SRR_RL_Clu_Locationvalid_55 "E2E_Order56";
CM_ SG_ 592 S4_SRR_RL_Clu_7_E2EChecksum "DataID = 0x052";
CM_ BO_ 593 "The sending period is unstable, ranging from 40 to 80ms
E2E Profile1 Message";
CM_ SG_ 593 S4_SRR_RL_Clu_ID_56 "E2E_Order1";
CM_ SG_ 593 S4_SRR_RL_Clu_Theta_56 "E2E_Order2";
CM_ SG_ 593 S4_SRR_RL_Clu_Dist_56 "E2E_Order3";
CM_ SG_ 593 S4_SRR_RL_Clu_Vel_56 "E2E_Order4";
CM_ SG_ 593 S4_SRR_RL_Clu_SNR_56 "E2E_Order5";
CM_ SG_ 593 S4_SRR_RL_Clu_RCS_56 "E2E_Order6";
CM_ SG_ 593 S4_SRR_RL_Clu_DynProp_56 "E2E_Order7";
CM_ SG_ 593 S4_SRR_RL_Clu_Locationvalid_56 "E2E_Order8";
CM_ SG_ 593 S4_SRR_RL_Clu_ID_57 "E2E_Order9";
CM_ SG_ 593 S4_SRR_RL_Clu_Theta_57 "E2E_Order10";
CM_ SG_ 593 S4_SRR_RL_Clu_Dist_57 "E2E_Order11";
CM_ SG_ 593 S4_SRR_RL_Clu_Vel_57 "E2E_Order12";
CM_ SG_ 593 S4_SRR_RL_Clu_SNR_57 "E2E_Order13";
CM_ SG_ 593 S4_SRR_RL_Clu_RCS_57 "E2E_Order14";
CM_ SG_ 593 S4_SRR_RL_Clu_DynProp_57 "E2E_Order15";
CM_ SG_ 593 S4_SRR_RL_Clu_Locationvalid_57 "E2E_Order16";
CM_ SG_ 593 S4_SRR_RL_Clu_ID_58 "E2E_Order17";
CM_ SG_ 593 S4_SRR_RL_Clu_Theta_58 "E2E_Order18";
CM_ SG_ 593 S4_SRR_RL_Clu_Dist_58 "E2E_Order19";
CM_ SG_ 593 S4_SRR_RL_Clu_Vel_58 "E2E_Order20";
CM_ SG_ 593 S4_SRR_RL_Clu_SNR_58 "E2E_Order21";
CM_ SG_ 593 S4_SRR_RL_Clu_RCS_58 "E2E_Order22";
CM_ SG_ 593 S4_SRR_RL_Clu_DynProp_58 "E2E_Order23";
CM_ SG_ 593 S4_SRR_RL_Clu_Locationvalid_58 "E2E_Order24";
CM_ SG_ 593 S4_SRR_RL_Clu_ID_59 "E2E_Order25";
CM_ SG_ 593 S4_SRR_RL_Clu_Theta_59 "E2E_Order26";
CM_ SG_ 593 S4_SRR_RL_Clu_Dist_59 "E2E_Order27";
CM_ SG_ 593 S4_SRR_RL_Clu_Vel_59 "E2E_Order28";
CM_ SG_ 593 S4_SRR_RL_Clu_SNR_59 "E2E_Order29";
CM_ SG_ 593 S4_SRR_RL_Clu_RCS_59 "E2E_Order30";
CM_ SG_ 593 S4_SRR_RL_Clu_DynProp_59 "E2E_Order31";
CM_ SG_ 593 S4_SRR_RL_Clu_Locationvalid_59 "E2E_Order32";
CM_ SG_ 593 S4_SRR_RL_Clu_ID_60 "E2E_Order33";
CM_ SG_ 593 S4_SRR_RL_Clu_Theta_60 "E2E_Order34";
CM_ SG_ 593 S4_SRR_RL_Clu_Dist_60 "E2E_Order35";
CM_ SG_ 593 S4_SRR_RL_Clu_Vel_60 "E2E_Order36";
CM_ SG_ 593 S4_SRR_RL_Clu_SNR_60 "E2E_Order37";
CM_ SG_ 593 S4_SRR_RL_Clu_RCS_60 "E2E_Order38";
CM_ SG_ 593 S4_SRR_RL_Clu_DynProp_60 "E2E_Order39";
CM_ SG_ 593 S4_SRR_RL_Clu_Locationvalid_60 "E2E_Order40";
CM_ SG_ 593 S4_SRR_RL_Clu_ID_61 "E2E_Order41";
CM_ SG_ 593 S4_SRR_RL_Clu_Theta_61 "E2E_Order42";
CM_ SG_ 593 S4_SRR_RL_Clu_Dist_61 "E2E_Order43";
CM_ SG_ 593 S4_SRR_RL_Clu_Vel_61 "E2E_Order44";
CM_ SG_ 593 S4_SRR_RL_Clu_SNR_61 "E2E_Order45";
CM_ SG_ 593 S4_SRR_RL_Clu_RCS_61 "E2E_Order46";
CM_ SG_ 593 S4_SRR_RL_Clu_DynProp_61 "E2E_Order47";
CM_ SG_ 593 S4_SRR_RL_Clu_Locationvalid_61 "E2E_Order48";
CM_ SG_ 593 S4_SRR_RL_Clu_ID_62 "E2E_Order49";
CM_ SG_ 593 S4_SRR_RL_Clu_Theta_62 "E2E_Order50";
CM_ SG_ 593 S4_SRR_RL_Clu_Dist_62 "E2E_Order51";
CM_ SG_ 593 S4_SRR_RL_Clu_Vel_62 "E2E_Order52";
CM_ SG_ 593 S4_SRR_RL_Clu_SNR_62 "E2E_Order53";
CM_ SG_ 593 S4_SRR_RL_Clu_RCS_62 "E2E_Order54";
CM_ SG_ 593 S4_SRR_RL_Clu_DynProp_62 "E2E_Order55";
CM_ SG_ 593 S4_SRR_RL_Clu_Locationvalid_62 "E2E_Order56";
CM_ SG_ 593 S4_SRR_RL_Clu_8_E2EChecksum "DataID = 0x152";
CM_ BO_ 594 "The sending period is unstable, ranging from 40 to 80ms
E2E Profile1 Message";
CM_ SG_ 594 S4_SRR_RL_Clu_ID_63 "E2E_Order1";
CM_ SG_ 594 S4_SRR_RL_Clu_Theta_63 "E2E_Order2";
CM_ SG_ 594 S4_SRR_RL_Clu_Dist_63 "E2E_Order3";
CM_ SG_ 594 S4_SRR_RL_Clu_Vel_63 "E2E_Order4";
CM_ SG_ 594 S4_SRR_RL_Clu_SNR_63 "E2E_Order5";
CM_ SG_ 594 S4_SRR_RL_Clu_RCS_63 "E2E_Order6";
CM_ SG_ 594 S4_SRR_RL_Clu_DynProp_63 "E2E_Order7";
CM_ SG_ 594 S4_SRR_RL_Clu_Locationvalid_63 "E2E_Order8";
CM_ SG_ 594 S4_SRR_RL_Clu_ID_64 "E2E_Order9";
CM_ SG_ 594 S4_SRR_RL_Clu_Theta_64 "E2E_Order10";
CM_ SG_ 594 S4_SRR_RL_Clu_Dist_64 "E2E_Order11";
CM_ SG_ 594 S4_SRR_RL_Clu_Vel_64 "E2E_Order12";
CM_ SG_ 594 S4_SRR_RL_Clu_SNR_64 "E2E_Order13";
CM_ SG_ 594 S4_SRR_RL_Clu_RCS_64 "E2E_Order14";
CM_ SG_ 594 S4_SRR_RL_Clu_DynProp_64 "E2E_Order15";
CM_ SG_ 594 S4_SRR_RL_Clu_Locationvalid_64 "E2E_Order16";
CM_ SG_ 594 S4_SRR_RL_Clu_ID_65 "E2E_Order17";
CM_ SG_ 594 S4_SRR_RL_Clu_Theta_65 "E2E_Order18";
CM_ SG_ 594 S4_SRR_RL_Clu_Dist_65 "E2E_Order19";
CM_ SG_ 594 S4_SRR_RL_Clu_Vel_65 "E2E_Order20";
CM_ SG_ 594 S4_SRR_RL_Clu_SNR_65 "E2E_Order21";
CM_ SG_ 594 S4_SRR_RL_Clu_RCS_65 "E2E_Order22";
CM_ SG_ 594 S4_SRR_RL_Clu_DynProp_65 "E2E_Order23";
CM_ SG_ 594 S4_SRR_RL_Clu_Locationvalid_65 "E2E_Order24";
CM_ SG_ 594 S4_SRR_RL_Clu_ID_66 "E2E_Order25";
CM_ SG_ 594 S4_SRR_RL_Clu_Theta_66 "E2E_Order26";
CM_ SG_ 594 S4_SRR_RL_Clu_Dist_66 "E2E_Order27";
CM_ SG_ 594 S4_SRR_RL_Clu_Vel_66 "E2E_Order28";
CM_ SG_ 594 S4_SRR_RL_Clu_SNR_66 "E2E_Order29";
CM_ SG_ 594 S4_SRR_RL_Clu_RCS_66 "E2E_Order30";
CM_ SG_ 594 S4_SRR_RL_Clu_DynProp_66 "E2E_Order31";
CM_ SG_ 594 S4_SRR_RL_Clu_Locationvalid_66 "E2E_Order32";
CM_ SG_ 594 S4_SRR_RL_Clu_ID_67 "E2E_Order33";
CM_ SG_ 594 S4_SRR_RL_Clu_Theta_67 "E2E_Order34";
CM_ SG_ 594 S4_SRR_RL_Clu_Dist_67 "E2E_Order35";
CM_ SG_ 594 S4_SRR_RL_Clu_Vel_67 "E2E_Order36";
CM_ SG_ 594 S4_SRR_RL_Clu_SNR_67 "E2E_Order37";
CM_ SG_ 594 S4_SRR_RL_Clu_RCS_67 "E2E_Order38";
CM_ SG_ 594 S4_SRR_RL_Clu_DynProp_67 "E2E_Order39";
CM_ SG_ 594 S4_SRR_RL_Clu_Locationvalid_67 "E2E_Order40";
CM_ SG_ 594 S4_SRR_RL_Clu_ID_68 "E2E_Order41";
CM_ SG_ 594 S4_SRR_RL_Clu_Theta_68 "E2E_Order42";
CM_ SG_ 594 S4_SRR_RL_Clu_Dist_68 "E2E_Order43";
CM_ SG_ 594 S4_SRR_RL_Clu_Vel_68 "E2E_Order44";
CM_ SG_ 594 S4_SRR_RL_Clu_SNR_68 "E2E_Order45";
CM_ SG_ 594 S4_SRR_RL_Clu_RCS_68 "E2E_Order46";
CM_ SG_ 594 S4_SRR_RL_Clu_DynProp_68 "E2E_Order47";
CM_ SG_ 594 S4_SRR_RL_Clu_Locationvalid_68 "E2E_Order48";
CM_ SG_ 594 S4_SRR_RL_Clu_ID_69 "E2E_Order49";
CM_ SG_ 594 S4_SRR_RL_Clu_Theta_69 "E2E_Order50";
CM_ SG_ 594 S4_SRR_RL_Clu_Dist_69 "E2E_Order51";
CM_ SG_ 594 S4_SRR_RL_Clu_Vel_69 "E2E_Order52";
CM_ SG_ 594 S4_SRR_RL_Clu_SNR_69 "E2E_Order53";
CM_ SG_ 594 S4_SRR_RL_Clu_RCS_69 "E2E_Order54";
CM_ SG_ 594 S4_SRR_RL_Clu_DynProp_69 "E2E_Order55";
CM_ SG_ 594 S4_SRR_RL_Clu_Locationvalid_69 "E2E_Order56";
CM_ SG_ 594 S4_SRR_RL_Clu_9_E2EChecksum "DataID = 0x252";
CM_ BO_ 595 "The sending period is unstable, ranging from 40 to 80ms
E2E Profile1 Message";
CM_ SG_ 595 S4_SRR_RL_Clu_ID_70 "E2E_Order1";
CM_ SG_ 595 S4_SRR_RL_Clu_Theta_70 "E2E_Order2";
CM_ SG_ 595 S4_SRR_RL_Clu_Dist_70 "E2E_Order3";
CM_ SG_ 595 S4_SRR_RL_Clu_Vel_70 "E2E_Order4";
CM_ SG_ 595 S4_SRR_RL_Clu_SNR_70 "E2E_Order5";
CM_ SG_ 595 S4_SRR_RL_Clu_RCS_70 "E2E_Order6";
CM_ SG_ 595 S4_SRR_RL_Clu_DynProp_70 "E2E_Order7";
CM_ SG_ 595 S4_SRR_RL_Clu_Locationvalid_70 "E2E_Order8";
CM_ SG_ 595 S4_SRR_RL_Clu_ID_71 "E2E_Order9";
CM_ SG_ 595 S4_SRR_RL_Clu_Theta_71 "E2E_Order10";
CM_ SG_ 595 S4_SRR_RL_Clu_Dist_71 "E2E_Order11";
CM_ SG_ 595 S4_SRR_RL_Clu_Vel_71 "E2E_Order12";
CM_ SG_ 595 S4_SRR_RL_Clu_SNR_71 "E2E_Order13";
CM_ SG_ 595 S4_SRR_RL_Clu_RCS_71 "E2E_Order14";
CM_ SG_ 595 S4_SRR_RL_Clu_DynProp_71 "E2E_Order15";
CM_ SG_ 595 S4_SRR_RL_Clu_Locationvalid_71 "E2E_Order16";
CM_ SG_ 595 S4_SRR_RL_Clu_ID_72 "E2E_Order17";
CM_ SG_ 595 S4_SRR_RL_Clu_Theta_72 "E2E_Order18";
CM_ SG_ 595 S4_SRR_RL_Clu_Dist_72 "E2E_Order19";
CM_ SG_ 595 S4_SRR_RL_Clu_Vel_72 "E2E_Order20";
CM_ SG_ 595 S4_SRR_RL_Clu_SNR_72 "E2E_Order21";
CM_ SG_ 595 S4_SRR_RL_Clu_RCS_72 "E2E_Order22";
CM_ SG_ 595 S4_SRR_RL_Clu_DynProp_72 "E2E_Order23";
CM_ SG_ 595 S4_SRR_RL_Clu_Locationvalid_72 "E2E_Order24";
CM_ SG_ 595 S4_SRR_RL_Clu_ID_73 "E2E_Order25";
CM_ SG_ 595 S4_SRR_RL_Clu_Theta_73 "E2E_Order26";
CM_ SG_ 595 S4_SRR_RL_Clu_Dist_73 "E2E_Order27";
CM_ SG_ 595 S4_SRR_RL_Clu_Vel_73 "E2E_Order28";
CM_ SG_ 595 S4_SRR_RL_Clu_SNR_73 "E2E_Order29";
CM_ SG_ 595 S4_SRR_RL_Clu_RCS_73 "E2E_Order30";
CM_ SG_ 595 S4_SRR_RL_Clu_DynProp_73 "E2E_Order31";
CM_ SG_ 595 S4_SRR_RL_Clu_Locationvalid_73 "E2E_Order32";
CM_ SG_ 595 S4_SRR_RL_Clu_ID_74 "E2E_Order33";
CM_ SG_ 595 S4_SRR_RL_Clu_Theta_74 "E2E_Order34";
CM_ SG_ 595 S4_SRR_RL_Clu_Dist_74 "E2E_Order35";
CM_ SG_ 595 S4_SRR_RL_Clu_Vel_74 "E2E_Order36";
CM_ SG_ 595 S4_SRR_RL_Clu_SNR_74 "E2E_Order37";
CM_ SG_ 595 S4_SRR_RL_Clu_RCS_74 "E2E_Order38";
CM_ SG_ 595 S4_SRR_RL_Clu_DynProp_74 "E2E_Order39";
CM_ SG_ 595 S4_SRR_RL_Clu_Locationvalid_74 "E2E_Order40";
CM_ SG_ 595 S4_SRR_RL_Clu_ID_75 "E2E_Order41";
CM_ SG_ 595 S4_SRR_RL_Clu_Theta_75 "E2E_Order42";
CM_ SG_ 595 S4_SRR_RL_Clu_Dist_75 "E2E_Order43";
CM_ SG_ 595 S4_SRR_RL_Clu_Vel_75 "E2E_Order44";
CM_ SG_ 595 S4_SRR_RL_Clu_SNR_75 "E2E_Order45";
CM_ SG_ 595 S4_SRR_RL_Clu_RCS_75 "E2E_Order46";
CM_ SG_ 595 S4_SRR_RL_Clu_DynProp_75 "E2E_Order47";
CM_ SG_ 595 S4_SRR_RL_Clu_Locationvalid_75 "E2E_Order48";
CM_ SG_ 595 S4_SRR_RL_Clu_ID_76 "E2E_Order49";
CM_ SG_ 595 S4_SRR_RL_Clu_Theta_76 "E2E_Order50";
CM_ SG_ 595 S4_SRR_RL_Clu_Dist_76 "E2E_Order51";
CM_ SG_ 595 S4_SRR_RL_Clu_Vel_76 "E2E_Order52";
CM_ SG_ 595 S4_SRR_RL_Clu_SNR_76 "E2E_Order53";
CM_ SG_ 595 S4_SRR_RL_Clu_RCS_76 "E2E_Order54";
CM_ SG_ 595 S4_SRR_RL_Clu_DynProp_76 "E2E_Order55";
CM_ SG_ 595 S4_SRR_RL_Clu_Locationvalid_76 "E2E_Order56";
CM_ SG_ 595 S4_SRR_RL_Clu_10_E2EChecksum "DataID = 0x352";
CM_ BO_ 596 "The sending period is unstable, ranging from 40 to 80ms
E2E Profile1 Message";
CM_ SG_ 596 S4_SRR_RL_Clu_ID_77 "E2E_Order1";
CM_ SG_ 596 S4_SRR_RL_Clu_Theta_77 "E2E_Order2";
CM_ SG_ 596 S4_SRR_RL_Clu_Dist_77 "E2E_Order3";
CM_ SG_ 596 S4_SRR_RL_Clu_Vel_77 "E2E_Order4";
CM_ SG_ 596 S4_SRR_RL_Clu_SNR_77 "E2E_Order5";
CM_ SG_ 596 S4_SRR_RL_Clu_RCS_77 "E2E_Order6";
CM_ SG_ 596 S4_SRR_RL_Clu_DynProp_77 "E2E_Order7";
CM_ SG_ 596 S4_SRR_RL_Clu_Locationvalid_77 "E2E_Order8";
CM_ SG_ 596 S4_SRR_RL_Clu_ID_78 "E2E_Order9";
CM_ SG_ 596 S4_SRR_RL_Clu_Theta_78 "E2E_Order10";
CM_ SG_ 596 S4_SRR_RL_Clu_Dist_78 "E2E_Order11";
CM_ SG_ 596 S4_SRR_RL_Clu_Vel_78 "E2E_Order12";
CM_ SG_ 596 S4_SRR_RL_Clu_SNR_78 "E2E_Order13";
CM_ SG_ 596 S4_SRR_RL_Clu_RCS_78 "E2E_Order14";
CM_ SG_ 596 S4_SRR_RL_Clu_DynProp_78 "E2E_Order15";
CM_ SG_ 596 S4_SRR_RL_Clu_Locationvalid_78 "E2E_Order16";
CM_ SG_ 596 S4_SRR_RL_Clu_ID_79 "E2E_Order17";
CM_ SG_ 596 S4_SRR_RL_Clu_Theta_79 "E2E_Order18";
CM_ SG_ 596 S4_SRR_RL_Clu_Dist_79 "E2E_Order19";
CM_ SG_ 596 S4_SRR_RL_Clu_Vel_79 "E2E_Order20";
CM_ SG_ 596 S4_SRR_RL_Clu_SNR_79 "E2E_Order21";
CM_ SG_ 596 S4_SRR_RL_Clu_RCS_79 "E2E_Order22";
CM_ SG_ 596 S4_SRR_RL_Clu_DynProp_79 "E2E_Order23";
CM_ SG_ 596 S4_SRR_RL_Clu_Locationvalid_79 "E2E_Order24";
CM_ SG_ 596 S4_SRR_RL_Clu_ID_80 "E2E_Order25";
CM_ SG_ 596 S4_SRR_RL_Clu_Theta_80 "E2E_Order26";
CM_ SG_ 596 S4_SRR_RL_Clu_Dist_80 "E2E_Order27";
CM_ SG_ 596 S4_SRR_RL_Clu_Vel_80 "E2E_Order28";
CM_ SG_ 596 S4_SRR_RL_Clu_SNR_80 "E2E_Order29";
CM_ SG_ 596 S4_SRR_RL_Clu_RCS_80 "E2E_Order30";
CM_ SG_ 596 S4_SRR_RL_Clu_DynProp_80 "E2E_Order31";
CM_ SG_ 596 S4_SRR_RL_Clu_Locationvalid_80 "E2E_Order32";
CM_ SG_ 596 S4_SRR_RL_Clu_ID_81 "E2E_Order33";
CM_ SG_ 596 S4_SRR_RL_Clu_Theta_81 "E2E_Order34";
CM_ SG_ 596 S4_SRR_RL_Clu_Dist_81 "E2E_Order35";
CM_ SG_ 596 S4_SRR_RL_Clu_Vel_81 "E2E_Order36";
CM_ SG_ 596 S4_SRR_RL_Clu_SNR_81 "E2E_Order37";
CM_ SG_ 596 S4_SRR_RL_Clu_RCS_81 "E2E_Order38";
CM_ SG_ 596 S4_SRR_RL_Clu_DynProp_81 "E2E_Order39";
CM_ SG_ 596 S4_SRR_RL_Clu_Locationvalid_81 "E2E_Order40";
CM_ SG_ 596 S4_SRR_RL_Clu_ID_82 "E2E_Order41";
CM_ SG_ 596 S4_SRR_RL_Clu_Theta_82 "E2E_Order42";
CM_ SG_ 596 S4_SRR_RL_Clu_Dist_82 "E2E_Order43";
CM_ SG_ 596 S4_SRR_RL_Clu_Vel_82 "E2E_Order44";
CM_ SG_ 596 S4_SRR_RL_Clu_SNR_82 "E2E_Order45";
CM_ SG_ 596 S4_SRR_RL_Clu_RCS_82 "E2E_Order46";
CM_ SG_ 596 S4_SRR_RL_Clu_DynProp_82 "E2E_Order47";
CM_ SG_ 596 S4_SRR_RL_Clu_Locationvalid_82 "E2E_Order48";
CM_ SG_ 596 S4_SRR_RL_Clu_ID_83 "E2E_Order49";
CM_ SG_ 596 S4_SRR_RL_Clu_Theta_83 "E2E_Order50";
CM_ SG_ 596 S4_SRR_RL_Clu_Dist_83 "E2E_Order51";
CM_ SG_ 596 S4_SRR_RL_Clu_Vel_83 "E2E_Order52";
CM_ SG_ 596 S4_SRR_RL_Clu_SNR_83 "E2E_Order53";
CM_ SG_ 596 S4_SRR_RL_Clu_RCS_83 "E2E_Order54";
CM_ SG_ 596 S4_SRR_RL_Clu_DynProp_83 "E2E_Order55";
CM_ SG_ 596 S4_SRR_RL_Clu_Locationvalid_83 "E2E_Order56";
CM_ SG_ 596 S4_SRR_RL_Clu_11_E2EChecksum "DataID = 0x452";
CM_ BO_ 597 "The sending period is unstable, ranging from 40 to 80ms
E2E Profile1 Message";
CM_ SG_ 597 S4_SRR_RL_Clu_ID_84 "E2E_Order1";
CM_ SG_ 597 S4_SRR_RL_Clu_Theta_84 "E2E_Order2";
CM_ SG_ 597 S4_SRR_RL_Clu_Dist_84 "E2E_Order3";
CM_ SG_ 597 S4_SRR_RL_Clu_Vel_84 "E2E_Order4";
CM_ SG_ 597 S4_SRR_RL_Clu_SNR_84 "E2E_Order5";
CM_ SG_ 597 S4_SRR_RL_Clu_RCS_84 "E2E_Order6";
CM_ SG_ 597 S4_SRR_RL_Clu_DynProp_84 "E2E_Order7";
CM_ SG_ 597 S4_SRR_RL_Clu_Locationvalid_84 "E2E_Order8";
CM_ SG_ 597 S4_SRR_RL_Clu_ID_85 "E2E_Order9";
CM_ SG_ 597 S4_SRR_RL_Clu_Theta_85 "E2E_Order10";
CM_ SG_ 597 S4_SRR_RL_Clu_Dist_85 "E2E_Order11";
CM_ SG_ 597 S4_SRR_RL_Clu_Vel_85 "E2E_Order12";
CM_ SG_ 597 S4_SRR_RL_Clu_SNR_85 "E2E_Order13";
CM_ SG_ 597 S4_SRR_RL_Clu_RCS_85 "E2E_Order14";
CM_ SG_ 597 S4_SRR_RL_Clu_DynProp_85 "E2E_Order15";
CM_ SG_ 597 S4_SRR_RL_Clu_Locationvalid_85 "E2E_Order16";
CM_ SG_ 597 S4_SRR_RL_Clu_ID_86 "E2E_Order17";
CM_ SG_ 597 S4_SRR_RL_Clu_Theta_86 "E2E_Order18";
CM_ SG_ 597 S4_SRR_RL_Clu_Dist_86 "E2E_Order19";
CM_ SG_ 597 S4_SRR_RL_Clu_Vel_86 "E2E_Order20";
CM_ SG_ 597 S4_SRR_RL_Clu_SNR_86 "E2E_Order21";
CM_ SG_ 597 S4_SRR_RL_Clu_RCS_86 "E2E_Order22";
CM_ SG_ 597 S4_SRR_RL_Clu_DynProp_86 "E2E_Order23";
CM_ SG_ 597 S4_SRR_RL_Clu_Locationvalid_86 "E2E_Order24";
CM_ SG_ 597 S4_SRR_RL_Clu_ID_87 "E2E_Order25";
CM_ SG_ 597 S4_SRR_RL_Clu_Theta_87 "E2E_Order26";
CM_ SG_ 597 S4_SRR_RL_Clu_Dist_87 "E2E_Order27";
CM_ SG_ 597 S4_SRR_RL_Clu_Vel_87 "E2E_Order28";
CM_ SG_ 597 S4_SRR_RL_Clu_SNR_87 "E2E_Order29";
CM_ SG_ 597 S4_SRR_RL_Clu_RCS_87 "E2E_Order30";
CM_ SG_ 597 S4_SRR_RL_Clu_DynProp_87 "E2E_Order31";
CM_ SG_ 597 S4_SRR_RL_Clu_Locationvalid_87 "E2E_Order32";
CM_ SG_ 597 S4_SRR_RL_Clu_ID_88 "E2E_Order33";
CM_ SG_ 597 S4_SRR_RL_Clu_Theta_88 "E2E_Order34";
CM_ SG_ 597 S4_SRR_RL_Clu_Dist_88 "E2E_Order35";
CM_ SG_ 597 S4_SRR_RL_Clu_Vel_88 "E2E_Order36";
CM_ SG_ 597 S4_SRR_RL_Clu_SNR_88 "E2E_Order37";
CM_ SG_ 597 S4_SRR_RL_Clu_RCS_88 "E2E_Order38";
CM_ SG_ 597 S4_SRR_RL_Clu_DynProp_88 "E2E_Order39";
CM_ SG_ 597 S4_SRR_RL_Clu_Locationvalid_88 "E2E_Order40";
CM_ SG_ 597 S4_SRR_RL_Clu_ID_89 "E2E_Order41";
CM_ SG_ 597 S4_SRR_RL_Clu_Theta_89 "E2E_Order42";
CM_ SG_ 597 S4_SRR_RL_Clu_Dist_89 "E2E_Order43";
CM_ SG_ 597 S4_SRR_RL_Clu_Vel_89 "E2E_Order44";
CM_ SG_ 597 S4_SRR_RL_Clu_SNR_89 "E2E_Order45";
CM_ SG_ 597 S4_SRR_RL_Clu_RCS_89 "E2E_Order46";
CM_ SG_ 597 S4_SRR_RL_Clu_DynProp_89 "E2E_Order47";
CM_ SG_ 597 S4_SRR_RL_Clu_Locationvalid_89 "E2E_Order48";
CM_ SG_ 597 S4_SRR_RL_Clu_ID_90 "E2E_Order49";
CM_ SG_ 597 S4_SRR_RL_Clu_Theta_90 "E2E_Order50";
CM_ SG_ 597 S4_SRR_RL_Clu_Dist_90 "E2E_Order51";
CM_ SG_ 597 S4_SRR_RL_Clu_Vel_90 "E2E_Order52";
CM_ SG_ 597 S4_SRR_RL_Clu_SNR_90 "E2E_Order53";
CM_ SG_ 597 S4_SRR_RL_Clu_RCS_90 "E2E_Order54";
CM_ SG_ 597 S4_SRR_RL_Clu_DynProp_90 "E2E_Order55";
CM_ SG_ 597 S4_SRR_RL_Clu_Locationvalid_90 "E2E_Order56";
CM_ SG_ 597 S4_SRR_RL_Clu_12_E2EChecksum "DataID = 0x552";
CM_ BO_ 598 "The sending period is unstable, ranging from 40 to 80ms
E2E Profile1 Message";
CM_ SG_ 598 S4_SRR_RL_Clu_ID_91 "E2E_Order1";
CM_ SG_ 598 S4_SRR_RL_Clu_Theta_91 "E2E_Order2";
CM_ SG_ 598 S4_SRR_RL_Clu_Dist_91 "E2E_Order3";
CM_ SG_ 598 S4_SRR_RL_Clu_Vel_91 "E2E_Order4";
CM_ SG_ 598 S4_SRR_RL_Clu_SNR_91 "E2E_Order5";
CM_ SG_ 598 S4_SRR_RL_Clu_RCS_91 "E2E_Order6";
CM_ SG_ 598 S4_SRR_RL_Clu_DynProp_91 "E2E_Order7";
CM_ SG_ 598 S4_SRR_RL_Clu_Locationvalid_91 "E2E_Order8";
CM_ SG_ 598 S4_SRR_RL_Clu_ID_92 "E2E_Order9";
CM_ SG_ 598 S4_SRR_RL_Clu_Theta_92 "E2E_Order10";
CM_ SG_ 598 S4_SRR_RL_Clu_Dist_92 "E2E_Order11";
CM_ SG_ 598 S4_SRR_RL_Clu_Vel_92 "E2E_Order12";
CM_ SG_ 598 S4_SRR_RL_Clu_SNR_92 "E2E_Order13";
CM_ SG_ 598 S4_SRR_RL_Clu_RCS_92 "E2E_Order14";
CM_ SG_ 598 S4_SRR_RL_Clu_DynProp_92 "E2E_Order15";
CM_ SG_ 598 S4_SRR_RL_Clu_Locationvalid_92 "E2E_Order16";
CM_ SG_ 598 S4_SRR_RL_Clu_ID_93 "E2E_Order17";
CM_ SG_ 598 S4_SRR_RL_Clu_Theta_93 "E2E_Order18";
CM_ SG_ 598 S4_SRR_RL_Clu_Dist_93 "E2E_Order19";
CM_ SG_ 598 S4_SRR_RL_Clu_Vel_93 "E2E_Order20";
CM_ SG_ 598 S4_SRR_RL_Clu_SNR_93 "E2E_Order21";
CM_ SG_ 598 S4_SRR_RL_Clu_RCS_93 "E2E_Order22";
CM_ SG_ 598 S4_SRR_RL_Clu_DynProp_93 "E2E_Order23";
CM_ SG_ 598 S4_SRR_RL_Clu_Locationvalid_93 "E2E_Order24";
CM_ SG_ 598 S4_SRR_RL_Clu_ID_94 "E2E_Order25";
CM_ SG_ 598 S4_SRR_RL_Clu_Theta_94 "E2E_Order26";
CM_ SG_ 598 S4_SRR_RL_Clu_Dist_94 "E2E_Order27";
CM_ SG_ 598 S4_SRR_RL_Clu_Vel_94 "E2E_Order28";
CM_ SG_ 598 S4_SRR_RL_Clu_SNR_94 "E2E_Order29";
CM_ SG_ 598 S4_SRR_RL_Clu_RCS_94 "E2E_Order30";
CM_ SG_ 598 S4_SRR_RL_Clu_DynProp_94 "E2E_Order31";
CM_ SG_ 598 S4_SRR_RL_Clu_Locationvalid_94 "E2E_Order32";
CM_ SG_ 598 S4_SRR_RL_Clu_ID_95 "E2E_Order33";
CM_ SG_ 598 S4_SRR_RL_Clu_Theta_95 "E2E_Order34";
CM_ SG_ 598 S4_SRR_RL_Clu_Dist_95 "E2E_Order35";
CM_ SG_ 598 S4_SRR_RL_Clu_Vel_95 "E2E_Order36";
CM_ SG_ 598 S4_SRR_RL_Clu_SNR_95 "E2E_Order37";
CM_ SG_ 598 S4_SRR_RL_Clu_RCS_95 "E2E_Order38";
CM_ SG_ 598 S4_SRR_RL_Clu_DynProp_95 "E2E_Order39";
CM_ SG_ 598 S4_SRR_RL_Clu_Locationvalid_95 "E2E_Order40";
CM_ SG_ 598 S4_SRR_RL_Clu_ID_96 "E2E_Order41";
CM_ SG_ 598 S4_SRR_RL_Clu_Theta_96 "E2E_Order42";
CM_ SG_ 598 S4_SRR_RL_Clu_Dist_96 "E2E_Order43";
CM_ SG_ 598 S4_SRR_RL_Clu_Vel_96 "E2E_Order44";
CM_ SG_ 598 S4_SRR_RL_Clu_SNR_96 "E2E_Order45";
CM_ SG_ 598 S4_SRR_RL_Clu_RCS_96 "E2E_Order46";
CM_ SG_ 598 S4_SRR_RL_Clu_DynProp_96 "E2E_Order47";
CM_ SG_ 598 S4_SRR_RL_Clu_Locationvalid_96 "E2E_Order48";
CM_ SG_ 598 S4_SRR_RL_Clu_ID_97 "E2E_Order49";
CM_ SG_ 598 S4_SRR_RL_Clu_Theta_97 "E2E_Order50";
CM_ SG_ 598 S4_SRR_RL_Clu_Dist_97 "E2E_Order51";
CM_ SG_ 598 S4_SRR_RL_Clu_Vel_97 "E2E_Order52";
CM_ SG_ 598 S4_SRR_RL_Clu_SNR_97 "E2E_Order53";
CM_ SG_ 598 S4_SRR_RL_Clu_RCS_97 "E2E_Order54";
CM_ SG_ 598 S4_SRR_RL_Clu_DynProp_97 "E2E_Order55";
CM_ SG_ 598 S4_SRR_RL_Clu_Locationvalid_97 "E2E_Order56";
CM_ SG_ 598 S4_SRR_RL_Clu_13_E2EChecksum "DataID = 0x652";
CM_ BO_ 599 "The sending period is unstable, ranging from 40 to 80ms
E2E Profile1 Message";
CM_ SG_ 599 S4_SRR_RL_Clu_ID_98 "E2E_Order1";
CM_ SG_ 599 S4_SRR_RL_Clu_Theta_98 "E2E_Order2";
CM_ SG_ 599 S4_SRR_RL_Clu_Dist_98 "E2E_Order3";
CM_ SG_ 599 S4_SRR_RL_Clu_Vel_98 "E2E_Order4";
CM_ SG_ 599 S4_SRR_RL_Clu_SNR_98 "E2E_Order5";
CM_ SG_ 599 S4_SRR_RL_Clu_RCS_98 "E2E_Order6";
CM_ SG_ 599 S4_SRR_RL_Clu_DynProp_98 "E2E_Order7";
CM_ SG_ 599 S4_SRR_RL_Clu_Locationvalid_98 "E2E_Order8";
CM_ SG_ 599 S4_SRR_RL_Clu_ID_99 "E2E_Order9";
CM_ SG_ 599 S4_SRR_RL_Clu_Theta_99 "E2E_Order10";
CM_ SG_ 599 S4_SRR_RL_Clu_Dist_99 "E2E_Order11";
CM_ SG_ 599 S4_SRR_RL_Clu_Vel_99 "E2E_Order12";
CM_ SG_ 599 S4_SRR_RL_Clu_SNR_99 "E2E_Order13";
CM_ SG_ 599 S4_SRR_RL_Clu_RCS_99 "E2E_Order14";
CM_ SG_ 599 S4_SRR_RL_Clu_DynProp_99 "E2E_Order15";
CM_ SG_ 599 S4_SRR_RL_Clu_Locationvalid_99 "E2E_Order16";
CM_ SG_ 599 S4_SRR_RL_Clu_ID_100 "E2E_Order17";
CM_ SG_ 599 S4_SRR_RL_Clu_Theta_100 "E2E_Order18";
CM_ SG_ 599 S4_SRR_RL_Clu_Dist_100 "E2E_Order19";
CM_ SG_ 599 S4_SRR_RL_Clu_Vel_100 "E2E_Order20";
CM_ SG_ 599 S4_SRR_RL_Clu_SNR_100 "E2E_Order21";
CM_ SG_ 599 S4_SRR_RL_Clu_RCS_100 "E2E_Order22";
CM_ SG_ 599 S4_SRR_RL_Clu_DynProp_100 "E2E_Order23";
CM_ SG_ 599 S4_SRR_RL_Clu_Locationvalid_100 "E2E_Order24";
CM_ SG_ 599 S4_SRR_RL_Clu_ID_101 "E2E_Order25";
CM_ SG_ 599 S4_SRR_RL_Clu_Theta_101 "E2E_Order26";
CM_ SG_ 599 S4_SRR_RL_Clu_Dist_101 "E2E_Order27";
CM_ SG_ 599 S4_SRR_RL_Clu_Vel_101 "E2E_Order28";
CM_ SG_ 599 S4_SRR_RL_Clu_SNR_101 "E2E_Order29";
CM_ SG_ 599 S4_SRR_RL_Clu_RCS_101 "E2E_Order30";
CM_ SG_ 599 S4_SRR_RL_Clu_DynProp_101 "E2E_Order31";
CM_ SG_ 599 S4_SRR_RL_Clu_Locationvalid_101 "E2E_Order32";
CM_ SG_ 599 S4_SRR_RL_Clu_ID_102 "E2E_Order33";
CM_ SG_ 599 S4_SRR_RL_Clu_Theta_102 "E2E_Order34";
CM_ SG_ 599 S4_SRR_RL_Clu_Dist_102 "E2E_Order35";
CM_ SG_ 599 S4_SRR_RL_Clu_Vel_102 "E2E_Order36";
CM_ SG_ 599 S4_SRR_RL_Clu_SNR_102 "E2E_Order37";
CM_ SG_ 599 S4_SRR_RL_Clu_RCS_102 "E2E_Order38";
CM_ SG_ 599 S4_SRR_RL_Clu_DynProp_102 "E2E_Order39";
CM_ SG_ 599 S4_SRR_RL_Clu_Locationvalid_102 "E2E_Order40";
CM_ SG_ 599 S4_SRR_RL_Clu_ID_103 "E2E_Order41";
CM_ SG_ 599 S4_SRR_RL_Clu_Theta_103 "E2E_Order42";
CM_ SG_ 599 S4_SRR_RL_Clu_Dist_103 "E2E_Order43";
CM_ SG_ 599 S4_SRR_RL_Clu_Vel_103 "E2E_Order44";
CM_ SG_ 599 S4_SRR_RL_Clu_SNR_103 "E2E_Order45";
CM_ SG_ 599 S4_SRR_RL_Clu_RCS_103 "E2E_Order46";
CM_ SG_ 599 S4_SRR_RL_Clu_DynProp_103 "E2E_Order47";
CM_ SG_ 599 S4_SRR_RL_Clu_Locationvalid_103 "E2E_Order48";
CM_ SG_ 599 S4_SRR_RL_Clu_ID_104 "E2E_Order49";
CM_ SG_ 599 S4_SRR_RL_Clu_Theta_104 "E2E_Order50";
CM_ SG_ 599 S4_SRR_RL_Clu_Dist_104 "E2E_Order51";
CM_ SG_ 599 S4_SRR_RL_Clu_Vel_104 "E2E_Order52";
CM_ SG_ 599 S4_SRR_RL_Clu_SNR_104 "E2E_Order53";
CM_ SG_ 599 S4_SRR_RL_Clu_RCS_104 "E2E_Order54";
CM_ SG_ 599 S4_SRR_RL_Clu_DynProp_104 "E2E_Order55";
CM_ SG_ 599 S4_SRR_RL_Clu_Locationvalid_104 "E2E_Order56";
CM_ SG_ 599 S4_SRR_RL_Clu_14_E2EChecksum "DataID = 0x752";
CM_ BO_ 600 "The sending period is unstable, ranging from 40 to 80ms
E2E Profile1 Message";
CM_ SG_ 600 S4_SRR_RL_Clu_ID_105 "E2E_Order1";
CM_ SG_ 600 S4_SRR_RL_Clu_Theta_105 "E2E_Order2";
CM_ SG_ 600 S4_SRR_RL_Clu_Dist_105 "E2E_Order3";
CM_ SG_ 600 S4_SRR_RL_Clu_Vel_105 "E2E_Order4";
CM_ SG_ 600 S4_SRR_RL_Clu_SNR_105 "E2E_Order5";
CM_ SG_ 600 S4_SRR_RL_Clu_RCS_105 "E2E_Order6";
CM_ SG_ 600 S4_SRR_RL_Clu_DynProp_105 "E2E_Order7";
CM_ SG_ 600 S4_SRR_RL_Clu_Locationvalid_105 "E2E_Order8";
CM_ SG_ 600 S4_SRR_RL_Clu_ID_106 "E2E_Order9";
CM_ SG_ 600 S4_SRR_RL_Clu_Theta_106 "E2E_Order10";
CM_ SG_ 600 S4_SRR_RL_Clu_Dist_106 "E2E_Order11";
CM_ SG_ 600 S4_SRR_RL_Clu_Vel_106 "E2E_Order12";
CM_ SG_ 600 S4_SRR_RL_Clu_SNR_106 "E2E_Order13";
CM_ SG_ 600 S4_SRR_RL_Clu_RCS_106 "E2E_Order14";
CM_ SG_ 600 S4_SRR_RL_Clu_DynProp_106 "E2E_Order15";
CM_ SG_ 600 S4_SRR_RL_Clu_Locationvalid_106 "E2E_Order16";
CM_ SG_ 600 S4_SRR_RL_Clu_ID_107 "E2E_Order17";
CM_ SG_ 600 S4_SRR_RL_Clu_Theta_107 "E2E_Order18";
CM_ SG_ 600 S4_SRR_RL_Clu_Dist_107 "E2E_Order19";
CM_ SG_ 600 S4_SRR_RL_Clu_Vel_107 "E2E_Order20";
CM_ SG_ 600 S4_SRR_RL_Clu_SNR_107 "E2E_Order21";
CM_ SG_ 600 S4_SRR_RL_Clu_RCS_107 "E2E_Order22";
CM_ SG_ 600 S4_SRR_RL_Clu_DynProp_107 "E2E_Order23";
CM_ SG_ 600 S4_SRR_RL_Clu_Locationvalid_107 "E2E_Order24";
CM_ SG_ 600 S4_SRR_RL_Clu_ID_108 "E2E_Order25";
CM_ SG_ 600 S4_SRR_RL_Clu_Theta_108 "E2E_Order26";
CM_ SG_ 600 S4_SRR_RL_Clu_Dist_108 "E2E_Order27";
CM_ SG_ 600 S4_SRR_RL_Clu_Vel_108 "E2E_Order28";
CM_ SG_ 600 S4_SRR_RL_Clu_SNR_108 "E2E_Order29";
CM_ SG_ 600 S4_SRR_RL_Clu_RCS_108 "E2E_Order30";
CM_ SG_ 600 S4_SRR_RL_Clu_DynProp_108 "E2E_Order31";
CM_ SG_ 600 S4_SRR_RL_Clu_Locationvalid_108 "E2E_Order32";
CM_ SG_ 600 S4_SRR_RL_Clu_ID_109 "E2E_Order33";
CM_ SG_ 600 S4_SRR_RL_Clu_Theta_109 "E2E_Order34";
CM_ SG_ 600 S4_SRR_RL_Clu_Dist_109 "E2E_Order35";
CM_ SG_ 600 S4_SRR_RL_Clu_Vel_109 "E2E_Order36";
CM_ SG_ 600 S4_SRR_RL_Clu_SNR_109 "E2E_Order37";
CM_ SG_ 600 S4_SRR_RL_Clu_RCS_109 "E2E_Order38";
CM_ SG_ 600 S4_SRR_RL_Clu_DynProp_109 "E2E_Order39";
CM_ SG_ 600 S4_SRR_RL_Clu_Locationvalid_109 "E2E_Order40";
CM_ SG_ 600 S4_SRR_RL_Clu_ID_110 "E2E_Order41";
CM_ SG_ 600 S4_SRR_RL_Clu_Theta_110 "E2E_Order42";
CM_ SG_ 600 S4_SRR_RL_Clu_Dist_110 "E2E_Order43";
CM_ SG_ 600 S4_SRR_RL_Clu_Vel_110 "E2E_Order44";
CM_ SG_ 600 S4_SRR_RL_Clu_SNR_110 "E2E_Order45";
CM_ SG_ 600 S4_SRR_RL_Clu_RCS_110 "E2E_Order46";
CM_ SG_ 600 S4_SRR_RL_Clu_DynProp_110 "E2E_Order47";
CM_ SG_ 600 S4_SRR_RL_Clu_Locationvalid_110 "E2E_Order48";
CM_ SG_ 600 S4_SRR_RL_Clu_ID_111 "E2E_Order49";
CM_ SG_ 600 S4_SRR_RL_Clu_Theta_111 "E2E_Order50";
CM_ SG_ 600 S4_SRR_RL_Clu_Dist_111 "E2E_Order51";
CM_ SG_ 600 S4_SRR_RL_Clu_Vel_111 "E2E_Order52";
CM_ SG_ 600 S4_SRR_RL_Clu_SNR_111 "E2E_Order53";
CM_ SG_ 600 S4_SRR_RL_Clu_RCS_111 "E2E_Order54";
CM_ SG_ 600 S4_SRR_RL_Clu_DynProp_111 "E2E_Order55";
CM_ SG_ 600 S4_SRR_RL_Clu_Locationvalid_111 "E2E_Order56";
CM_ SG_ 600 S4_SRR_RL_Clu_15_E2EChecksum "DataID = 0x852";

BA_DEF_ BO_  "AliveTimeout" INT 0 100000;
BA_DEF_ BO_  "DiagDCM" ENUM  "Yes","No";
BA_DEF_ SG_  "InvalidHex" STRING ;
BA_DEF_ SG_  "GenSigEnvVarType" ENUM  "int","float","undef";
BA_DEF_  "DBName" STRING ;
BA_DEF_  "BusType" STRING ;
BA_DEF_ SG_  "GenSigStartValue" FLOAT 0 100000000000;
BA_DEF_ SG_  "GenSigSendType" ENUM  "Cyclic","OnWrite","OnWriteWithRepetition","OnChange","OnChangeWithRepetition","IfActive","IfActiveWithRepetition","NoSigSendType";
BA_DEF_ BO_  "DiagRequest" ENUM  "No","Yes";
BA_DEF_ BO_  "DiagResponse" ENUM  "No","Yes";
BA_DEF_ BO_  "CANFD_BRS" ENUM  "0","1";
BA_DEF_ BO_  "GenMsgCycleTimeFast" INT 0 100000;
BA_DEF_ BO_  "GenMsgNrOfRepetition" INT 0 100;
BA_DEF_ BO_  "NmMessage" ENUM  "No","Yes";
BA_DEF_ BO_  "GenMsgILSupport" ENUM  "No","Yes";
BA_DEF_ BO_  "GenMsgCycleTime" INT 0 15000;
BA_DEF_ BO_  "GenMsgSendType" ENUM  "FixedPeriodic","Event","EnabledPeriodic","Enable","NotUsed","EventPeriodic","NotUsed","NotUsed","NoMsgSendType";
BA_DEF_ BU_  "NmCAN" INT 1 2;
BA_DEF_ BO_  "VFrameFormat" ENUM  "StandardCAN","ExtendedCAN","reserved","reserved","reserved","reserved","reserved","reserved","reserved","reserved","reserved","reserved","reserved","reserved","StandardCAN_FD","ExtendedCAN_FD";
BA_DEF_ BU_  "NmStationAddress" HEX 0 255;
BA_DEF_  "Manufacturer" STRING ;
BA_DEF_  "Project" STRING ;
BA_DEF_  "Version" STRING ;
BA_DEF_  "Date" STRING ;
BA_DEF_  "Author" STRING ;
BA_DEF_  "NmBaseAddress" HEX 0 2047;
BA_DEF_  "NmMessageCount" INT 0 256;
BA_DEF_  "SamplePointMax" FLOAT 0 100;
BA_DEF_DEF_  "AliveTimeout" 0;
BA_DEF_DEF_  "DiagDCM" "No";
BA_DEF_DEF_  "InvalidHex" "";
BA_DEF_DEF_  "GenSigEnvVarType" "undef";
BA_DEF_DEF_  "DBName" "";
BA_DEF_DEF_  "BusType" "";
BA_DEF_DEF_  "GenSigStartValue" 0;
BA_DEF_DEF_  "GenSigSendType" "Cyclic";
BA_DEF_DEF_  "DiagRequest" "No";
BA_DEF_DEF_  "DiagResponse" "No";
BA_DEF_DEF_  "CANFD_BRS" "1";
BA_DEF_DEF_  "GenMsgCycleTimeFast" 0;
BA_DEF_DEF_  "GenMsgNrOfRepetition" 3;
BA_DEF_DEF_  "NmMessage" "No";
BA_DEF_DEF_  "GenMsgILSupport" "Yes";
BA_DEF_DEF_  "GenMsgCycleTime" 0;
BA_DEF_DEF_  "GenMsgSendType" "NoMsgSendType";
BA_DEF_DEF_  "NmCAN" 1;
BA_DEF_DEF_  "VFrameFormat" "StandardCAN";
BA_DEF_DEF_  "NmStationAddress" 0;
BA_DEF_DEF_  "Manufacturer" "XPeng";
BA_DEF_DEF_  "Project" "H93_F30";
BA_DEF_DEF_  "Version" "N";
BA_DEF_DEF_  "Date" "N";
BA_DEF_DEF_  "Author" "LiJiaqi";
BA_DEF_DEF_  "NmBaseAddress" 1024;
BA_DEF_DEF_  "NmMessageCount" 256;
BA_DEF_DEF_  "SamplePointMax" 81.25;

BA_ "NmStationAddress" BU_ XPU 18;
BA_ "NmStationAddress" BU_ SRR_RL 50;
BA_ "BusType" "CAN FD";
BA_ "DBName" "SCAN4";
BA_ "Version" "V10";
BA_ "Date" "2023-06-15";
BA_ "VFrameFormat" BO_ 576 14;
BA_ "GenMsgSendType" BO_ 576 0;
BA_ "GenMsgCycleTime" BO_ 576 50;
BA_ "InvalidHex" SG_ 576 S4_SRR_RL_Clu_ID_0 "0xFF";
BA_ "GenSigStartValue" SG_ 576 S4_SRR_RL_Clu_Theta_0 253;
BA_ "GenSigStartValue" SG_ 576 S4_SRR_RL_Clu_Vel_0 1111;
BA_ "GenSigStartValue" SG_ 576 S4_SRR_RL_Clu_RCS_0 30;
BA_ "GenSigStartValue" SG_ 576 S4_SRR_RL_Clu_Locationvalid_0 1;
BA_ "InvalidHex" SG_ 576 S4_SRR_RL_Clu_ID_1 "0xFF";
BA_ "GenSigStartValue" SG_ 576 S4_SRR_RL_Clu_Theta_1 253;
BA_ "GenSigStartValue" SG_ 576 S4_SRR_RL_Clu_Vel_1 1111;
BA_ "GenSigStartValue" SG_ 576 S4_SRR_RL_Clu_RCS_1 30;
BA_ "GenSigStartValue" SG_ 576 S4_SRR_RL_Clu_Locationvalid_1 1;
BA_ "InvalidHex" SG_ 576 S4_SRR_RL_Clu_ID_2 "0xFF";
BA_ "GenSigStartValue" SG_ 576 S4_SRR_RL_Clu_Theta_2 253;
BA_ "GenSigStartValue" SG_ 576 S4_SRR_RL_Clu_Vel_2 1111;
BA_ "GenSigStartValue" SG_ 576 S4_SRR_RL_Clu_RCS_2 30;
BA_ "GenSigStartValue" SG_ 576 S4_SRR_RL_Clu_Locationvalid_2 1;
BA_ "InvalidHex" SG_ 576 S4_SRR_RL_Clu_ID_3 "0xFF";
BA_ "GenSigStartValue" SG_ 576 S4_SRR_RL_Clu_Theta_3 253;
BA_ "GenSigStartValue" SG_ 576 S4_SRR_RL_Clu_Vel_3 1111;
BA_ "GenSigStartValue" SG_ 576 S4_SRR_RL_Clu_RCS_3 30;
BA_ "GenSigStartValue" SG_ 576 S4_SRR_RL_Clu_Locationvalid_3 1;
BA_ "InvalidHex" SG_ 576 S4_SRR_RL_Clu_ID_4 "0xFF";
BA_ "GenSigStartValue" SG_ 576 S4_SRR_RL_Clu_Theta_4 253;
BA_ "GenSigStartValue" SG_ 576 S4_SRR_RL_Clu_Vel_4 1111;
BA_ "GenSigStartValue" SG_ 576 S4_SRR_RL_Clu_RCS_4 30;
BA_ "GenSigStartValue" SG_ 576 S4_SRR_RL_Clu_Locationvalid_4 1;
BA_ "InvalidHex" SG_ 576 S4_SRR_RL_Clu_ID_5 "0xFF";
BA_ "GenSigStartValue" SG_ 576 S4_SRR_RL_Clu_Theta_5 253;
BA_ "GenSigStartValue" SG_ 576 S4_SRR_RL_Clu_Vel_5 1111;
BA_ "GenSigStartValue" SG_ 576 S4_SRR_RL_Clu_RCS_5 30;
BA_ "GenSigStartValue" SG_ 576 S4_SRR_RL_Clu_Locationvalid_5 1;
BA_ "InvalidHex" SG_ 576 S4_SRR_RL_Clu_ID_6 "0xFF";
BA_ "GenSigStartValue" SG_ 576 S4_SRR_RL_Clu_Theta_6 253;
BA_ "GenSigStartValue" SG_ 576 S4_SRR_RL_Clu_Vel_6 1111;
BA_ "GenSigStartValue" SG_ 576 S4_SRR_RL_Clu_RCS_6 30;
BA_ "GenSigStartValue" SG_ 576 S4_SRR_RL_Clu_Locationvalid_6 1;
BA_ "VFrameFormat" BO_ 577 14;
BA_ "GenMsgSendType" BO_ 577 0;
BA_ "GenMsgCycleTime" BO_ 577 50;
BA_ "InvalidHex" SG_ 577 S4_SRR_RL_Clu_ID_7 "0xFF";
BA_ "GenSigStartValue" SG_ 577 S4_SRR_RL_Clu_Theta_7 253;
BA_ "GenSigStartValue" SG_ 577 S4_SRR_RL_Clu_Vel_7 1111;
BA_ "GenSigStartValue" SG_ 577 S4_SRR_RL_Clu_RCS_7 30;
BA_ "GenSigStartValue" SG_ 577 S4_SRR_RL_Clu_Locationvalid_7 1;
BA_ "InvalidHex" SG_ 577 S4_SRR_RL_Clu_ID_8 "0xFF";
BA_ "GenSigStartValue" SG_ 577 S4_SRR_RL_Clu_Theta_8 253;
BA_ "GenSigStartValue" SG_ 577 S4_SRR_RL_Clu_Vel_8 1111;
BA_ "GenSigStartValue" SG_ 577 S4_SRR_RL_Clu_RCS_8 30;
BA_ "GenSigStartValue" SG_ 577 S4_SRR_RL_Clu_Locationvalid_8 1;
BA_ "InvalidHex" SG_ 577 S4_SRR_RL_Clu_ID_9 "0xFF";
BA_ "GenSigStartValue" SG_ 577 S4_SRR_RL_Clu_Theta_9 253;
BA_ "GenSigStartValue" SG_ 577 S4_SRR_RL_Clu_Vel_9 1111;
BA_ "GenSigStartValue" SG_ 577 S4_SRR_RL_Clu_RCS_9 30;
BA_ "GenSigStartValue" SG_ 577 S4_SRR_RL_Clu_Locationvalid_9 1;
BA_ "InvalidHex" SG_ 577 S4_SRR_RL_Clu_ID_10 "0xFF";
BA_ "GenSigStartValue" SG_ 577 S4_SRR_RL_Clu_Theta_10 253;
BA_ "GenSigStartValue" SG_ 577 S4_SRR_RL_Clu_Vel_10 1111;
BA_ "GenSigStartValue" SG_ 577 S4_SRR_RL_Clu_RCS_10 30;
BA_ "GenSigStartValue" SG_ 577 S4_SRR_RL_Clu_Locationvalid_10 1;
BA_ "InvalidHex" SG_ 577 S4_SRR_RL_Clu_ID_11 "0xFF";
BA_ "GenSigStartValue" SG_ 577 S4_SRR_RL_Clu_Theta_11 253;
BA_ "GenSigStartValue" SG_ 577 S4_SRR_RL_Clu_Vel_11 1111;
BA_ "GenSigStartValue" SG_ 577 S4_SRR_RL_Clu_RCS_11 30;
BA_ "GenSigStartValue" SG_ 577 S4_SRR_RL_Clu_Locationvalid_11 1;
BA_ "InvalidHex" SG_ 577 S4_SRR_RL_Clu_ID_12 "0xFF";
BA_ "GenSigStartValue" SG_ 577 S4_SRR_RL_Clu_Theta_12 253;
BA_ "GenSigStartValue" SG_ 577 S4_SRR_RL_Clu_Vel_12 1111;
BA_ "GenSigStartValue" SG_ 577 S4_SRR_RL_Clu_RCS_12 30;
BA_ "GenSigStartValue" SG_ 577 S4_SRR_RL_Clu_Locationvalid_12 1;
BA_ "InvalidHex" SG_ 577 S4_SRR_RL_Clu_ID_13 "0xFF";
BA_ "GenSigStartValue" SG_ 577 S4_SRR_RL_Clu_Theta_13 253;
BA_ "GenSigStartValue" SG_ 577 S4_SRR_RL_Clu_Vel_13 1111;
BA_ "GenSigStartValue" SG_ 577 S4_SRR_RL_Clu_RCS_13 30;
BA_ "GenSigStartValue" SG_ 577 S4_SRR_RL_Clu_Locationvalid_13 1;
BA_ "VFrameFormat" BO_ 587 14;
BA_ "GenMsgSendType" BO_ 587 0;
BA_ "GenMsgCycleTime" BO_ 587 50;
BA_ "InvalidHex" SG_ 587 S4_SRR_RL_Clu_ID_14 "0xFF";
BA_ "GenSigStartValue" SG_ 587 S4_SRR_RL_Clu_Theta_14 253;
BA_ "GenSigStartValue" SG_ 587 S4_SRR_RL_Clu_Vel_14 1111;
BA_ "GenSigStartValue" SG_ 587 S4_SRR_RL_Clu_RCS_14 30;
BA_ "GenSigStartValue" SG_ 587 S4_SRR_RL_Clu_Locationvalid_14 1;
BA_ "InvalidHex" SG_ 587 S4_SRR_RL_Clu_ID_15 "0xFF";
BA_ "GenSigStartValue" SG_ 587 S4_SRR_RL_Clu_Theta_15 253;
BA_ "GenSigStartValue" SG_ 587 S4_SRR_RL_Clu_Vel_15 1111;
BA_ "GenSigStartValue" SG_ 587 S4_SRR_RL_Clu_RCS_15 30;
BA_ "GenSigStartValue" SG_ 587 S4_SRR_RL_Clu_Locationvalid_15 1;
BA_ "InvalidHex" SG_ 587 S4_SRR_RL_Clu_ID_16 "0xFF";
BA_ "GenSigStartValue" SG_ 587 S4_SRR_RL_Clu_Theta_16 253;
BA_ "GenSigStartValue" SG_ 587 S4_SRR_RL_Clu_Vel_16 1111;
BA_ "GenSigStartValue" SG_ 587 S4_SRR_RL_Clu_RCS_16 30;
BA_ "GenSigStartValue" SG_ 587 S4_SRR_RL_Clu_Locationvalid_16 1;
BA_ "InvalidHex" SG_ 587 S4_SRR_RL_Clu_ID_17 "0xFF";
BA_ "GenSigStartValue" SG_ 587 S4_SRR_RL_Clu_Theta_17 253;
BA_ "GenSigStartValue" SG_ 587 S4_SRR_RL_Clu_Vel_17 1111;
BA_ "GenSigStartValue" SG_ 587 S4_SRR_RL_Clu_RCS_17 30;
BA_ "GenSigStartValue" SG_ 587 S4_SRR_RL_Clu_Locationvalid_17 1;
BA_ "InvalidHex" SG_ 587 S4_SRR_RL_Clu_ID_18 "0xFF";
BA_ "GenSigStartValue" SG_ 587 S4_SRR_RL_Clu_Theta_18 253;
BA_ "GenSigStartValue" SG_ 587 S4_SRR_RL_Clu_Vel_18 1111;
BA_ "GenSigStartValue" SG_ 587 S4_SRR_RL_Clu_RCS_18 30;
BA_ "GenSigStartValue" SG_ 587 S4_SRR_RL_Clu_Locationvalid_18 1;
BA_ "InvalidHex" SG_ 587 S4_SRR_RL_Clu_ID_19 "0xFF";
BA_ "GenSigStartValue" SG_ 587 S4_SRR_RL_Clu_Theta_19 253;
BA_ "GenSigStartValue" SG_ 587 S4_SRR_RL_Clu_Vel_19 1111;
BA_ "GenSigStartValue" SG_ 587 S4_SRR_RL_Clu_RCS_19 30;
BA_ "GenSigStartValue" SG_ 587 S4_SRR_RL_Clu_Locationvalid_19 1;
BA_ "InvalidHex" SG_ 587 S4_SRR_RL_Clu_ID_20 "0xFF";
BA_ "GenSigStartValue" SG_ 587 S4_SRR_RL_Clu_Theta_20 253;
BA_ "GenSigStartValue" SG_ 587 S4_SRR_RL_Clu_Vel_20 1111;
BA_ "GenSigStartValue" SG_ 587 S4_SRR_RL_Clu_RCS_20 30;
BA_ "GenSigStartValue" SG_ 587 S4_SRR_RL_Clu_Locationvalid_20 1;
BA_ "VFrameFormat" BO_ 588 14;
BA_ "GenMsgSendType" BO_ 588 0;
BA_ "GenMsgCycleTime" BO_ 588 50;
BA_ "InvalidHex" SG_ 588 S4_SRR_RL_Clu_ID_21 "0xFF";
BA_ "GenSigStartValue" SG_ 588 S4_SRR_RL_Clu_Theta_21 253;
BA_ "GenSigStartValue" SG_ 588 S4_SRR_RL_Clu_Vel_21 1111;
BA_ "GenSigStartValue" SG_ 588 S4_SRR_RL_Clu_RCS_21 30;
BA_ "GenSigStartValue" SG_ 588 S4_SRR_RL_Clu_Locationvalid_21 1;
BA_ "InvalidHex" SG_ 588 S4_SRR_RL_Clu_ID_22 "0xFF";
BA_ "GenSigStartValue" SG_ 588 S4_SRR_RL_Clu_Theta_22 253;
BA_ "GenSigStartValue" SG_ 588 S4_SRR_RL_Clu_Vel_22 1111;
BA_ "GenSigStartValue" SG_ 588 S4_SRR_RL_Clu_RCS_22 30;
BA_ "GenSigStartValue" SG_ 588 S4_SRR_RL_Clu_Locationvalid_22 1;
BA_ "InvalidHex" SG_ 588 S4_SRR_RL_Clu_ID_23 "0xFF";
BA_ "GenSigStartValue" SG_ 588 S4_SRR_RL_Clu_Theta_23 253;
BA_ "GenSigStartValue" SG_ 588 S4_SRR_RL_Clu_Vel_23 1111;
BA_ "GenSigStartValue" SG_ 588 S4_SRR_RL_Clu_RCS_23 30;
BA_ "GenSigStartValue" SG_ 588 S4_SRR_RL_Clu_Locationvalid_23 1;
BA_ "InvalidHex" SG_ 588 S4_SRR_RL_Clu_ID_24 "0xFF";
BA_ "GenSigStartValue" SG_ 588 S4_SRR_RL_Clu_Theta_24 253;
BA_ "GenSigStartValue" SG_ 588 S4_SRR_RL_Clu_Vel_24 1111;
BA_ "GenSigStartValue" SG_ 588 S4_SRR_RL_Clu_RCS_24 30;
BA_ "GenSigStartValue" SG_ 588 S4_SRR_RL_Clu_Locationvalid_24 1;
BA_ "InvalidHex" SG_ 588 S4_SRR_RL_Clu_ID_25 "0xFF";
BA_ "GenSigStartValue" SG_ 588 S4_SRR_RL_Clu_Theta_25 253;
BA_ "GenSigStartValue" SG_ 588 S4_SRR_RL_Clu_Vel_25 1111;
BA_ "GenSigStartValue" SG_ 588 S4_SRR_RL_Clu_RCS_25 30;
BA_ "GenSigStartValue" SG_ 588 S4_SRR_RL_Clu_Locationvalid_25 1;
BA_ "InvalidHex" SG_ 588 S4_SRR_RL_Clu_ID_26 "0xFF";
BA_ "GenSigStartValue" SG_ 588 S4_SRR_RL_Clu_Theta_26 253;
BA_ "GenSigStartValue" SG_ 588 S4_SRR_RL_Clu_Vel_26 1111;
BA_ "GenSigStartValue" SG_ 588 S4_SRR_RL_Clu_RCS_26 30;
BA_ "GenSigStartValue" SG_ 588 S4_SRR_RL_Clu_Locationvalid_26 1;
BA_ "InvalidHex" SG_ 588 S4_SRR_RL_Clu_ID_27 "0xFF";
BA_ "GenSigStartValue" SG_ 588 S4_SRR_RL_Clu_Theta_27 253;
BA_ "GenSigStartValue" SG_ 588 S4_SRR_RL_Clu_Vel_27 1111;
BA_ "GenSigStartValue" SG_ 588 S4_SRR_RL_Clu_RCS_27 30;
BA_ "GenSigStartValue" SG_ 588 S4_SRR_RL_Clu_Locationvalid_27 1;
BA_ "VFrameFormat" BO_ 589 14;
BA_ "GenMsgSendType" BO_ 589 0;
BA_ "GenMsgCycleTime" BO_ 589 50;
BA_ "InvalidHex" SG_ 589 S4_SRR_RL_Clu_ID_28 "0xFF";
BA_ "GenSigStartValue" SG_ 589 S4_SRR_RL_Clu_Theta_28 253;
BA_ "GenSigStartValue" SG_ 589 S4_SRR_RL_Clu_Vel_28 1111;
BA_ "GenSigStartValue" SG_ 589 S4_SRR_RL_Clu_RCS_28 30;
BA_ "GenSigStartValue" SG_ 589 S4_SRR_RL_Clu_Locationvalid_28 1;
BA_ "InvalidHex" SG_ 589 S4_SRR_RL_Clu_ID_29 "0xFF";
BA_ "GenSigStartValue" SG_ 589 S4_SRR_RL_Clu_Theta_29 253;
BA_ "GenSigStartValue" SG_ 589 S4_SRR_RL_Clu_Vel_29 1111;
BA_ "GenSigStartValue" SG_ 589 S4_SRR_RL_Clu_RCS_29 30;
BA_ "GenSigStartValue" SG_ 589 S4_SRR_RL_Clu_Locationvalid_29 1;
BA_ "InvalidHex" SG_ 589 S4_SRR_RL_Clu_ID_30 "0xFF";
BA_ "GenSigStartValue" SG_ 589 S4_SRR_RL_Clu_Theta_30 253;
BA_ "GenSigStartValue" SG_ 589 S4_SRR_RL_Clu_Vel_30 1111;
BA_ "GenSigStartValue" SG_ 589 S4_SRR_RL_Clu_RCS_30 30;
BA_ "GenSigStartValue" SG_ 589 S4_SRR_RL_Clu_Locationvalid_30 1;
BA_ "InvalidHex" SG_ 589 S4_SRR_RL_Clu_ID_31 "0xFF";
BA_ "GenSigStartValue" SG_ 589 S4_SRR_RL_Clu_Theta_31 253;
BA_ "GenSigStartValue" SG_ 589 S4_SRR_RL_Clu_Vel_31 1111;
BA_ "GenSigStartValue" SG_ 589 S4_SRR_RL_Clu_RCS_31 30;
BA_ "GenSigStartValue" SG_ 589 S4_SRR_RL_Clu_Locationvalid_31 1;
BA_ "InvalidHex" SG_ 589 S4_SRR_RL_Clu_ID_32 "0xFF";
BA_ "GenSigStartValue" SG_ 589 S4_SRR_RL_Clu_Theta_32 253;
BA_ "GenSigStartValue" SG_ 589 S4_SRR_RL_Clu_Vel_32 1111;
BA_ "GenSigStartValue" SG_ 589 S4_SRR_RL_Clu_RCS_32 30;
BA_ "GenSigStartValue" SG_ 589 S4_SRR_RL_Clu_Locationvalid_32 1;
BA_ "InvalidHex" SG_ 589 S4_SRR_RL_Clu_ID_33 "0xFF";
BA_ "GenSigStartValue" SG_ 589 S4_SRR_RL_Clu_Theta_33 253;
BA_ "GenSigStartValue" SG_ 589 S4_SRR_RL_Clu_Vel_33 1111;
BA_ "GenSigStartValue" SG_ 589 S4_SRR_RL_Clu_RCS_33 30;
BA_ "GenSigStartValue" SG_ 589 S4_SRR_RL_Clu_Locationvalid_33 1;
BA_ "InvalidHex" SG_ 589 S4_SRR_RL_Clu_ID_34 "0xFF";
BA_ "GenSigStartValue" SG_ 589 S4_SRR_RL_Clu_Theta_34 253;
BA_ "GenSigStartValue" SG_ 589 S4_SRR_RL_Clu_Vel_34 1111;
BA_ "GenSigStartValue" SG_ 589 S4_SRR_RL_Clu_RCS_34 30;
BA_ "GenSigStartValue" SG_ 589 S4_SRR_RL_Clu_Locationvalid_34 1;
BA_ "VFrameFormat" BO_ 590 14;
BA_ "GenMsgSendType" BO_ 590 0;
BA_ "GenMsgCycleTime" BO_ 590 50;
BA_ "InvalidHex" SG_ 590 S4_SRR_RL_Clu_ID_35 "0xFF";
BA_ "GenSigStartValue" SG_ 590 S4_SRR_RL_Clu_Theta_35 253;
BA_ "GenSigStartValue" SG_ 590 S4_SRR_RL_Clu_Vel_35 1111;
BA_ "GenSigStartValue" SG_ 590 S4_SRR_RL_Clu_RCS_35 30;
BA_ "GenSigStartValue" SG_ 590 S4_SRR_RL_Clu_Locationvalid_35 1;
BA_ "InvalidHex" SG_ 590 S4_SRR_RL_Clu_ID_36 "0xFF";
BA_ "GenSigStartValue" SG_ 590 S4_SRR_RL_Clu_Theta_36 253;
BA_ "GenSigStartValue" SG_ 590 S4_SRR_RL_Clu_Vel_36 1111;
BA_ "GenSigStartValue" SG_ 590 S4_SRR_RL_Clu_RCS_36 30;
BA_ "GenSigStartValue" SG_ 590 S4_SRR_RL_Clu_Locationvalid_36 1;
BA_ "InvalidHex" SG_ 590 S4_SRR_RL_Clu_ID_37 "0xFF";
BA_ "GenSigStartValue" SG_ 590 S4_SRR_RL_Clu_Theta_37 253;
BA_ "GenSigStartValue" SG_ 590 S4_SRR_RL_Clu_Vel_37 1111;
BA_ "GenSigStartValue" SG_ 590 S4_SRR_RL_Clu_RCS_37 30;
BA_ "GenSigStartValue" SG_ 590 S4_SRR_RL_Clu_Locationvalid_37 1;
BA_ "InvalidHex" SG_ 590 S4_SRR_RL_Clu_ID_38 "0xFF";
BA_ "GenSigStartValue" SG_ 590 S4_SRR_RL_Clu_Theta_38 253;
BA_ "GenSigStartValue" SG_ 590 S4_SRR_RL_Clu_Vel_38 1111;
BA_ "GenSigStartValue" SG_ 590 S4_SRR_RL_Clu_RCS_38 30;
BA_ "GenSigStartValue" SG_ 590 S4_SRR_RL_Clu_Locationvalid_38 1;
BA_ "InvalidHex" SG_ 590 S4_SRR_RL_Clu_ID_39 "0xFF";
BA_ "GenSigStartValue" SG_ 590 S4_SRR_RL_Clu_Theta_39 253;
BA_ "GenSigStartValue" SG_ 590 S4_SRR_RL_Clu_Vel_39 1111;
BA_ "GenSigStartValue" SG_ 590 S4_SRR_RL_Clu_RCS_39 30;
BA_ "GenSigStartValue" SG_ 590 S4_SRR_RL_Clu_Locationvalid_39 1;
BA_ "InvalidHex" SG_ 590 S4_SRR_RL_Clu_ID_40 "0xFF";
BA_ "GenSigStartValue" SG_ 590 S4_SRR_RL_Clu_Theta_40 253;
BA_ "GenSigStartValue" SG_ 590 S4_SRR_RL_Clu_Vel_40 1111;
BA_ "GenSigStartValue" SG_ 590 S4_SRR_RL_Clu_RCS_40 30;
BA_ "GenSigStartValue" SG_ 590 S4_SRR_RL_Clu_Locationvalid_40 1;
BA_ "InvalidHex" SG_ 590 S4_SRR_RL_Clu_ID_41 "0xFF";
BA_ "GenSigStartValue" SG_ 590 S4_SRR_RL_Clu_Theta_41 253;
BA_ "GenSigStartValue" SG_ 590 S4_SRR_RL_Clu_Vel_41 1111;
BA_ "GenSigStartValue" SG_ 590 S4_SRR_RL_Clu_RCS_41 30;
BA_ "GenSigStartValue" SG_ 590 S4_SRR_RL_Clu_Locationvalid_41 1;
BA_ "VFrameFormat" BO_ 591 14;
BA_ "GenMsgSendType" BO_ 591 0;
BA_ "GenMsgCycleTime" BO_ 591 50;
BA_ "InvalidHex" SG_ 591 S4_SRR_RL_Clu_ID_42 "0xFF";
BA_ "GenSigStartValue" SG_ 591 S4_SRR_RL_Clu_Theta_42 253;
BA_ "GenSigStartValue" SG_ 591 S4_SRR_RL_Clu_Vel_42 1111;
BA_ "GenSigStartValue" SG_ 591 S4_SRR_RL_Clu_RCS_42 30;
BA_ "GenSigStartValue" SG_ 591 S4_SRR_RL_Clu_Locationvalid_42 1;
BA_ "InvalidHex" SG_ 591 S4_SRR_RL_Clu_ID_43 "0xFF";
BA_ "GenSigStartValue" SG_ 591 S4_SRR_RL_Clu_Theta_43 253;
BA_ "GenSigStartValue" SG_ 591 S4_SRR_RL_Clu_Vel_43 1111;
BA_ "GenSigStartValue" SG_ 591 S4_SRR_RL_Clu_RCS_43 30;
BA_ "GenSigStartValue" SG_ 591 S4_SRR_RL_Clu_Locationvalid_43 1;
BA_ "InvalidHex" SG_ 591 S4_SRR_RL_Clu_ID_44 "0xFF";
BA_ "GenSigStartValue" SG_ 591 S4_SRR_RL_Clu_Theta_44 253;
BA_ "GenSigStartValue" SG_ 591 S4_SRR_RL_Clu_Vel_44 1111;
BA_ "GenSigStartValue" SG_ 591 S4_SRR_RL_Clu_RCS_44 30;
BA_ "GenSigStartValue" SG_ 591 S4_SRR_RL_Clu_Locationvalid_44 1;
BA_ "InvalidHex" SG_ 591 S4_SRR_RL_Clu_ID_45 "0xFF";
BA_ "GenSigStartValue" SG_ 591 S4_SRR_RL_Clu_Theta_45 253;
BA_ "GenSigStartValue" SG_ 591 S4_SRR_RL_Clu_Vel_45 1111;
BA_ "GenSigStartValue" SG_ 591 S4_SRR_RL_Clu_RCS_45 30;
BA_ "GenSigStartValue" SG_ 591 S4_SRR_RL_Clu_Locationvalid_45 1;
BA_ "InvalidHex" SG_ 591 S4_SRR_RL_Clu_ID_46 "0xFF";
BA_ "GenSigStartValue" SG_ 591 S4_SRR_RL_Clu_Theta_46 253;
BA_ "GenSigStartValue" SG_ 591 S4_SRR_RL_Clu_Vel_46 1111;
BA_ "GenSigStartValue" SG_ 591 S4_SRR_RL_Clu_RCS_46 30;
BA_ "GenSigStartValue" SG_ 591 S4_SRR_RL_Clu_Locationvalid_46 1;
BA_ "InvalidHex" SG_ 591 S4_SRR_RL_Clu_ID_47 "0xFF";
BA_ "GenSigStartValue" SG_ 591 S4_SRR_RL_Clu_Theta_47 253;
BA_ "GenSigStartValue" SG_ 591 S4_SRR_RL_Clu_Vel_47 1111;
BA_ "GenSigStartValue" SG_ 591 S4_SRR_RL_Clu_RCS_47 30;
BA_ "GenSigStartValue" SG_ 591 S4_SRR_RL_Clu_Locationvalid_47 1;
BA_ "InvalidHex" SG_ 591 S4_SRR_RL_Clu_ID_48 "0xFF";
BA_ "GenSigStartValue" SG_ 591 S4_SRR_RL_Clu_Theta_48 253;
BA_ "GenSigStartValue" SG_ 591 S4_SRR_RL_Clu_Vel_48 1111;
BA_ "GenSigStartValue" SG_ 591 S4_SRR_RL_Clu_RCS_48 30;
BA_ "GenSigStartValue" SG_ 591 S4_SRR_RL_Clu_Locationvalid_48 1;
BA_ "VFrameFormat" BO_ 592 14;
BA_ "GenMsgSendType" BO_ 592 0;
BA_ "GenMsgCycleTime" BO_ 592 50;
BA_ "InvalidHex" SG_ 592 S4_SRR_RL_Clu_ID_49 "0xFF";
BA_ "GenSigStartValue" SG_ 592 S4_SRR_RL_Clu_Theta_49 253;
BA_ "GenSigStartValue" SG_ 592 S4_SRR_RL_Clu_Vel_49 1111;
BA_ "GenSigStartValue" SG_ 592 S4_SRR_RL_Clu_RCS_49 30;
BA_ "GenSigStartValue" SG_ 592 S4_SRR_RL_Clu_Locationvalid_49 1;
BA_ "InvalidHex" SG_ 592 S4_SRR_RL_Clu_ID_50 "0xFF";
BA_ "GenSigStartValue" SG_ 592 S4_SRR_RL_Clu_Theta_50 253;
BA_ "GenSigStartValue" SG_ 592 S4_SRR_RL_Clu_Vel_50 1111;
BA_ "GenSigStartValue" SG_ 592 S4_SRR_RL_Clu_RCS_50 30;
BA_ "GenSigStartValue" SG_ 592 S4_SRR_RL_Clu_Locationvalid_50 1;
BA_ "InvalidHex" SG_ 592 S4_SRR_RL_Clu_ID_51 "0xFF";
BA_ "GenSigStartValue" SG_ 592 S4_SRR_RL_Clu_Theta_51 253;
BA_ "GenSigStartValue" SG_ 592 S4_SRR_RL_Clu_Vel_51 1111;
BA_ "GenSigStartValue" SG_ 592 S4_SRR_RL_Clu_RCS_51 30;
BA_ "GenSigStartValue" SG_ 592 S4_SRR_RL_Clu_Locationvalid_51 1;
BA_ "InvalidHex" SG_ 592 S4_SRR_RL_Clu_ID_52 "0xFF";
BA_ "GenSigStartValue" SG_ 592 S4_SRR_RL_Clu_Theta_52 253;
BA_ "GenSigStartValue" SG_ 592 S4_SRR_RL_Clu_Vel_52 1111;
BA_ "GenSigStartValue" SG_ 592 S4_SRR_RL_Clu_RCS_52 30;
BA_ "GenSigStartValue" SG_ 592 S4_SRR_RL_Clu_Locationvalid_52 1;
BA_ "InvalidHex" SG_ 592 S4_SRR_RL_Clu_ID_53 "0xFF";
BA_ "GenSigStartValue" SG_ 592 S4_SRR_RL_Clu_Theta_53 253;
BA_ "GenSigStartValue" SG_ 592 S4_SRR_RL_Clu_Vel_53 1111;
BA_ "GenSigStartValue" SG_ 592 S4_SRR_RL_Clu_RCS_53 30;
BA_ "GenSigStartValue" SG_ 592 S4_SRR_RL_Clu_Locationvalid_53 1;
BA_ "InvalidHex" SG_ 592 S4_SRR_RL_Clu_ID_54 "0xFF";
BA_ "GenSigStartValue" SG_ 592 S4_SRR_RL_Clu_Theta_54 253;
BA_ "GenSigStartValue" SG_ 592 S4_SRR_RL_Clu_Vel_54 1111;
BA_ "GenSigStartValue" SG_ 592 S4_SRR_RL_Clu_RCS_54 30;
BA_ "GenSigStartValue" SG_ 592 S4_SRR_RL_Clu_Locationvalid_54 1;
BA_ "InvalidHex" SG_ 592 S4_SRR_RL_Clu_ID_55 "0xFF";
BA_ "GenSigStartValue" SG_ 592 S4_SRR_RL_Clu_Theta_55 253;
BA_ "GenSigStartValue" SG_ 592 S4_SRR_RL_Clu_Vel_55 1111;
BA_ "GenSigStartValue" SG_ 592 S4_SRR_RL_Clu_RCS_55 30;
BA_ "GenSigStartValue" SG_ 592 S4_SRR_RL_Clu_Locationvalid_55 1;
BA_ "VFrameFormat" BO_ 593 14;
BA_ "GenMsgSendType" BO_ 593 0;
BA_ "GenMsgCycleTime" BO_ 593 50;
BA_ "InvalidHex" SG_ 593 S4_SRR_RL_Clu_ID_56 "0xFF";
BA_ "GenSigStartValue" SG_ 593 S4_SRR_RL_Clu_Theta_56 253;
BA_ "GenSigStartValue" SG_ 593 S4_SRR_RL_Clu_Vel_56 1111;
BA_ "GenSigStartValue" SG_ 593 S4_SRR_RL_Clu_RCS_56 30;
BA_ "GenSigStartValue" SG_ 593 S4_SRR_RL_Clu_Locationvalid_56 1;
BA_ "InvalidHex" SG_ 593 S4_SRR_RL_Clu_ID_57 "0xFF";
BA_ "GenSigStartValue" SG_ 593 S4_SRR_RL_Clu_Theta_57 253;
BA_ "GenSigStartValue" SG_ 593 S4_SRR_RL_Clu_Vel_57 1111;
BA_ "GenSigStartValue" SG_ 593 S4_SRR_RL_Clu_RCS_57 30;
BA_ "GenSigStartValue" SG_ 593 S4_SRR_RL_Clu_Locationvalid_57 1;
BA_ "InvalidHex" SG_ 593 S4_SRR_RL_Clu_ID_58 "0xFF";
BA_ "GenSigStartValue" SG_ 593 S4_SRR_RL_Clu_Theta_58 253;
BA_ "GenSigStartValue" SG_ 593 S4_SRR_RL_Clu_Vel_58 1111;
BA_ "GenSigStartValue" SG_ 593 S4_SRR_RL_Clu_RCS_58 30;
BA_ "GenSigStartValue" SG_ 593 S4_SRR_RL_Clu_Locationvalid_58 1;
BA_ "InvalidHex" SG_ 593 S4_SRR_RL_Clu_ID_59 "0xFF";
BA_ "GenSigStartValue" SG_ 593 S4_SRR_RL_Clu_Theta_59 253;
BA_ "GenSigStartValue" SG_ 593 S4_SRR_RL_Clu_Vel_59 1111;
BA_ "GenSigStartValue" SG_ 593 S4_SRR_RL_Clu_RCS_59 30;
BA_ "GenSigStartValue" SG_ 593 S4_SRR_RL_Clu_Locationvalid_59 1;
BA_ "InvalidHex" SG_ 593 S4_SRR_RL_Clu_ID_60 "0xFF";
BA_ "GenSigStartValue" SG_ 593 S4_SRR_RL_Clu_Theta_60 253;
BA_ "GenSigStartValue" SG_ 593 S4_SRR_RL_Clu_Vel_60 1111;
BA_ "GenSigStartValue" SG_ 593 S4_SRR_RL_Clu_RCS_60 30;
BA_ "GenSigStartValue" SG_ 593 S4_SRR_RL_Clu_Locationvalid_60 1;
BA_ "InvalidHex" SG_ 593 S4_SRR_RL_Clu_ID_61 "0xFF";
BA_ "GenSigStartValue" SG_ 593 S4_SRR_RL_Clu_Theta_61 253;
BA_ "GenSigStartValue" SG_ 593 S4_SRR_RL_Clu_Vel_61 1111;
BA_ "GenSigStartValue" SG_ 593 S4_SRR_RL_Clu_RCS_61 30;
BA_ "GenSigStartValue" SG_ 593 S4_SRR_RL_Clu_Locationvalid_61 1;
BA_ "InvalidHex" SG_ 593 S4_SRR_RL_Clu_ID_62 "0xFF";
BA_ "GenSigStartValue" SG_ 593 S4_SRR_RL_Clu_Theta_62 253;
BA_ "GenSigStartValue" SG_ 593 S4_SRR_RL_Clu_Vel_62 1111;
BA_ "GenSigStartValue" SG_ 593 S4_SRR_RL_Clu_RCS_62 30;
BA_ "GenSigStartValue" SG_ 593 S4_SRR_RL_Clu_Locationvalid_62 1;
BA_ "VFrameFormat" BO_ 594 14;
BA_ "GenMsgSendType" BO_ 594 0;
BA_ "GenMsgCycleTime" BO_ 594 50;
BA_ "InvalidHex" SG_ 594 S4_SRR_RL_Clu_ID_63 "0xFF";
BA_ "GenSigStartValue" SG_ 594 S4_SRR_RL_Clu_Theta_63 253;
BA_ "GenSigStartValue" SG_ 594 S4_SRR_RL_Clu_Vel_63 1111;
BA_ "GenSigStartValue" SG_ 594 S4_SRR_RL_Clu_RCS_63 30;
BA_ "GenSigStartValue" SG_ 594 S4_SRR_RL_Clu_Locationvalid_63 1;
BA_ "InvalidHex" SG_ 594 S4_SRR_RL_Clu_ID_64 "0xFF";
BA_ "GenSigStartValue" SG_ 594 S4_SRR_RL_Clu_Theta_64 253;
BA_ "GenSigStartValue" SG_ 594 S4_SRR_RL_Clu_Vel_64 1111;
BA_ "GenSigStartValue" SG_ 594 S4_SRR_RL_Clu_RCS_64 30;
BA_ "GenSigStartValue" SG_ 594 S4_SRR_RL_Clu_Locationvalid_64 1;
BA_ "InvalidHex" SG_ 594 S4_SRR_RL_Clu_ID_65 "0xFF";
BA_ "GenSigStartValue" SG_ 594 S4_SRR_RL_Clu_Theta_65 253;
BA_ "GenSigStartValue" SG_ 594 S4_SRR_RL_Clu_Vel_65 1111;
BA_ "GenSigStartValue" SG_ 594 S4_SRR_RL_Clu_RCS_65 30;
BA_ "GenSigStartValue" SG_ 594 S4_SRR_RL_Clu_Locationvalid_65 1;
BA_ "InvalidHex" SG_ 594 S4_SRR_RL_Clu_ID_66 "0xFF";
BA_ "GenSigStartValue" SG_ 594 S4_SRR_RL_Clu_Theta_66 253;
BA_ "GenSigStartValue" SG_ 594 S4_SRR_RL_Clu_Vel_66 1111;
BA_ "GenSigStartValue" SG_ 594 S4_SRR_RL_Clu_RCS_66 30;
BA_ "GenSigStartValue" SG_ 594 S4_SRR_RL_Clu_Locationvalid_66 1;
BA_ "InvalidHex" SG_ 594 S4_SRR_RL_Clu_ID_67 "0xFF";
BA_ "GenSigStartValue" SG_ 594 S4_SRR_RL_Clu_Theta_67 253;
BA_ "GenSigStartValue" SG_ 594 S4_SRR_RL_Clu_Vel_67 1111;
BA_ "GenSigStartValue" SG_ 594 S4_SRR_RL_Clu_RCS_67 30;
BA_ "GenSigStartValue" SG_ 594 S4_SRR_RL_Clu_Locationvalid_67 1;
BA_ "InvalidHex" SG_ 594 S4_SRR_RL_Clu_ID_68 "0xFF";
BA_ "GenSigStartValue" SG_ 594 S4_SRR_RL_Clu_Theta_68 253;
BA_ "GenSigStartValue" SG_ 594 S4_SRR_RL_Clu_Vel_68 1111;
BA_ "GenSigStartValue" SG_ 594 S4_SRR_RL_Clu_RCS_68 30;
BA_ "GenSigStartValue" SG_ 594 S4_SRR_RL_Clu_Locationvalid_68 1;
BA_ "InvalidHex" SG_ 594 S4_SRR_RL_Clu_ID_69 "0xFF";
BA_ "GenSigStartValue" SG_ 594 S4_SRR_RL_Clu_Theta_69 253;
BA_ "GenSigStartValue" SG_ 594 S4_SRR_RL_Clu_Vel_69 1111;
BA_ "GenSigStartValue" SG_ 594 S4_SRR_RL_Clu_RCS_69 30;
BA_ "GenSigStartValue" SG_ 594 S4_SRR_RL_Clu_Locationvalid_69 1;
BA_ "VFrameFormat" BO_ 595 14;
BA_ "GenMsgSendType" BO_ 595 0;
BA_ "GenMsgCycleTime" BO_ 595 50;
BA_ "InvalidHex" SG_ 595 S4_SRR_RL_Clu_ID_70 "0xFF";
BA_ "GenSigStartValue" SG_ 595 S4_SRR_RL_Clu_Theta_70 253;
BA_ "GenSigStartValue" SG_ 595 S4_SRR_RL_Clu_Vel_70 1111;
BA_ "GenSigStartValue" SG_ 595 S4_SRR_RL_Clu_RCS_70 30;
BA_ "GenSigStartValue" SG_ 595 S4_SRR_RL_Clu_Locationvalid_70 1;
BA_ "InvalidHex" SG_ 595 S4_SRR_RL_Clu_ID_71 "0xFF";
BA_ "GenSigStartValue" SG_ 595 S4_SRR_RL_Clu_Theta_71 253;
BA_ "GenSigStartValue" SG_ 595 S4_SRR_RL_Clu_Vel_71 1111;
BA_ "GenSigStartValue" SG_ 595 S4_SRR_RL_Clu_RCS_71 30;
BA_ "GenSigStartValue" SG_ 595 S4_SRR_RL_Clu_Locationvalid_71 1;
BA_ "InvalidHex" SG_ 595 S4_SRR_RL_Clu_ID_72 "0xFF";
BA_ "GenSigStartValue" SG_ 595 S4_SRR_RL_Clu_Theta_72 253;
BA_ "GenSigStartValue" SG_ 595 S4_SRR_RL_Clu_Vel_72 1111;
BA_ "GenSigStartValue" SG_ 595 S4_SRR_RL_Clu_RCS_72 30;
BA_ "GenSigStartValue" SG_ 595 S4_SRR_RL_Clu_Locationvalid_72 1;
BA_ "InvalidHex" SG_ 595 S4_SRR_RL_Clu_ID_73 "0xFF";
BA_ "GenSigStartValue" SG_ 595 S4_SRR_RL_Clu_Theta_73 253;
BA_ "GenSigStartValue" SG_ 595 S4_SRR_RL_Clu_Vel_73 1111;
BA_ "GenSigStartValue" SG_ 595 S4_SRR_RL_Clu_RCS_73 30;
BA_ "GenSigStartValue" SG_ 595 S4_SRR_RL_Clu_Locationvalid_73 1;
BA_ "InvalidHex" SG_ 595 S4_SRR_RL_Clu_ID_74 "0xFF";
BA_ "GenSigStartValue" SG_ 595 S4_SRR_RL_Clu_Theta_74 253;
BA_ "GenSigStartValue" SG_ 595 S4_SRR_RL_Clu_Vel_74 1111;
BA_ "GenSigStartValue" SG_ 595 S4_SRR_RL_Clu_RCS_74 30;
BA_ "GenSigStartValue" SG_ 595 S4_SRR_RL_Clu_Locationvalid_74 1;
BA_ "InvalidHex" SG_ 595 S4_SRR_RL_Clu_ID_75 "0xFF";
BA_ "GenSigStartValue" SG_ 595 S4_SRR_RL_Clu_Theta_75 253;
BA_ "GenSigStartValue" SG_ 595 S4_SRR_RL_Clu_Vel_75 1111;
BA_ "GenSigStartValue" SG_ 595 S4_SRR_RL_Clu_RCS_75 30;
BA_ "GenSigStartValue" SG_ 595 S4_SRR_RL_Clu_Locationvalid_75 1;
BA_ "InvalidHex" SG_ 595 S4_SRR_RL_Clu_ID_76 "0xFF";
BA_ "GenSigStartValue" SG_ 595 S4_SRR_RL_Clu_Theta_76 253;
BA_ "GenSigStartValue" SG_ 595 S4_SRR_RL_Clu_Vel_76 1111;
BA_ "GenSigStartValue" SG_ 595 S4_SRR_RL_Clu_RCS_76 30;
BA_ "GenSigStartValue" SG_ 595 S4_SRR_RL_Clu_Locationvalid_76 1;
BA_ "VFrameFormat" BO_ 596 14;
BA_ "GenMsgSendType" BO_ 596 0;
BA_ "GenMsgCycleTime" BO_ 596 50;
BA_ "InvalidHex" SG_ 596 S4_SRR_RL_Clu_ID_77 "0xFF";
BA_ "GenSigStartValue" SG_ 596 S4_SRR_RL_Clu_Theta_77 253;
BA_ "GenSigStartValue" SG_ 596 S4_SRR_RL_Clu_Vel_77 1111;
BA_ "GenSigStartValue" SG_ 596 S4_SRR_RL_Clu_RCS_77 30;
BA_ "GenSigStartValue" SG_ 596 S4_SRR_RL_Clu_Locationvalid_77 1;
BA_ "InvalidHex" SG_ 596 S4_SRR_RL_Clu_ID_78 "0xFF";
BA_ "GenSigStartValue" SG_ 596 S4_SRR_RL_Clu_Theta_78 253;
BA_ "GenSigStartValue" SG_ 596 S4_SRR_RL_Clu_Vel_78 1111;
BA_ "GenSigStartValue" SG_ 596 S4_SRR_RL_Clu_RCS_78 30;
BA_ "GenSigStartValue" SG_ 596 S4_SRR_RL_Clu_Locationvalid_78 1;
BA_ "InvalidHex" SG_ 596 S4_SRR_RL_Clu_ID_79 "0xFF";
BA_ "GenSigStartValue" SG_ 596 S4_SRR_RL_Clu_Theta_79 253;
BA_ "GenSigStartValue" SG_ 596 S4_SRR_RL_Clu_Vel_79 1111;
BA_ "GenSigStartValue" SG_ 596 S4_SRR_RL_Clu_RCS_79 30;
BA_ "GenSigStartValue" SG_ 596 S4_SRR_RL_Clu_Locationvalid_79 1;
BA_ "InvalidHex" SG_ 596 S4_SRR_RL_Clu_ID_80 "0xFF";
BA_ "GenSigStartValue" SG_ 596 S4_SRR_RL_Clu_Theta_80 253;
BA_ "GenSigStartValue" SG_ 596 S4_SRR_RL_Clu_Vel_80 1111;
BA_ "GenSigStartValue" SG_ 596 S4_SRR_RL_Clu_RCS_80 30;
BA_ "GenSigStartValue" SG_ 596 S4_SRR_RL_Clu_Locationvalid_80 1;
BA_ "InvalidHex" SG_ 596 S4_SRR_RL_Clu_ID_81 "0xFF";
BA_ "GenSigStartValue" SG_ 596 S4_SRR_RL_Clu_Theta_81 253;
BA_ "GenSigStartValue" SG_ 596 S4_SRR_RL_Clu_Vel_81 1111;
BA_ "GenSigStartValue" SG_ 596 S4_SRR_RL_Clu_RCS_81 30;
BA_ "GenSigStartValue" SG_ 596 S4_SRR_RL_Clu_Locationvalid_81 1;
BA_ "InvalidHex" SG_ 596 S4_SRR_RL_Clu_ID_82 "0xFF";
BA_ "GenSigStartValue" SG_ 596 S4_SRR_RL_Clu_Theta_82 253;
BA_ "GenSigStartValue" SG_ 596 S4_SRR_RL_Clu_Vel_82 1111;
BA_ "GenSigStartValue" SG_ 596 S4_SRR_RL_Clu_RCS_82 30;
BA_ "GenSigStartValue" SG_ 596 S4_SRR_RL_Clu_Locationvalid_82 1;
BA_ "InvalidHex" SG_ 596 S4_SRR_RL_Clu_ID_83 "0xFF";
BA_ "GenSigStartValue" SG_ 596 S4_SRR_RL_Clu_Theta_83 253;
BA_ "GenSigStartValue" SG_ 596 S4_SRR_RL_Clu_Vel_83 1111;
BA_ "GenSigStartValue" SG_ 596 S4_SRR_RL_Clu_RCS_83 30;
BA_ "GenSigStartValue" SG_ 596 S4_SRR_RL_Clu_Locationvalid_83 1;
BA_ "VFrameFormat" BO_ 597 14;
BA_ "GenMsgSendType" BO_ 597 0;
BA_ "GenMsgCycleTime" BO_ 597 50;
BA_ "InvalidHex" SG_ 597 S4_SRR_RL_Clu_ID_84 "0xFF";
BA_ "GenSigStartValue" SG_ 597 S4_SRR_RL_Clu_Theta_84 253;
BA_ "GenSigStartValue" SG_ 597 S4_SRR_RL_Clu_Vel_84 1111;
BA_ "GenSigStartValue" SG_ 597 S4_SRR_RL_Clu_RCS_84 30;
BA_ "GenSigStartValue" SG_ 597 S4_SRR_RL_Clu_Locationvalid_84 1;
BA_ "InvalidHex" SG_ 597 S4_SRR_RL_Clu_ID_85 "0xFF";
BA_ "GenSigStartValue" SG_ 597 S4_SRR_RL_Clu_Theta_85 253;
BA_ "GenSigStartValue" SG_ 597 S4_SRR_RL_Clu_Vel_85 1111;
BA_ "GenSigStartValue" SG_ 597 S4_SRR_RL_Clu_RCS_85 30;
BA_ "GenSigStartValue" SG_ 597 S4_SRR_RL_Clu_Locationvalid_85 1;
BA_ "InvalidHex" SG_ 597 S4_SRR_RL_Clu_ID_86 "0xFF";
BA_ "GenSigStartValue" SG_ 597 S4_SRR_RL_Clu_Theta_86 253;
BA_ "GenSigStartValue" SG_ 597 S4_SRR_RL_Clu_Vel_86 1111;
BA_ "GenSigStartValue" SG_ 597 S4_SRR_RL_Clu_RCS_86 30;
BA_ "GenSigStartValue" SG_ 597 S4_SRR_RL_Clu_Locationvalid_86 1;
BA_ "InvalidHex" SG_ 597 S4_SRR_RL_Clu_ID_87 "0xFF";
BA_ "GenSigStartValue" SG_ 597 S4_SRR_RL_Clu_Theta_87 253;
BA_ "GenSigStartValue" SG_ 597 S4_SRR_RL_Clu_Vel_87 1111;
BA_ "GenSigStartValue" SG_ 597 S4_SRR_RL_Clu_RCS_87 30;
BA_ "GenSigStartValue" SG_ 597 S4_SRR_RL_Clu_Locationvalid_87 1;
BA_ "InvalidHex" SG_ 597 S4_SRR_RL_Clu_ID_88 "0xFF";
BA_ "GenSigStartValue" SG_ 597 S4_SRR_RL_Clu_Theta_88 253;
BA_ "GenSigStartValue" SG_ 597 S4_SRR_RL_Clu_Vel_88 1111;
BA_ "GenSigStartValue" SG_ 597 S4_SRR_RL_Clu_RCS_88 30;
BA_ "GenSigStartValue" SG_ 597 S4_SRR_RL_Clu_Locationvalid_88 1;
BA_ "InvalidHex" SG_ 597 S4_SRR_RL_Clu_ID_89 "0xFF";
BA_ "GenSigStartValue" SG_ 597 S4_SRR_RL_Clu_Theta_89 253;
BA_ "GenSigStartValue" SG_ 597 S4_SRR_RL_Clu_Vel_89 1111;
BA_ "GenSigStartValue" SG_ 597 S4_SRR_RL_Clu_RCS_89 30;
BA_ "GenSigStartValue" SG_ 597 S4_SRR_RL_Clu_Locationvalid_89 1;
BA_ "InvalidHex" SG_ 597 S4_SRR_RL_Clu_ID_90 "0xFF";
BA_ "GenSigStartValue" SG_ 597 S4_SRR_RL_Clu_Theta_90 253;
BA_ "GenSigStartValue" SG_ 597 S4_SRR_RL_Clu_Vel_90 1111;
BA_ "GenSigStartValue" SG_ 597 S4_SRR_RL_Clu_RCS_90 30;
BA_ "GenSigStartValue" SG_ 597 S4_SRR_RL_Clu_Locationvalid_90 1;
BA_ "VFrameFormat" BO_ 598 14;
BA_ "GenMsgSendType" BO_ 598 0;
BA_ "GenMsgCycleTime" BO_ 598 50;
BA_ "InvalidHex" SG_ 598 S4_SRR_RL_Clu_ID_91 "0xFF";
BA_ "GenSigStartValue" SG_ 598 S4_SRR_RL_Clu_Theta_91 253;
BA_ "GenSigStartValue" SG_ 598 S4_SRR_RL_Clu_Vel_91 1111;
BA_ "GenSigStartValue" SG_ 598 S4_SRR_RL_Clu_RCS_91 30;
BA_ "GenSigStartValue" SG_ 598 S4_SRR_RL_Clu_Locationvalid_91 1;
BA_ "InvalidHex" SG_ 598 S4_SRR_RL_Clu_ID_92 "0xFF";
BA_ "GenSigStartValue" SG_ 598 S4_SRR_RL_Clu_Theta_92 253;
BA_ "GenSigStartValue" SG_ 598 S4_SRR_RL_Clu_Vel_92 1111;
BA_ "GenSigStartValue" SG_ 598 S4_SRR_RL_Clu_RCS_92 30;
BA_ "GenSigStartValue" SG_ 598 S4_SRR_RL_Clu_Locationvalid_92 1;
BA_ "InvalidHex" SG_ 598 S4_SRR_RL_Clu_ID_93 "0xFF";
BA_ "GenSigStartValue" SG_ 598 S4_SRR_RL_Clu_Theta_93 253;
BA_ "GenSigStartValue" SG_ 598 S4_SRR_RL_Clu_Vel_93 1111;
BA_ "GenSigStartValue" SG_ 598 S4_SRR_RL_Clu_RCS_93 30;
BA_ "GenSigStartValue" SG_ 598 S4_SRR_RL_Clu_Locationvalid_93 1;
BA_ "InvalidHex" SG_ 598 S4_SRR_RL_Clu_ID_94 "0xFF";
BA_ "GenSigStartValue" SG_ 598 S4_SRR_RL_Clu_Theta_94 253;
BA_ "GenSigStartValue" SG_ 598 S4_SRR_RL_Clu_Vel_94 1111;
BA_ "GenSigStartValue" SG_ 598 S4_SRR_RL_Clu_RCS_94 30;
BA_ "GenSigStartValue" SG_ 598 S4_SRR_RL_Clu_Locationvalid_94 1;
BA_ "InvalidHex" SG_ 598 S4_SRR_RL_Clu_ID_95 "0xFF";
BA_ "GenSigStartValue" SG_ 598 S4_SRR_RL_Clu_Theta_95 253;
BA_ "GenSigStartValue" SG_ 598 S4_SRR_RL_Clu_Vel_95 1111;
BA_ "GenSigStartValue" SG_ 598 S4_SRR_RL_Clu_RCS_95 30;
BA_ "GenSigStartValue" SG_ 598 S4_SRR_RL_Clu_Locationvalid_95 1;
BA_ "InvalidHex" SG_ 598 S4_SRR_RL_Clu_ID_96 "0xFF";
BA_ "GenSigStartValue" SG_ 598 S4_SRR_RL_Clu_Theta_96 253;
BA_ "GenSigStartValue" SG_ 598 S4_SRR_RL_Clu_Vel_96 1111;
BA_ "GenSigStartValue" SG_ 598 S4_SRR_RL_Clu_RCS_96 30;
BA_ "GenSigStartValue" SG_ 598 S4_SRR_RL_Clu_Locationvalid_96 1;
BA_ "InvalidHex" SG_ 598 S4_SRR_RL_Clu_ID_97 "0xFF";
BA_ "GenSigStartValue" SG_ 598 S4_SRR_RL_Clu_Theta_97 253;
BA_ "GenSigStartValue" SG_ 598 S4_SRR_RL_Clu_Vel_97 1111;
BA_ "GenSigStartValue" SG_ 598 S4_SRR_RL_Clu_RCS_97 30;
BA_ "GenSigStartValue" SG_ 598 S4_SRR_RL_Clu_Locationvalid_97 1;
BA_ "VFrameFormat" BO_ 599 14;
BA_ "GenMsgSendType" BO_ 599 0;
BA_ "GenMsgCycleTime" BO_ 599 50;
BA_ "InvalidHex" SG_ 599 S4_SRR_RL_Clu_ID_98 "0xFF";
BA_ "GenSigStartValue" SG_ 599 S4_SRR_RL_Clu_Theta_98 253;
BA_ "GenSigStartValue" SG_ 599 S4_SRR_RL_Clu_Vel_98 1111;
BA_ "GenSigStartValue" SG_ 599 S4_SRR_RL_Clu_RCS_98 30;
BA_ "GenSigStartValue" SG_ 599 S4_SRR_RL_Clu_Locationvalid_98 1;
BA_ "InvalidHex" SG_ 599 S4_SRR_RL_Clu_ID_99 "0xFF";
BA_ "GenSigStartValue" SG_ 599 S4_SRR_RL_Clu_Theta_99 253;
BA_ "GenSigStartValue" SG_ 599 S4_SRR_RL_Clu_Vel_99 1111;
BA_ "GenSigStartValue" SG_ 599 S4_SRR_RL_Clu_RCS_99 30;
BA_ "GenSigStartValue" SG_ 599 S4_SRR_RL_Clu_Locationvalid_99 1;
BA_ "InvalidHex" SG_ 599 S4_SRR_RL_Clu_ID_100 "0xFF";
BA_ "GenSigStartValue" SG_ 599 S4_SRR_RL_Clu_Theta_100 253;
BA_ "GenSigStartValue" SG_ 599 S4_SRR_RL_Clu_Vel_100 1111;
BA_ "GenSigStartValue" SG_ 599 S4_SRR_RL_Clu_RCS_100 30;
BA_ "GenSigStartValue" SG_ 599 S4_SRR_RL_Clu_Locationvalid_100 1;
BA_ "InvalidHex" SG_ 599 S4_SRR_RL_Clu_ID_101 "0xFF";
BA_ "GenSigStartValue" SG_ 599 S4_SRR_RL_Clu_Theta_101 253;
BA_ "GenSigStartValue" SG_ 599 S4_SRR_RL_Clu_Vel_101 1111;
BA_ "GenSigStartValue" SG_ 599 S4_SRR_RL_Clu_RCS_101 30;
BA_ "GenSigStartValue" SG_ 599 S4_SRR_RL_Clu_Locationvalid_101 1;
BA_ "InvalidHex" SG_ 599 S4_SRR_RL_Clu_ID_102 "0xFF";
BA_ "GenSigStartValue" SG_ 599 S4_SRR_RL_Clu_Theta_102 253;
BA_ "GenSigStartValue" SG_ 599 S4_SRR_RL_Clu_Vel_102 1111;
BA_ "GenSigStartValue" SG_ 599 S4_SRR_RL_Clu_RCS_102 30;
BA_ "GenSigStartValue" SG_ 599 S4_SRR_RL_Clu_Locationvalid_102 1;
BA_ "InvalidHex" SG_ 599 S4_SRR_RL_Clu_ID_103 "0xFF";
BA_ "GenSigStartValue" SG_ 599 S4_SRR_RL_Clu_Theta_103 253;
BA_ "GenSigStartValue" SG_ 599 S4_SRR_RL_Clu_Vel_103 1111;
BA_ "GenSigStartValue" SG_ 599 S4_SRR_RL_Clu_RCS_103 30;
BA_ "GenSigStartValue" SG_ 599 S4_SRR_RL_Clu_Locationvalid_103 1;
BA_ "InvalidHex" SG_ 599 S4_SRR_RL_Clu_ID_104 "0xFF";
BA_ "GenSigStartValue" SG_ 599 S4_SRR_RL_Clu_Theta_104 253;
BA_ "GenSigStartValue" SG_ 599 S4_SRR_RL_Clu_Vel_104 1111;
BA_ "GenSigStartValue" SG_ 599 S4_SRR_RL_Clu_RCS_104 30;
BA_ "GenSigStartValue" SG_ 599 S4_SRR_RL_Clu_Locationvalid_104 1;
BA_ "VFrameFormat" BO_ 600 14;
BA_ "GenMsgSendType" BO_ 600 0;
BA_ "GenMsgCycleTime" BO_ 600 50;
BA_ "InvalidHex" SG_ 600 S4_SRR_RL_Clu_ID_105 "0xFF";
BA_ "GenSigStartValue" SG_ 600 S4_SRR_RL_Clu_Theta_105 253;
BA_ "GenSigStartValue" SG_ 600 S4_SRR_RL_Clu_Vel_105 1111;
BA_ "GenSigStartValue" SG_ 600 S4_SRR_RL_Clu_RCS_105 30;
BA_ "GenSigStartValue" SG_ 600 S4_SRR_RL_Clu_Locationvalid_105 1;
BA_ "InvalidHex" SG_ 600 S4_SRR_RL_Clu_ID_106 "0xFF";
BA_ "GenSigStartValue" SG_ 600 S4_SRR_RL_Clu_Theta_106 253;
BA_ "GenSigStartValue" SG_ 600 S4_SRR_RL_Clu_Vel_106 1111;
BA_ "GenSigStartValue" SG_ 600 S4_SRR_RL_Clu_RCS_106 30;
BA_ "GenSigStartValue" SG_ 600 S4_SRR_RL_Clu_Locationvalid_106 1;
BA_ "InvalidHex" SG_ 600 S4_SRR_RL_Clu_ID_107 "0xFF";
BA_ "GenSigStartValue" SG_ 600 S4_SRR_RL_Clu_Theta_107 253;
BA_ "GenSigStartValue" SG_ 600 S4_SRR_RL_Clu_Vel_107 1111;
BA_ "GenSigStartValue" SG_ 600 S4_SRR_RL_Clu_RCS_107 30;
BA_ "GenSigStartValue" SG_ 600 S4_SRR_RL_Clu_Locationvalid_107 1;
BA_ "InvalidHex" SG_ 600 S4_SRR_RL_Clu_ID_108 "0xFF";
BA_ "GenSigStartValue" SG_ 600 S4_SRR_RL_Clu_Theta_108 253;
BA_ "GenSigStartValue" SG_ 600 S4_SRR_RL_Clu_Vel_108 1111;
BA_ "GenSigStartValue" SG_ 600 S4_SRR_RL_Clu_RCS_108 30;
BA_ "GenSigStartValue" SG_ 600 S4_SRR_RL_Clu_Locationvalid_108 1;
BA_ "InvalidHex" SG_ 600 S4_SRR_RL_Clu_ID_109 "0xFF";
BA_ "GenSigStartValue" SG_ 600 S4_SRR_RL_Clu_Theta_109 253;
BA_ "GenSigStartValue" SG_ 600 S4_SRR_RL_Clu_Vel_109 1111;
BA_ "GenSigStartValue" SG_ 600 S4_SRR_RL_Clu_RCS_109 30;
BA_ "GenSigStartValue" SG_ 600 S4_SRR_RL_Clu_Locationvalid_109 1;
BA_ "InvalidHex" SG_ 600 S4_SRR_RL_Clu_ID_110 "0xFF";
BA_ "GenSigStartValue" SG_ 600 S4_SRR_RL_Clu_Theta_110 253;
BA_ "GenSigStartValue" SG_ 600 S4_SRR_RL_Clu_Vel_110 1111;
BA_ "GenSigStartValue" SG_ 600 S4_SRR_RL_Clu_RCS_110 30;
BA_ "GenSigStartValue" SG_ 600 S4_SRR_RL_Clu_Locationvalid_110 1;
BA_ "InvalidHex" SG_ 600 S4_SRR_RL_Clu_ID_111 "0xFF";
BA_ "GenSigStartValue" SG_ 600 S4_SRR_RL_Clu_Theta_111 253;
BA_ "GenSigStartValue" SG_ 600 S4_SRR_RL_Clu_Vel_111 1111;
BA_ "GenSigStartValue" SG_ 600 S4_SRR_RL_Clu_RCS_111 30;
BA_ "GenSigStartValue" SG_ 600 S4_SRR_RL_Clu_Locationvalid_111 1;

VAL_ 576 S4_SRR_RL_Clu_DynProp_0 0 "Stationary" 1 "Moving" ;
VAL_ 576 S4_SRR_RL_Clu_Locationvalid_0 0 "valid" 1 "invalid" ;
VAL_ 576 S4_SRR_RL_Clu_DynProp_1 0 "Stationary" 1 "Moving" ;
VAL_ 576 S4_SRR_RL_Clu_Locationvalid_1 0 "valid" 1 "invalid" ;
VAL_ 576 S4_SRR_RL_Clu_DynProp_2 0 "Stationary" 1 "Moving" ;
VAL_ 576 S4_SRR_RL_Clu_Locationvalid_2 0 "valid" 1 "invalid" ;
VAL_ 576 S4_SRR_RL_Clu_DynProp_3 0 "Stationary" 1 "Moving" ;
VAL_ 576 S4_SRR_RL_Clu_Locationvalid_3 0 "valid" 1 "invalid" ;
VAL_ 576 S4_SRR_RL_Clu_DynProp_4 0 "Stationary" 1 "Moving" ;
VAL_ 576 S4_SRR_RL_Clu_Locationvalid_4 0 "valid" 1 "invalid" ;
VAL_ 576 S4_SRR_RL_Clu_DynProp_5 0 "Stationary" 1 "Moving" ;
VAL_ 576 S4_SRR_RL_Clu_Locationvalid_5 0 "valid" 1 "invalid" ;
VAL_ 576 S4_SRR_RL_Clu_DynProp_6 0 "Stationary" 1 "Moving" ;
VAL_ 576 S4_SRR_RL_Clu_Locationvalid_6 0 "valid" 1 "invalid" ;
VAL_ 577 S4_SRR_RL_Clu_DynProp_7 0 "Stationary" 1 "Moving" ;
VAL_ 577 S4_SRR_RL_Clu_Locationvalid_7 0 "valid" 1 "invalid" ;
VAL_ 577 S4_SRR_RL_Clu_DynProp_8 0 "Stationary" 1 "Moving" ;
VAL_ 577 S4_SRR_RL_Clu_Locationvalid_8 0 "valid" 1 "invalid" ;
VAL_ 577 S4_SRR_RL_Clu_DynProp_9 0 "Stationary" 1 "Moving" ;
VAL_ 577 S4_SRR_RL_Clu_Locationvalid_9 0 "valid" 1 "invalid" ;
VAL_ 577 S4_SRR_RL_Clu_DynProp_10 0 "Stationary" 1 "Moving" ;
VAL_ 577 S4_SRR_RL_Clu_Locationvalid_10 0 "valid" 1 "invalid" ;
VAL_ 577 S4_SRR_RL_Clu_DynProp_11 0 "Stationary" 1 "Moving" ;
VAL_ 577 S4_SRR_RL_Clu_Locationvalid_11 0 "valid" 1 "invalid" ;
VAL_ 577 S4_SRR_RL_Clu_DynProp_12 0 "Stationary" 1 "Moving" ;
VAL_ 577 S4_SRR_RL_Clu_Locationvalid_12 0 "valid" 1 "invalid" ;
VAL_ 577 S4_SRR_RL_Clu_DynProp_13 0 "Stationary" 1 "Moving" ;
VAL_ 577 S4_SRR_RL_Clu_Locationvalid_13 0 "valid" 1 "invalid" ;
VAL_ 587 S4_SRR_RL_Clu_DynProp_14 0 "Stationary" 1 "Moving" ;
VAL_ 587 S4_SRR_RL_Clu_Locationvalid_14 0 "valid" 1 "invalid" ;
VAL_ 587 S4_SRR_RL_Clu_DynProp_15 0 "Stationary" 1 "Moving" ;
VAL_ 587 S4_SRR_RL_Clu_Locationvalid_15 0 "valid" 1 "invalid" ;
VAL_ 587 S4_SRR_RL_Clu_DynProp_16 0 "Stationary" 1 "Moving" ;
VAL_ 587 S4_SRR_RL_Clu_Locationvalid_16 0 "valid" 1 "invalid" ;
VAL_ 587 S4_SRR_RL_Clu_DynProp_17 0 "Stationary" 1 "Moving" ;
VAL_ 587 S4_SRR_RL_Clu_Locationvalid_17 0 "valid" 1 "invalid" ;
VAL_ 587 S4_SRR_RL_Clu_DynProp_18 0 "Stationary" 1 "Moving" ;
VAL_ 587 S4_SRR_RL_Clu_Locationvalid_18 0 "valid" 1 "invalid" ;
VAL_ 587 S4_SRR_RL_Clu_DynProp_19 0 "Stationary" 1 "Moving" ;
VAL_ 587 S4_SRR_RL_Clu_Locationvalid_19 0 "valid" 1 "invalid" ;
VAL_ 587 S4_SRR_RL_Clu_DynProp_20 0 "Stationary" 1 "Moving" ;
VAL_ 587 S4_SRR_RL_Clu_Locationvalid_20 0 "valid" 1 "invalid" ;
VAL_ 588 S4_SRR_RL_Clu_DynProp_21 0 "Stationary" 1 "Moving" ;
VAL_ 588 S4_SRR_RL_Clu_Locationvalid_21 0 "valid" 1 "invalid" ;
VAL_ 588 S4_SRR_RL_Clu_DynProp_22 0 "Stationary" 1 "Moving" ;
VAL_ 588 S4_SRR_RL_Clu_Locationvalid_22 0 "valid" 1 "invalid" ;
VAL_ 588 S4_SRR_RL_Clu_DynProp_23 0 "Stationary" 1 "Moving" ;
VAL_ 588 S4_SRR_RL_Clu_Locationvalid_23 0 "valid" 1 "invalid" ;
VAL_ 588 S4_SRR_RL_Clu_DynProp_24 0 "Stationary" 1 "Moving" ;
VAL_ 588 S4_SRR_RL_Clu_Locationvalid_24 0 "valid" 1 "invalid" ;
VAL_ 588 S4_SRR_RL_Clu_DynProp_25 0 "Stationary" 1 "Moving" ;
VAL_ 588 S4_SRR_RL_Clu_Locationvalid_25 0 "valid" 1 "invalid" ;
VAL_ 588 S4_SRR_RL_Clu_DynProp_26 0 "Stationary" 1 "Moving" ;
VAL_ 588 S4_SRR_RL_Clu_Locationvalid_26 0 "valid" 1 "invalid" ;
VAL_ 588 S4_SRR_RL_Clu_DynProp_27 0 "Stationary" 1 "Moving" ;
VAL_ 588 S4_SRR_RL_Clu_Locationvalid_27 0 "valid" 1 "invalid" ;
VAL_ 589 S4_SRR_RL_Clu_DynProp_28 0 "Stationary" 1 "Moving" ;
VAL_ 589 S4_SRR_RL_Clu_Locationvalid_28 0 "valid" 1 "invalid" ;
VAL_ 589 S4_SRR_RL_Clu_DynProp_29 0 "Stationary" 1 "Moving" ;
VAL_ 589 S4_SRR_RL_Clu_Locationvalid_29 0 "valid" 1 "invalid" ;
VAL_ 589 S4_SRR_RL_Clu_DynProp_30 0 "Stationary" 1 "Moving" ;
VAL_ 589 S4_SRR_RL_Clu_Locationvalid_30 0 "valid" 1 "invalid" ;
VAL_ 589 S4_SRR_RL_Clu_DynProp_31 0 "Stationary" 1 "Moving" ;
VAL_ 589 S4_SRR_RL_Clu_Locationvalid_31 0 "valid" 1 "invalid" ;
VAL_ 589 S4_SRR_RL_Clu_DynProp_32 0 "Stationary" 1 "Moving" ;
VAL_ 589 S4_SRR_RL_Clu_Locationvalid_32 0 "valid" 1 "invalid" ;
VAL_ 589 S4_SRR_RL_Clu_DynProp_33 0 "Stationary" 1 "Moving" ;
VAL_ 589 S4_SRR_RL_Clu_Locationvalid_33 0 "valid" 1 "invalid" ;
VAL_ 589 S4_SRR_RL_Clu_DynProp_34 0 "Stationary" 1 "Moving" ;
VAL_ 589 S4_SRR_RL_Clu_Locationvalid_34 0 "valid" 1 "invalid" ;
VAL_ 590 S4_SRR_RL_Clu_DynProp_35 0 "Stationary" 1 "Moving" ;
VAL_ 590 S4_SRR_RL_Clu_Locationvalid_35 0 "valid" 1 "invalid" ;
VAL_ 590 S4_SRR_RL_Clu_DynProp_36 0 "Stationary" 1 "Moving" ;
VAL_ 590 S4_SRR_RL_Clu_Locationvalid_36 0 "valid" 1 "invalid" ;
VAL_ 590 S4_SRR_RL_Clu_DynProp_37 0 "Stationary" 1 "Moving" ;
VAL_ 590 S4_SRR_RL_Clu_Locationvalid_37 0 "valid" 1 "invalid" ;
VAL_ 590 S4_SRR_RL_Clu_DynProp_38 0 "Stationary" 1 "Moving" ;
VAL_ 590 S4_SRR_RL_Clu_Locationvalid_38 0 "valid" 1 "invalid" ;
VAL_ 590 S4_SRR_RL_Clu_DynProp_39 0 "Stationary" 1 "Moving" ;
VAL_ 590 S4_SRR_RL_Clu_Locationvalid_39 0 "valid" 1 "invalid" ;
VAL_ 590 S4_SRR_RL_Clu_DynProp_40 0 "Stationary" 1 "Moving" ;
VAL_ 590 S4_SRR_RL_Clu_Locationvalid_40 0 "valid" 1 "invalid" ;
VAL_ 590 S4_SRR_RL_Clu_DynProp_41 0 "Stationary" 1 "Moving" ;
VAL_ 590 S4_SRR_RL_Clu_Locationvalid_41 0 "valid" 1 "invalid" ;
VAL_ 591 S4_SRR_RL_Clu_DynProp_42 0 "Stationary" 1 "Moving" ;
VAL_ 591 S4_SRR_RL_Clu_Locationvalid_42 0 "valid" 1 "invalid" ;
VAL_ 591 S4_SRR_RL_Clu_DynProp_43 0 "Stationary" 1 "Moving" ;
VAL_ 591 S4_SRR_RL_Clu_Locationvalid_43 0 "valid" 1 "invalid" ;
VAL_ 591 S4_SRR_RL_Clu_DynProp_44 0 "Stationary" 1 "Moving" ;
VAL_ 591 S4_SRR_RL_Clu_Locationvalid_44 0 "valid" 1 "invalid" ;
VAL_ 591 S4_SRR_RL_Clu_DynProp_45 0 "Stationary" 1 "Moving" ;
VAL_ 591 S4_SRR_RL_Clu_Locationvalid_45 0 "valid" 1 "invalid" ;
VAL_ 591 S4_SRR_RL_Clu_DynProp_46 0 "Stationary" 1 "Moving" ;
VAL_ 591 S4_SRR_RL_Clu_Locationvalid_46 0 "valid" 1 "invalid" ;
VAL_ 591 S4_SRR_RL_Clu_DynProp_47 0 "Stationary" 1 "Moving" ;
VAL_ 591 S4_SRR_RL_Clu_Locationvalid_47 0 "valid" 1 "invalid" ;
VAL_ 591 S4_SRR_RL_Clu_DynProp_48 0 "Stationary" 1 "Moving" ;
VAL_ 591 S4_SRR_RL_Clu_Locationvalid_48 0 "valid" 1 "invalid" ;
VAL_ 592 S4_SRR_RL_Clu_DynProp_49 0 "Stationary" 1 "Moving" ;
VAL_ 592 S4_SRR_RL_Clu_Locationvalid_49 0 "valid" 1 "invalid" ;
VAL_ 592 S4_SRR_RL_Clu_DynProp_50 0 "Stationary" 1 "Moving" ;
VAL_ 592 S4_SRR_RL_Clu_Locationvalid_50 0 "valid" 1 "invalid" ;
VAL_ 592 S4_SRR_RL_Clu_DynProp_51 0 "Stationary" 1 "Moving" ;
VAL_ 592 S4_SRR_RL_Clu_Locationvalid_51 0 "valid" 1 "invalid" ;
VAL_ 592 S4_SRR_RL_Clu_DynProp_52 0 "Stationary" 1 "Moving" ;
VAL_ 592 S4_SRR_RL_Clu_Locationvalid_52 0 "valid" 1 "invalid" ;
VAL_ 592 S4_SRR_RL_Clu_DynProp_53 0 "Stationary" 1 "Moving" ;
VAL_ 592 S4_SRR_RL_Clu_Locationvalid_53 0 "valid" 1 "invalid" ;
VAL_ 592 S4_SRR_RL_Clu_DynProp_54 0 "Stationary" 1 "Moving" ;
VAL_ 592 S4_SRR_RL_Clu_Locationvalid_54 0 "valid" 1 "invalid" ;
VAL_ 592 S4_SRR_RL_Clu_DynProp_55 0 "Stationary" 1 "Moving" ;
VAL_ 592 S4_SRR_RL_Clu_Locationvalid_55 0 "valid" 1 "invalid" ;
VAL_ 593 S4_SRR_RL_Clu_DynProp_56 0 "Stationary" 1 "Moving" ;
VAL_ 593 S4_SRR_RL_Clu_Locationvalid_56 0 "valid" 1 "invalid" ;
VAL_ 593 S4_SRR_RL_Clu_DynProp_57 0 "Stationary" 1 "Moving" ;
VAL_ 593 S4_SRR_RL_Clu_Locationvalid_57 0 "valid" 1 "invalid" ;
VAL_ 593 S4_SRR_RL_Clu_DynProp_58 0 "Stationary" 1 "Moving" ;
VAL_ 593 S4_SRR_RL_Clu_Locationvalid_58 0 "valid" 1 "invalid" ;
VAL_ 593 S4_SRR_RL_Clu_DynProp_59 0 "Stationary" 1 "Moving" ;
VAL_ 593 S4_SRR_RL_Clu_Locationvalid_59 0 "valid" 1 "invalid" ;
VAL_ 593 S4_SRR_RL_Clu_DynProp_60 0 "Stationary" 1 "Moving" ;
VAL_ 593 S4_SRR_RL_Clu_Locationvalid_60 0 "valid" 1 "invalid" ;
VAL_ 593 S4_SRR_RL_Clu_DynProp_61 0 "Stationary" 1 "Moving" ;
VAL_ 593 S4_SRR_RL_Clu_Locationvalid_61 0 "valid" 1 "invalid" ;
VAL_ 593 S4_SRR_RL_Clu_DynProp_62 0 "Stationary" 1 "Moving" ;
VAL_ 593 S4_SRR_RL_Clu_Locationvalid_62 0 "valid" 1 "invalid" ;
VAL_ 594 S4_SRR_RL_Clu_DynProp_63 0 "Stationary" 1 "Moving" ;
VAL_ 594 S4_SRR_RL_Clu_Locationvalid_63 0 "valid" 1 "invalid" ;
VAL_ 594 S4_SRR_RL_Clu_DynProp_64 0 "Stationary" 1 "Moving" ;
VAL_ 594 S4_SRR_RL_Clu_Locationvalid_64 0 "valid" 1 "invalid" ;
VAL_ 594 S4_SRR_RL_Clu_DynProp_65 0 "Stationary" 1 "Moving" ;
VAL_ 594 S4_SRR_RL_Clu_Locationvalid_65 0 "valid" 1 "invalid" ;
VAL_ 594 S4_SRR_RL_Clu_DynProp_66 0 "Stationary" 1 "Moving" ;
VAL_ 594 S4_SRR_RL_Clu_Locationvalid_66 0 "valid" 1 "invalid" ;
VAL_ 594 S4_SRR_RL_Clu_DynProp_67 0 "Stationary" 1 "Moving" ;
VAL_ 594 S4_SRR_RL_Clu_Locationvalid_67 0 "valid" 1 "invalid" ;
VAL_ 594 S4_SRR_RL_Clu_DynProp_68 0 "Stationary" 1 "Moving" ;
VAL_ 594 S4_SRR_RL_Clu_Locationvalid_68 0 "valid" 1 "invalid" ;
VAL_ 594 S4_SRR_RL_Clu_DynProp_69 0 "Stationary" 1 "Moving" ;
VAL_ 594 S4_SRR_RL_Clu_Locationvalid_69 0 "valid" 1 "invalid" ;
VAL_ 595 S4_SRR_RL_Clu_DynProp_70 0 "Stationary" 1 "Moving" ;
VAL_ 595 S4_SRR_RL_Clu_Locationvalid_70 0 "valid" 1 "invalid" ;
VAL_ 595 S4_SRR_RL_Clu_DynProp_71 0 "Stationary" 1 "Moving" ;
VAL_ 595 S4_SRR_RL_Clu_Locationvalid_71 0 "valid" 1 "invalid" ;
VAL_ 595 S4_SRR_RL_Clu_DynProp_72 0 "Stationary" 1 "Moving" ;
VAL_ 595 S4_SRR_RL_Clu_Locationvalid_72 0 "valid" 1 "invalid" ;
VAL_ 595 S4_SRR_RL_Clu_DynProp_73 0 "Stationary" 1 "Moving" ;
VAL_ 595 S4_SRR_RL_Clu_Locationvalid_73 0 "valid" 1 "invalid" ;
VAL_ 595 S4_SRR_RL_Clu_DynProp_74 0 "Stationary" 1 "Moving" ;
VAL_ 595 S4_SRR_RL_Clu_Locationvalid_74 0 "valid" 1 "invalid" ;
VAL_ 595 S4_SRR_RL_Clu_DynProp_75 0 "Stationary" 1 "Moving" ;
VAL_ 595 S4_SRR_RL_Clu_Locationvalid_75 0 "valid" 1 "invalid" ;
VAL_ 595 S4_SRR_RL_Clu_DynProp_76 0 "Stationary" 1 "Moving" ;
VAL_ 595 S4_SRR_RL_Clu_Locationvalid_76 0 "valid" 1 "invalid" ;
VAL_ 596 S4_SRR_RL_Clu_DynProp_77 0 "Stationary" 1 "Moving" ;
VAL_ 596 S4_SRR_RL_Clu_Locationvalid_77 0 "valid" 1 "invalid" ;
VAL_ 596 S4_SRR_RL_Clu_DynProp_78 0 "Stationary" 1 "Moving" ;
VAL_ 596 S4_SRR_RL_Clu_Locationvalid_78 0 "valid" 1 "invalid" ;
VAL_ 596 S4_SRR_RL_Clu_DynProp_79 0 "Stationary" 1 "Moving" ;
VAL_ 596 S4_SRR_RL_Clu_Locationvalid_79 0 "valid" 1 "invalid" ;
VAL_ 596 S4_SRR_RL_Clu_DynProp_80 0 "Stationary" 1 "Moving" ;
VAL_ 596 S4_SRR_RL_Clu_Locationvalid_80 0 "valid" 1 "invalid" ;
VAL_ 596 S4_SRR_RL_Clu_DynProp_81 0 "Stationary" 1 "Moving" ;
VAL_ 596 S4_SRR_RL_Clu_Locationvalid_81 0 "valid" 1 "invalid" ;
VAL_ 596 S4_SRR_RL_Clu_DynProp_82 0 "Stationary" 1 "Moving" ;
VAL_ 596 S4_SRR_RL_Clu_Locationvalid_82 0 "valid" 1 "invalid" ;
VAL_ 596 S4_SRR_RL_Clu_DynProp_83 0 "Stationary" 1 "Moving" ;
VAL_ 596 S4_SRR_RL_Clu_Locationvalid_83 0 "valid" 1 "invalid" ;
VAL_ 597 S4_SRR_RL_Clu_DynProp_84 0 "Stationary" 1 "Moving" ;
VAL_ 597 S4_SRR_RL_Clu_Locationvalid_84 0 "valid" 1 "invalid" ;
VAL_ 597 S4_SRR_RL_Clu_DynProp_85 0 "Stationary" 1 "Moving" ;
VAL_ 597 S4_SRR_RL_Clu_Locationvalid_85 0 "valid" 1 "invalid" ;
VAL_ 597 S4_SRR_RL_Clu_DynProp_86 0 "Stationary" 1 "Moving" ;
VAL_ 597 S4_SRR_RL_Clu_Locationvalid_86 0 "valid" 1 "invalid" ;
VAL_ 597 S4_SRR_RL_Clu_DynProp_87 0 "Stationary" 1 "Moving" ;
VAL_ 597 S4_SRR_RL_Clu_Locationvalid_87 0 "valid" 1 "invalid" ;
VAL_ 597 S4_SRR_RL_Clu_DynProp_88 0 "Stationary" 1 "Moving" ;
VAL_ 597 S4_SRR_RL_Clu_Locationvalid_88 0 "valid" 1 "invalid" ;
VAL_ 597 S4_SRR_RL_Clu_DynProp_89 0 "Stationary" 1 "Moving" ;
VAL_ 597 S4_SRR_RL_Clu_Locationvalid_89 0 "valid" 1 "invalid" ;
VAL_ 597 S4_SRR_RL_Clu_DynProp_90 0 "Stationary" 1 "Moving" ;
VAL_ 597 S4_SRR_RL_Clu_Locationvalid_90 0 "valid" 1 "invalid" ;
VAL_ 598 S4_SRR_RL_Clu_DynProp_91 0 "Stationary" 1 "Moving" ;
VAL_ 598 S4_SRR_RL_Clu_Locationvalid_91 0 "valid" 1 "invalid" ;
VAL_ 598 S4_SRR_RL_Clu_DynProp_92 0 "Stationary" 1 "Moving" ;
VAL_ 598 S4_SRR_RL_Clu_Locationvalid_92 0 "valid" 1 "invalid" ;
VAL_ 598 S4_SRR_RL_Clu_DynProp_93 0 "Stationary" 1 "Moving" ;
VAL_ 598 S4_SRR_RL_Clu_Locationvalid_93 0 "valid" 1 "invalid" ;
VAL_ 598 S4_SRR_RL_Clu_DynProp_94 0 "Stationary" 1 "Moving" ;
VAL_ 598 S4_SRR_RL_Clu_Locationvalid_94 0 "valid" 1 "invalid" ;
VAL_ 598 S4_SRR_RL_Clu_DynProp_95 0 "Stationary" 1 "Moving" ;
VAL_ 598 S4_SRR_RL_Clu_Locationvalid_95 0 "valid" 1 "invalid" ;
VAL_ 598 S4_SRR_RL_Clu_DynProp_96 0 "Stationary" 1 "Moving" ;
VAL_ 598 S4_SRR_RL_Clu_Locationvalid_96 0 "valid" 1 "invalid" ;
VAL_ 598 S4_SRR_RL_Clu_DynProp_97 0 "Stationary" 1 "Moving" ;
VAL_ 598 S4_SRR_RL_Clu_Locationvalid_97 0 "valid" 1 "invalid" ;
VAL_ 599 S4_SRR_RL_Clu_DynProp_98 0 "Stationary" 1 "Moving" ;
VAL_ 599 S4_SRR_RL_Clu_Locationvalid_98 0 "valid" 1 "invalid" ;
VAL_ 599 S4_SRR_RL_Clu_DynProp_99 0 "Stationary" 1 "Moving" ;
VAL_ 599 S4_SRR_RL_Clu_Locationvalid_99 0 "valid" 1 "invalid" ;
VAL_ 599 S4_SRR_RL_Clu_DynProp_100 0 "Stationary" 1 "Moving" ;
VAL_ 599 S4_SRR_RL_Clu_Locationvalid_100 0 "valid" 1 "invalid" ;
VAL_ 599 S4_SRR_RL_Clu_DynProp_101 0 "Stationary" 1 "Moving" ;
VAL_ 599 S4_SRR_RL_Clu_Locationvalid_101 0 "valid" 1 "invalid" ;
VAL_ 599 S4_SRR_RL_Clu_DynProp_102 0 "Stationary" 1 "Moving" ;
VAL_ 599 S4_SRR_RL_Clu_Locationvalid_102 0 "valid" 1 "invalid" ;
VAL_ 599 S4_SRR_RL_Clu_DynProp_103 0 "Stationary" 1 "Moving" ;
VAL_ 599 S4_SRR_RL_Clu_Locationvalid_103 0 "valid" 1 "invalid" ;
VAL_ 599 S4_SRR_RL_Clu_DynProp_104 0 "Stationary" 1 "Moving" ;
VAL_ 599 S4_SRR_RL_Clu_Locationvalid_104 0 "valid" 1 "invalid" ;
VAL_ 600 S4_SRR_RL_Clu_DynProp_105 0 "Stationary" 1 "Moving" ;
VAL_ 600 S4_SRR_RL_Clu_Locationvalid_105 0 "valid" 1 "invalid" ;
VAL_ 600 S4_SRR_RL_Clu_DynProp_106 0 "Stationary" 1 "Moving" ;
VAL_ 600 S4_SRR_RL_Clu_Locationvalid_106 0 "valid" 1 "invalid" ;
VAL_ 600 S4_SRR_RL_Clu_DynProp_107 0 "Stationary" 1 "Moving" ;
VAL_ 600 S4_SRR_RL_Clu_Locationvalid_107 0 "valid" 1 "invalid" ;
VAL_ 600 S4_SRR_RL_Clu_DynProp_108 0 "Stationary" 1 "Moving" ;
VAL_ 600 S4_SRR_RL_Clu_Locationvalid_108 0 "valid" 1 "invalid" ;
VAL_ 600 S4_SRR_RL_Clu_DynProp_109 0 "Stationary" 1 "Moving" ;
VAL_ 600 S4_SRR_RL_Clu_Locationvalid_109 0 "valid" 1 "invalid" ;
VAL_ 600 S4_SRR_RL_Clu_DynProp_110 0 "Stationary" 1 "Moving" ;
VAL_ 600 S4_SRR_RL_Clu_Locationvalid_110 0 "valid" 1 "invalid" ;
VAL_ 600 S4_SRR_RL_Clu_DynProp_111 0 "Stationary" 1 "Moving" ;
VAL_ 600 S4_SRR_RL_Clu_Locationvalid_111 0 "valid" 1 "invalid" ;
