// *************************************************************************** *
// *                                                                           *
// * Description:         CANDB File                                           *
// * Generated at:        2023-03-30 16:08                                     *
// * System:              ZSDB123101                                           *
// * Variant:             CS1E                                                 *
// * Network:             Private_CANFD5                                       *
// *                                                                           *
// *************************************************************************** *
VERSION "Private_CANFD5"

NS_ :

BS_ :

BU_ :  ASDM SODL

BO_ 119 SODLPrivateCANFD5Fr60 : 64 SODL
 SG_ ReSideRdrLeDetn157_UB : 487|1@0+ (1,0) [0|1] "" ASDM
 SG_ ReSideRdrLeDetn157RdrDetnAmbigState : 72|1@0+ (1,0) [0|1] "" ASDM
 SG_ ReSideRdrLeDetn157RdrDetnAssoTrkID : 79|7@0+ (1.0,0.0) [0.0|127.0] "Unitless" ASDM
 SG_ ReSideRdrLeDetn157RdrDetnAzi : 34|11@0+ (0.1,-90.0) [-90.0|90.0] "Deg" ASDM
 SG_ ReSideRdrLeDetn157RdrDetnChks : 7|8@0+ (1.0,0.0) [0.0|255.0] "Unitless" ASDM
 SG_ ReSideRdrLeDetn157RdrDetnCntr : 15|4@0+ (1.0,0.0) [0.0|15.0] "Unitless" ASDM
 SG_ ReSideRdrLeDetn157RdrDetnConf : 11|7@0+ (1.0,0.0) [0.0|100.0] "%" ASDM
 SG_ ReSideRdrLeDetn157RdrDetnElevn : 20|5@0+ (1.0,-15.0) [-15.0|15.0] "Deg" ASDM
 SG_ ReSideRdrLeDetn157RdrDetnPwr : 71|6@0+ (1.0,0.0) [0.0|63.0] "dB" ASDM
 SG_ ReSideRdrLeDetn157RdrDetnRng : 55|14@0+ (0.02,-1.0) [-1.0|200.0] "m" ASDM
 SG_ ReSideRdrLeDetn157RdrDetnRngV : 31|13@0+ (0.02,-80.0) [-80.0|80.0] "m/s" ASDM
 SG_ ReSideRdrLeDetn157RdrDetnSameRV : 65|2@0+ (1,0) [0|3] "" ASDM
 SG_ ReSideRdrLeDetn157RdrDetnSts : 57|2@0+ (1,0) [0|3] "" ASDM
 SG_ ReSideRdrLeDetn158_UB : 486|1@0+ (1,0) [0|1] "" ASDM
 SG_ ReSideRdrLeDetn158RdrDetnAmbigState : 152|1@0+ (1,0) [0|1] "" ASDM
 SG_ ReSideRdrLeDetn158RdrDetnAssoTrkID : 159|7@0+ (1.0,0.0) [0.0|127.0] "Unitless" ASDM
 SG_ ReSideRdrLeDetn158RdrDetnAzi : 114|11@0+ (0.1,-90.0) [-90.0|90.0] "Deg" ASDM
 SG_ ReSideRdrLeDetn158RdrDetnChks : 87|8@0+ (1.0,0.0) [0.0|255.0] "Unitless" ASDM
 SG_ ReSideRdrLeDetn158RdrDetnCntr : 95|4@0+ (1.0,0.0) [0.0|15.0] "Unitless" ASDM
 SG_ ReSideRdrLeDetn158RdrDetnConf : 91|7@0+ (1.0,0.0) [0.0|100.0] "%" ASDM
 SG_ ReSideRdrLeDetn158RdrDetnElevn : 100|5@0+ (1.0,-15.0) [-15.0|15.0] "Deg" ASDM
 SG_ ReSideRdrLeDetn158RdrDetnPwr : 151|6@0+ (1.0,0.0) [0.0|63.0] "dB" ASDM
 SG_ ReSideRdrLeDetn158RdrDetnRng : 135|14@0+ (0.02,-1.0) [-1.0|200.0] "m" ASDM
 SG_ ReSideRdrLeDetn158RdrDetnRngV : 111|13@0+ (0.02,-80.0) [-80.0|80.0] "m/s" ASDM
 SG_ ReSideRdrLeDetn158RdrDetnSameRV : 145|2@0+ (1,0) [0|3] "" ASDM
 SG_ ReSideRdrLeDetn158RdrDetnSts : 137|2@0+ (1,0) [0|3] "" ASDM
 SG_ ReSideRdrLeDetn159_UB : 485|1@0+ (1,0) [0|1] "" ASDM
 SG_ ReSideRdrLeDetn159RdrDetnAmbigState : 232|1@0+ (1,0) [0|1] "" ASDM
 SG_ ReSideRdrLeDetn159RdrDetnAssoTrkID : 239|7@0+ (1.0,0.0) [0.0|127.0] "Unitless" ASDM
 SG_ ReSideRdrLeDetn159RdrDetnAzi : 194|11@0+ (0.1,-90.0) [-90.0|90.0] "Deg" ASDM
 SG_ ReSideRdrLeDetn159RdrDetnChks : 167|8@0+ (1.0,0.0) [0.0|255.0] "Unitless" ASDM
 SG_ ReSideRdrLeDetn159RdrDetnCntr : 175|4@0+ (1.0,0.0) [0.0|15.0] "Unitless" ASDM
 SG_ ReSideRdrLeDetn159RdrDetnConf : 171|7@0+ (1.0,0.0) [0.0|100.0] "%" ASDM
 SG_ ReSideRdrLeDetn159RdrDetnElevn : 180|5@0+ (1.0,-15.0) [-15.0|15.0] "Deg" ASDM
 SG_ ReSideRdrLeDetn159RdrDetnPwr : 231|6@0+ (1.0,0.0) [0.0|63.0] "dB" ASDM
 SG_ ReSideRdrLeDetn159RdrDetnRng : 215|14@0+ (0.02,-1.0) [-1.0|200.0] "m" ASDM
 SG_ ReSideRdrLeDetn159RdrDetnRngV : 191|13@0+ (0.02,-80.0) [-80.0|80.0] "m/s" ASDM
 SG_ ReSideRdrLeDetn159RdrDetnSameRV : 225|2@0+ (1,0) [0|3] "" ASDM
 SG_ ReSideRdrLeDetn159RdrDetnSts : 217|2@0+ (1,0) [0|3] "" ASDM
 SG_ ReSideRdrLeDetn160_UB : 484|1@0+ (1,0) [0|1] "" ASDM
 SG_ ReSideRdrLeDetn160RdrDetnAmbigState : 312|1@0+ (1,0) [0|1] "" ASDM
 SG_ ReSideRdrLeDetn160RdrDetnAssoTrkID : 319|7@0+ (1.0,0.0) [0.0|127.0] "Unitless" ASDM
 SG_ ReSideRdrLeDetn160RdrDetnAzi : 274|11@0+ (0.1,-90.0) [-90.0|90.0] "Deg" ASDM
 SG_ ReSideRdrLeDetn160RdrDetnChks : 247|8@0+ (1.0,0.0) [0.0|255.0] "Unitless" ASDM
 SG_ ReSideRdrLeDetn160RdrDetnCntr : 255|4@0+ (1.0,0.0) [0.0|15.0] "Unitless" ASDM
 SG_ ReSideRdrLeDetn160RdrDetnConf : 251|7@0+ (1.0,0.0) [0.0|100.0] "%" ASDM
 SG_ ReSideRdrLeDetn160RdrDetnElevn : 260|5@0+ (1.0,-15.0) [-15.0|15.0] "Deg" ASDM
 SG_ ReSideRdrLeDetn160RdrDetnPwr : 311|6@0+ (1.0,0.0) [0.0|63.0] "dB" ASDM
 SG_ ReSideRdrLeDetn160RdrDetnRng : 295|14@0+ (0.02,-1.0) [-1.0|200.0] "m" ASDM
 SG_ ReSideRdrLeDetn160RdrDetnRngV : 271|13@0+ (0.02,-80.0) [-80.0|80.0] "m/s" ASDM
 SG_ ReSideRdrLeDetn160RdrDetnSameRV : 305|2@0+ (1,0) [0|3] "" ASDM
 SG_ ReSideRdrLeDetn160RdrDetnSts : 297|2@0+ (1,0) [0|3] "" ASDM
 SG_ ReSideRdrLeDetn161_UB : 483|1@0+ (1,0) [0|1] "" ASDM
 SG_ ReSideRdrLeDetn161RdrDetnAmbigState : 392|1@0+ (1,0) [0|1] "" ASDM
 SG_ ReSideRdrLeDetn161RdrDetnAssoTrkID : 399|7@0+ (1.0,0.0) [0.0|127.0] "Unitless" ASDM
 SG_ ReSideRdrLeDetn161RdrDetnAzi : 354|11@0+ (0.1,-90.0) [-90.0|90.0] "Deg" ASDM
 SG_ ReSideRdrLeDetn161RdrDetnChks : 327|8@0+ (1.0,0.0) [0.0|255.0] "Unitless" ASDM
 SG_ ReSideRdrLeDetn161RdrDetnCntr : 335|4@0+ (1.0,0.0) [0.0|15.0] "Unitless" ASDM
 SG_ ReSideRdrLeDetn161RdrDetnConf : 331|7@0+ (1.0,0.0) [0.0|100.0] "%" ASDM
 SG_ ReSideRdrLeDetn161RdrDetnElevn : 340|5@0+ (1.0,-15.0) [-15.0|15.0] "Deg" ASDM
 SG_ ReSideRdrLeDetn161RdrDetnPwr : 391|6@0+ (1.0,0.0) [0.0|63.0] "dB" ASDM
 SG_ ReSideRdrLeDetn161RdrDetnRng : 375|14@0+ (0.02,-1.0) [-1.0|200.0] "m" ASDM
 SG_ ReSideRdrLeDetn161RdrDetnRngV : 351|13@0+ (0.02,-80.0) [-80.0|80.0] "m/s" ASDM
 SG_ ReSideRdrLeDetn161RdrDetnSameRV : 385|2@0+ (1,0) [0|3] "" ASDM
 SG_ ReSideRdrLeDetn161RdrDetnSts : 377|2@0+ (1,0) [0|3] "" ASDM
 SG_ ReSideRdrLeDetn162_UB : 482|1@0+ (1,0) [0|1] "" ASDM
 SG_ ReSideRdrLeDetn162RdrDetnAmbigState : 472|1@0+ (1,0) [0|1] "" ASDM
 SG_ ReSideRdrLeDetn162RdrDetnAssoTrkID : 479|7@0+ (1.0,0.0) [0.0|127.0] "Unitless" ASDM
 SG_ ReSideRdrLeDetn162RdrDetnAzi : 434|11@0+ (0.1,-90.0) [-90.0|90.0] "Deg" ASDM
 SG_ ReSideRdrLeDetn162RdrDetnChks : 407|8@0+ (1.0,0.0) [0.0|255.0] "Unitless" ASDM
 SG_ ReSideRdrLeDetn162RdrDetnCntr : 415|4@0+ (1.0,0.0) [0.0|15.0] "Unitless" ASDM
 SG_ ReSideRdrLeDetn162RdrDetnConf : 411|7@0+ (1.0,0.0) [0.0|100.0] "%" ASDM
 SG_ ReSideRdrLeDetn162RdrDetnElevn : 420|5@0+ (1.0,-15.0) [-15.0|15.0] "Deg" ASDM
 SG_ ReSideRdrLeDetn162RdrDetnPwr : 471|6@0+ (1.0,0.0) [0.0|63.0] "dB" ASDM
 SG_ ReSideRdrLeDetn162RdrDetnRng : 455|14@0+ (0.02,-1.0) [-1.0|200.0] "m" ASDM
 SG_ ReSideRdrLeDetn162RdrDetnRngV : 431|13@0+ (0.02,-80.0) [-80.0|80.0] "m/s" ASDM
 SG_ ReSideRdrLeDetn162RdrDetnSameRV : 465|2@0+ (1,0) [0|3] "" ASDM
 SG_ ReSideRdrLeDetn162RdrDetnSts : 457|2@0+ (1,0) [0|3] "" ASDM

BO_ 120 SODLPrivateCANFD5Fr61 : 64 SODL
 SG_ ReSideRdrLeDetn163_UB : 487|1@0+ (1,0) [0|1] "" ASDM
 SG_ ReSideRdrLeDetn163RdrDetnAmbigState : 72|1@0+ (1,0) [0|1] "" ASDM
 SG_ ReSideRdrLeDetn163RdrDetnAssoTrkID : 79|7@0+ (1.0,0.0) [0.0|127.0] "Unitless" ASDM
 SG_ ReSideRdrLeDetn163RdrDetnAzi : 34|11@0+ (0.1,-90.0) [-90.0|90.0] "Deg" ASDM
 SG_ ReSideRdrLeDetn163RdrDetnChks : 7|8@0+ (1.0,0.0) [0.0|255.0] "Unitless" ASDM
 SG_ ReSideRdrLeDetn163RdrDetnCntr : 15|4@0+ (1.0,0.0) [0.0|15.0] "Unitless" ASDM
 SG_ ReSideRdrLeDetn163RdrDetnConf : 11|7@0+ (1.0,0.0) [0.0|100.0] "%" ASDM
 SG_ ReSideRdrLeDetn163RdrDetnElevn : 20|5@0+ (1.0,-15.0) [-15.0|15.0] "Deg" ASDM
 SG_ ReSideRdrLeDetn163RdrDetnPwr : 71|6@0+ (1.0,0.0) [0.0|63.0] "dB" ASDM
 SG_ ReSideRdrLeDetn163RdrDetnRng : 55|14@0+ (0.02,-1.0) [-1.0|200.0] "m" ASDM
 SG_ ReSideRdrLeDetn163RdrDetnRngV : 31|13@0+ (0.02,-80.0) [-80.0|80.0] "m/s" ASDM
 SG_ ReSideRdrLeDetn163RdrDetnSameRV : 65|2@0+ (1,0) [0|3] "" ASDM
 SG_ ReSideRdrLeDetn163RdrDetnSts : 57|2@0+ (1,0) [0|3] "" ASDM
 SG_ ReSideRdrLeDetn164_UB : 486|1@0+ (1,0) [0|1] "" ASDM
 SG_ ReSideRdrLeDetn164RdrDetnAmbigState : 152|1@0+ (1,0) [0|1] "" ASDM
 SG_ ReSideRdrLeDetn164RdrDetnAssoTrkID : 159|7@0+ (1.0,0.0) [0.0|127.0] "Unitless" ASDM
 SG_ ReSideRdrLeDetn164RdrDetnAzi : 114|11@0+ (0.1,-90.0) [-90.0|90.0] "Deg" ASDM
 SG_ ReSideRdrLeDetn164RdrDetnChks : 87|8@0+ (1.0,0.0) [0.0|255.0] "Unitless" ASDM
 SG_ ReSideRdrLeDetn164RdrDetnCntr : 95|4@0+ (1.0,0.0) [0.0|15.0] "Unitless" ASDM
 SG_ ReSideRdrLeDetn164RdrDetnConf : 91|7@0+ (1.0,0.0) [0.0|100.0] "%" ASDM
 SG_ ReSideRdrLeDetn164RdrDetnElevn : 100|5@0+ (1.0,-15.0) [-15.0|15.0] "Deg" ASDM
 SG_ ReSideRdrLeDetn164RdrDetnPwr : 151|6@0+ (1.0,0.0) [0.0|63.0] "dB" ASDM
 SG_ ReSideRdrLeDetn164RdrDetnRng : 135|14@0+ (0.02,-1.0) [-1.0|200.0] "m" ASDM
 SG_ ReSideRdrLeDetn164RdrDetnRngV : 111|13@0+ (0.02,-80.0) [-80.0|80.0] "m/s" ASDM
 SG_ ReSideRdrLeDetn164RdrDetnSameRV : 145|2@0+ (1,0) [0|3] "" ASDM
 SG_ ReSideRdrLeDetn164RdrDetnSts : 137|2@0+ (1,0) [0|3] "" ASDM
 SG_ ReSideRdrLeDetn165_UB : 485|1@0+ (1,0) [0|1] "" ASDM
 SG_ ReSideRdrLeDetn165RdrDetnAmbigState : 232|1@0+ (1,0) [0|1] "" ASDM
 SG_ ReSideRdrLeDetn165RdrDetnAssoTrkID : 239|7@0+ (1.0,0.0) [0.0|127.0] "Unitless" ASDM
 SG_ ReSideRdrLeDetn165RdrDetnAzi : 194|11@0+ (0.1,-90.0) [-90.0|90.0] "Deg" ASDM
 SG_ ReSideRdrLeDetn165RdrDetnChks : 167|8@0+ (1.0,0.0) [0.0|255.0] "Unitless" ASDM
 SG_ ReSideRdrLeDetn165RdrDetnCntr : 175|4@0+ (1.0,0.0) [0.0|15.0] "Unitless" ASDM
 SG_ ReSideRdrLeDetn165RdrDetnConf : 171|7@0+ (1.0,0.0) [0.0|100.0] "%" ASDM
 SG_ ReSideRdrLeDetn165RdrDetnElevn : 180|5@0+ (1.0,-15.0) [-15.0|15.0] "Deg" ASDM
 SG_ ReSideRdrLeDetn165RdrDetnPwr : 231|6@0+ (1.0,0.0) [0.0|63.0] "dB" ASDM
 SG_ ReSideRdrLeDetn165RdrDetnRng : 215|14@0+ (0.02,-1.0) [-1.0|200.0] "m" ASDM
 SG_ ReSideRdrLeDetn165RdrDetnRngV : 191|13@0+ (0.02,-80.0) [-80.0|80.0] "m/s" ASDM
 SG_ ReSideRdrLeDetn165RdrDetnSameRV : 225|2@0+ (1,0) [0|3] "" ASDM
 SG_ ReSideRdrLeDetn165RdrDetnSts : 217|2@0+ (1,0) [0|3] "" ASDM
 SG_ ReSideRdrLeDetn166_UB : 484|1@0+ (1,0) [0|1] "" ASDM
 SG_ ReSideRdrLeDetn166RdrDetnAmbigState : 312|1@0+ (1,0) [0|1] "" ASDM
 SG_ ReSideRdrLeDetn166RdrDetnAssoTrkID : 319|7@0+ (1.0,0.0) [0.0|127.0] "Unitless" ASDM
 SG_ ReSideRdrLeDetn166RdrDetnAzi : 274|11@0+ (0.1,-90.0) [-90.0|90.0] "Deg" ASDM
 SG_ ReSideRdrLeDetn166RdrDetnChks : 247|8@0+ (1.0,0.0) [0.0|255.0] "Unitless" ASDM
 SG_ ReSideRdrLeDetn166RdrDetnCntr : 255|4@0+ (1.0,0.0) [0.0|15.0] "Unitless" ASDM
 SG_ ReSideRdrLeDetn166RdrDetnConf : 251|7@0+ (1.0,0.0) [0.0|100.0] "%" ASDM
 SG_ ReSideRdrLeDetn166RdrDetnElevn : 260|5@0+ (1.0,-15.0) [-15.0|15.0] "Deg" ASDM
 SG_ ReSideRdrLeDetn166RdrDetnPwr : 311|6@0+ (1.0,0.0) [0.0|63.0] "dB" ASDM
 SG_ ReSideRdrLeDetn166RdrDetnRng : 295|14@0+ (0.02,-1.0) [-1.0|200.0] "m" ASDM
 SG_ ReSideRdrLeDetn166RdrDetnRngV : 271|13@0+ (0.02,-80.0) [-80.0|80.0] "m/s" ASDM
 SG_ ReSideRdrLeDetn166RdrDetnSameRV : 305|2@0+ (1,0) [0|3] "" ASDM
 SG_ ReSideRdrLeDetn166RdrDetnSts : 297|2@0+ (1,0) [0|3] "" ASDM
 SG_ ReSideRdrLeDetn167_UB : 483|1@0+ (1,0) [0|1] "" ASDM
 SG_ ReSideRdrLeDetn167RdrDetnAmbigState : 392|1@0+ (1,0) [0|1] "" ASDM
 SG_ ReSideRdrLeDetn167RdrDetnAssoTrkID : 399|7@0+ (1.0,0.0) [0.0|127.0] "Unitless" ASDM
 SG_ ReSideRdrLeDetn167RdrDetnAzi : 354|11@0+ (0.1,-90.0) [-90.0|90.0] "Deg" ASDM
 SG_ ReSideRdrLeDetn167RdrDetnChks : 327|8@0+ (1.0,0.0) [0.0|255.0] "Unitless" ASDM
 SG_ ReSideRdrLeDetn167RdrDetnCntr : 335|4@0+ (1.0,0.0) [0.0|15.0] "Unitless" ASDM
 SG_ ReSideRdrLeDetn167RdrDetnConf : 331|7@0+ (1.0,0.0) [0.0|100.0] "%" ASDM
 SG_ ReSideRdrLeDetn167RdrDetnElevn : 340|5@0+ (1.0,-15.0) [-15.0|15.0] "Deg" ASDM
 SG_ ReSideRdrLeDetn167RdrDetnPwr : 391|6@0+ (1.0,0.0) [0.0|63.0] "dB" ASDM
 SG_ ReSideRdrLeDetn167RdrDetnRng : 375|14@0+ (0.02,-1.0) [-1.0|200.0] "m" ASDM
 SG_ ReSideRdrLeDetn167RdrDetnRngV : 351|13@0+ (0.02,-80.0) [-80.0|80.0] "m/s" ASDM
 SG_ ReSideRdrLeDetn167RdrDetnSameRV : 385|2@0+ (1,0) [0|3] "" ASDM
 SG_ ReSideRdrLeDetn167RdrDetnSts : 377|2@0+ (1,0) [0|3] "" ASDM
 SG_ ReSideRdrLeDetn168_UB : 482|1@0+ (1,0) [0|1] "" ASDM
 SG_ ReSideRdrLeDetn168RdrDetnAmbigState : 472|1@0+ (1,0) [0|1] "" ASDM
 SG_ ReSideRdrLeDetn168RdrDetnAssoTrkID : 479|7@0+ (1.0,0.0) [0.0|127.0] "Unitless" ASDM
 SG_ ReSideRdrLeDetn168RdrDetnAzi : 434|11@0+ (0.1,-90.0) [-90.0|90.0] "Deg" ASDM
 SG_ ReSideRdrLeDetn168RdrDetnChks : 407|8@0+ (1.0,0.0) [0.0|255.0] "Unitless" ASDM
 SG_ ReSideRdrLeDetn168RdrDetnCntr : 415|4@0+ (1.0,0.0) [0.0|15.0] "Unitless" ASDM
 SG_ ReSideRdrLeDetn168RdrDetnConf : 411|7@0+ (1.0,0.0) [0.0|100.0] "%" ASDM
 SG_ ReSideRdrLeDetn168RdrDetnElevn : 420|5@0+ (1.0,-15.0) [-15.0|15.0] "Deg" ASDM
 SG_ ReSideRdrLeDetn168RdrDetnPwr : 471|6@0+ (1.0,0.0) [0.0|63.0] "dB" ASDM
 SG_ ReSideRdrLeDetn168RdrDetnRng : 455|14@0+ (0.02,-1.0) [-1.0|200.0] "m" ASDM
 SG_ ReSideRdrLeDetn168RdrDetnRngV : 431|13@0+ (0.02,-80.0) [-80.0|80.0] "m/s" ASDM
 SG_ ReSideRdrLeDetn168RdrDetnSameRV : 465|2@0+ (1,0) [0|3] "" ASDM
 SG_ ReSideRdrLeDetn168RdrDetnSts : 457|2@0+ (1,0) [0|3] "" ASDM

BO_ 121 SODLPrivateCANFD5Fr62 : 64 SODL
 SG_ ReSideRdrLeDetn169_UB : 487|1@0+ (1,0) [0|1] "" ASDM
 SG_ ReSideRdrLeDetn169RdrDetnAmbigState : 72|1@0+ (1,0) [0|1] "" ASDM
 SG_ ReSideRdrLeDetn169RdrDetnAssoTrkID : 79|7@0+ (1.0,0.0) [0.0|127.0] "Unitless" ASDM
 SG_ ReSideRdrLeDetn169RdrDetnAzi : 34|11@0+ (0.1,-90.0) [-90.0|90.0] "Deg" ASDM
 SG_ ReSideRdrLeDetn169RdrDetnChks : 7|8@0+ (1.0,0.0) [0.0|255.0] "Unitless" ASDM
 SG_ ReSideRdrLeDetn169RdrDetnCntr : 15|4@0+ (1.0,0.0) [0.0|15.0] "Unitless" ASDM
 SG_ ReSideRdrLeDetn169RdrDetnConf : 11|7@0+ (1.0,0.0) [0.0|100.0] "%" ASDM
 SG_ ReSideRdrLeDetn169RdrDetnElevn : 20|5@0+ (1.0,-15.0) [-15.0|15.0] "Deg" ASDM
 SG_ ReSideRdrLeDetn169RdrDetnPwr : 71|6@0+ (1.0,0.0) [0.0|63.0] "dB" ASDM
 SG_ ReSideRdrLeDetn169RdrDetnRng : 55|14@0+ (0.02,-1.0) [-1.0|200.0] "m" ASDM
 SG_ ReSideRdrLeDetn169RdrDetnRngV : 31|13@0+ (0.02,-80.0) [-80.0|80.0] "m/s" ASDM
 SG_ ReSideRdrLeDetn169RdrDetnSameRV : 65|2@0+ (1,0) [0|3] "" ASDM
 SG_ ReSideRdrLeDetn169RdrDetnSts : 57|2@0+ (1,0) [0|3] "" ASDM
 SG_ ReSideRdrLeDetn170_UB : 486|1@0+ (1,0) [0|1] "" ASDM
 SG_ ReSideRdrLeDetn170RdrDetnAmbigState : 152|1@0+ (1,0) [0|1] "" ASDM
 SG_ ReSideRdrLeDetn170RdrDetnAssoTrkID : 159|7@0+ (1.0,0.0) [0.0|127.0] "Unitless" ASDM
 SG_ ReSideRdrLeDetn170RdrDetnAzi : 114|11@0+ (0.1,-90.0) [-90.0|90.0] "Deg" ASDM
 SG_ ReSideRdrLeDetn170RdrDetnChks : 87|8@0+ (1.0,0.0) [0.0|255.0] "Unitless" ASDM
 SG_ ReSideRdrLeDetn170RdrDetnCntr : 95|4@0+ (1.0,0.0) [0.0|15.0] "Unitless" ASDM
 SG_ ReSideRdrLeDetn170RdrDetnConf : 91|7@0+ (1.0,0.0) [0.0|100.0] "%" ASDM
 SG_ ReSideRdrLeDetn170RdrDetnElevn : 100|5@0+ (1.0,-15.0) [-15.0|15.0] "Deg" ASDM
 SG_ ReSideRdrLeDetn170RdrDetnPwr : 151|6@0+ (1.0,0.0) [0.0|63.0] "dB" ASDM
 SG_ ReSideRdrLeDetn170RdrDetnRng : 135|14@0+ (0.02,-1.0) [-1.0|200.0] "m" ASDM
 SG_ ReSideRdrLeDetn170RdrDetnRngV : 111|13@0+ (0.02,-80.0) [-80.0|80.0] "m/s" ASDM
 SG_ ReSideRdrLeDetn170RdrDetnSameRV : 145|2@0+ (1,0) [0|3] "" ASDM
 SG_ ReSideRdrLeDetn170RdrDetnSts : 137|2@0+ (1,0) [0|3] "" ASDM
 SG_ ReSideRdrLeDetn171_UB : 485|1@0+ (1,0) [0|1] "" ASDM
 SG_ ReSideRdrLeDetn171RdrDetnAmbigState : 232|1@0+ (1,0) [0|1] "" ASDM
 SG_ ReSideRdrLeDetn171RdrDetnAssoTrkID : 239|7@0+ (1.0,0.0) [0.0|127.0] "Unitless" ASDM
 SG_ ReSideRdrLeDetn171RdrDetnAzi : 194|11@0+ (0.1,-90.0) [-90.0|90.0] "Deg" ASDM
 SG_ ReSideRdrLeDetn171RdrDetnChks : 167|8@0+ (1.0,0.0) [0.0|255.0] "Unitless" ASDM
 SG_ ReSideRdrLeDetn171RdrDetnCntr : 175|4@0+ (1.0,0.0) [0.0|15.0] "Unitless" ASDM
 SG_ ReSideRdrLeDetn171RdrDetnConf : 171|7@0+ (1.0,0.0) [0.0|100.0] "%" ASDM
 SG_ ReSideRdrLeDetn171RdrDetnElevn : 180|5@0+ (1.0,-15.0) [-15.0|15.0] "Deg" ASDM
 SG_ ReSideRdrLeDetn171RdrDetnPwr : 231|6@0+ (1.0,0.0) [0.0|63.0] "dB" ASDM
 SG_ ReSideRdrLeDetn171RdrDetnRng : 215|14@0+ (0.02,-1.0) [-1.0|200.0] "m" ASDM
 SG_ ReSideRdrLeDetn171RdrDetnRngV : 191|13@0+ (0.02,-80.0) [-80.0|80.0] "m/s" ASDM
 SG_ ReSideRdrLeDetn171RdrDetnSameRV : 225|2@0+ (1,0) [0|3] "" ASDM
 SG_ ReSideRdrLeDetn171RdrDetnSts : 217|2@0+ (1,0) [0|3] "" ASDM
 SG_ ReSideRdrLeDetn172_UB : 484|1@0+ (1,0) [0|1] "" ASDM
 SG_ ReSideRdrLeDetn172RdrDetnAmbigState : 312|1@0+ (1,0) [0|1] "" ASDM
 SG_ ReSideRdrLeDetn172RdrDetnAssoTrkID : 319|7@0+ (1.0,0.0) [0.0|127.0] "Unitless" ASDM
 SG_ ReSideRdrLeDetn172RdrDetnAzi : 274|11@0+ (0.1,-90.0) [-90.0|90.0] "Deg" ASDM
 SG_ ReSideRdrLeDetn172RdrDetnChks : 247|8@0+ (1.0,0.0) [0.0|255.0] "Unitless" ASDM
 SG_ ReSideRdrLeDetn172RdrDetnCntr : 255|4@0+ (1.0,0.0) [0.0|15.0] "Unitless" ASDM
 SG_ ReSideRdrLeDetn172RdrDetnConf : 251|7@0+ (1.0,0.0) [0.0|100.0] "%" ASDM
 SG_ ReSideRdrLeDetn172RdrDetnElevn : 260|5@0+ (1.0,-15.0) [-15.0|15.0] "Deg" ASDM
 SG_ ReSideRdrLeDetn172RdrDetnPwr : 311|6@0+ (1.0,0.0) [0.0|63.0] "dB" ASDM
 SG_ ReSideRdrLeDetn172RdrDetnRng : 295|14@0+ (0.02,-1.0) [-1.0|200.0] "m" ASDM
 SG_ ReSideRdrLeDetn172RdrDetnRngV : 271|13@0+ (0.02,-80.0) [-80.0|80.0] "m/s" ASDM
 SG_ ReSideRdrLeDetn172RdrDetnSameRV : 305|2@0+ (1,0) [0|3] "" ASDM
 SG_ ReSideRdrLeDetn172RdrDetnSts : 297|2@0+ (1,0) [0|3] "" ASDM
 SG_ ReSideRdrLeDetn173_UB : 483|1@0+ (1,0) [0|1] "" ASDM
 SG_ ReSideRdrLeDetn173RdrDetnAmbigState : 392|1@0+ (1,0) [0|1] "" ASDM
 SG_ ReSideRdrLeDetn173RdrDetnAssoTrkID : 399|7@0+ (1.0,0.0) [0.0|127.0] "Unitless" ASDM
 SG_ ReSideRdrLeDetn173RdrDetnAzi : 354|11@0+ (0.1,-90.0) [-90.0|90.0] "Deg" ASDM
 SG_ ReSideRdrLeDetn173RdrDetnChks : 327|8@0+ (1.0,0.0) [0.0|255.0] "Unitless" ASDM
 SG_ ReSideRdrLeDetn173RdrDetnCntr : 335|4@0+ (1.0,0.0) [0.0|15.0] "Unitless" ASDM
 SG_ ReSideRdrLeDetn173RdrDetnConf : 331|7@0+ (1.0,0.0) [0.0|100.0] "%" ASDM
 SG_ ReSideRdrLeDetn173RdrDetnElevn : 340|5@0+ (1.0,-15.0) [-15.0|15.0] "Deg" ASDM
 SG_ ReSideRdrLeDetn173RdrDetnPwr : 391|6@0+ (1.0,0.0) [0.0|63.0] "dB" ASDM
 SG_ ReSideRdrLeDetn173RdrDetnRng : 375|14@0+ (0.02,-1.0) [-1.0|200.0] "m" ASDM
 SG_ ReSideRdrLeDetn173RdrDetnRngV : 351|13@0+ (0.02,-80.0) [-80.0|80.0] "m/s" ASDM
 SG_ ReSideRdrLeDetn173RdrDetnSameRV : 385|2@0+ (1,0) [0|3] "" ASDM
 SG_ ReSideRdrLeDetn173RdrDetnSts : 377|2@0+ (1,0) [0|3] "" ASDM
 SG_ ReSideRdrLeDetn174_UB : 482|1@0+ (1,0) [0|1] "" ASDM
 SG_ ReSideRdrLeDetn174RdrDetnAmbigState : 472|1@0+ (1,0) [0|1] "" ASDM
 SG_ ReSideRdrLeDetn174RdrDetnAssoTrkID : 479|7@0+ (1.0,0.0) [0.0|127.0] "Unitless" ASDM
 SG_ ReSideRdrLeDetn174RdrDetnAzi : 434|11@0+ (0.1,-90.0) [-90.0|90.0] "Deg" ASDM
 SG_ ReSideRdrLeDetn174RdrDetnChks : 407|8@0+ (1.0,0.0) [0.0|255.0] "Unitless" ASDM
 SG_ ReSideRdrLeDetn174RdrDetnCntr : 415|4@0+ (1.0,0.0) [0.0|15.0] "Unitless" ASDM
 SG_ ReSideRdrLeDetn174RdrDetnConf : 411|7@0+ (1.0,0.0) [0.0|100.0] "%" ASDM
 SG_ ReSideRdrLeDetn174RdrDetnElevn : 420|5@0+ (1.0,-15.0) [-15.0|15.0] "Deg" ASDM
 SG_ ReSideRdrLeDetn174RdrDetnPwr : 471|6@0+ (1.0,0.0) [0.0|63.0] "dB" ASDM
 SG_ ReSideRdrLeDetn174RdrDetnRng : 455|14@0+ (0.02,-1.0) [-1.0|200.0] "m" ASDM
 SG_ ReSideRdrLeDetn174RdrDetnRngV : 431|13@0+ (0.02,-80.0) [-80.0|80.0] "m/s" ASDM
 SG_ ReSideRdrLeDetn174RdrDetnSameRV : 465|2@0+ (1,0) [0|3] "" ASDM
 SG_ ReSideRdrLeDetn174RdrDetnSts : 457|2@0+ (1,0) [0|3] "" ASDM

BO_ 128 SODLPrivateCANFD5Fr63 : 64 SODL
 SG_ ReSideRdrLeDetn175_UB : 487|1@0+ (1,0) [0|1] "" ASDM
 SG_ ReSideRdrLeDetn175RdrDetnAmbigState : 72|1@0+ (1,0) [0|1] "" ASDM
 SG_ ReSideRdrLeDetn175RdrDetnAssoTrkID : 79|7@0+ (1.0,0.0) [0.0|127.0] "Unitless" ASDM
 SG_ ReSideRdrLeDetn175RdrDetnAzi : 34|11@0+ (0.1,-90.0) [-90.0|90.0] "Deg" ASDM
 SG_ ReSideRdrLeDetn175RdrDetnChks : 7|8@0+ (1.0,0.0) [0.0|255.0] "Unitless" ASDM
 SG_ ReSideRdrLeDetn175RdrDetnCntr : 15|4@0+ (1.0,0.0) [0.0|15.0] "Unitless" ASDM
 SG_ ReSideRdrLeDetn175RdrDetnConf : 11|7@0+ (1.0,0.0) [0.0|100.0] "%" ASDM
 SG_ ReSideRdrLeDetn175RdrDetnElevn : 20|5@0+ (1.0,-15.0) [-15.0|15.0] "Deg" ASDM
 SG_ ReSideRdrLeDetn175RdrDetnPwr : 71|6@0+ (1.0,0.0) [0.0|63.0] "dB" ASDM
 SG_ ReSideRdrLeDetn175RdrDetnRng : 55|14@0+ (0.02,-1.0) [-1.0|200.0] "m" ASDM
 SG_ ReSideRdrLeDetn175RdrDetnRngV : 31|13@0+ (0.02,-80.0) [-80.0|80.0] "m/s" ASDM
 SG_ ReSideRdrLeDetn175RdrDetnSameRV : 65|2@0+ (1,0) [0|3] "" ASDM
 SG_ ReSideRdrLeDetn175RdrDetnSts : 57|2@0+ (1,0) [0|3] "" ASDM
 SG_ ReSideRdrLeDetn176_UB : 486|1@0+ (1,0) [0|1] "" ASDM
 SG_ ReSideRdrLeDetn176RdrDetnAmbigState : 152|1@0+ (1,0) [0|1] "" ASDM
 SG_ ReSideRdrLeDetn176RdrDetnAssoTrkID : 159|7@0+ (1.0,0.0) [0.0|127.0] "Unitless" ASDM
 SG_ ReSideRdrLeDetn176RdrDetnAzi : 114|11@0+ (0.1,-90.0) [-90.0|90.0] "Deg" ASDM
 SG_ ReSideRdrLeDetn176RdrDetnChks : 87|8@0+ (1.0,0.0) [0.0|255.0] "Unitless" ASDM
 SG_ ReSideRdrLeDetn176RdrDetnCntr : 95|4@0+ (1.0,0.0) [0.0|15.0] "Unitless" ASDM
 SG_ ReSideRdrLeDetn176RdrDetnConf : 91|7@0+ (1.0,0.0) [0.0|100.0] "%" ASDM
 SG_ ReSideRdrLeDetn176RdrDetnElevn : 100|5@0+ (1.0,-15.0) [-15.0|15.0] "Deg" ASDM
 SG_ ReSideRdrLeDetn176RdrDetnPwr : 151|6@0+ (1.0,0.0) [0.0|63.0] "dB" ASDM
 SG_ ReSideRdrLeDetn176RdrDetnRng : 135|14@0+ (0.02,-1.0) [-1.0|200.0] "m" ASDM
 SG_ ReSideRdrLeDetn176RdrDetnRngV : 111|13@0+ (0.02,-80.0) [-80.0|80.0] "m/s" ASDM
 SG_ ReSideRdrLeDetn176RdrDetnSameRV : 145|2@0+ (1,0) [0|3] "" ASDM
 SG_ ReSideRdrLeDetn176RdrDetnSts : 137|2@0+ (1,0) [0|3] "" ASDM
 SG_ ReSideRdrLeDetn177_UB : 485|1@0+ (1,0) [0|1] "" ASDM
 SG_ ReSideRdrLeDetn177RdrDetnAmbigState : 232|1@0+ (1,0) [0|1] "" ASDM
 SG_ ReSideRdrLeDetn177RdrDetnAssoTrkID : 239|7@0+ (1.0,0.0) [0.0|127.0] "Unitless" ASDM
 SG_ ReSideRdrLeDetn177RdrDetnAzi : 194|11@0+ (0.1,-90.0) [-90.0|90.0] "Deg" ASDM
 SG_ ReSideRdrLeDetn177RdrDetnChks : 167|8@0+ (1.0,0.0) [0.0|255.0] "Unitless" ASDM
 SG_ ReSideRdrLeDetn177RdrDetnCntr : 175|4@0+ (1.0,0.0) [0.0|15.0] "Unitless" ASDM
 SG_ ReSideRdrLeDetn177RdrDetnConf : 171|7@0+ (1.0,0.0) [0.0|100.0] "%" ASDM
 SG_ ReSideRdrLeDetn177RdrDetnElevn : 180|5@0+ (1.0,-15.0) [-15.0|15.0] "Deg" ASDM
 SG_ ReSideRdrLeDetn177RdrDetnPwr : 231|6@0+ (1.0,0.0) [0.0|63.0] "dB" ASDM
 SG_ ReSideRdrLeDetn177RdrDetnRng : 215|14@0+ (0.02,-1.0) [-1.0|200.0] "m" ASDM
 SG_ ReSideRdrLeDetn177RdrDetnRngV : 191|13@0+ (0.02,-80.0) [-80.0|80.0] "m/s" ASDM
 SG_ ReSideRdrLeDetn177RdrDetnSameRV : 225|2@0+ (1,0) [0|3] "" ASDM
 SG_ ReSideRdrLeDetn177RdrDetnSts : 217|2@0+ (1,0) [0|3] "" ASDM
 SG_ ReSideRdrLeDetn178_UB : 484|1@0+ (1,0) [0|1] "" ASDM
 SG_ ReSideRdrLeDetn178RdrDetnAmbigState : 312|1@0+ (1,0) [0|1] "" ASDM
 SG_ ReSideRdrLeDetn178RdrDetnAssoTrkID : 319|7@0+ (1.0,0.0) [0.0|127.0] "Unitless" ASDM
 SG_ ReSideRdrLeDetn178RdrDetnAzi : 274|11@0+ (0.1,-90.0) [-90.0|90.0] "Deg" ASDM
 SG_ ReSideRdrLeDetn178RdrDetnChks : 247|8@0+ (1.0,0.0) [0.0|255.0] "Unitless" ASDM
 SG_ ReSideRdrLeDetn178RdrDetnCntr : 255|4@0+ (1.0,0.0) [0.0|15.0] "Unitless" ASDM
 SG_ ReSideRdrLeDetn178RdrDetnConf : 251|7@0+ (1.0,0.0) [0.0|100.0] "%" ASDM
 SG_ ReSideRdrLeDetn178RdrDetnElevn : 260|5@0+ (1.0,-15.0) [-15.0|15.0] "Deg" ASDM
 SG_ ReSideRdrLeDetn178RdrDetnPwr : 311|6@0+ (1.0,0.0) [0.0|63.0] "dB" ASDM
 SG_ ReSideRdrLeDetn178RdrDetnRng : 295|14@0+ (0.02,-1.0) [-1.0|200.0] "m" ASDM
 SG_ ReSideRdrLeDetn178RdrDetnRngV : 271|13@0+ (0.02,-80.0) [-80.0|80.0] "m/s" ASDM
 SG_ ReSideRdrLeDetn178RdrDetnSameRV : 305|2@0+ (1,0) [0|3] "" ASDM
 SG_ ReSideRdrLeDetn178RdrDetnSts : 297|2@0+ (1,0) [0|3] "" ASDM
 SG_ ReSideRdrLeDetn179_UB : 483|1@0+ (1,0) [0|1] "" ASDM
 SG_ ReSideRdrLeDetn179RdrDetnAmbigState : 392|1@0+ (1,0) [0|1] "" ASDM
 SG_ ReSideRdrLeDetn179RdrDetnAssoTrkID : 399|7@0+ (1.0,0.0) [0.0|127.0] "Unitless" ASDM
 SG_ ReSideRdrLeDetn179RdrDetnAzi : 354|11@0+ (0.1,-90.0) [-90.0|90.0] "Deg" ASDM
 SG_ ReSideRdrLeDetn179RdrDetnChks : 327|8@0+ (1.0,0.0) [0.0|255.0] "Unitless" ASDM
 SG_ ReSideRdrLeDetn179RdrDetnCntr : 335|4@0+ (1.0,0.0) [0.0|15.0] "Unitless" ASDM
 SG_ ReSideRdrLeDetn179RdrDetnConf : 331|7@0+ (1.0,0.0) [0.0|100.0] "%" ASDM
 SG_ ReSideRdrLeDetn179RdrDetnElevn : 340|5@0+ (1.0,-15.0) [-15.0|15.0] "Deg" ASDM
 SG_ ReSideRdrLeDetn179RdrDetnPwr : 391|6@0+ (1.0,0.0) [0.0|63.0] "dB" ASDM
 SG_ ReSideRdrLeDetn179RdrDetnRng : 375|14@0+ (0.02,-1.0) [-1.0|200.0] "m" ASDM
 SG_ ReSideRdrLeDetn179RdrDetnRngV : 351|13@0+ (0.02,-80.0) [-80.0|80.0] "m/s" ASDM
 SG_ ReSideRdrLeDetn179RdrDetnSameRV : 385|2@0+ (1,0) [0|3] "" ASDM
 SG_ ReSideRdrLeDetn179RdrDetnSts : 377|2@0+ (1,0) [0|3] "" ASDM
 SG_ ReSideRdrLeDetn180_UB : 482|1@0+ (1,0) [0|1] "" ASDM
 SG_ ReSideRdrLeDetn180RdrDetnAmbigState : 472|1@0+ (1,0) [0|1] "" ASDM
 SG_ ReSideRdrLeDetn180RdrDetnAssoTrkID : 479|7@0+ (1.0,0.0) [0.0|127.0] "Unitless" ASDM
 SG_ ReSideRdrLeDetn180RdrDetnAzi : 434|11@0+ (0.1,-90.0) [-90.0|90.0] "Deg" ASDM
 SG_ ReSideRdrLeDetn180RdrDetnChks : 407|8@0+ (1.0,0.0) [0.0|255.0] "Unitless" ASDM
 SG_ ReSideRdrLeDetn180RdrDetnCntr : 415|4@0+ (1.0,0.0) [0.0|15.0] "Unitless" ASDM
 SG_ ReSideRdrLeDetn180RdrDetnConf : 411|7@0+ (1.0,0.0) [0.0|100.0] "%" ASDM
 SG_ ReSideRdrLeDetn180RdrDetnElevn : 420|5@0+ (1.0,-15.0) [-15.0|15.0] "Deg" ASDM
 SG_ ReSideRdrLeDetn180RdrDetnPwr : 471|6@0+ (1.0,0.0) [0.0|63.0] "dB" ASDM
 SG_ ReSideRdrLeDetn180RdrDetnRng : 455|14@0+ (0.02,-1.0) [-1.0|200.0] "m" ASDM
 SG_ ReSideRdrLeDetn180RdrDetnRngV : 431|13@0+ (0.02,-80.0) [-80.0|80.0] "m/s" ASDM
 SG_ ReSideRdrLeDetn180RdrDetnSameRV : 465|2@0+ (1,0) [0|3] "" ASDM
 SG_ ReSideRdrLeDetn180RdrDetnSts : 457|2@0+ (1,0) [0|3] "" ASDM

BO_ 129 SODLPrivateCANFD5Fr64 : 64 SODL
 SG_ ReSideRdrLeDetn181_UB : 487|1@0+ (1,0) [0|1] "" ASDM
 SG_ ReSideRdrLeDetn181RdrDetnAmbigState : 72|1@0+ (1,0) [0|1] "" ASDM
 SG_ ReSideRdrLeDetn181RdrDetnAssoTrkID : 79|7@0+ (1.0,0.0) [0.0|127.0] "Unitless" ASDM
 SG_ ReSideRdrLeDetn181RdrDetnAzi : 34|11@0+ (0.1,-90.0) [-90.0|90.0] "Deg" ASDM
 SG_ ReSideRdrLeDetn181RdrDetnChks : 7|8@0+ (1.0,0.0) [0.0|255.0] "Unitless" ASDM
 SG_ ReSideRdrLeDetn181RdrDetnCntr : 15|4@0+ (1.0,0.0) [0.0|15.0] "Unitless" ASDM
 SG_ ReSideRdrLeDetn181RdrDetnConf : 11|7@0+ (1.0,0.0) [0.0|100.0] "%" ASDM
 SG_ ReSideRdrLeDetn181RdrDetnElevn : 20|5@0+ (1.0,-15.0) [-15.0|15.0] "Deg" ASDM
 SG_ ReSideRdrLeDetn181RdrDetnPwr : 71|6@0+ (1.0,0.0) [0.0|63.0] "dB" ASDM
 SG_ ReSideRdrLeDetn181RdrDetnRng : 55|14@0+ (0.02,-1.0) [-1.0|200.0] "m" ASDM
 SG_ ReSideRdrLeDetn181RdrDetnRngV : 31|13@0+ (0.02,-80.0) [-80.0|80.0] "m/s" ASDM
 SG_ ReSideRdrLeDetn181RdrDetnSameRV : 65|2@0+ (1,0) [0|3] "" ASDM
 SG_ ReSideRdrLeDetn181RdrDetnSts : 57|2@0+ (1,0) [0|3] "" ASDM
 SG_ ReSideRdrLeDetn182_UB : 486|1@0+ (1,0) [0|1] "" ASDM
 SG_ ReSideRdrLeDetn182RdrDetnAmbigState : 152|1@0+ (1,0) [0|1] "" ASDM
 SG_ ReSideRdrLeDetn182RdrDetnAssoTrkID : 159|7@0+ (1.0,0.0) [0.0|127.0] "Unitless" ASDM
 SG_ ReSideRdrLeDetn182RdrDetnAzi : 114|11@0+ (0.1,-90.0) [-90.0|90.0] "Deg" ASDM
 SG_ ReSideRdrLeDetn182RdrDetnChks : 87|8@0+ (1.0,0.0) [0.0|255.0] "Unitless" ASDM
 SG_ ReSideRdrLeDetn182RdrDetnCntr : 95|4@0+ (1.0,0.0) [0.0|15.0] "Unitless" ASDM
 SG_ ReSideRdrLeDetn182RdrDetnConf : 91|7@0+ (1.0,0.0) [0.0|100.0] "%" ASDM
 SG_ ReSideRdrLeDetn182RdrDetnElevn : 100|5@0+ (1.0,-15.0) [-15.0|15.0] "Deg" ASDM
 SG_ ReSideRdrLeDetn182RdrDetnPwr : 151|6@0+ (1.0,0.0) [0.0|63.0] "dB" ASDM
 SG_ ReSideRdrLeDetn182RdrDetnRng : 135|14@0+ (0.02,-1.0) [-1.0|200.0] "m" ASDM
 SG_ ReSideRdrLeDetn182RdrDetnRngV : 111|13@0+ (0.02,-80.0) [-80.0|80.0] "m/s" ASDM
 SG_ ReSideRdrLeDetn182RdrDetnSameRV : 145|2@0+ (1,0) [0|3] "" ASDM
 SG_ ReSideRdrLeDetn182RdrDetnSts : 137|2@0+ (1,0) [0|3] "" ASDM
 SG_ ReSideRdrLeDetn183_UB : 485|1@0+ (1,0) [0|1] "" ASDM
 SG_ ReSideRdrLeDetn183RdrDetnAmbigState : 232|1@0+ (1,0) [0|1] "" ASDM
 SG_ ReSideRdrLeDetn183RdrDetnAssoTrkID : 239|7@0+ (1.0,0.0) [0.0|127.0] "Unitless" ASDM
 SG_ ReSideRdrLeDetn183RdrDetnAzi : 194|11@0+ (0.1,-90.0) [-90.0|90.0] "Deg" ASDM
 SG_ ReSideRdrLeDetn183RdrDetnChks : 167|8@0+ (1.0,0.0) [0.0|255.0] "Unitless" ASDM
 SG_ ReSideRdrLeDetn183RdrDetnCntr : 175|4@0+ (1.0,0.0) [0.0|15.0] "Unitless" ASDM
 SG_ ReSideRdrLeDetn183RdrDetnConf : 171|7@0+ (1.0,0.0) [0.0|100.0] "%" ASDM
 SG_ ReSideRdrLeDetn183RdrDetnElevn : 180|5@0+ (1.0,-15.0) [-15.0|15.0] "Deg" ASDM
 SG_ ReSideRdrLeDetn183RdrDetnPwr : 231|6@0+ (1.0,0.0) [0.0|63.0] "dB" ASDM
 SG_ ReSideRdrLeDetn183RdrDetnRng : 215|14@0+ (0.02,-1.0) [-1.0|200.0] "m" ASDM
 SG_ ReSideRdrLeDetn183RdrDetnRngV : 191|13@0+ (0.02,-80.0) [-80.0|80.0] "m/s" ASDM
 SG_ ReSideRdrLeDetn183RdrDetnSameRV : 225|2@0+ (1,0) [0|3] "" ASDM
 SG_ ReSideRdrLeDetn183RdrDetnSts : 217|2@0+ (1,0) [0|3] "" ASDM
 SG_ ReSideRdrLeDetn184_UB : 484|1@0+ (1,0) [0|1] "" ASDM
 SG_ ReSideRdrLeDetn184RdrDetnAmbigState : 312|1@0+ (1,0) [0|1] "" ASDM
 SG_ ReSideRdrLeDetn184RdrDetnAssoTrkID : 319|7@0+ (1.0,0.0) [0.0|127.0] "Unitless" ASDM
 SG_ ReSideRdrLeDetn184RdrDetnAzi : 274|11@0+ (0.1,-90.0) [-90.0|90.0] "Deg" ASDM
 SG_ ReSideRdrLeDetn184RdrDetnChks : 247|8@0+ (1.0,0.0) [0.0|255.0] "Unitless" ASDM
 SG_ ReSideRdrLeDetn184RdrDetnCntr : 255|4@0+ (1.0,0.0) [0.0|15.0] "Unitless" ASDM
 SG_ ReSideRdrLeDetn184RdrDetnConf : 251|7@0+ (1.0,0.0) [0.0|100.0] "%" ASDM
 SG_ ReSideRdrLeDetn184RdrDetnElevn : 260|5@0+ (1.0,-15.0) [-15.0|15.0] "Deg" ASDM
 SG_ ReSideRdrLeDetn184RdrDetnPwr : 311|6@0+ (1.0,0.0) [0.0|63.0] "dB" ASDM
 SG_ ReSideRdrLeDetn184RdrDetnRng : 295|14@0+ (0.02,-1.0) [-1.0|200.0] "m" ASDM
 SG_ ReSideRdrLeDetn184RdrDetnRngV : 271|13@0+ (0.02,-80.0) [-80.0|80.0] "m/s" ASDM
 SG_ ReSideRdrLeDetn184RdrDetnSameRV : 305|2@0+ (1,0) [0|3] "" ASDM
 SG_ ReSideRdrLeDetn184RdrDetnSts : 297|2@0+ (1,0) [0|3] "" ASDM
 SG_ ReSideRdrLeDetn185_UB : 483|1@0+ (1,0) [0|1] "" ASDM
 SG_ ReSideRdrLeDetn185RdrDetnAmbigState : 392|1@0+ (1,0) [0|1] "" ASDM
 SG_ ReSideRdrLeDetn185RdrDetnAssoTrkID : 399|7@0+ (1.0,0.0) [0.0|127.0] "Unitless" ASDM
 SG_ ReSideRdrLeDetn185RdrDetnAzi : 354|11@0+ (0.1,-90.0) [-90.0|90.0] "Deg" ASDM
 SG_ ReSideRdrLeDetn185RdrDetnChks : 327|8@0+ (1.0,0.0) [0.0|255.0] "Unitless" ASDM
 SG_ ReSideRdrLeDetn185RdrDetnCntr : 335|4@0+ (1.0,0.0) [0.0|15.0] "Unitless" ASDM
 SG_ ReSideRdrLeDetn185RdrDetnConf : 331|7@0+ (1.0,0.0) [0.0|100.0] "%" ASDM
 SG_ ReSideRdrLeDetn185RdrDetnElevn : 340|5@0+ (1.0,-15.0) [-15.0|15.0] "Deg" ASDM
 SG_ ReSideRdrLeDetn185RdrDetnPwr : 391|6@0+ (1.0,0.0) [0.0|63.0] "dB" ASDM
 SG_ ReSideRdrLeDetn185RdrDetnRng : 375|14@0+ (0.02,-1.0) [-1.0|200.0] "m" ASDM
 SG_ ReSideRdrLeDetn185RdrDetnRngV : 351|13@0+ (0.02,-80.0) [-80.0|80.0] "m/s" ASDM
 SG_ ReSideRdrLeDetn185RdrDetnSameRV : 385|2@0+ (1,0) [0|3] "" ASDM
 SG_ ReSideRdrLeDetn185RdrDetnSts : 377|2@0+ (1,0) [0|3] "" ASDM
 SG_ ReSideRdrLeDetn186_UB : 482|1@0+ (1,0) [0|1] "" ASDM
 SG_ ReSideRdrLeDetn186RdrDetnAmbigState : 472|1@0+ (1,0) [0|1] "" ASDM
 SG_ ReSideRdrLeDetn186RdrDetnAssoTrkID : 479|7@0+ (1.0,0.0) [0.0|127.0] "Unitless" ASDM
 SG_ ReSideRdrLeDetn186RdrDetnAzi : 434|11@0+ (0.1,-90.0) [-90.0|90.0] "Deg" ASDM
 SG_ ReSideRdrLeDetn186RdrDetnChks : 407|8@0+ (1.0,0.0) [0.0|255.0] "Unitless" ASDM
 SG_ ReSideRdrLeDetn186RdrDetnCntr : 415|4@0+ (1.0,0.0) [0.0|15.0] "Unitless" ASDM
 SG_ ReSideRdrLeDetn186RdrDetnConf : 411|7@0+ (1.0,0.0) [0.0|100.0] "%" ASDM
 SG_ ReSideRdrLeDetn186RdrDetnElevn : 420|5@0+ (1.0,-15.0) [-15.0|15.0] "Deg" ASDM
 SG_ ReSideRdrLeDetn186RdrDetnPwr : 471|6@0+ (1.0,0.0) [0.0|63.0] "dB" ASDM
 SG_ ReSideRdrLeDetn186RdrDetnRng : 455|14@0+ (0.02,-1.0) [-1.0|200.0] "m" ASDM
 SG_ ReSideRdrLeDetn186RdrDetnRngV : 431|13@0+ (0.02,-80.0) [-80.0|80.0] "m/s" ASDM
 SG_ ReSideRdrLeDetn186RdrDetnSameRV : 465|2@0+ (1,0) [0|3] "" ASDM
 SG_ ReSideRdrLeDetn186RdrDetnSts : 457|2@0+ (1,0) [0|3] "" ASDM

BO_ 130 SODLPrivateCANFD5Fr65 : 64 SODL
 SG_ ReSideRdrLeDetn187_UB : 487|1@0+ (1,0) [0|1] "" ASDM
 SG_ ReSideRdrLeDetn187RdrDetnAmbigState : 72|1@0+ (1,0) [0|1] "" ASDM
 SG_ ReSideRdrLeDetn187RdrDetnAssoTrkID : 79|7@0+ (1.0,0.0) [0.0|127.0] "Unitless" ASDM
 SG_ ReSideRdrLeDetn187RdrDetnAzi : 34|11@0+ (0.1,-90.0) [-90.0|90.0] "Deg" ASDM
 SG_ ReSideRdrLeDetn187RdrDetnChks : 7|8@0+ (1.0,0.0) [0.0|255.0] "Unitless" ASDM
 SG_ ReSideRdrLeDetn187RdrDetnCntr : 15|4@0+ (1.0,0.0) [0.0|15.0] "Unitless" ASDM
 SG_ ReSideRdrLeDetn187RdrDetnConf : 11|7@0+ (1.0,0.0) [0.0|100.0] "%" ASDM
 SG_ ReSideRdrLeDetn187RdrDetnElevn : 20|5@0+ (1.0,-15.0) [-15.0|15.0] "Deg" ASDM
 SG_ ReSideRdrLeDetn187RdrDetnPwr : 71|6@0+ (1.0,0.0) [0.0|63.0] "dB" ASDM
 SG_ ReSideRdrLeDetn187RdrDetnRng : 55|14@0+ (0.02,-1.0) [-1.0|200.0] "m" ASDM
 SG_ ReSideRdrLeDetn187RdrDetnRngV : 31|13@0+ (0.02,-80.0) [-80.0|80.0] "m/s" ASDM
 SG_ ReSideRdrLeDetn187RdrDetnSameRV : 65|2@0+ (1,0) [0|3] "" ASDM
 SG_ ReSideRdrLeDetn187RdrDetnSts : 57|2@0+ (1,0) [0|3] "" ASDM
 SG_ ReSideRdrLeDetn188_UB : 486|1@0+ (1,0) [0|1] "" ASDM
 SG_ ReSideRdrLeDetn188RdrDetnAmbigState : 152|1@0+ (1,0) [0|1] "" ASDM
 SG_ ReSideRdrLeDetn188RdrDetnAssoTrkID : 159|7@0+ (1.0,0.0) [0.0|127.0] "Unitless" ASDM
 SG_ ReSideRdrLeDetn188RdrDetnAzi : 114|11@0+ (0.1,-90.0) [-90.0|90.0] "Deg" ASDM
 SG_ ReSideRdrLeDetn188RdrDetnChks : 87|8@0+ (1.0,0.0) [0.0|255.0] "Unitless" ASDM
 SG_ ReSideRdrLeDetn188RdrDetnCntr : 95|4@0+ (1.0,0.0) [0.0|15.0] "Unitless" ASDM
 SG_ ReSideRdrLeDetn188RdrDetnConf : 91|7@0+ (1.0,0.0) [0.0|100.0] "%" ASDM
 SG_ ReSideRdrLeDetn188RdrDetnElevn : 100|5@0+ (1.0,-15.0) [-15.0|15.0] "Deg" ASDM
 SG_ ReSideRdrLeDetn188RdrDetnPwr : 151|6@0+ (1.0,0.0) [0.0|63.0] "dB" ASDM
 SG_ ReSideRdrLeDetn188RdrDetnRng : 135|14@0+ (0.02,-1.0) [-1.0|200.0] "m" ASDM
 SG_ ReSideRdrLeDetn188RdrDetnRngV : 111|13@0+ (0.02,-80.0) [-80.0|80.0] "m/s" ASDM
 SG_ ReSideRdrLeDetn188RdrDetnSameRV : 145|2@0+ (1,0) [0|3] "" ASDM
 SG_ ReSideRdrLeDetn188RdrDetnSts : 137|2@0+ (1,0) [0|3] "" ASDM
 SG_ ReSideRdrLeDetn189_UB : 485|1@0+ (1,0) [0|1] "" ASDM
 SG_ ReSideRdrLeDetn189RdrDetnAmbigState : 232|1@0+ (1,0) [0|1] "" ASDM
 SG_ ReSideRdrLeDetn189RdrDetnAssoTrkID : 239|7@0+ (1.0,0.0) [0.0|127.0] "Unitless" ASDM
 SG_ ReSideRdrLeDetn189RdrDetnAzi : 194|11@0+ (0.1,-90.0) [-90.0|90.0] "Deg" ASDM
 SG_ ReSideRdrLeDetn189RdrDetnChks : 167|8@0+ (1.0,0.0) [0.0|255.0] "Unitless" ASDM
 SG_ ReSideRdrLeDetn189RdrDetnCntr : 175|4@0+ (1.0,0.0) [0.0|15.0] "Unitless" ASDM
 SG_ ReSideRdrLeDetn189RdrDetnConf : 171|7@0+ (1.0,0.0) [0.0|100.0] "%" ASDM
 SG_ ReSideRdrLeDetn189RdrDetnElevn : 180|5@0+ (1.0,-15.0) [-15.0|15.0] "Deg" ASDM
 SG_ ReSideRdrLeDetn189RdrDetnPwr : 231|6@0+ (1.0,0.0) [0.0|63.0] "dB" ASDM
 SG_ ReSideRdrLeDetn189RdrDetnRng : 215|14@0+ (0.02,-1.0) [-1.0|200.0] "m" ASDM
 SG_ ReSideRdrLeDetn189RdrDetnRngV : 191|13@0+ (0.02,-80.0) [-80.0|80.0] "m/s" ASDM
 SG_ ReSideRdrLeDetn189RdrDetnSameRV : 225|2@0+ (1,0) [0|3] "" ASDM
 SG_ ReSideRdrLeDetn189RdrDetnSts : 217|2@0+ (1,0) [0|3] "" ASDM
 SG_ ReSideRdrLeDetn190_UB : 484|1@0+ (1,0) [0|1] "" ASDM
 SG_ ReSideRdrLeDetn190RdrDetnAmbigState : 312|1@0+ (1,0) [0|1] "" ASDM
 SG_ ReSideRdrLeDetn190RdrDetnAssoTrkID : 319|7@0+ (1.0,0.0) [0.0|127.0] "Unitless" ASDM
 SG_ ReSideRdrLeDetn190RdrDetnAzi : 274|11@0+ (0.1,-90.0) [-90.0|90.0] "Deg" ASDM
 SG_ ReSideRdrLeDetn190RdrDetnChks : 247|8@0+ (1.0,0.0) [0.0|255.0] "Unitless" ASDM
 SG_ ReSideRdrLeDetn190RdrDetnCntr : 255|4@0+ (1.0,0.0) [0.0|15.0] "Unitless" ASDM
 SG_ ReSideRdrLeDetn190RdrDetnConf : 251|7@0+ (1.0,0.0) [0.0|100.0] "%" ASDM
 SG_ ReSideRdrLeDetn190RdrDetnElevn : 260|5@0+ (1.0,-15.0) [-15.0|15.0] "Deg" ASDM
 SG_ ReSideRdrLeDetn190RdrDetnPwr : 311|6@0+ (1.0,0.0) [0.0|63.0] "dB" ASDM
 SG_ ReSideRdrLeDetn190RdrDetnRng : 295|14@0+ (0.02,-1.0) [-1.0|200.0] "m" ASDM
 SG_ ReSideRdrLeDetn190RdrDetnRngV : 271|13@0+ (0.02,-80.0) [-80.0|80.0] "m/s" ASDM
 SG_ ReSideRdrLeDetn190RdrDetnSameRV : 305|2@0+ (1,0) [0|3] "" ASDM
 SG_ ReSideRdrLeDetn190RdrDetnSts : 297|2@0+ (1,0) [0|3] "" ASDM
 SG_ ReSideRdrLeDetn191_UB : 483|1@0+ (1,0) [0|1] "" ASDM
 SG_ ReSideRdrLeDetn191RdrDetnAmbigState : 392|1@0+ (1,0) [0|1] "" ASDM
 SG_ ReSideRdrLeDetn191RdrDetnAssoTrkID : 399|7@0+ (1.0,0.0) [0.0|127.0] "Unitless" ASDM
 SG_ ReSideRdrLeDetn191RdrDetnAzi : 354|11@0+ (0.1,-90.0) [-90.0|90.0] "Deg" ASDM
 SG_ ReSideRdrLeDetn191RdrDetnChks : 327|8@0+ (1.0,0.0) [0.0|255.0] "Unitless" ASDM
 SG_ ReSideRdrLeDetn191RdrDetnCntr : 335|4@0+ (1.0,0.0) [0.0|15.0] "Unitless" ASDM
 SG_ ReSideRdrLeDetn191RdrDetnConf : 331|7@0+ (1.0,0.0) [0.0|100.0] "%" ASDM
 SG_ ReSideRdrLeDetn191RdrDetnElevn : 340|5@0+ (1.0,-15.0) [-15.0|15.0] "Deg" ASDM
 SG_ ReSideRdrLeDetn191RdrDetnPwr : 391|6@0+ (1.0,0.0) [0.0|63.0] "dB" ASDM
 SG_ ReSideRdrLeDetn191RdrDetnRng : 375|14@0+ (0.02,-1.0) [-1.0|200.0] "m" ASDM
 SG_ ReSideRdrLeDetn191RdrDetnRngV : 351|13@0+ (0.02,-80.0) [-80.0|80.0] "m/s" ASDM
 SG_ ReSideRdrLeDetn191RdrDetnSameRV : 385|2@0+ (1,0) [0|3] "" ASDM
 SG_ ReSideRdrLeDetn191RdrDetnSts : 377|2@0+ (1,0) [0|3] "" ASDM
 SG_ ReSideRdrLeDetn192_UB : 482|1@0+ (1,0) [0|1] "" ASDM
 SG_ ReSideRdrLeDetn192RdrDetnAmbigState : 472|1@0+ (1,0) [0|1] "" ASDM
 SG_ ReSideRdrLeDetn192RdrDetnAssoTrkID : 479|7@0+ (1.0,0.0) [0.0|127.0] "Unitless" ASDM
 SG_ ReSideRdrLeDetn192RdrDetnAzi : 434|11@0+ (0.1,-90.0) [-90.0|90.0] "Deg" ASDM
 SG_ ReSideRdrLeDetn192RdrDetnChks : 407|8@0+ (1.0,0.0) [0.0|255.0] "Unitless" ASDM
 SG_ ReSideRdrLeDetn192RdrDetnCntr : 415|4@0+ (1.0,0.0) [0.0|15.0] "Unitless" ASDM
 SG_ ReSideRdrLeDetn192RdrDetnConf : 411|7@0+ (1.0,0.0) [0.0|100.0] "%" ASDM
 SG_ ReSideRdrLeDetn192RdrDetnElevn : 420|5@0+ (1.0,-15.0) [-15.0|15.0] "Deg" ASDM
 SG_ ReSideRdrLeDetn192RdrDetnPwr : 471|6@0+ (1.0,0.0) [0.0|63.0] "dB" ASDM
 SG_ ReSideRdrLeDetn192RdrDetnRng : 455|14@0+ (0.02,-1.0) [-1.0|200.0] "m" ASDM
 SG_ ReSideRdrLeDetn192RdrDetnRngV : 431|13@0+ (0.02,-80.0) [-80.0|80.0] "m/s" ASDM
 SG_ ReSideRdrLeDetn192RdrDetnSameRV : 465|2@0+ (1,0) [0|3] "" ASDM
 SG_ ReSideRdrLeDetn192RdrDetnSts : 457|2@0+ (1,0) [0|3] "" ASDM

CM_ SG_ 119 ReSideRdrLeDetn157RdrDetnAmbigState "Dection ambiguous status";
CM_ SG_ 119 ReSideRdrLeDetn157RdrDetnAssoTrkID "Associated tracker ID
";
CM_ SG_ 119 ReSideRdrLeDetn157RdrDetnAzi "Refer to the data element description in ReSideRdrLeDetn1 with the same data element name";
CM_ SG_ 119 ReSideRdrLeDetn157RdrDetnChks "Refer to the data element description in ReSideRdrLeDetn1 with the same data element name";
CM_ SG_ 119 ReSideRdrLeDetn157RdrDetnCntr "Refer to the data element description in ReSideRdrLeDetn1 with the same data element name";
CM_ SG_ 119 ReSideRdrLeDetn157RdrDetnConf "Refer to the data element description in ReSideRdrLeDetn1 with the same data element name";
CM_ SG_ 119 ReSideRdrLeDetn157RdrDetnElevn "Refer to the data element description in ReSideRdrLeDetn1 with the same data element name";
CM_ SG_ 119 ReSideRdrLeDetn157RdrDetnPwr "Refer to the data element description in ReSideRdrLeDetn1 with the same data element name";
CM_ SG_ 119 ReSideRdrLeDetn157RdrDetnRng "Refer to the data element description in ReSideRdrLeDetn1 with the same data element name";
CM_ SG_ 119 ReSideRdrLeDetn157RdrDetnRngV "Range Velocity";
CM_ SG_ 119 ReSideRdrLeDetn157RdrDetnSameRV "object with same distance and speed";
CM_ SG_ 119 ReSideRdrLeDetn157RdrDetnSts "Refer to the data element description in ReSideRdrLeDetn1 with the same data element name";
CM_ SG_ 119 ReSideRdrLeDetn158RdrDetnAmbigState "Dection ambiguous status";
CM_ SG_ 119 ReSideRdrLeDetn158RdrDetnAssoTrkID "Associated tracker ID
";
CM_ SG_ 119 ReSideRdrLeDetn158RdrDetnAzi "Refer to the data element description in ReSideRdrLeDetn1 with the same data element name";
CM_ SG_ 119 ReSideRdrLeDetn158RdrDetnChks "Refer to the data element description in ReSideRdrLeDetn1 with the same data element name";
CM_ SG_ 119 ReSideRdrLeDetn158RdrDetnCntr "Refer to the data element description in ReSideRdrLeDetn1 with the same data element name";
CM_ SG_ 119 ReSideRdrLeDetn158RdrDetnConf "Refer to the data element description in ReSideRdrLeDetn1 with the same data element name";
CM_ SG_ 119 ReSideRdrLeDetn158RdrDetnElevn "Refer to the data element description in ReSideRdrLeDetn1 with the same data element name";
CM_ SG_ 119 ReSideRdrLeDetn158RdrDetnPwr "Refer to the data element description in ReSideRdrLeDetn1 with the same data element name";
CM_ SG_ 119 ReSideRdrLeDetn158RdrDetnRng "Refer to the data element description in ReSideRdrLeDetn1 with the same data element name";
CM_ SG_ 119 ReSideRdrLeDetn158RdrDetnRngV "Range Velocity";
CM_ SG_ 119 ReSideRdrLeDetn158RdrDetnSameRV "object with same distance and speed";
CM_ SG_ 119 ReSideRdrLeDetn158RdrDetnSts "Refer to the data element description in ReSideRdrLeDetn1 with the same data element name";
CM_ SG_ 119 ReSideRdrLeDetn159RdrDetnAmbigState "Dection ambiguous status";
CM_ SG_ 119 ReSideRdrLeDetn159RdrDetnAssoTrkID "Associated tracker ID
";
CM_ SG_ 119 ReSideRdrLeDetn159RdrDetnAzi "Refer to the data element description in ReSideRdrLeDetn1 with the same data element name";
CM_ SG_ 119 ReSideRdrLeDetn159RdrDetnChks "Refer to the data element description in ReSideRdrLeDetn1 with the same data element name";
CM_ SG_ 119 ReSideRdrLeDetn159RdrDetnCntr "Refer to the data element description in ReSideRdrLeDetn1 with the same data element name";
CM_ SG_ 119 ReSideRdrLeDetn159RdrDetnConf "Refer to the data element description in ReSideRdrLeDetn1 with the same data element name";
CM_ SG_ 119 ReSideRdrLeDetn159RdrDetnElevn "Refer to the data element description in ReSideRdrLeDetn1 with the same data element name";
CM_ SG_ 119 ReSideRdrLeDetn159RdrDetnPwr "Refer to the data element description in ReSideRdrLeDetn1 with the same data element name";
CM_ SG_ 119 ReSideRdrLeDetn159RdrDetnRng "Refer to the data element description in ReSideRdrLeDetn1 with the same data element name";
CM_ SG_ 119 ReSideRdrLeDetn159RdrDetnRngV "Range Velocity";
CM_ SG_ 119 ReSideRdrLeDetn159RdrDetnSameRV "object with same distance and speed";
CM_ SG_ 119 ReSideRdrLeDetn159RdrDetnSts "Refer to the data element description in ReSideRdrLeDetn1 with the same data element name";
CM_ SG_ 119 ReSideRdrLeDetn160RdrDetnAmbigState "Dection ambiguous status";
CM_ SG_ 119 ReSideRdrLeDetn160RdrDetnAssoTrkID "Associated tracker ID
";
CM_ SG_ 119 ReSideRdrLeDetn160RdrDetnAzi "Refer to the data element description in ReSideRdrLeDetn1 with the same data element name";
CM_ SG_ 119 ReSideRdrLeDetn160RdrDetnChks "Refer to the data element description in ReSideRdrLeDetn1 with the same data element name";
CM_ SG_ 119 ReSideRdrLeDetn160RdrDetnCntr "Refer to the data element description in ReSideRdrLeDetn1 with the same data element name";
CM_ SG_ 119 ReSideRdrLeDetn160RdrDetnConf "Refer to the data element description in ReSideRdrLeDetn1 with the same data element name";
CM_ SG_ 119 ReSideRdrLeDetn160RdrDetnElevn "Refer to the data element description in ReSideRdrLeDetn1 with the same data element name";
CM_ SG_ 119 ReSideRdrLeDetn160RdrDetnPwr "Refer to the data element description in ReSideRdrLeDetn1 with the same data element name";
CM_ SG_ 119 ReSideRdrLeDetn160RdrDetnRng "Refer to the data element description in ReSideRdrLeDetn1 with the same data element name";
CM_ SG_ 119 ReSideRdrLeDetn160RdrDetnRngV "Range Velocity";
CM_ SG_ 119 ReSideRdrLeDetn160RdrDetnSameRV "object with same distance and speed";
CM_ SG_ 119 ReSideRdrLeDetn160RdrDetnSts "Refer to the data element description in ReSideRdrLeDetn1 with the same data element name";
CM_ SG_ 119 ReSideRdrLeDetn161RdrDetnAmbigState "Dection ambiguous status";
CM_ SG_ 119 ReSideRdrLeDetn161RdrDetnAssoTrkID "Associated tracker ID
";
CM_ SG_ 119 ReSideRdrLeDetn161RdrDetnAzi "Refer to the data element description in ReSideRdrLeDetn1 with the same data element name";
CM_ SG_ 119 ReSideRdrLeDetn161RdrDetnChks "Refer to the data element description in ReSideRdrLeDetn1 with the same data element name";
CM_ SG_ 119 ReSideRdrLeDetn161RdrDetnCntr "Refer to the data element description in ReSideRdrLeDetn1 with the same data element name";
CM_ SG_ 119 ReSideRdrLeDetn161RdrDetnConf "Refer to the data element description in ReSideRdrLeDetn1 with the same data element name";
CM_ SG_ 119 ReSideRdrLeDetn161RdrDetnElevn "Refer to the data element description in ReSideRdrLeDetn1 with the same data element name";
CM_ SG_ 119 ReSideRdrLeDetn161RdrDetnPwr "Refer to the data element description in ReSideRdrLeDetn1 with the same data element name";
CM_ SG_ 119 ReSideRdrLeDetn161RdrDetnRng "Refer to the data element description in ReSideRdrLeDetn1 with the same data element name";
CM_ SG_ 119 ReSideRdrLeDetn161RdrDetnRngV "Range Velocity";
CM_ SG_ 119 ReSideRdrLeDetn161RdrDetnSameRV "object with same distance and speed";
CM_ SG_ 119 ReSideRdrLeDetn161RdrDetnSts "Refer to the data element description in ReSideRdrLeDetn1 with the same data element name";
CM_ SG_ 119 ReSideRdrLeDetn162RdrDetnAmbigState "Dection ambiguous status";
CM_ SG_ 119 ReSideRdrLeDetn162RdrDetnAssoTrkID "Associated tracker ID
";
CM_ SG_ 119 ReSideRdrLeDetn162RdrDetnAzi "Refer to the data element description in ReSideRdrLeDetn1 with the same data element name";
CM_ SG_ 119 ReSideRdrLeDetn162RdrDetnChks "Refer to the data element description in ReSideRdrLeDetn1 with the same data element name";
CM_ SG_ 119 ReSideRdrLeDetn162RdrDetnCntr "Refer to the data element description in ReSideRdrLeDetn1 with the same data element name";
CM_ SG_ 119 ReSideRdrLeDetn162RdrDetnConf "Refer to the data element description in ReSideRdrLeDetn1 with the same data element name";
CM_ SG_ 119 ReSideRdrLeDetn162RdrDetnElevn "Refer to the data element description in ReSideRdrLeDetn1 with the same data element name";
CM_ SG_ 119 ReSideRdrLeDetn162RdrDetnPwr "Refer to the data element description in ReSideRdrLeDetn1 with the same data element name";
CM_ SG_ 119 ReSideRdrLeDetn162RdrDetnRng "Refer to the data element description in ReSideRdrLeDetn1 with the same data element name";
CM_ SG_ 119 ReSideRdrLeDetn162RdrDetnRngV "Range Velocity";
CM_ SG_ 119 ReSideRdrLeDetn162RdrDetnSameRV "object with same distance and speed";
CM_ SG_ 119 ReSideRdrLeDetn162RdrDetnSts "Refer to the data element description in ReSideRdrLeDetn1 with the same data element name";
CM_ SG_ 120 ReSideRdrLeDetn163RdrDetnAmbigState "Dection ambiguous status";
CM_ SG_ 120 ReSideRdrLeDetn163RdrDetnAssoTrkID "Associated tracker ID
";
CM_ SG_ 120 ReSideRdrLeDetn163RdrDetnAzi "Refer to the data element description in ReSideRdrLeDetn1 with the same data element name";
CM_ SG_ 120 ReSideRdrLeDetn163RdrDetnChks "Refer to the data element description in ReSideRdrLeDetn1 with the same data element name";
CM_ SG_ 120 ReSideRdrLeDetn163RdrDetnCntr "Refer to the data element description in ReSideRdrLeDetn1 with the same data element name";
CM_ SG_ 120 ReSideRdrLeDetn163RdrDetnConf "Refer to the data element description in ReSideRdrLeDetn1 with the same data element name";
CM_ SG_ 120 ReSideRdrLeDetn163RdrDetnElevn "Refer to the data element description in ReSideRdrLeDetn1 with the same data element name";
CM_ SG_ 120 ReSideRdrLeDetn163RdrDetnPwr "Refer to the data element description in ReSideRdrLeDetn1 with the same data element name";
CM_ SG_ 120 ReSideRdrLeDetn163RdrDetnRng "Refer to the data element description in ReSideRdrLeDetn1 with the same data element name";
CM_ SG_ 120 ReSideRdrLeDetn163RdrDetnRngV "Range Velocity";
CM_ SG_ 120 ReSideRdrLeDetn163RdrDetnSameRV "object with same distance and speed";
CM_ SG_ 120 ReSideRdrLeDetn163RdrDetnSts "Refer to the data element description in ReSideRdrLeDetn1 with the same data element name";
CM_ SG_ 120 ReSideRdrLeDetn164RdrDetnAmbigState "Dection ambiguous status";
CM_ SG_ 120 ReSideRdrLeDetn164RdrDetnAssoTrkID "Associated tracker ID
";
CM_ SG_ 120 ReSideRdrLeDetn164RdrDetnAzi "Refer to the data element description in ReSideRdrLeDetn1 with the same data element name";
CM_ SG_ 120 ReSideRdrLeDetn164RdrDetnChks "Refer to the data element description in ReSideRdrLeDetn1 with the same data element name";
CM_ SG_ 120 ReSideRdrLeDetn164RdrDetnCntr "Refer to the data element description in ReSideRdrLeDetn1 with the same data element name";
CM_ SG_ 120 ReSideRdrLeDetn164RdrDetnConf "Refer to the data element description in ReSideRdrLeDetn1 with the same data element name";
CM_ SG_ 120 ReSideRdrLeDetn164RdrDetnElevn "Refer to the data element description in ReSideRdrLeDetn1 with the same data element name";
CM_ SG_ 120 ReSideRdrLeDetn164RdrDetnPwr "Refer to the data element description in ReSideRdrLeDetn1 with the same data element name";
CM_ SG_ 120 ReSideRdrLeDetn164RdrDetnRng "Refer to the data element description in ReSideRdrLeDetn1 with the same data element name";
CM_ SG_ 120 ReSideRdrLeDetn164RdrDetnRngV "Range Velocity";
CM_ SG_ 120 ReSideRdrLeDetn164RdrDetnSameRV "object with same distance and speed";
CM_ SG_ 120 ReSideRdrLeDetn164RdrDetnSts "Refer to the data element description in ReSideRdrLeDetn1 with the same data element name";
CM_ SG_ 120 ReSideRdrLeDetn165RdrDetnAmbigState "Dection ambiguous status";
CM_ SG_ 120 ReSideRdrLeDetn165RdrDetnAssoTrkID "Associated tracker ID
";
CM_ SG_ 120 ReSideRdrLeDetn165RdrDetnAzi "Refer to the data element description in ReSideRdrLeDetn1 with the same data element name";
CM_ SG_ 120 ReSideRdrLeDetn165RdrDetnChks "Refer to the data element description in ReSideRdrLeDetn1 with the same data element name";
CM_ SG_ 120 ReSideRdrLeDetn165RdrDetnCntr "Refer to the data element description in ReSideRdrLeDetn1 with the same data element name";
CM_ SG_ 120 ReSideRdrLeDetn165RdrDetnConf "Refer to the data element description in ReSideRdrLeDetn1 with the same data element name";
CM_ SG_ 120 ReSideRdrLeDetn165RdrDetnElevn "Refer to the data element description in ReSideRdrLeDetn1 with the same data element name";
CM_ SG_ 120 ReSideRdrLeDetn165RdrDetnPwr "Refer to the data element description in ReSideRdrLeDetn1 with the same data element name";
CM_ SG_ 120 ReSideRdrLeDetn165RdrDetnRng "Refer to the data element description in ReSideRdrLeDetn1 with the same data element name";
CM_ SG_ 120 ReSideRdrLeDetn165RdrDetnRngV "Range Velocity";
CM_ SG_ 120 ReSideRdrLeDetn165RdrDetnSameRV "object with same distance and speed";
CM_ SG_ 120 ReSideRdrLeDetn165RdrDetnSts "Refer to the data element description in ReSideRdrLeDetn1 with the same data element name";
CM_ SG_ 120 ReSideRdrLeDetn166RdrDetnAmbigState "Dection ambiguous status";
CM_ SG_ 120 ReSideRdrLeDetn166RdrDetnAssoTrkID "Associated tracker ID
";
CM_ SG_ 120 ReSideRdrLeDetn166RdrDetnAzi "Refer to the data element description in ReSideRdrLeDetn1 with the same data element name";
CM_ SG_ 120 ReSideRdrLeDetn166RdrDetnChks "Refer to the data element description in ReSideRdrLeDetn1 with the same data element name";
CM_ SG_ 120 ReSideRdrLeDetn166RdrDetnCntr "Refer to the data element description in ReSideRdrLeDetn1 with the same data element name";
CM_ SG_ 120 ReSideRdrLeDetn166RdrDetnConf "Refer to the data element description in ReSideRdrLeDetn1 with the same data element name";
CM_ SG_ 120 ReSideRdrLeDetn166RdrDetnElevn "Refer to the data element description in ReSideRdrLeDetn1 with the same data element name";
CM_ SG_ 120 ReSideRdrLeDetn166RdrDetnPwr "Refer to the data element description in ReSideRdrLeDetn1 with the same data element name";
CM_ SG_ 120 ReSideRdrLeDetn166RdrDetnRng "Refer to the data element description in ReSideRdrLeDetn1 with the same data element name";
CM_ SG_ 120 ReSideRdrLeDetn166RdrDetnRngV "Range Velocity";
CM_ SG_ 120 ReSideRdrLeDetn166RdrDetnSameRV "object with same distance and speed";
CM_ SG_ 120 ReSideRdrLeDetn166RdrDetnSts "Refer to the data element description in ReSideRdrLeDetn1 with the same data element name";
CM_ SG_ 120 ReSideRdrLeDetn167RdrDetnAmbigState "Dection ambiguous status";
CM_ SG_ 120 ReSideRdrLeDetn167RdrDetnAssoTrkID "Associated tracker ID
";
CM_ SG_ 120 ReSideRdrLeDetn167RdrDetnAzi "Refer to the data element description in ReSideRdrLeDetn1 with the same data element name";
CM_ SG_ 120 ReSideRdrLeDetn167RdrDetnChks "Refer to the data element description in ReSideRdrLeDetn1 with the same data element name";
CM_ SG_ 120 ReSideRdrLeDetn167RdrDetnCntr "Refer to the data element description in ReSideRdrLeDetn1 with the same data element name";
CM_ SG_ 120 ReSideRdrLeDetn167RdrDetnConf "Refer to the data element description in ReSideRdrLeDetn1 with the same data element name";
CM_ SG_ 120 ReSideRdrLeDetn167RdrDetnElevn "Refer to the data element description in ReSideRdrLeDetn1 with the same data element name";
CM_ SG_ 120 ReSideRdrLeDetn167RdrDetnPwr "Refer to the data element description in ReSideRdrLeDetn1 with the same data element name";
CM_ SG_ 120 ReSideRdrLeDetn167RdrDetnRng "Refer to the data element description in ReSideRdrLeDetn1 with the same data element name";
CM_ SG_ 120 ReSideRdrLeDetn167RdrDetnRngV "Range Velocity";
CM_ SG_ 120 ReSideRdrLeDetn167RdrDetnSameRV "object with same distance and speed";
CM_ SG_ 120 ReSideRdrLeDetn167RdrDetnSts "Refer to the data element description in ReSideRdrLeDetn1 with the same data element name";
CM_ SG_ 120 ReSideRdrLeDetn168RdrDetnAmbigState "Dection ambiguous status";
CM_ SG_ 120 ReSideRdrLeDetn168RdrDetnAssoTrkID "Associated tracker ID
";
CM_ SG_ 120 ReSideRdrLeDetn168RdrDetnAzi "Refer to the data element description in ReSideRdrLeDetn1 with the same data element name";
CM_ SG_ 120 ReSideRdrLeDetn168RdrDetnChks "Refer to the data element description in ReSideRdrLeDetn1 with the same data element name";
CM_ SG_ 120 ReSideRdrLeDetn168RdrDetnCntr "Refer to the data element description in ReSideRdrLeDetn1 with the same data element name";
CM_ SG_ 120 ReSideRdrLeDetn168RdrDetnConf "Refer to the data element description in ReSideRdrLeDetn1 with the same data element name";
CM_ SG_ 120 ReSideRdrLeDetn168RdrDetnElevn "Refer to the data element description in ReSideRdrLeDetn1 with the same data element name";
CM_ SG_ 120 ReSideRdrLeDetn168RdrDetnPwr "Refer to the data element description in ReSideRdrLeDetn1 with the same data element name";
CM_ SG_ 120 ReSideRdrLeDetn168RdrDetnRng "Refer to the data element description in ReSideRdrLeDetn1 with the same data element name";
CM_ SG_ 120 ReSideRdrLeDetn168RdrDetnRngV "Range Velocity";
CM_ SG_ 120 ReSideRdrLeDetn168RdrDetnSameRV "object with same distance and speed";
CM_ SG_ 120 ReSideRdrLeDetn168RdrDetnSts "Refer to the data element description in ReSideRdrLeDetn1 with the same data element name";
CM_ SG_ 121 ReSideRdrLeDetn169RdrDetnAmbigState "Dection ambiguous status";
CM_ SG_ 121 ReSideRdrLeDetn169RdrDetnAssoTrkID "Associated tracker ID
";
CM_ SG_ 121 ReSideRdrLeDetn169RdrDetnAzi "Refer to the data element description in ReSideRdrLeDetn1 with the same data element name";
CM_ SG_ 121 ReSideRdrLeDetn169RdrDetnChks "Refer to the data element description in ReSideRdrLeDetn1 with the same data element name";
CM_ SG_ 121 ReSideRdrLeDetn169RdrDetnCntr "Refer to the data element description in ReSideRdrLeDetn1 with the same data element name";
CM_ SG_ 121 ReSideRdrLeDetn169RdrDetnConf "Refer to the data element description in ReSideRdrLeDetn1 with the same data element name";
CM_ SG_ 121 ReSideRdrLeDetn169RdrDetnElevn "Refer to the data element description in ReSideRdrLeDetn1 with the same data element name";
CM_ SG_ 121 ReSideRdrLeDetn169RdrDetnPwr "Refer to the data element description in ReSideRdrLeDetn1 with the same data element name";
CM_ SG_ 121 ReSideRdrLeDetn169RdrDetnRng "Refer to the data element description in ReSideRdrLeDetn1 with the same data element name";
CM_ SG_ 121 ReSideRdrLeDetn169RdrDetnRngV "Range Velocity";
CM_ SG_ 121 ReSideRdrLeDetn169RdrDetnSameRV "object with same distance and speed";
CM_ SG_ 121 ReSideRdrLeDetn169RdrDetnSts "Refer to the data element description in ReSideRdrLeDetn1 with the same data element name";
CM_ SG_ 121 ReSideRdrLeDetn170RdrDetnAmbigState "Dection ambiguous status";
CM_ SG_ 121 ReSideRdrLeDetn170RdrDetnAssoTrkID "Associated tracker ID
";
CM_ SG_ 121 ReSideRdrLeDetn170RdrDetnAzi "Refer to the data element description in ReSideRdrLeDetn1 with the same data element name";
CM_ SG_ 121 ReSideRdrLeDetn170RdrDetnChks "Refer to the data element description in ReSideRdrLeDetn1 with the same data element name";
CM_ SG_ 121 ReSideRdrLeDetn170RdrDetnCntr "Refer to the data element description in ReSideRdrLeDetn1 with the same data element name";
CM_ SG_ 121 ReSideRdrLeDetn170RdrDetnConf "Refer to the data element description in ReSideRdrLeDetn1 with the same data element name";
CM_ SG_ 121 ReSideRdrLeDetn170RdrDetnElevn "Refer to the data element description in ReSideRdrLeDetn1 with the same data element name";
CM_ SG_ 121 ReSideRdrLeDetn170RdrDetnPwr "Refer to the data element description in ReSideRdrLeDetn1 with the same data element name";
CM_ SG_ 121 ReSideRdrLeDetn170RdrDetnRng "Refer to the data element description in ReSideRdrLeDetn1 with the same data element name";
CM_ SG_ 121 ReSideRdrLeDetn170RdrDetnRngV "Range Velocity";
CM_ SG_ 121 ReSideRdrLeDetn170RdrDetnSameRV "object with same distance and speed";
CM_ SG_ 121 ReSideRdrLeDetn170RdrDetnSts "Refer to the data element description in ReSideRdrLeDetn1 with the same data element name";
CM_ SG_ 121 ReSideRdrLeDetn171RdrDetnAmbigState "Dection ambiguous status";
CM_ SG_ 121 ReSideRdrLeDetn171RdrDetnAssoTrkID "Associated tracker ID
";
CM_ SG_ 121 ReSideRdrLeDetn171RdrDetnAzi "Refer to the data element description in ReSideRdrLeDetn1 with the same data element name";
CM_ SG_ 121 ReSideRdrLeDetn171RdrDetnChks "Refer to the data element description in ReSideRdrLeDetn1 with the same data element name";
CM_ SG_ 121 ReSideRdrLeDetn171RdrDetnCntr "Refer to the data element description in ReSideRdrLeDetn1 with the same data element name";
CM_ SG_ 121 ReSideRdrLeDetn171RdrDetnConf "Refer to the data element description in ReSideRdrLeDetn1 with the same data element name";
CM_ SG_ 121 ReSideRdrLeDetn171RdrDetnElevn "Refer to the data element description in ReSideRdrLeDetn1 with the same data element name";
CM_ SG_ 121 ReSideRdrLeDetn171RdrDetnPwr "Refer to the data element description in ReSideRdrLeDetn1 with the same data element name";
CM_ SG_ 121 ReSideRdrLeDetn171RdrDetnRng "Refer to the data element description in ReSideRdrLeDetn1 with the same data element name";
CM_ SG_ 121 ReSideRdrLeDetn171RdrDetnRngV "Range Velocity";
CM_ SG_ 121 ReSideRdrLeDetn171RdrDetnSameRV "object with same distance and speed";
CM_ SG_ 121 ReSideRdrLeDetn171RdrDetnSts "Refer to the data element description in ReSideRdrLeDetn1 with the same data element name";
CM_ SG_ 121 ReSideRdrLeDetn172RdrDetnAmbigState "Dection ambiguous status";
CM_ SG_ 121 ReSideRdrLeDetn172RdrDetnAssoTrkID "Associated tracker ID
";
CM_ SG_ 121 ReSideRdrLeDetn172RdrDetnAzi "Refer to the data element description in ReSideRdrLeDetn1 with the same data element name";
CM_ SG_ 121 ReSideRdrLeDetn172RdrDetnChks "Refer to the data element description in ReSideRdrLeDetn1 with the same data element name";
CM_ SG_ 121 ReSideRdrLeDetn172RdrDetnCntr "Refer to the data element description in ReSideRdrLeDetn1 with the same data element name";
CM_ SG_ 121 ReSideRdrLeDetn172RdrDetnConf "Refer to the data element description in ReSideRdrLeDetn1 with the same data element name";
CM_ SG_ 121 ReSideRdrLeDetn172RdrDetnElevn "Refer to the data element description in ReSideRdrLeDetn1 with the same data element name";
CM_ SG_ 121 ReSideRdrLeDetn172RdrDetnPwr "Refer to the data element description in ReSideRdrLeDetn1 with the same data element name";
CM_ SG_ 121 ReSideRdrLeDetn172RdrDetnRng "Refer to the data element description in ReSideRdrLeDetn1 with the same data element name";
CM_ SG_ 121 ReSideRdrLeDetn172RdrDetnRngV "Range Velocity";
CM_ SG_ 121 ReSideRdrLeDetn172RdrDetnSameRV "object with same distance and speed";
CM_ SG_ 121 ReSideRdrLeDetn172RdrDetnSts "Refer to the data element description in ReSideRdrLeDetn1 with the same data element name";
CM_ SG_ 121 ReSideRdrLeDetn173RdrDetnAmbigState "Dection ambiguous status";
CM_ SG_ 121 ReSideRdrLeDetn173RdrDetnAssoTrkID "Associated tracker ID
";
CM_ SG_ 121 ReSideRdrLeDetn173RdrDetnAzi "Refer to the data element description in ReSideRdrLeDetn1 with the same data element name";
CM_ SG_ 121 ReSideRdrLeDetn173RdrDetnChks "Refer to the data element description in ReSideRdrLeDetn1 with the same data element name";
CM_ SG_ 121 ReSideRdrLeDetn173RdrDetnCntr "Refer to the data element description in ReSideRdrLeDetn1 with the same data element name";
CM_ SG_ 121 ReSideRdrLeDetn173RdrDetnConf "Refer to the data element description in ReSideRdrLeDetn1 with the same data element name";
CM_ SG_ 121 ReSideRdrLeDetn173RdrDetnElevn "Refer to the data element description in ReSideRdrLeDetn1 with the same data element name";
CM_ SG_ 121 ReSideRdrLeDetn173RdrDetnPwr "Refer to the data element description in ReSideRdrLeDetn1 with the same data element name";
CM_ SG_ 121 ReSideRdrLeDetn173RdrDetnRng "Refer to the data element description in ReSideRdrLeDetn1 with the same data element name";
CM_ SG_ 121 ReSideRdrLeDetn173RdrDetnRngV "Range Velocity";
CM_ SG_ 121 ReSideRdrLeDetn173RdrDetnSameRV "object with same distance and speed";
CM_ SG_ 121 ReSideRdrLeDetn173RdrDetnSts "Refer to the data element description in ReSideRdrLeDetn1 with the same data element name";
CM_ SG_ 121 ReSideRdrLeDetn174RdrDetnAmbigState "Dection ambiguous status";
CM_ SG_ 121 ReSideRdrLeDetn174RdrDetnAssoTrkID "Associated tracker ID
";
CM_ SG_ 121 ReSideRdrLeDetn174RdrDetnAzi "Refer to the data element description in ReSideRdrLeDetn1 with the same data element name";
CM_ SG_ 121 ReSideRdrLeDetn174RdrDetnChks "Refer to the data element description in ReSideRdrLeDetn1 with the same data element name";
CM_ SG_ 121 ReSideRdrLeDetn174RdrDetnCntr "Refer to the data element description in ReSideRdrLeDetn1 with the same data element name";
CM_ SG_ 121 ReSideRdrLeDetn174RdrDetnConf "Refer to the data element description in ReSideRdrLeDetn1 with the same data element name";
CM_ SG_ 121 ReSideRdrLeDetn174RdrDetnElevn "Refer to the data element description in ReSideRdrLeDetn1 with the same data element name";
CM_ SG_ 121 ReSideRdrLeDetn174RdrDetnPwr "Refer to the data element description in ReSideRdrLeDetn1 with the same data element name";
CM_ SG_ 121 ReSideRdrLeDetn174RdrDetnRng "Refer to the data element description in ReSideRdrLeDetn1 with the same data element name";
CM_ SG_ 121 ReSideRdrLeDetn174RdrDetnRngV "Range Velocity";
CM_ SG_ 121 ReSideRdrLeDetn174RdrDetnSameRV "object with same distance and speed";
CM_ SG_ 121 ReSideRdrLeDetn174RdrDetnSts "Refer to the data element description in ReSideRdrLeDetn1 with the same data element name";
CM_ SG_ 128 ReSideRdrLeDetn175RdrDetnAmbigState "Dection ambiguous status";
CM_ SG_ 128 ReSideRdrLeDetn175RdrDetnAssoTrkID "Associated tracker ID
";
CM_ SG_ 128 ReSideRdrLeDetn175RdrDetnAzi "Refer to the data element description in ReSideRdrLeDetn1 with the same data element name";
CM_ SG_ 128 ReSideRdrLeDetn175RdrDetnChks "Refer to the data element description in ReSideRdrLeDetn1 with the same data element name";
CM_ SG_ 128 ReSideRdrLeDetn175RdrDetnCntr "Refer to the data element description in ReSideRdrLeDetn1 with the same data element name";
CM_ SG_ 128 ReSideRdrLeDetn175RdrDetnConf "Refer to the data element description in ReSideRdrLeDetn1 with the same data element name";
CM_ SG_ 128 ReSideRdrLeDetn175RdrDetnElevn "Refer to the data element description in ReSideRdrLeDetn1 with the same data element name";
CM_ SG_ 128 ReSideRdrLeDetn175RdrDetnPwr "Refer to the data element description in ReSideRdrLeDetn1 with the same data element name";
CM_ SG_ 128 ReSideRdrLeDetn175RdrDetnRng "Refer to the data element description in ReSideRdrLeDetn1 with the same data element name";
CM_ SG_ 128 ReSideRdrLeDetn175RdrDetnRngV "Range Velocity";
CM_ SG_ 128 ReSideRdrLeDetn175RdrDetnSameRV "object with same distance and speed";
CM_ SG_ 128 ReSideRdrLeDetn175RdrDetnSts "Refer to the data element description in ReSideRdrLeDetn1 with the same data element name";
CM_ SG_ 128 ReSideRdrLeDetn176RdrDetnAmbigState "Dection ambiguous status";
CM_ SG_ 128 ReSideRdrLeDetn176RdrDetnAssoTrkID "Associated tracker ID
";
CM_ SG_ 128 ReSideRdrLeDetn176RdrDetnAzi "Refer to the data element description in ReSideRdrLeDetn1 with the same data element name";
CM_ SG_ 128 ReSideRdrLeDetn176RdrDetnChks "Refer to the data element description in ReSideRdrLeDetn1 with the same data element name";
CM_ SG_ 128 ReSideRdrLeDetn176RdrDetnCntr "Refer to the data element description in ReSideRdrLeDetn1 with the same data element name";
CM_ SG_ 128 ReSideRdrLeDetn176RdrDetnConf "Refer to the data element description in ReSideRdrLeDetn1 with the same data element name";
CM_ SG_ 128 ReSideRdrLeDetn176RdrDetnElevn "Refer to the data element description in ReSideRdrLeDetn1 with the same data element name";
CM_ SG_ 128 ReSideRdrLeDetn176RdrDetnPwr "Refer to the data element description in ReSideRdrLeDetn1 with the same data element name";
CM_ SG_ 128 ReSideRdrLeDetn176RdrDetnRng "Refer to the data element description in ReSideRdrLeDetn1 with the same data element name";
CM_ SG_ 128 ReSideRdrLeDetn176RdrDetnRngV "Range Velocity";
CM_ SG_ 128 ReSideRdrLeDetn176RdrDetnSameRV "object with same distance and speed";
CM_ SG_ 128 ReSideRdrLeDetn176RdrDetnSts "Refer to the data element description in ReSideRdrLeDetn1 with the same data element name";
CM_ SG_ 128 ReSideRdrLeDetn177RdrDetnAmbigState "Dection ambiguous status";
CM_ SG_ 128 ReSideRdrLeDetn177RdrDetnAssoTrkID "Associated tracker ID
";
CM_ SG_ 128 ReSideRdrLeDetn177RdrDetnAzi "Refer to the data element description in ReSideRdrLeDetn1 with the same data element name";
CM_ SG_ 128 ReSideRdrLeDetn177RdrDetnChks "Refer to the data element description in ReSideRdrLeDetn1 with the same data element name";
CM_ SG_ 128 ReSideRdrLeDetn177RdrDetnCntr "Refer to the data element description in ReSideRdrLeDetn1 with the same data element name";
CM_ SG_ 128 ReSideRdrLeDetn177RdrDetnConf "Refer to the data element description in ReSideRdrLeDetn1 with the same data element name";
CM_ SG_ 128 ReSideRdrLeDetn177RdrDetnElevn "Refer to the data element description in ReSideRdrLeDetn1 with the same data element name";
CM_ SG_ 128 ReSideRdrLeDetn177RdrDetnPwr "Refer to the data element description in ReSideRdrLeDetn1 with the same data element name";
CM_ SG_ 128 ReSideRdrLeDetn177RdrDetnRng "Refer to the data element description in ReSideRdrLeDetn1 with the same data element name";
CM_ SG_ 128 ReSideRdrLeDetn177RdrDetnRngV "Range Velocity";
CM_ SG_ 128 ReSideRdrLeDetn177RdrDetnSameRV "object with same distance and speed";
CM_ SG_ 128 ReSideRdrLeDetn177RdrDetnSts "Refer to the data element description in ReSideRdrLeDetn1 with the same data element name";
CM_ SG_ 128 ReSideRdrLeDetn178RdrDetnAmbigState "Dection ambiguous status";
CM_ SG_ 128 ReSideRdrLeDetn178RdrDetnAssoTrkID "Associated tracker ID
";
CM_ SG_ 128 ReSideRdrLeDetn178RdrDetnAzi "Refer to the data element description in ReSideRdrLeDetn1 with the same data element name";
CM_ SG_ 128 ReSideRdrLeDetn178RdrDetnChks "Refer to the data element description in ReSideRdrLeDetn1 with the same data element name";
CM_ SG_ 128 ReSideRdrLeDetn178RdrDetnCntr "Refer to the data element description in ReSideRdrLeDetn1 with the same data element name";
CM_ SG_ 128 ReSideRdrLeDetn178RdrDetnConf "Refer to the data element description in ReSideRdrLeDetn1 with the same data element name";
CM_ SG_ 128 ReSideRdrLeDetn178RdrDetnElevn "Refer to the data element description in ReSideRdrLeDetn1 with the same data element name";
CM_ SG_ 128 ReSideRdrLeDetn178RdrDetnPwr "Refer to the data element description in ReSideRdrLeDetn1 with the same data element name";
CM_ SG_ 128 ReSideRdrLeDetn178RdrDetnRng "Refer to the data element description in ReSideRdrLeDetn1 with the same data element name";
CM_ SG_ 128 ReSideRdrLeDetn178RdrDetnRngV "Range Velocity";
CM_ SG_ 128 ReSideRdrLeDetn178RdrDetnSameRV "object with same distance and speed";
CM_ SG_ 128 ReSideRdrLeDetn178RdrDetnSts "Refer to the data element description in ReSideRdrLeDetn1 with the same data element name";
CM_ SG_ 128 ReSideRdrLeDetn179RdrDetnAmbigState "Dection ambiguous status";
CM_ SG_ 128 ReSideRdrLeDetn179RdrDetnAssoTrkID "Associated tracker ID
";
CM_ SG_ 128 ReSideRdrLeDetn179RdrDetnAzi "Refer to the data element description in ReSideRdrLeDetn1 with the same data element name";
CM_ SG_ 128 ReSideRdrLeDetn179RdrDetnChks "Refer to the data element description in ReSideRdrLeDetn1 with the same data element name";
CM_ SG_ 128 ReSideRdrLeDetn179RdrDetnCntr "Refer to the data element description in ReSideRdrLeDetn1 with the same data element name";
CM_ SG_ 128 ReSideRdrLeDetn179RdrDetnConf "Refer to the data element description in ReSideRdrLeDetn1 with the same data element name";
CM_ SG_ 128 ReSideRdrLeDetn179RdrDetnElevn "Refer to the data element description in ReSideRdrLeDetn1 with the same data element name";
CM_ SG_ 128 ReSideRdrLeDetn179RdrDetnPwr "Refer to the data element description in ReSideRdrLeDetn1 with the same data element name";
CM_ SG_ 128 ReSideRdrLeDetn179RdrDetnRng "Refer to the data element description in ReSideRdrLeDetn1 with the same data element name";
CM_ SG_ 128 ReSideRdrLeDetn179RdrDetnRngV "Range Velocity";
CM_ SG_ 128 ReSideRdrLeDetn179RdrDetnSameRV "object with same distance and speed";
CM_ SG_ 128 ReSideRdrLeDetn179RdrDetnSts "Refer to the data element description in ReSideRdrLeDetn1 with the same data element name";
CM_ SG_ 128 ReSideRdrLeDetn180RdrDetnAmbigState "Dection ambiguous status";
CM_ SG_ 128 ReSideRdrLeDetn180RdrDetnAssoTrkID "Associated tracker ID
";
CM_ SG_ 128 ReSideRdrLeDetn180RdrDetnAzi "Refer to the data element description in ReSideRdrLeDetn1 with the same data element name";
CM_ SG_ 128 ReSideRdrLeDetn180RdrDetnChks "Refer to the data element description in ReSideRdrLeDetn1 with the same data element name";
CM_ SG_ 128 ReSideRdrLeDetn180RdrDetnCntr "Refer to the data element description in ReSideRdrLeDetn1 with the same data element name";
CM_ SG_ 128 ReSideRdrLeDetn180RdrDetnConf "Refer to the data element description in ReSideRdrLeDetn1 with the same data element name";
CM_ SG_ 128 ReSideRdrLeDetn180RdrDetnElevn "Refer to the data element description in ReSideRdrLeDetn1 with the same data element name";
CM_ SG_ 128 ReSideRdrLeDetn180RdrDetnPwr "Refer to the data element description in ReSideRdrLeDetn1 with the same data element name";
CM_ SG_ 128 ReSideRdrLeDetn180RdrDetnRng "Refer to the data element description in ReSideRdrLeDetn1 with the same data element name";
CM_ SG_ 128 ReSideRdrLeDetn180RdrDetnRngV "Range Velocity";
CM_ SG_ 128 ReSideRdrLeDetn180RdrDetnSameRV "object with same distance and speed";
CM_ SG_ 128 ReSideRdrLeDetn180RdrDetnSts "Refer to the data element description in ReSideRdrLeDetn1 with the same data element name";
CM_ SG_ 129 ReSideRdrLeDetn181RdrDetnAmbigState "Dection ambiguous status";
CM_ SG_ 129 ReSideRdrLeDetn181RdrDetnAssoTrkID "Associated tracker ID
";
CM_ SG_ 129 ReSideRdrLeDetn181RdrDetnAzi "Refer to the data element description in ReSideRdrLeDetn1 with the same data element name";
CM_ SG_ 129 ReSideRdrLeDetn181RdrDetnChks "Refer to the data element description in ReSideRdrLeDetn1 with the same data element name";
CM_ SG_ 129 ReSideRdrLeDetn181RdrDetnCntr "Refer to the data element description in ReSideRdrLeDetn1 with the same data element name";
CM_ SG_ 129 ReSideRdrLeDetn181RdrDetnConf "Refer to the data element description in ReSideRdrLeDetn1 with the same data element name";
CM_ SG_ 129 ReSideRdrLeDetn181RdrDetnElevn "Refer to the data element description in ReSideRdrLeDetn1 with the same data element name";
CM_ SG_ 129 ReSideRdrLeDetn181RdrDetnPwr "Refer to the data element description in ReSideRdrLeDetn1 with the same data element name";
CM_ SG_ 129 ReSideRdrLeDetn181RdrDetnRng "Refer to the data element description in ReSideRdrLeDetn1 with the same data element name";
CM_ SG_ 129 ReSideRdrLeDetn181RdrDetnRngV "Range Velocity";
CM_ SG_ 129 ReSideRdrLeDetn181RdrDetnSameRV "object with same distance and speed";
CM_ SG_ 129 ReSideRdrLeDetn181RdrDetnSts "Refer to the data element description in ReSideRdrLeDetn1 with the same data element name";
CM_ SG_ 129 ReSideRdrLeDetn182RdrDetnAmbigState "Dection ambiguous status";
CM_ SG_ 129 ReSideRdrLeDetn182RdrDetnAssoTrkID "Associated tracker ID
";
CM_ SG_ 129 ReSideRdrLeDetn182RdrDetnAzi "Refer to the data element description in ReSideRdrLeDetn1 with the same data element name";
CM_ SG_ 129 ReSideRdrLeDetn182RdrDetnChks "Refer to the data element description in ReSideRdrLeDetn1 with the same data element name";
CM_ SG_ 129 ReSideRdrLeDetn182RdrDetnCntr "Refer to the data element description in ReSideRdrLeDetn1 with the same data element name";
CM_ SG_ 129 ReSideRdrLeDetn182RdrDetnConf "Refer to the data element description in ReSideRdrLeDetn1 with the same data element name";
CM_ SG_ 129 ReSideRdrLeDetn182RdrDetnElevn "Refer to the data element description in ReSideRdrLeDetn1 with the same data element name";
CM_ SG_ 129 ReSideRdrLeDetn182RdrDetnPwr "Refer to the data element description in ReSideRdrLeDetn1 with the same data element name";
CM_ SG_ 129 ReSideRdrLeDetn182RdrDetnRng "Refer to the data element description in ReSideRdrLeDetn1 with the same data element name";
CM_ SG_ 129 ReSideRdrLeDetn182RdrDetnRngV "Range Velocity";
CM_ SG_ 129 ReSideRdrLeDetn182RdrDetnSameRV "object with same distance and speed";
CM_ SG_ 129 ReSideRdrLeDetn182RdrDetnSts "Refer to the data element description in ReSideRdrLeDetn1 with the same data element name";
CM_ SG_ 129 ReSideRdrLeDetn183RdrDetnAmbigState "Dection ambiguous status";
CM_ SG_ 129 ReSideRdrLeDetn183RdrDetnAssoTrkID "Associated tracker ID
";
CM_ SG_ 129 ReSideRdrLeDetn183RdrDetnAzi "Refer to the data element description in ReSideRdrLeDetn1 with the same data element name";
CM_ SG_ 129 ReSideRdrLeDetn183RdrDetnChks "Refer to the data element description in ReSideRdrLeDetn1 with the same data element name";
CM_ SG_ 129 ReSideRdrLeDetn183RdrDetnCntr "Refer to the data element description in ReSideRdrLeDetn1 with the same data element name";
CM_ SG_ 129 ReSideRdrLeDetn183RdrDetnConf "Refer to the data element description in ReSideRdrLeDetn1 with the same data element name";
CM_ SG_ 129 ReSideRdrLeDetn183RdrDetnElevn "Refer to the data element description in ReSideRdrLeDetn1 with the same data element name";
CM_ SG_ 129 ReSideRdrLeDetn183RdrDetnPwr "Refer to the data element description in ReSideRdrLeDetn1 with the same data element name";
CM_ SG_ 129 ReSideRdrLeDetn183RdrDetnRng "Refer to the data element description in ReSideRdrLeDetn1 with the same data element name";
CM_ SG_ 129 ReSideRdrLeDetn183RdrDetnRngV "Range Velocity";
CM_ SG_ 129 ReSideRdrLeDetn183RdrDetnSameRV "object with same distance and speed";
CM_ SG_ 129 ReSideRdrLeDetn183RdrDetnSts "Refer to the data element description in ReSideRdrLeDetn1 with the same data element name";
CM_ SG_ 129 ReSideRdrLeDetn184RdrDetnAmbigState "Dection ambiguous status";
CM_ SG_ 129 ReSideRdrLeDetn184RdrDetnAssoTrkID "Associated tracker ID
";
CM_ SG_ 129 ReSideRdrLeDetn184RdrDetnAzi "Refer to the data element description in ReSideRdrLeDetn1 with the same data element name";
CM_ SG_ 129 ReSideRdrLeDetn184RdrDetnChks "Refer to the data element description in ReSideRdrLeDetn1 with the same data element name";
CM_ SG_ 129 ReSideRdrLeDetn184RdrDetnCntr "Refer to the data element description in ReSideRdrLeDetn1 with the same data element name";
CM_ SG_ 129 ReSideRdrLeDetn184RdrDetnConf "Refer to the data element description in ReSideRdrLeDetn1 with the same data element name";
CM_ SG_ 129 ReSideRdrLeDetn184RdrDetnElevn "Refer to the data element description in ReSideRdrLeDetn1 with the same data element name";
CM_ SG_ 129 ReSideRdrLeDetn184RdrDetnPwr "Refer to the data element description in ReSideRdrLeDetn1 with the same data element name";
CM_ SG_ 129 ReSideRdrLeDetn184RdrDetnRng "Refer to the data element description in ReSideRdrLeDetn1 with the same data element name";
CM_ SG_ 129 ReSideRdrLeDetn184RdrDetnRngV "Range Velocity";
CM_ SG_ 129 ReSideRdrLeDetn184RdrDetnSameRV "object with same distance and speed";
CM_ SG_ 129 ReSideRdrLeDetn184RdrDetnSts "Refer to the data element description in ReSideRdrLeDetn1 with the same data element name";
CM_ SG_ 129 ReSideRdrLeDetn185RdrDetnAmbigState "Dection ambiguous status";
CM_ SG_ 129 ReSideRdrLeDetn185RdrDetnAssoTrkID "Associated tracker ID
";
CM_ SG_ 129 ReSideRdrLeDetn185RdrDetnAzi "Refer to the data element description in ReSideRdrLeDetn1 with the same data element name";
CM_ SG_ 129 ReSideRdrLeDetn185RdrDetnChks "Refer to the data element description in ReSideRdrLeDetn1 with the same data element name";
CM_ SG_ 129 ReSideRdrLeDetn185RdrDetnCntr "Refer to the data element description in ReSideRdrLeDetn1 with the same data element name";
CM_ SG_ 129 ReSideRdrLeDetn185RdrDetnConf "Refer to the data element description in ReSideRdrLeDetn1 with the same data element name";
CM_ SG_ 129 ReSideRdrLeDetn185RdrDetnElevn "Refer to the data element description in ReSideRdrLeDetn1 with the same data element name";
CM_ SG_ 129 ReSideRdrLeDetn185RdrDetnPwr "Refer to the data element description in ReSideRdrLeDetn1 with the same data element name";
CM_ SG_ 129 ReSideRdrLeDetn185RdrDetnRng "Refer to the data element description in ReSideRdrLeDetn1 with the same data element name";
CM_ SG_ 129 ReSideRdrLeDetn185RdrDetnRngV "Range Velocity";
CM_ SG_ 129 ReSideRdrLeDetn185RdrDetnSameRV "object with same distance and speed";
CM_ SG_ 129 ReSideRdrLeDetn185RdrDetnSts "Refer to the data element description in ReSideRdrLeDetn1 with the same data element name";
CM_ SG_ 129 ReSideRdrLeDetn186RdrDetnAmbigState "Dection ambiguous status";
CM_ SG_ 129 ReSideRdrLeDetn186RdrDetnAssoTrkID "Associated tracker ID
";
CM_ SG_ 129 ReSideRdrLeDetn186RdrDetnAzi "Refer to the data element description in ReSideRdrLeDetn1 with the same data element name";
CM_ SG_ 129 ReSideRdrLeDetn186RdrDetnChks "Refer to the data element description in ReSideRdrLeDetn1 with the same data element name";
CM_ SG_ 129 ReSideRdrLeDetn186RdrDetnCntr "Refer to the data element description in ReSideRdrLeDetn1 with the same data element name";
CM_ SG_ 129 ReSideRdrLeDetn186RdrDetnConf "Refer to the data element description in ReSideRdrLeDetn1 with the same data element name";
CM_ SG_ 129 ReSideRdrLeDetn186RdrDetnElevn "Refer to the data element description in ReSideRdrLeDetn1 with the same data element name";
CM_ SG_ 129 ReSideRdrLeDetn186RdrDetnPwr "Refer to the data element description in ReSideRdrLeDetn1 with the same data element name";
CM_ SG_ 129 ReSideRdrLeDetn186RdrDetnRng "Refer to the data element description in ReSideRdrLeDetn1 with the same data element name";
CM_ SG_ 129 ReSideRdrLeDetn186RdrDetnRngV "Range Velocity";
CM_ SG_ 129 ReSideRdrLeDetn186RdrDetnSameRV "object with same distance and speed";
CM_ SG_ 129 ReSideRdrLeDetn186RdrDetnSts "Refer to the data element description in ReSideRdrLeDetn1 with the same data element name";
CM_ SG_ 130 ReSideRdrLeDetn187RdrDetnAmbigState "Dection ambiguous status";
CM_ SG_ 130 ReSideRdrLeDetn187RdrDetnAssoTrkID "Associated tracker ID
";
CM_ SG_ 130 ReSideRdrLeDetn187RdrDetnAzi "Refer to the data element description in ReSideRdrLeDetn1 with the same data element name";
CM_ SG_ 130 ReSideRdrLeDetn187RdrDetnChks "Refer to the data element description in ReSideRdrLeDetn1 with the same data element name";
CM_ SG_ 130 ReSideRdrLeDetn187RdrDetnCntr "Refer to the data element description in ReSideRdrLeDetn1 with the same data element name";
CM_ SG_ 130 ReSideRdrLeDetn187RdrDetnConf "Refer to the data element description in ReSideRdrLeDetn1 with the same data element name";
CM_ SG_ 130 ReSideRdrLeDetn187RdrDetnElevn "Refer to the data element description in ReSideRdrLeDetn1 with the same data element name";
CM_ SG_ 130 ReSideRdrLeDetn187RdrDetnPwr "Refer to the data element description in ReSideRdrLeDetn1 with the same data element name";
CM_ SG_ 130 ReSideRdrLeDetn187RdrDetnRng "Refer to the data element description in ReSideRdrLeDetn1 with the same data element name";
CM_ SG_ 130 ReSideRdrLeDetn187RdrDetnRngV "Range Velocity";
CM_ SG_ 130 ReSideRdrLeDetn187RdrDetnSameRV "object with same distance and speed";
CM_ SG_ 130 ReSideRdrLeDetn187RdrDetnSts "Refer to the data element description in ReSideRdrLeDetn1 with the same data element name";
CM_ SG_ 130 ReSideRdrLeDetn188RdrDetnAmbigState "Dection ambiguous status";
CM_ SG_ 130 ReSideRdrLeDetn188RdrDetnAssoTrkID "Associated tracker ID
";
CM_ SG_ 130 ReSideRdrLeDetn188RdrDetnAzi "Refer to the data element description in ReSideRdrLeDetn1 with the same data element name";
CM_ SG_ 130 ReSideRdrLeDetn188RdrDetnChks "Refer to the data element description in ReSideRdrLeDetn1 with the same data element name";
CM_ SG_ 130 ReSideRdrLeDetn188RdrDetnCntr "Refer to the data element description in ReSideRdrLeDetn1 with the same data element name";
CM_ SG_ 130 ReSideRdrLeDetn188RdrDetnConf "Refer to the data element description in ReSideRdrLeDetn1 with the same data element name";
CM_ SG_ 130 ReSideRdrLeDetn188RdrDetnElevn "Refer to the data element description in ReSideRdrLeDetn1 with the same data element name";
CM_ SG_ 130 ReSideRdrLeDetn188RdrDetnPwr "Refer to the data element description in ReSideRdrLeDetn1 with the same data element name";
CM_ SG_ 130 ReSideRdrLeDetn188RdrDetnRng "Refer to the data element description in ReSideRdrLeDetn1 with the same data element name";
CM_ SG_ 130 ReSideRdrLeDetn188RdrDetnRngV "Range Velocity";
CM_ SG_ 130 ReSideRdrLeDetn188RdrDetnSameRV "object with same distance and speed";
CM_ SG_ 130 ReSideRdrLeDetn188RdrDetnSts "Refer to the data element description in ReSideRdrLeDetn1 with the same data element name";
CM_ SG_ 130 ReSideRdrLeDetn189RdrDetnAmbigState "Dection ambiguous status";
CM_ SG_ 130 ReSideRdrLeDetn189RdrDetnAssoTrkID "Associated tracker ID
";
CM_ SG_ 130 ReSideRdrLeDetn189RdrDetnAzi "Refer to the data element description in ReSideRdrLeDetn1 with the same data element name";
CM_ SG_ 130 ReSideRdrLeDetn189RdrDetnChks "Refer to the data element description in ReSideRdrLeDetn1 with the same data element name";
CM_ SG_ 130 ReSideRdrLeDetn189RdrDetnCntr "Refer to the data element description in ReSideRdrLeDetn1 with the same data element name";
CM_ SG_ 130 ReSideRdrLeDetn189RdrDetnConf "Refer to the data element description in ReSideRdrLeDetn1 with the same data element name";
CM_ SG_ 130 ReSideRdrLeDetn189RdrDetnElevn "Refer to the data element description in ReSideRdrLeDetn1 with the same data element name";
CM_ SG_ 130 ReSideRdrLeDetn189RdrDetnPwr "Refer to the data element description in ReSideRdrLeDetn1 with the same data element name";
CM_ SG_ 130 ReSideRdrLeDetn189RdrDetnRng "Refer to the data element description in ReSideRdrLeDetn1 with the same data element name";
CM_ SG_ 130 ReSideRdrLeDetn189RdrDetnRngV "Range Velocity";
CM_ SG_ 130 ReSideRdrLeDetn189RdrDetnSameRV "object with same distance and speed";
CM_ SG_ 130 ReSideRdrLeDetn189RdrDetnSts "Refer to the data element description in ReSideRdrLeDetn1 with the same data element name";
CM_ SG_ 130 ReSideRdrLeDetn190RdrDetnAmbigState "Dection ambiguous status";
CM_ SG_ 130 ReSideRdrLeDetn190RdrDetnAssoTrkID "Associated tracker ID
";
CM_ SG_ 130 ReSideRdrLeDetn190RdrDetnAzi "Refer to the data element description in ReSideRdrLeDetn1 with the same data element name";
CM_ SG_ 130 ReSideRdrLeDetn190RdrDetnChks "Refer to the data element description in ReSideRdrLeDetn1 with the same data element name";
CM_ SG_ 130 ReSideRdrLeDetn190RdrDetnCntr "Refer to the data element description in ReSideRdrLeDetn1 with the same data element name";
CM_ SG_ 130 ReSideRdrLeDetn190RdrDetnConf "Refer to the data element description in ReSideRdrLeDetn1 with the same data element name";
CM_ SG_ 130 ReSideRdrLeDetn190RdrDetnElevn "Refer to the data element description in ReSideRdrLeDetn1 with the same data element name";
CM_ SG_ 130 ReSideRdrLeDetn190RdrDetnPwr "Refer to the data element description in ReSideRdrLeDetn1 with the same data element name";
CM_ SG_ 130 ReSideRdrLeDetn190RdrDetnRng "Refer to the data element description in ReSideRdrLeDetn1 with the same data element name";
CM_ SG_ 130 ReSideRdrLeDetn190RdrDetnRngV "Range Velocity";
CM_ SG_ 130 ReSideRdrLeDetn190RdrDetnSameRV "object with same distance and speed";
CM_ SG_ 130 ReSideRdrLeDetn190RdrDetnSts "Refer to the data element description in ReSideRdrLeDetn1 with the same data element name";
CM_ SG_ 130 ReSideRdrLeDetn191RdrDetnAmbigState "Dection ambiguous status";
CM_ SG_ 130 ReSideRdrLeDetn191RdrDetnAssoTrkID "Associated tracker ID
";
CM_ SG_ 130 ReSideRdrLeDetn191RdrDetnAzi "Refer to the data element description in ReSideRdrLeDetn1 with the same data element name";
CM_ SG_ 130 ReSideRdrLeDetn191RdrDetnChks "Refer to the data element description in ReSideRdrLeDetn1 with the same data element name";
CM_ SG_ 130 ReSideRdrLeDetn191RdrDetnCntr "Refer to the data element description in ReSideRdrLeDetn1 with the same data element name";
CM_ SG_ 130 ReSideRdrLeDetn191RdrDetnConf "Refer to the data element description in ReSideRdrLeDetn1 with the same data element name";
CM_ SG_ 130 ReSideRdrLeDetn191RdrDetnElevn "Refer to the data element description in ReSideRdrLeDetn1 with the same data element name";
CM_ SG_ 130 ReSideRdrLeDetn191RdrDetnPwr "Refer to the data element description in ReSideRdrLeDetn1 with the same data element name";
CM_ SG_ 130 ReSideRdrLeDetn191RdrDetnRng "Refer to the data element description in ReSideRdrLeDetn1 with the same data element name";
CM_ SG_ 130 ReSideRdrLeDetn191RdrDetnRngV "Range Velocity";
CM_ SG_ 130 ReSideRdrLeDetn191RdrDetnSameRV "object with same distance and speed";
CM_ SG_ 130 ReSideRdrLeDetn191RdrDetnSts "Refer to the data element description in ReSideRdrLeDetn1 with the same data element name";
CM_ SG_ 130 ReSideRdrLeDetn192RdrDetnAmbigState "Dection ambiguous status";
CM_ SG_ 130 ReSideRdrLeDetn192RdrDetnAssoTrkID "Associated tracker ID
";
CM_ SG_ 130 ReSideRdrLeDetn192RdrDetnAzi "Refer to the data element description in ReSideRdrLeDetn1 with the same data element name";
CM_ SG_ 130 ReSideRdrLeDetn192RdrDetnChks "Refer to the data element description in ReSideRdrLeDetn1 with the same data element name";
CM_ SG_ 130 ReSideRdrLeDetn192RdrDetnCntr "Refer to the data element description in ReSideRdrLeDetn1 with the same data element name";
CM_ SG_ 130 ReSideRdrLeDetn192RdrDetnConf "Refer to the data element description in ReSideRdrLeDetn1 with the same data element name";
CM_ SG_ 130 ReSideRdrLeDetn192RdrDetnElevn "Refer to the data element description in ReSideRdrLeDetn1 with the same data element name";
CM_ SG_ 130 ReSideRdrLeDetn192RdrDetnPwr "Refer to the data element description in ReSideRdrLeDetn1 with the same data element name";
CM_ SG_ 130 ReSideRdrLeDetn192RdrDetnRng "Refer to the data element description in ReSideRdrLeDetn1 with the same data element name";
CM_ SG_ 130 ReSideRdrLeDetn192RdrDetnRngV "Range Velocity";
CM_ SG_ 130 ReSideRdrLeDetn192RdrDetnSameRV "object with same distance and speed";
CM_ SG_ 130 ReSideRdrLeDetn192RdrDetnSts "Refer to the data element description in ReSideRdrLeDetn1 with the same data element name";
BA_DEF_ BO_ "CANFD_BRS" ENUM "0","1";
BA_DEF_ BO_ "GenMsgCycleTime" INT 0 65536; // [ms]
BA_DEF_ BO_ "GenMsgDelayTime" INT 0 65536; // [ms]
BA_DEF_ BO_ "GenMsgSendType" ENUM "cyclic", "spontaneous", "not-used", "not-used", "not-used", "cyclicAndSpontaneous", "not-used", "cyclicIfActive", "NoMsgSendType"; // [us]
BA_DEF_ BO_ "GenMsgStartDelayTime" INT 0 65536; // [ms]
BA_DEF_ BO_ "VFrameFormat" ENUM "StandardCAN","ExtendedCAN","reserved","J1939PG","reserved","reserved","reserved","reserved","reserved","reserved","reserved","reserved","reserved","reserved","StandardCAN_FD","ExtendedCAN_FD";
BA_DEF_ SG_ "GenSigSendType" ENUM "Cyclic","OnWrite","OnWriteWithRepetition","OnChange","OnChangeWithRepetition","IfActive","IfActiveWithRepetition","NoSigSendType";
BA_DEF_ SG_ "GenSigStartValue" HEX 0 80000000;
BA_DEF_ BO_ "GenMsgILSupport" ENUM "No","Yes";
BA_DEF_ BO_ "NmAsrMessage" ENUM "No","Yes";
BA_DEF_ SG_ "GenSigFuncType" ENUM "NoFunction","n/a","n/a","n/a","n/a","n/a","n/a","n/a","n/a","n/a","n/a","n/a","n/a","n/a","n/a","CHK","CNTR","n/a","n/a","n/a","CNTR_AR_01","CRC_AR_01_BOTH","CRC_AR_01_ALT","CRC_AR_01_LOW","CRC_AR_01_NIBBLE","CNTR_AR_04","CRC_AR_04A","CNTR_AR_05","CRC_AR_05";
BA_DEF_ SG_ "GenSigDataID" STRING;
BA_DEF_DEF_ "CANFD_BRS" "1";
BA_DEF_DEF_ "GenSigStartValue" 0;
BA_DEF_DEF_ "VFrameFormat" "J1939PG";
BA_DEF_DEF_ "GenSigSendType" "NoSigSendType";
BA_DEF_DEF_ "GenMsgCycleTime" 0;
BA_DEF_DEF_ "GenMsgDelayTime" 0;
BA_DEF_DEF_ "GenMsgStartDelayTime" 0;
BA_DEF_DEF_ "GenMsgSendType" "NoMsgSendType";
BA_DEF_DEF_ "GenMsgILSupport" "Yes";
BA_DEF_DEF_ "NmAsrMessage" "No";
BA_DEF_DEF_ "GenSigFuncType" "NoFunction";
BA_DEF_DEF_ "GenSigDataID" "";
// Frame: SODLPrivateCANFD5Fr60
BA_ "GenMsgCycleTime" BO_ 119 50 ;
BA_ "GenMsgSendType" BO_ 119 0;
BA_ "VFrameFormat" BO_ 119 14;
// Frame: SODLPrivateCANFD5Fr61
BA_ "GenMsgCycleTime" BO_ 120 50 ;
BA_ "GenMsgSendType" BO_ 120 0;
BA_ "VFrameFormat" BO_ 120 14;
// Frame: SODLPrivateCANFD5Fr62
BA_ "GenMsgCycleTime" BO_ 121 50 ;
BA_ "GenMsgSendType" BO_ 121 0;
BA_ "VFrameFormat" BO_ 121 14;
// Frame: SODLPrivateCANFD5Fr63
BA_ "GenMsgCycleTime" BO_ 128 50 ;
BA_ "GenMsgSendType" BO_ 128 0;
BA_ "VFrameFormat" BO_ 128 14;
// Frame: SODLPrivateCANFD5Fr64
BA_ "GenMsgCycleTime" BO_ 129 50 ;
BA_ "GenMsgSendType" BO_ 129 0;
BA_ "VFrameFormat" BO_ 129 14;
// Frame: SODLPrivateCANFD5Fr65
BA_ "GenMsgCycleTime" BO_ 130 50 ;
BA_ "GenMsgSendType" BO_ 130 0;
BA_ "VFrameFormat" BO_ 130 14;
BA_ "GenSigSendType" SG_ 119 ReSideRdrLeDetn157RdrDetnAmbigState 0;
BA_ "GenSigSendType" SG_ 119 ReSideRdrLeDetn157RdrDetnAssoTrkID 0;
BA_ "GenSigSendType" SG_ 119 ReSideRdrLeDetn157RdrDetnAzi 0;
BA_ "GenSigStartValue" SG_ 119 ReSideRdrLeDetn157RdrDetnAzi 900;
BA_ "GenSigDataID" SG_ 119 ReSideRdrLeDetn157RdrDetnChks "0x10F9";
BA_ "GenSigFuncType" SG_ 119 ReSideRdrLeDetn157RdrDetnChks 15;
BA_ "GenSigSendType" SG_ 119 ReSideRdrLeDetn157RdrDetnChks 0;
BA_ "GenSigFuncType" SG_ 119 ReSideRdrLeDetn157RdrDetnCntr 16;
BA_ "GenSigSendType" SG_ 119 ReSideRdrLeDetn157RdrDetnCntr 0;
BA_ "GenSigSendType" SG_ 119 ReSideRdrLeDetn157RdrDetnConf 0;
BA_ "GenSigSendType" SG_ 119 ReSideRdrLeDetn157RdrDetnElevn 0;
BA_ "GenSigStartValue" SG_ 119 ReSideRdrLeDetn157RdrDetnElevn 15;
BA_ "GenSigSendType" SG_ 119 ReSideRdrLeDetn157RdrDetnPwr 0;
BA_ "GenSigSendType" SG_ 119 ReSideRdrLeDetn157RdrDetnRng 0;
BA_ "GenSigStartValue" SG_ 119 ReSideRdrLeDetn157RdrDetnRng 10050;
BA_ "GenSigSendType" SG_ 119 ReSideRdrLeDetn157RdrDetnRngV 0;
BA_ "GenSigStartValue" SG_ 119 ReSideRdrLeDetn157RdrDetnRngV 4000;
BA_ "GenSigSendType" SG_ 119 ReSideRdrLeDetn157RdrDetnSameRV 0;
BA_ "GenSigSendType" SG_ 119 ReSideRdrLeDetn157RdrDetnSts 0;
BA_ "GenSigStartValue" SG_ 119 ReSideRdrLeDetn157RdrDetnSts 3;
BA_ "GenSigSendType" SG_ 119 ReSideRdrLeDetn158RdrDetnAmbigState 0;
BA_ "GenSigSendType" SG_ 119 ReSideRdrLeDetn158RdrDetnAssoTrkID 0;
BA_ "GenSigSendType" SG_ 119 ReSideRdrLeDetn158RdrDetnAzi 0;
BA_ "GenSigStartValue" SG_ 119 ReSideRdrLeDetn158RdrDetnAzi 900;
BA_ "GenSigDataID" SG_ 119 ReSideRdrLeDetn158RdrDetnChks "0x122B";
BA_ "GenSigFuncType" SG_ 119 ReSideRdrLeDetn158RdrDetnChks 15;
BA_ "GenSigSendType" SG_ 119 ReSideRdrLeDetn158RdrDetnChks 0;
BA_ "GenSigFuncType" SG_ 119 ReSideRdrLeDetn158RdrDetnCntr 16;
BA_ "GenSigSendType" SG_ 119 ReSideRdrLeDetn158RdrDetnCntr 0;
BA_ "GenSigSendType" SG_ 119 ReSideRdrLeDetn158RdrDetnConf 0;
BA_ "GenSigSendType" SG_ 119 ReSideRdrLeDetn158RdrDetnElevn 0;
BA_ "GenSigStartValue" SG_ 119 ReSideRdrLeDetn158RdrDetnElevn 15;
BA_ "GenSigSendType" SG_ 119 ReSideRdrLeDetn158RdrDetnPwr 0;
BA_ "GenSigSendType" SG_ 119 ReSideRdrLeDetn158RdrDetnRng 0;
BA_ "GenSigStartValue" SG_ 119 ReSideRdrLeDetn158RdrDetnRng 10050;
BA_ "GenSigSendType" SG_ 119 ReSideRdrLeDetn158RdrDetnRngV 0;
BA_ "GenSigStartValue" SG_ 119 ReSideRdrLeDetn158RdrDetnRngV 4000;
BA_ "GenSigSendType" SG_ 119 ReSideRdrLeDetn158RdrDetnSameRV 0;
BA_ "GenSigSendType" SG_ 119 ReSideRdrLeDetn158RdrDetnSts 0;
BA_ "GenSigStartValue" SG_ 119 ReSideRdrLeDetn158RdrDetnSts 3;
BA_ "GenSigSendType" SG_ 119 ReSideRdrLeDetn159RdrDetnAmbigState 0;
BA_ "GenSigSendType" SG_ 119 ReSideRdrLeDetn159RdrDetnAssoTrkID 0;
BA_ "GenSigSendType" SG_ 119 ReSideRdrLeDetn159RdrDetnAzi 0;
BA_ "GenSigStartValue" SG_ 119 ReSideRdrLeDetn159RdrDetnAzi 900;
BA_ "GenSigDataID" SG_ 119 ReSideRdrLeDetn159RdrDetnChks "0x122A";
BA_ "GenSigFuncType" SG_ 119 ReSideRdrLeDetn159RdrDetnChks 15;
BA_ "GenSigSendType" SG_ 119 ReSideRdrLeDetn159RdrDetnChks 0;
BA_ "GenSigFuncType" SG_ 119 ReSideRdrLeDetn159RdrDetnCntr 16;
BA_ "GenSigSendType" SG_ 119 ReSideRdrLeDetn159RdrDetnCntr 0;
BA_ "GenSigSendType" SG_ 119 ReSideRdrLeDetn159RdrDetnConf 0;
BA_ "GenSigSendType" SG_ 119 ReSideRdrLeDetn159RdrDetnElevn 0;
BA_ "GenSigStartValue" SG_ 119 ReSideRdrLeDetn159RdrDetnElevn 15;
BA_ "GenSigSendType" SG_ 119 ReSideRdrLeDetn159RdrDetnPwr 0;
BA_ "GenSigSendType" SG_ 119 ReSideRdrLeDetn159RdrDetnRng 0;
BA_ "GenSigStartValue" SG_ 119 ReSideRdrLeDetn159RdrDetnRng 10050;
BA_ "GenSigSendType" SG_ 119 ReSideRdrLeDetn159RdrDetnRngV 0;
BA_ "GenSigStartValue" SG_ 119 ReSideRdrLeDetn159RdrDetnRngV 4000;
BA_ "GenSigSendType" SG_ 119 ReSideRdrLeDetn159RdrDetnSameRV 0;
BA_ "GenSigSendType" SG_ 119 ReSideRdrLeDetn159RdrDetnSts 0;
BA_ "GenSigStartValue" SG_ 119 ReSideRdrLeDetn159RdrDetnSts 3;
BA_ "GenSigSendType" SG_ 119 ReSideRdrLeDetn160RdrDetnAmbigState 0;
BA_ "GenSigSendType" SG_ 119 ReSideRdrLeDetn160RdrDetnAssoTrkID 0;
BA_ "GenSigSendType" SG_ 119 ReSideRdrLeDetn160RdrDetnAzi 0;
BA_ "GenSigStartValue" SG_ 119 ReSideRdrLeDetn160RdrDetnAzi 900;
BA_ "GenSigDataID" SG_ 119 ReSideRdrLeDetn160RdrDetnChks "0x10FC";
BA_ "GenSigFuncType" SG_ 119 ReSideRdrLeDetn160RdrDetnChks 15;
BA_ "GenSigSendType" SG_ 119 ReSideRdrLeDetn160RdrDetnChks 0;
BA_ "GenSigFuncType" SG_ 119 ReSideRdrLeDetn160RdrDetnCntr 16;
BA_ "GenSigSendType" SG_ 119 ReSideRdrLeDetn160RdrDetnCntr 0;
BA_ "GenSigSendType" SG_ 119 ReSideRdrLeDetn160RdrDetnConf 0;
BA_ "GenSigSendType" SG_ 119 ReSideRdrLeDetn160RdrDetnElevn 0;
BA_ "GenSigStartValue" SG_ 119 ReSideRdrLeDetn160RdrDetnElevn 15;
BA_ "GenSigSendType" SG_ 119 ReSideRdrLeDetn160RdrDetnPwr 0;
BA_ "GenSigSendType" SG_ 119 ReSideRdrLeDetn160RdrDetnRng 0;
BA_ "GenSigStartValue" SG_ 119 ReSideRdrLeDetn160RdrDetnRng 10050;
BA_ "GenSigSendType" SG_ 119 ReSideRdrLeDetn160RdrDetnRngV 0;
BA_ "GenSigStartValue" SG_ 119 ReSideRdrLeDetn160RdrDetnRngV 4000;
BA_ "GenSigSendType" SG_ 119 ReSideRdrLeDetn160RdrDetnSameRV 0;
BA_ "GenSigSendType" SG_ 119 ReSideRdrLeDetn160RdrDetnSts 0;
BA_ "GenSigStartValue" SG_ 119 ReSideRdrLeDetn160RdrDetnSts 3;
BA_ "GenSigSendType" SG_ 119 ReSideRdrLeDetn161RdrDetnAmbigState 0;
BA_ "GenSigSendType" SG_ 119 ReSideRdrLeDetn161RdrDetnAssoTrkID 0;
BA_ "GenSigSendType" SG_ 119 ReSideRdrLeDetn161RdrDetnAzi 0;
BA_ "GenSigStartValue" SG_ 119 ReSideRdrLeDetn161RdrDetnAzi 900;
BA_ "GenSigDataID" SG_ 119 ReSideRdrLeDetn161RdrDetnChks "0x10FD";
BA_ "GenSigFuncType" SG_ 119 ReSideRdrLeDetn161RdrDetnChks 15;
BA_ "GenSigSendType" SG_ 119 ReSideRdrLeDetn161RdrDetnChks 0;
BA_ "GenSigFuncType" SG_ 119 ReSideRdrLeDetn161RdrDetnCntr 16;
BA_ "GenSigSendType" SG_ 119 ReSideRdrLeDetn161RdrDetnCntr 0;
BA_ "GenSigSendType" SG_ 119 ReSideRdrLeDetn161RdrDetnConf 0;
BA_ "GenSigSendType" SG_ 119 ReSideRdrLeDetn161RdrDetnElevn 0;
BA_ "GenSigStartValue" SG_ 119 ReSideRdrLeDetn161RdrDetnElevn 15;
BA_ "GenSigSendType" SG_ 119 ReSideRdrLeDetn161RdrDetnPwr 0;
BA_ "GenSigSendType" SG_ 119 ReSideRdrLeDetn161RdrDetnRng 0;
BA_ "GenSigStartValue" SG_ 119 ReSideRdrLeDetn161RdrDetnRng 10050;
BA_ "GenSigSendType" SG_ 119 ReSideRdrLeDetn161RdrDetnRngV 0;
BA_ "GenSigStartValue" SG_ 119 ReSideRdrLeDetn161RdrDetnRngV 4000;
BA_ "GenSigSendType" SG_ 119 ReSideRdrLeDetn161RdrDetnSameRV 0;
BA_ "GenSigSendType" SG_ 119 ReSideRdrLeDetn161RdrDetnSts 0;
BA_ "GenSigStartValue" SG_ 119 ReSideRdrLeDetn161RdrDetnSts 3;
BA_ "GenSigSendType" SG_ 119 ReSideRdrLeDetn162RdrDetnAmbigState 0;
BA_ "GenSigSendType" SG_ 119 ReSideRdrLeDetn162RdrDetnAssoTrkID 0;
BA_ "GenSigSendType" SG_ 119 ReSideRdrLeDetn162RdrDetnAzi 0;
BA_ "GenSigStartValue" SG_ 119 ReSideRdrLeDetn162RdrDetnAzi 900;
BA_ "GenSigDataID" SG_ 119 ReSideRdrLeDetn162RdrDetnChks "0x10FE";
BA_ "GenSigFuncType" SG_ 119 ReSideRdrLeDetn162RdrDetnChks 15;
BA_ "GenSigSendType" SG_ 119 ReSideRdrLeDetn162RdrDetnChks 0;
BA_ "GenSigFuncType" SG_ 119 ReSideRdrLeDetn162RdrDetnCntr 16;
BA_ "GenSigSendType" SG_ 119 ReSideRdrLeDetn162RdrDetnCntr 0;
BA_ "GenSigSendType" SG_ 119 ReSideRdrLeDetn162RdrDetnConf 0;
BA_ "GenSigSendType" SG_ 119 ReSideRdrLeDetn162RdrDetnElevn 0;
BA_ "GenSigStartValue" SG_ 119 ReSideRdrLeDetn162RdrDetnElevn 15;
BA_ "GenSigSendType" SG_ 119 ReSideRdrLeDetn162RdrDetnPwr 0;
BA_ "GenSigSendType" SG_ 119 ReSideRdrLeDetn162RdrDetnRng 0;
BA_ "GenSigStartValue" SG_ 119 ReSideRdrLeDetn162RdrDetnRng 10050;
BA_ "GenSigSendType" SG_ 119 ReSideRdrLeDetn162RdrDetnRngV 0;
BA_ "GenSigStartValue" SG_ 119 ReSideRdrLeDetn162RdrDetnRngV 4000;
BA_ "GenSigSendType" SG_ 119 ReSideRdrLeDetn162RdrDetnSameRV 0;
BA_ "GenSigSendType" SG_ 119 ReSideRdrLeDetn162RdrDetnSts 0;
BA_ "GenSigStartValue" SG_ 119 ReSideRdrLeDetn162RdrDetnSts 3;
BA_ "GenSigSendType" SG_ 120 ReSideRdrLeDetn163RdrDetnAmbigState 0;
BA_ "GenSigSendType" SG_ 120 ReSideRdrLeDetn163RdrDetnAssoTrkID 0;
BA_ "GenSigSendType" SG_ 120 ReSideRdrLeDetn163RdrDetnAzi 0;
BA_ "GenSigStartValue" SG_ 120 ReSideRdrLeDetn163RdrDetnAzi 900;
BA_ "GenSigDataID" SG_ 120 ReSideRdrLeDetn163RdrDetnChks "0x10FF";
BA_ "GenSigFuncType" SG_ 120 ReSideRdrLeDetn163RdrDetnChks 15;
BA_ "GenSigSendType" SG_ 120 ReSideRdrLeDetn163RdrDetnChks 0;
BA_ "GenSigFuncType" SG_ 120 ReSideRdrLeDetn163RdrDetnCntr 16;
BA_ "GenSigSendType" SG_ 120 ReSideRdrLeDetn163RdrDetnCntr 0;
BA_ "GenSigSendType" SG_ 120 ReSideRdrLeDetn163RdrDetnConf 0;
BA_ "GenSigSendType" SG_ 120 ReSideRdrLeDetn163RdrDetnElevn 0;
BA_ "GenSigStartValue" SG_ 120 ReSideRdrLeDetn163RdrDetnElevn 15;
BA_ "GenSigSendType" SG_ 120 ReSideRdrLeDetn163RdrDetnPwr 0;
BA_ "GenSigSendType" SG_ 120 ReSideRdrLeDetn163RdrDetnRng 0;
BA_ "GenSigStartValue" SG_ 120 ReSideRdrLeDetn163RdrDetnRng 10050;
BA_ "GenSigSendType" SG_ 120 ReSideRdrLeDetn163RdrDetnRngV 0;
BA_ "GenSigStartValue" SG_ 120 ReSideRdrLeDetn163RdrDetnRngV 4000;
BA_ "GenSigSendType" SG_ 120 ReSideRdrLeDetn163RdrDetnSameRV 0;
BA_ "GenSigSendType" SG_ 120 ReSideRdrLeDetn163RdrDetnSts 0;
BA_ "GenSigStartValue" SG_ 120 ReSideRdrLeDetn163RdrDetnSts 3;
BA_ "GenSigSendType" SG_ 120 ReSideRdrLeDetn164RdrDetnAmbigState 0;
BA_ "GenSigSendType" SG_ 120 ReSideRdrLeDetn164RdrDetnAssoTrkID 0;
BA_ "GenSigSendType" SG_ 120 ReSideRdrLeDetn164RdrDetnAzi 0;
BA_ "GenSigStartValue" SG_ 120 ReSideRdrLeDetn164RdrDetnAzi 900;
BA_ "GenSigDataID" SG_ 120 ReSideRdrLeDetn164RdrDetnChks "0x1100";
BA_ "GenSigFuncType" SG_ 120 ReSideRdrLeDetn164RdrDetnChks 15;
BA_ "GenSigSendType" SG_ 120 ReSideRdrLeDetn164RdrDetnChks 0;
BA_ "GenSigFuncType" SG_ 120 ReSideRdrLeDetn164RdrDetnCntr 16;
BA_ "GenSigSendType" SG_ 120 ReSideRdrLeDetn164RdrDetnCntr 0;
BA_ "GenSigSendType" SG_ 120 ReSideRdrLeDetn164RdrDetnConf 0;
BA_ "GenSigSendType" SG_ 120 ReSideRdrLeDetn164RdrDetnElevn 0;
BA_ "GenSigStartValue" SG_ 120 ReSideRdrLeDetn164RdrDetnElevn 15;
BA_ "GenSigSendType" SG_ 120 ReSideRdrLeDetn164RdrDetnPwr 0;
BA_ "GenSigSendType" SG_ 120 ReSideRdrLeDetn164RdrDetnRng 0;
BA_ "GenSigStartValue" SG_ 120 ReSideRdrLeDetn164RdrDetnRng 10050;
BA_ "GenSigSendType" SG_ 120 ReSideRdrLeDetn164RdrDetnRngV 0;
BA_ "GenSigStartValue" SG_ 120 ReSideRdrLeDetn164RdrDetnRngV 4000;
BA_ "GenSigSendType" SG_ 120 ReSideRdrLeDetn164RdrDetnSameRV 0;
BA_ "GenSigSendType" SG_ 120 ReSideRdrLeDetn164RdrDetnSts 0;
BA_ "GenSigStartValue" SG_ 120 ReSideRdrLeDetn164RdrDetnSts 3;
BA_ "GenSigSendType" SG_ 120 ReSideRdrLeDetn165RdrDetnAmbigState 0;
BA_ "GenSigSendType" SG_ 120 ReSideRdrLeDetn165RdrDetnAssoTrkID 0;
BA_ "GenSigSendType" SG_ 120 ReSideRdrLeDetn165RdrDetnAzi 0;
BA_ "GenSigStartValue" SG_ 120 ReSideRdrLeDetn165RdrDetnAzi 900;
BA_ "GenSigDataID" SG_ 120 ReSideRdrLeDetn165RdrDetnChks "0x1101";
BA_ "GenSigFuncType" SG_ 120 ReSideRdrLeDetn165RdrDetnChks 15;
BA_ "GenSigSendType" SG_ 120 ReSideRdrLeDetn165RdrDetnChks 0;
BA_ "GenSigFuncType" SG_ 120 ReSideRdrLeDetn165RdrDetnCntr 16;
BA_ "GenSigSendType" SG_ 120 ReSideRdrLeDetn165RdrDetnCntr 0;
BA_ "GenSigSendType" SG_ 120 ReSideRdrLeDetn165RdrDetnConf 0;
BA_ "GenSigSendType" SG_ 120 ReSideRdrLeDetn165RdrDetnElevn 0;
BA_ "GenSigStartValue" SG_ 120 ReSideRdrLeDetn165RdrDetnElevn 15;
BA_ "GenSigSendType" SG_ 120 ReSideRdrLeDetn165RdrDetnPwr 0;
BA_ "GenSigSendType" SG_ 120 ReSideRdrLeDetn165RdrDetnRng 0;
BA_ "GenSigStartValue" SG_ 120 ReSideRdrLeDetn165RdrDetnRng 10050;
BA_ "GenSigSendType" SG_ 120 ReSideRdrLeDetn165RdrDetnRngV 0;
BA_ "GenSigStartValue" SG_ 120 ReSideRdrLeDetn165RdrDetnRngV 4000;
BA_ "GenSigSendType" SG_ 120 ReSideRdrLeDetn165RdrDetnSameRV 0;
BA_ "GenSigSendType" SG_ 120 ReSideRdrLeDetn165RdrDetnSts 0;
BA_ "GenSigStartValue" SG_ 120 ReSideRdrLeDetn165RdrDetnSts 3;
BA_ "GenSigSendType" SG_ 120 ReSideRdrLeDetn166RdrDetnAmbigState 0;
BA_ "GenSigSendType" SG_ 120 ReSideRdrLeDetn166RdrDetnAssoTrkID 0;
BA_ "GenSigSendType" SG_ 120 ReSideRdrLeDetn166RdrDetnAzi 0;
BA_ "GenSigStartValue" SG_ 120 ReSideRdrLeDetn166RdrDetnAzi 900;
BA_ "GenSigDataID" SG_ 120 ReSideRdrLeDetn166RdrDetnChks "0x1102";
BA_ "GenSigFuncType" SG_ 120 ReSideRdrLeDetn166RdrDetnChks 15;
BA_ "GenSigSendType" SG_ 120 ReSideRdrLeDetn166RdrDetnChks 0;
BA_ "GenSigFuncType" SG_ 120 ReSideRdrLeDetn166RdrDetnCntr 16;
BA_ "GenSigSendType" SG_ 120 ReSideRdrLeDetn166RdrDetnCntr 0;
BA_ "GenSigSendType" SG_ 120 ReSideRdrLeDetn166RdrDetnConf 0;
BA_ "GenSigSendType" SG_ 120 ReSideRdrLeDetn166RdrDetnElevn 0;
BA_ "GenSigStartValue" SG_ 120 ReSideRdrLeDetn166RdrDetnElevn 15;
BA_ "GenSigSendType" SG_ 120 ReSideRdrLeDetn166RdrDetnPwr 0;
BA_ "GenSigSendType" SG_ 120 ReSideRdrLeDetn166RdrDetnRng 0;
BA_ "GenSigStartValue" SG_ 120 ReSideRdrLeDetn166RdrDetnRng 10050;
BA_ "GenSigSendType" SG_ 120 ReSideRdrLeDetn166RdrDetnRngV 0;
BA_ "GenSigStartValue" SG_ 120 ReSideRdrLeDetn166RdrDetnRngV 4000;
BA_ "GenSigSendType" SG_ 120 ReSideRdrLeDetn166RdrDetnSameRV 0;
BA_ "GenSigSendType" SG_ 120 ReSideRdrLeDetn166RdrDetnSts 0;
BA_ "GenSigStartValue" SG_ 120 ReSideRdrLeDetn166RdrDetnSts 3;
BA_ "GenSigSendType" SG_ 120 ReSideRdrLeDetn167RdrDetnAmbigState 0;
BA_ "GenSigSendType" SG_ 120 ReSideRdrLeDetn167RdrDetnAssoTrkID 0;
BA_ "GenSigSendType" SG_ 120 ReSideRdrLeDetn167RdrDetnAzi 0;
BA_ "GenSigStartValue" SG_ 120 ReSideRdrLeDetn167RdrDetnAzi 900;
BA_ "GenSigDataID" SG_ 120 ReSideRdrLeDetn167RdrDetnChks "0x1103";
BA_ "GenSigFuncType" SG_ 120 ReSideRdrLeDetn167RdrDetnChks 15;
BA_ "GenSigSendType" SG_ 120 ReSideRdrLeDetn167RdrDetnChks 0;
BA_ "GenSigFuncType" SG_ 120 ReSideRdrLeDetn167RdrDetnCntr 16;
BA_ "GenSigSendType" SG_ 120 ReSideRdrLeDetn167RdrDetnCntr 0;
BA_ "GenSigSendType" SG_ 120 ReSideRdrLeDetn167RdrDetnConf 0;
BA_ "GenSigSendType" SG_ 120 ReSideRdrLeDetn167RdrDetnElevn 0;
BA_ "GenSigStartValue" SG_ 120 ReSideRdrLeDetn167RdrDetnElevn 15;
BA_ "GenSigSendType" SG_ 120 ReSideRdrLeDetn167RdrDetnPwr 0;
BA_ "GenSigSendType" SG_ 120 ReSideRdrLeDetn167RdrDetnRng 0;
BA_ "GenSigStartValue" SG_ 120 ReSideRdrLeDetn167RdrDetnRng 10050;
BA_ "GenSigSendType" SG_ 120 ReSideRdrLeDetn167RdrDetnRngV 0;
BA_ "GenSigStartValue" SG_ 120 ReSideRdrLeDetn167RdrDetnRngV 4000;
BA_ "GenSigSendType" SG_ 120 ReSideRdrLeDetn167RdrDetnSameRV 0;
BA_ "GenSigSendType" SG_ 120 ReSideRdrLeDetn167RdrDetnSts 0;
BA_ "GenSigStartValue" SG_ 120 ReSideRdrLeDetn167RdrDetnSts 3;
BA_ "GenSigSendType" SG_ 120 ReSideRdrLeDetn168RdrDetnAmbigState 0;
BA_ "GenSigSendType" SG_ 120 ReSideRdrLeDetn168RdrDetnAssoTrkID 0;
BA_ "GenSigSendType" SG_ 120 ReSideRdrLeDetn168RdrDetnAzi 0;
BA_ "GenSigStartValue" SG_ 120 ReSideRdrLeDetn168RdrDetnAzi 900;
BA_ "GenSigDataID" SG_ 120 ReSideRdrLeDetn168RdrDetnChks "0x1104";
BA_ "GenSigFuncType" SG_ 120 ReSideRdrLeDetn168RdrDetnChks 15;
BA_ "GenSigSendType" SG_ 120 ReSideRdrLeDetn168RdrDetnChks 0;
BA_ "GenSigFuncType" SG_ 120 ReSideRdrLeDetn168RdrDetnCntr 16;
BA_ "GenSigSendType" SG_ 120 ReSideRdrLeDetn168RdrDetnCntr 0;
BA_ "GenSigSendType" SG_ 120 ReSideRdrLeDetn168RdrDetnConf 0;
BA_ "GenSigSendType" SG_ 120 ReSideRdrLeDetn168RdrDetnElevn 0;
BA_ "GenSigStartValue" SG_ 120 ReSideRdrLeDetn168RdrDetnElevn 15;
BA_ "GenSigSendType" SG_ 120 ReSideRdrLeDetn168RdrDetnPwr 0;
BA_ "GenSigSendType" SG_ 120 ReSideRdrLeDetn168RdrDetnRng 0;
BA_ "GenSigStartValue" SG_ 120 ReSideRdrLeDetn168RdrDetnRng 10050;
BA_ "GenSigSendType" SG_ 120 ReSideRdrLeDetn168RdrDetnRngV 0;
BA_ "GenSigStartValue" SG_ 120 ReSideRdrLeDetn168RdrDetnRngV 4000;
BA_ "GenSigSendType" SG_ 120 ReSideRdrLeDetn168RdrDetnSameRV 0;
BA_ "GenSigSendType" SG_ 120 ReSideRdrLeDetn168RdrDetnSts 0;
BA_ "GenSigStartValue" SG_ 120 ReSideRdrLeDetn168RdrDetnSts 3;
BA_ "GenSigSendType" SG_ 121 ReSideRdrLeDetn169RdrDetnAmbigState 0;
BA_ "GenSigSendType" SG_ 121 ReSideRdrLeDetn169RdrDetnAssoTrkID 0;
BA_ "GenSigSendType" SG_ 121 ReSideRdrLeDetn169RdrDetnAzi 0;
BA_ "GenSigStartValue" SG_ 121 ReSideRdrLeDetn169RdrDetnAzi 900;
BA_ "GenSigDataID" SG_ 121 ReSideRdrLeDetn169RdrDetnChks "0x1105";
BA_ "GenSigFuncType" SG_ 121 ReSideRdrLeDetn169RdrDetnChks 15;
BA_ "GenSigSendType" SG_ 121 ReSideRdrLeDetn169RdrDetnChks 0;
BA_ "GenSigFuncType" SG_ 121 ReSideRdrLeDetn169RdrDetnCntr 16;
BA_ "GenSigSendType" SG_ 121 ReSideRdrLeDetn169RdrDetnCntr 0;
BA_ "GenSigSendType" SG_ 121 ReSideRdrLeDetn169RdrDetnConf 0;
BA_ "GenSigSendType" SG_ 121 ReSideRdrLeDetn169RdrDetnElevn 0;
BA_ "GenSigStartValue" SG_ 121 ReSideRdrLeDetn169RdrDetnElevn 15;
BA_ "GenSigSendType" SG_ 121 ReSideRdrLeDetn169RdrDetnPwr 0;
BA_ "GenSigSendType" SG_ 121 ReSideRdrLeDetn169RdrDetnRng 0;
BA_ "GenSigStartValue" SG_ 121 ReSideRdrLeDetn169RdrDetnRng 10050;
BA_ "GenSigSendType" SG_ 121 ReSideRdrLeDetn169RdrDetnRngV 0;
BA_ "GenSigStartValue" SG_ 121 ReSideRdrLeDetn169RdrDetnRngV 4000;
BA_ "GenSigSendType" SG_ 121 ReSideRdrLeDetn169RdrDetnSameRV 0;
BA_ "GenSigSendType" SG_ 121 ReSideRdrLeDetn169RdrDetnSts 0;
BA_ "GenSigStartValue" SG_ 121 ReSideRdrLeDetn169RdrDetnSts 3;
BA_ "GenSigSendType" SG_ 121 ReSideRdrLeDetn170RdrDetnAmbigState 0;
BA_ "GenSigSendType" SG_ 121 ReSideRdrLeDetn170RdrDetnAssoTrkID 0;
BA_ "GenSigSendType" SG_ 121 ReSideRdrLeDetn170RdrDetnAzi 0;
BA_ "GenSigStartValue" SG_ 121 ReSideRdrLeDetn170RdrDetnAzi 900;
BA_ "GenSigDataID" SG_ 121 ReSideRdrLeDetn170RdrDetnChks "0x1106";
BA_ "GenSigFuncType" SG_ 121 ReSideRdrLeDetn170RdrDetnChks 15;
BA_ "GenSigSendType" SG_ 121 ReSideRdrLeDetn170RdrDetnChks 0;
BA_ "GenSigFuncType" SG_ 121 ReSideRdrLeDetn170RdrDetnCntr 16;
BA_ "GenSigSendType" SG_ 121 ReSideRdrLeDetn170RdrDetnCntr 0;
BA_ "GenSigSendType" SG_ 121 ReSideRdrLeDetn170RdrDetnConf 0;
BA_ "GenSigSendType" SG_ 121 ReSideRdrLeDetn170RdrDetnElevn 0;
BA_ "GenSigStartValue" SG_ 121 ReSideRdrLeDetn170RdrDetnElevn 15;
BA_ "GenSigSendType" SG_ 121 ReSideRdrLeDetn170RdrDetnPwr 0;
BA_ "GenSigSendType" SG_ 121 ReSideRdrLeDetn170RdrDetnRng 0;
BA_ "GenSigStartValue" SG_ 121 ReSideRdrLeDetn170RdrDetnRng 10050;
BA_ "GenSigSendType" SG_ 121 ReSideRdrLeDetn170RdrDetnRngV 0;
BA_ "GenSigStartValue" SG_ 121 ReSideRdrLeDetn170RdrDetnRngV 4000;
BA_ "GenSigSendType" SG_ 121 ReSideRdrLeDetn170RdrDetnSameRV 0;
BA_ "GenSigSendType" SG_ 121 ReSideRdrLeDetn170RdrDetnSts 0;
BA_ "GenSigStartValue" SG_ 121 ReSideRdrLeDetn170RdrDetnSts 3;
BA_ "GenSigSendType" SG_ 121 ReSideRdrLeDetn171RdrDetnAmbigState 0;
BA_ "GenSigSendType" SG_ 121 ReSideRdrLeDetn171RdrDetnAssoTrkID 0;
BA_ "GenSigSendType" SG_ 121 ReSideRdrLeDetn171RdrDetnAzi 0;
BA_ "GenSigStartValue" SG_ 121 ReSideRdrLeDetn171RdrDetnAzi 900;
BA_ "GenSigDataID" SG_ 121 ReSideRdrLeDetn171RdrDetnChks "0x1230";
BA_ "GenSigFuncType" SG_ 121 ReSideRdrLeDetn171RdrDetnChks 15;
BA_ "GenSigSendType" SG_ 121 ReSideRdrLeDetn171RdrDetnChks 0;
BA_ "GenSigFuncType" SG_ 121 ReSideRdrLeDetn171RdrDetnCntr 16;
BA_ "GenSigSendType" SG_ 121 ReSideRdrLeDetn171RdrDetnCntr 0;
BA_ "GenSigSendType" SG_ 121 ReSideRdrLeDetn171RdrDetnConf 0;
BA_ "GenSigSendType" SG_ 121 ReSideRdrLeDetn171RdrDetnElevn 0;
BA_ "GenSigStartValue" SG_ 121 ReSideRdrLeDetn171RdrDetnElevn 15;
BA_ "GenSigSendType" SG_ 121 ReSideRdrLeDetn171RdrDetnPwr 0;
BA_ "GenSigSendType" SG_ 121 ReSideRdrLeDetn171RdrDetnRng 0;
BA_ "GenSigStartValue" SG_ 121 ReSideRdrLeDetn171RdrDetnRng 10050;
BA_ "GenSigSendType" SG_ 121 ReSideRdrLeDetn171RdrDetnRngV 0;
BA_ "GenSigStartValue" SG_ 121 ReSideRdrLeDetn171RdrDetnRngV 4000;
BA_ "GenSigSendType" SG_ 121 ReSideRdrLeDetn171RdrDetnSameRV 0;
BA_ "GenSigSendType" SG_ 121 ReSideRdrLeDetn171RdrDetnSts 0;
BA_ "GenSigStartValue" SG_ 121 ReSideRdrLeDetn171RdrDetnSts 3;
BA_ "GenSigSendType" SG_ 121 ReSideRdrLeDetn172RdrDetnAmbigState 0;
BA_ "GenSigSendType" SG_ 121 ReSideRdrLeDetn172RdrDetnAssoTrkID 0;
BA_ "GenSigSendType" SG_ 121 ReSideRdrLeDetn172RdrDetnAzi 0;
BA_ "GenSigStartValue" SG_ 121 ReSideRdrLeDetn172RdrDetnAzi 900;
BA_ "GenSigDataID" SG_ 121 ReSideRdrLeDetn172RdrDetnChks "0x1108";
BA_ "GenSigFuncType" SG_ 121 ReSideRdrLeDetn172RdrDetnChks 15;
BA_ "GenSigSendType" SG_ 121 ReSideRdrLeDetn172RdrDetnChks 0;
BA_ "GenSigFuncType" SG_ 121 ReSideRdrLeDetn172RdrDetnCntr 16;
BA_ "GenSigSendType" SG_ 121 ReSideRdrLeDetn172RdrDetnCntr 0;
BA_ "GenSigSendType" SG_ 121 ReSideRdrLeDetn172RdrDetnConf 0;
BA_ "GenSigSendType" SG_ 121 ReSideRdrLeDetn172RdrDetnElevn 0;
BA_ "GenSigStartValue" SG_ 121 ReSideRdrLeDetn172RdrDetnElevn 15;
BA_ "GenSigSendType" SG_ 121 ReSideRdrLeDetn172RdrDetnPwr 0;
BA_ "GenSigSendType" SG_ 121 ReSideRdrLeDetn172RdrDetnRng 0;
BA_ "GenSigStartValue" SG_ 121 ReSideRdrLeDetn172RdrDetnRng 10050;
BA_ "GenSigSendType" SG_ 121 ReSideRdrLeDetn172RdrDetnRngV 0;
BA_ "GenSigStartValue" SG_ 121 ReSideRdrLeDetn172RdrDetnRngV 4000;
BA_ "GenSigSendType" SG_ 121 ReSideRdrLeDetn172RdrDetnSameRV 0;
BA_ "GenSigSendType" SG_ 121 ReSideRdrLeDetn172RdrDetnSts 0;
BA_ "GenSigStartValue" SG_ 121 ReSideRdrLeDetn172RdrDetnSts 3;
BA_ "GenSigSendType" SG_ 121 ReSideRdrLeDetn173RdrDetnAmbigState 0;
BA_ "GenSigSendType" SG_ 121 ReSideRdrLeDetn173RdrDetnAssoTrkID 0;
BA_ "GenSigSendType" SG_ 121 ReSideRdrLeDetn173RdrDetnAzi 0;
BA_ "GenSigStartValue" SG_ 121 ReSideRdrLeDetn173RdrDetnAzi 900;
BA_ "GenSigDataID" SG_ 121 ReSideRdrLeDetn173RdrDetnChks "0x1232";
BA_ "GenSigFuncType" SG_ 121 ReSideRdrLeDetn173RdrDetnChks 15;
BA_ "GenSigSendType" SG_ 121 ReSideRdrLeDetn173RdrDetnChks 0;
BA_ "GenSigFuncType" SG_ 121 ReSideRdrLeDetn173RdrDetnCntr 16;
BA_ "GenSigSendType" SG_ 121 ReSideRdrLeDetn173RdrDetnCntr 0;
BA_ "GenSigSendType" SG_ 121 ReSideRdrLeDetn173RdrDetnConf 0;
BA_ "GenSigSendType" SG_ 121 ReSideRdrLeDetn173RdrDetnElevn 0;
BA_ "GenSigStartValue" SG_ 121 ReSideRdrLeDetn173RdrDetnElevn 15;
BA_ "GenSigSendType" SG_ 121 ReSideRdrLeDetn173RdrDetnPwr 0;
BA_ "GenSigSendType" SG_ 121 ReSideRdrLeDetn173RdrDetnRng 0;
BA_ "GenSigStartValue" SG_ 121 ReSideRdrLeDetn173RdrDetnRng 10050;
BA_ "GenSigSendType" SG_ 121 ReSideRdrLeDetn173RdrDetnRngV 0;
BA_ "GenSigStartValue" SG_ 121 ReSideRdrLeDetn173RdrDetnRngV 4000;
BA_ "GenSigSendType" SG_ 121 ReSideRdrLeDetn173RdrDetnSameRV 0;
BA_ "GenSigSendType" SG_ 121 ReSideRdrLeDetn173RdrDetnSts 0;
BA_ "GenSigStartValue" SG_ 121 ReSideRdrLeDetn173RdrDetnSts 3;
BA_ "GenSigSendType" SG_ 121 ReSideRdrLeDetn174RdrDetnAmbigState 0;
BA_ "GenSigSendType" SG_ 121 ReSideRdrLeDetn174RdrDetnAssoTrkID 0;
BA_ "GenSigSendType" SG_ 121 ReSideRdrLeDetn174RdrDetnAzi 0;
BA_ "GenSigStartValue" SG_ 121 ReSideRdrLeDetn174RdrDetnAzi 900;
BA_ "GenSigDataID" SG_ 121 ReSideRdrLeDetn174RdrDetnChks "0x110A";
BA_ "GenSigFuncType" SG_ 121 ReSideRdrLeDetn174RdrDetnChks 15;
BA_ "GenSigSendType" SG_ 121 ReSideRdrLeDetn174RdrDetnChks 0;
BA_ "GenSigFuncType" SG_ 121 ReSideRdrLeDetn174RdrDetnCntr 16;
BA_ "GenSigSendType" SG_ 121 ReSideRdrLeDetn174RdrDetnCntr 0;
BA_ "GenSigSendType" SG_ 121 ReSideRdrLeDetn174RdrDetnConf 0;
BA_ "GenSigSendType" SG_ 121 ReSideRdrLeDetn174RdrDetnElevn 0;
BA_ "GenSigStartValue" SG_ 121 ReSideRdrLeDetn174RdrDetnElevn 15;
BA_ "GenSigSendType" SG_ 121 ReSideRdrLeDetn174RdrDetnPwr 0;
BA_ "GenSigSendType" SG_ 121 ReSideRdrLeDetn174RdrDetnRng 0;
BA_ "GenSigStartValue" SG_ 121 ReSideRdrLeDetn174RdrDetnRng 10050;
BA_ "GenSigSendType" SG_ 121 ReSideRdrLeDetn174RdrDetnRngV 0;
BA_ "GenSigStartValue" SG_ 121 ReSideRdrLeDetn174RdrDetnRngV 4000;
BA_ "GenSigSendType" SG_ 121 ReSideRdrLeDetn174RdrDetnSameRV 0;
BA_ "GenSigSendType" SG_ 121 ReSideRdrLeDetn174RdrDetnSts 0;
BA_ "GenSigStartValue" SG_ 121 ReSideRdrLeDetn174RdrDetnSts 3;
BA_ "GenSigSendType" SG_ 128 ReSideRdrLeDetn175RdrDetnAmbigState 0;
BA_ "GenSigSendType" SG_ 128 ReSideRdrLeDetn175RdrDetnAssoTrkID 0;
BA_ "GenSigSendType" SG_ 128 ReSideRdrLeDetn175RdrDetnAzi 0;
BA_ "GenSigStartValue" SG_ 128 ReSideRdrLeDetn175RdrDetnAzi 900;
BA_ "GenSigDataID" SG_ 128 ReSideRdrLeDetn175RdrDetnChks "0x1231";
BA_ "GenSigFuncType" SG_ 128 ReSideRdrLeDetn175RdrDetnChks 15;
BA_ "GenSigSendType" SG_ 128 ReSideRdrLeDetn175RdrDetnChks 0;
BA_ "GenSigFuncType" SG_ 128 ReSideRdrLeDetn175RdrDetnCntr 16;
BA_ "GenSigSendType" SG_ 128 ReSideRdrLeDetn175RdrDetnCntr 0;
BA_ "GenSigSendType" SG_ 128 ReSideRdrLeDetn175RdrDetnConf 0;
BA_ "GenSigSendType" SG_ 128 ReSideRdrLeDetn175RdrDetnElevn 0;
BA_ "GenSigStartValue" SG_ 128 ReSideRdrLeDetn175RdrDetnElevn 15;
BA_ "GenSigSendType" SG_ 128 ReSideRdrLeDetn175RdrDetnPwr 0;
BA_ "GenSigSendType" SG_ 128 ReSideRdrLeDetn175RdrDetnRng 0;
BA_ "GenSigStartValue" SG_ 128 ReSideRdrLeDetn175RdrDetnRng 10050;
BA_ "GenSigSendType" SG_ 128 ReSideRdrLeDetn175RdrDetnRngV 0;
BA_ "GenSigStartValue" SG_ 128 ReSideRdrLeDetn175RdrDetnRngV 4000;
BA_ "GenSigSendType" SG_ 128 ReSideRdrLeDetn175RdrDetnSameRV 0;
BA_ "GenSigSendType" SG_ 128 ReSideRdrLeDetn175RdrDetnSts 0;
BA_ "GenSigStartValue" SG_ 128 ReSideRdrLeDetn175RdrDetnSts 3;
BA_ "GenSigSendType" SG_ 128 ReSideRdrLeDetn176RdrDetnAmbigState 0;
BA_ "GenSigSendType" SG_ 128 ReSideRdrLeDetn176RdrDetnAssoTrkID 0;
BA_ "GenSigSendType" SG_ 128 ReSideRdrLeDetn176RdrDetnAzi 0;
BA_ "GenSigStartValue" SG_ 128 ReSideRdrLeDetn176RdrDetnAzi 900;
BA_ "GenSigDataID" SG_ 128 ReSideRdrLeDetn176RdrDetnChks "0x110C";
BA_ "GenSigFuncType" SG_ 128 ReSideRdrLeDetn176RdrDetnChks 15;
BA_ "GenSigSendType" SG_ 128 ReSideRdrLeDetn176RdrDetnChks 0;
BA_ "GenSigFuncType" SG_ 128 ReSideRdrLeDetn176RdrDetnCntr 16;
BA_ "GenSigSendType" SG_ 128 ReSideRdrLeDetn176RdrDetnCntr 0;
BA_ "GenSigSendType" SG_ 128 ReSideRdrLeDetn176RdrDetnConf 0;
BA_ "GenSigSendType" SG_ 128 ReSideRdrLeDetn176RdrDetnElevn 0;
BA_ "GenSigStartValue" SG_ 128 ReSideRdrLeDetn176RdrDetnElevn 15;
BA_ "GenSigSendType" SG_ 128 ReSideRdrLeDetn176RdrDetnPwr 0;
BA_ "GenSigSendType" SG_ 128 ReSideRdrLeDetn176RdrDetnRng 0;
BA_ "GenSigStartValue" SG_ 128 ReSideRdrLeDetn176RdrDetnRng 10050;
BA_ "GenSigSendType" SG_ 128 ReSideRdrLeDetn176RdrDetnRngV 0;
BA_ "GenSigStartValue" SG_ 128 ReSideRdrLeDetn176RdrDetnRngV 4000;
BA_ "GenSigSendType" SG_ 128 ReSideRdrLeDetn176RdrDetnSameRV 0;
BA_ "GenSigSendType" SG_ 128 ReSideRdrLeDetn176RdrDetnSts 0;
BA_ "GenSigStartValue" SG_ 128 ReSideRdrLeDetn176RdrDetnSts 3;
BA_ "GenSigSendType" SG_ 128 ReSideRdrLeDetn177RdrDetnAmbigState 0;
BA_ "GenSigSendType" SG_ 128 ReSideRdrLeDetn177RdrDetnAssoTrkID 0;
BA_ "GenSigSendType" SG_ 128 ReSideRdrLeDetn177RdrDetnAzi 0;
BA_ "GenSigStartValue" SG_ 128 ReSideRdrLeDetn177RdrDetnAzi 900;
BA_ "GenSigDataID" SG_ 128 ReSideRdrLeDetn177RdrDetnChks "0x122F";
BA_ "GenSigFuncType" SG_ 128 ReSideRdrLeDetn177RdrDetnChks 15;
BA_ "GenSigSendType" SG_ 128 ReSideRdrLeDetn177RdrDetnChks 0;
BA_ "GenSigFuncType" SG_ 128 ReSideRdrLeDetn177RdrDetnCntr 16;
BA_ "GenSigSendType" SG_ 128 ReSideRdrLeDetn177RdrDetnCntr 0;
BA_ "GenSigSendType" SG_ 128 ReSideRdrLeDetn177RdrDetnConf 0;
BA_ "GenSigSendType" SG_ 128 ReSideRdrLeDetn177RdrDetnElevn 0;
BA_ "GenSigStartValue" SG_ 128 ReSideRdrLeDetn177RdrDetnElevn 15;
BA_ "GenSigSendType" SG_ 128 ReSideRdrLeDetn177RdrDetnPwr 0;
BA_ "GenSigSendType" SG_ 128 ReSideRdrLeDetn177RdrDetnRng 0;
BA_ "GenSigStartValue" SG_ 128 ReSideRdrLeDetn177RdrDetnRng 10050;
BA_ "GenSigSendType" SG_ 128 ReSideRdrLeDetn177RdrDetnRngV 0;
BA_ "GenSigStartValue" SG_ 128 ReSideRdrLeDetn177RdrDetnRngV 4000;
BA_ "GenSigSendType" SG_ 128 ReSideRdrLeDetn177RdrDetnSameRV 0;
BA_ "GenSigSendType" SG_ 128 ReSideRdrLeDetn177RdrDetnSts 0;
BA_ "GenSigStartValue" SG_ 128 ReSideRdrLeDetn177RdrDetnSts 3;
BA_ "GenSigSendType" SG_ 128 ReSideRdrLeDetn178RdrDetnAmbigState 0;
BA_ "GenSigSendType" SG_ 128 ReSideRdrLeDetn178RdrDetnAssoTrkID 0;
BA_ "GenSigSendType" SG_ 128 ReSideRdrLeDetn178RdrDetnAzi 0;
BA_ "GenSigStartValue" SG_ 128 ReSideRdrLeDetn178RdrDetnAzi 900;
BA_ "GenSigDataID" SG_ 128 ReSideRdrLeDetn178RdrDetnChks "0x110E";
BA_ "GenSigFuncType" SG_ 128 ReSideRdrLeDetn178RdrDetnChks 15;
BA_ "GenSigSendType" SG_ 128 ReSideRdrLeDetn178RdrDetnChks 0;
BA_ "GenSigFuncType" SG_ 128 ReSideRdrLeDetn178RdrDetnCntr 16;
BA_ "GenSigSendType" SG_ 128 ReSideRdrLeDetn178RdrDetnCntr 0;
BA_ "GenSigSendType" SG_ 128 ReSideRdrLeDetn178RdrDetnConf 0;
BA_ "GenSigSendType" SG_ 128 ReSideRdrLeDetn178RdrDetnElevn 0;
BA_ "GenSigStartValue" SG_ 128 ReSideRdrLeDetn178RdrDetnElevn 15;
BA_ "GenSigSendType" SG_ 128 ReSideRdrLeDetn178RdrDetnPwr 0;
BA_ "GenSigSendType" SG_ 128 ReSideRdrLeDetn178RdrDetnRng 0;
BA_ "GenSigStartValue" SG_ 128 ReSideRdrLeDetn178RdrDetnRng 10050;
BA_ "GenSigSendType" SG_ 128 ReSideRdrLeDetn178RdrDetnRngV 0;
BA_ "GenSigStartValue" SG_ 128 ReSideRdrLeDetn178RdrDetnRngV 4000;
BA_ "GenSigSendType" SG_ 128 ReSideRdrLeDetn178RdrDetnSameRV 0;
BA_ "GenSigSendType" SG_ 128 ReSideRdrLeDetn178RdrDetnSts 0;
BA_ "GenSigStartValue" SG_ 128 ReSideRdrLeDetn178RdrDetnSts 3;
BA_ "GenSigSendType" SG_ 128 ReSideRdrLeDetn179RdrDetnAmbigState 0;
BA_ "GenSigSendType" SG_ 128 ReSideRdrLeDetn179RdrDetnAssoTrkID 0;
BA_ "GenSigSendType" SG_ 128 ReSideRdrLeDetn179RdrDetnAzi 0;
BA_ "GenSigStartValue" SG_ 128 ReSideRdrLeDetn179RdrDetnAzi 900;
BA_ "GenSigDataID" SG_ 128 ReSideRdrLeDetn179RdrDetnChks "0x110F";
BA_ "GenSigFuncType" SG_ 128 ReSideRdrLeDetn179RdrDetnChks 15;
BA_ "GenSigSendType" SG_ 128 ReSideRdrLeDetn179RdrDetnChks 0;
BA_ "GenSigFuncType" SG_ 128 ReSideRdrLeDetn179RdrDetnCntr 16;
BA_ "GenSigSendType" SG_ 128 ReSideRdrLeDetn179RdrDetnCntr 0;
BA_ "GenSigSendType" SG_ 128 ReSideRdrLeDetn179RdrDetnConf 0;
BA_ "GenSigSendType" SG_ 128 ReSideRdrLeDetn179RdrDetnElevn 0;
BA_ "GenSigStartValue" SG_ 128 ReSideRdrLeDetn179RdrDetnElevn 15;
BA_ "GenSigSendType" SG_ 128 ReSideRdrLeDetn179RdrDetnPwr 0;
BA_ "GenSigSendType" SG_ 128 ReSideRdrLeDetn179RdrDetnRng 0;
BA_ "GenSigStartValue" SG_ 128 ReSideRdrLeDetn179RdrDetnRng 10050;
BA_ "GenSigSendType" SG_ 128 ReSideRdrLeDetn179RdrDetnRngV 0;
BA_ "GenSigStartValue" SG_ 128 ReSideRdrLeDetn179RdrDetnRngV 4000;
BA_ "GenSigSendType" SG_ 128 ReSideRdrLeDetn179RdrDetnSameRV 0;
BA_ "GenSigSendType" SG_ 128 ReSideRdrLeDetn179RdrDetnSts 0;
BA_ "GenSigStartValue" SG_ 128 ReSideRdrLeDetn179RdrDetnSts 3;
BA_ "GenSigSendType" SG_ 128 ReSideRdrLeDetn180RdrDetnAmbigState 0;
BA_ "GenSigSendType" SG_ 128 ReSideRdrLeDetn180RdrDetnAssoTrkID 0;
BA_ "GenSigSendType" SG_ 128 ReSideRdrLeDetn180RdrDetnAzi 0;
BA_ "GenSigStartValue" SG_ 128 ReSideRdrLeDetn180RdrDetnAzi 900;
BA_ "GenSigDataID" SG_ 128 ReSideRdrLeDetn180RdrDetnChks "0x1110";
BA_ "GenSigFuncType" SG_ 128 ReSideRdrLeDetn180RdrDetnChks 15;
BA_ "GenSigSendType" SG_ 128 ReSideRdrLeDetn180RdrDetnChks 0;
BA_ "GenSigFuncType" SG_ 128 ReSideRdrLeDetn180RdrDetnCntr 16;
BA_ "GenSigSendType" SG_ 128 ReSideRdrLeDetn180RdrDetnCntr 0;
BA_ "GenSigSendType" SG_ 128 ReSideRdrLeDetn180RdrDetnConf 0;
BA_ "GenSigSendType" SG_ 128 ReSideRdrLeDetn180RdrDetnElevn 0;
BA_ "GenSigStartValue" SG_ 128 ReSideRdrLeDetn180RdrDetnElevn 15;
BA_ "GenSigSendType" SG_ 128 ReSideRdrLeDetn180RdrDetnPwr 0;
BA_ "GenSigSendType" SG_ 128 ReSideRdrLeDetn180RdrDetnRng 0;
BA_ "GenSigStartValue" SG_ 128 ReSideRdrLeDetn180RdrDetnRng 10050;
BA_ "GenSigSendType" SG_ 128 ReSideRdrLeDetn180RdrDetnRngV 0;
BA_ "GenSigStartValue" SG_ 128 ReSideRdrLeDetn180RdrDetnRngV 4000;
BA_ "GenSigSendType" SG_ 128 ReSideRdrLeDetn180RdrDetnSameRV 0;
BA_ "GenSigSendType" SG_ 128 ReSideRdrLeDetn180RdrDetnSts 0;
BA_ "GenSigStartValue" SG_ 128 ReSideRdrLeDetn180RdrDetnSts 3;
BA_ "GenSigSendType" SG_ 129 ReSideRdrLeDetn181RdrDetnAmbigState 0;
BA_ "GenSigSendType" SG_ 129 ReSideRdrLeDetn181RdrDetnAssoTrkID 0;
BA_ "GenSigSendType" SG_ 129 ReSideRdrLeDetn181RdrDetnAzi 0;
BA_ "GenSigStartValue" SG_ 129 ReSideRdrLeDetn181RdrDetnAzi 900;
BA_ "GenSigDataID" SG_ 129 ReSideRdrLeDetn181RdrDetnChks "0x1111";
BA_ "GenSigFuncType" SG_ 129 ReSideRdrLeDetn181RdrDetnChks 15;
BA_ "GenSigSendType" SG_ 129 ReSideRdrLeDetn181RdrDetnChks 0;
BA_ "GenSigFuncType" SG_ 129 ReSideRdrLeDetn181RdrDetnCntr 16;
BA_ "GenSigSendType" SG_ 129 ReSideRdrLeDetn181RdrDetnCntr 0;
BA_ "GenSigSendType" SG_ 129 ReSideRdrLeDetn181RdrDetnConf 0;
BA_ "GenSigSendType" SG_ 129 ReSideRdrLeDetn181RdrDetnElevn 0;
BA_ "GenSigStartValue" SG_ 129 ReSideRdrLeDetn181RdrDetnElevn 15;
BA_ "GenSigSendType" SG_ 129 ReSideRdrLeDetn181RdrDetnPwr 0;
BA_ "GenSigSendType" SG_ 129 ReSideRdrLeDetn181RdrDetnRng 0;
BA_ "GenSigStartValue" SG_ 129 ReSideRdrLeDetn181RdrDetnRng 10050;
BA_ "GenSigSendType" SG_ 129 ReSideRdrLeDetn181RdrDetnRngV 0;
BA_ "GenSigStartValue" SG_ 129 ReSideRdrLeDetn181RdrDetnRngV 4000;
BA_ "GenSigSendType" SG_ 129 ReSideRdrLeDetn181RdrDetnSameRV 0;
BA_ "GenSigSendType" SG_ 129 ReSideRdrLeDetn181RdrDetnSts 0;
BA_ "GenSigStartValue" SG_ 129 ReSideRdrLeDetn181RdrDetnSts 3;
BA_ "GenSigSendType" SG_ 129 ReSideRdrLeDetn182RdrDetnAmbigState 0;
BA_ "GenSigSendType" SG_ 129 ReSideRdrLeDetn182RdrDetnAssoTrkID 0;
BA_ "GenSigSendType" SG_ 129 ReSideRdrLeDetn182RdrDetnAzi 0;
BA_ "GenSigStartValue" SG_ 129 ReSideRdrLeDetn182RdrDetnAzi 900;
BA_ "GenSigDataID" SG_ 129 ReSideRdrLeDetn182RdrDetnChks "0x1112";
BA_ "GenSigFuncType" SG_ 129 ReSideRdrLeDetn182RdrDetnChks 15;
BA_ "GenSigSendType" SG_ 129 ReSideRdrLeDetn182RdrDetnChks 0;
BA_ "GenSigFuncType" SG_ 129 ReSideRdrLeDetn182RdrDetnCntr 16;
BA_ "GenSigSendType" SG_ 129 ReSideRdrLeDetn182RdrDetnCntr 0;
BA_ "GenSigSendType" SG_ 129 ReSideRdrLeDetn182RdrDetnConf 0;
BA_ "GenSigSendType" SG_ 129 ReSideRdrLeDetn182RdrDetnElevn 0;
BA_ "GenSigStartValue" SG_ 129 ReSideRdrLeDetn182RdrDetnElevn 15;
BA_ "GenSigSendType" SG_ 129 ReSideRdrLeDetn182RdrDetnPwr 0;
BA_ "GenSigSendType" SG_ 129 ReSideRdrLeDetn182RdrDetnRng 0;
BA_ "GenSigStartValue" SG_ 129 ReSideRdrLeDetn182RdrDetnRng 10050;
BA_ "GenSigSendType" SG_ 129 ReSideRdrLeDetn182RdrDetnRngV 0;
BA_ "GenSigStartValue" SG_ 129 ReSideRdrLeDetn182RdrDetnRngV 4000;
BA_ "GenSigSendType" SG_ 129 ReSideRdrLeDetn182RdrDetnSameRV 0;
BA_ "GenSigSendType" SG_ 129 ReSideRdrLeDetn182RdrDetnSts 0;
BA_ "GenSigStartValue" SG_ 129 ReSideRdrLeDetn182RdrDetnSts 3;
BA_ "GenSigSendType" SG_ 129 ReSideRdrLeDetn183RdrDetnAmbigState 0;
BA_ "GenSigSendType" SG_ 129 ReSideRdrLeDetn183RdrDetnAssoTrkID 0;
BA_ "GenSigSendType" SG_ 129 ReSideRdrLeDetn183RdrDetnAzi 0;
BA_ "GenSigStartValue" SG_ 129 ReSideRdrLeDetn183RdrDetnAzi 900;
BA_ "GenSigDataID" SG_ 129 ReSideRdrLeDetn183RdrDetnChks "0x1113";
BA_ "GenSigFuncType" SG_ 129 ReSideRdrLeDetn183RdrDetnChks 15;
BA_ "GenSigSendType" SG_ 129 ReSideRdrLeDetn183RdrDetnChks 0;
BA_ "GenSigFuncType" SG_ 129 ReSideRdrLeDetn183RdrDetnCntr 16;
BA_ "GenSigSendType" SG_ 129 ReSideRdrLeDetn183RdrDetnCntr 0;
BA_ "GenSigSendType" SG_ 129 ReSideRdrLeDetn183RdrDetnConf 0;
BA_ "GenSigSendType" SG_ 129 ReSideRdrLeDetn183RdrDetnElevn 0;
BA_ "GenSigStartValue" SG_ 129 ReSideRdrLeDetn183RdrDetnElevn 15;
BA_ "GenSigSendType" SG_ 129 ReSideRdrLeDetn183RdrDetnPwr 0;
BA_ "GenSigSendType" SG_ 129 ReSideRdrLeDetn183RdrDetnRng 0;
BA_ "GenSigStartValue" SG_ 129 ReSideRdrLeDetn183RdrDetnRng 10050;
BA_ "GenSigSendType" SG_ 129 ReSideRdrLeDetn183RdrDetnRngV 0;
BA_ "GenSigStartValue" SG_ 129 ReSideRdrLeDetn183RdrDetnRngV 4000;
BA_ "GenSigSendType" SG_ 129 ReSideRdrLeDetn183RdrDetnSameRV 0;
BA_ "GenSigSendType" SG_ 129 ReSideRdrLeDetn183RdrDetnSts 0;
BA_ "GenSigStartValue" SG_ 129 ReSideRdrLeDetn183RdrDetnSts 3;
BA_ "GenSigSendType" SG_ 129 ReSideRdrLeDetn184RdrDetnAmbigState 0;
BA_ "GenSigSendType" SG_ 129 ReSideRdrLeDetn184RdrDetnAssoTrkID 0;
BA_ "GenSigSendType" SG_ 129 ReSideRdrLeDetn184RdrDetnAzi 0;
BA_ "GenSigStartValue" SG_ 129 ReSideRdrLeDetn184RdrDetnAzi 900;
BA_ "GenSigDataID" SG_ 129 ReSideRdrLeDetn184RdrDetnChks "0x1114";
BA_ "GenSigFuncType" SG_ 129 ReSideRdrLeDetn184RdrDetnChks 15;
BA_ "GenSigSendType" SG_ 129 ReSideRdrLeDetn184RdrDetnChks 0;
BA_ "GenSigFuncType" SG_ 129 ReSideRdrLeDetn184RdrDetnCntr 16;
BA_ "GenSigSendType" SG_ 129 ReSideRdrLeDetn184RdrDetnCntr 0;
BA_ "GenSigSendType" SG_ 129 ReSideRdrLeDetn184RdrDetnConf 0;
BA_ "GenSigSendType" SG_ 129 ReSideRdrLeDetn184RdrDetnElevn 0;
BA_ "GenSigStartValue" SG_ 129 ReSideRdrLeDetn184RdrDetnElevn 15;
BA_ "GenSigSendType" SG_ 129 ReSideRdrLeDetn184RdrDetnPwr 0;
BA_ "GenSigSendType" SG_ 129 ReSideRdrLeDetn184RdrDetnRng 0;
BA_ "GenSigStartValue" SG_ 129 ReSideRdrLeDetn184RdrDetnRng 10050;
BA_ "GenSigSendType" SG_ 129 ReSideRdrLeDetn184RdrDetnRngV 0;
BA_ "GenSigStartValue" SG_ 129 ReSideRdrLeDetn184RdrDetnRngV 4000;
BA_ "GenSigSendType" SG_ 129 ReSideRdrLeDetn184RdrDetnSameRV 0;
BA_ "GenSigSendType" SG_ 129 ReSideRdrLeDetn184RdrDetnSts 0;
BA_ "GenSigStartValue" SG_ 129 ReSideRdrLeDetn184RdrDetnSts 3;
BA_ "GenSigSendType" SG_ 129 ReSideRdrLeDetn185RdrDetnAmbigState 0;
BA_ "GenSigSendType" SG_ 129 ReSideRdrLeDetn185RdrDetnAssoTrkID 0;
BA_ "GenSigSendType" SG_ 129 ReSideRdrLeDetn185RdrDetnAzi 0;
BA_ "GenSigStartValue" SG_ 129 ReSideRdrLeDetn185RdrDetnAzi 900;
BA_ "GenSigDataID" SG_ 129 ReSideRdrLeDetn185RdrDetnChks "0x1115";
BA_ "GenSigFuncType" SG_ 129 ReSideRdrLeDetn185RdrDetnChks 15;
BA_ "GenSigSendType" SG_ 129 ReSideRdrLeDetn185RdrDetnChks 0;
BA_ "GenSigFuncType" SG_ 129 ReSideRdrLeDetn185RdrDetnCntr 16;
BA_ "GenSigSendType" SG_ 129 ReSideRdrLeDetn185RdrDetnCntr 0;
BA_ "GenSigSendType" SG_ 129 ReSideRdrLeDetn185RdrDetnConf 0;
BA_ "GenSigSendType" SG_ 129 ReSideRdrLeDetn185RdrDetnElevn 0;
BA_ "GenSigStartValue" SG_ 129 ReSideRdrLeDetn185RdrDetnElevn 15;
BA_ "GenSigSendType" SG_ 129 ReSideRdrLeDetn185RdrDetnPwr 0;
BA_ "GenSigSendType" SG_ 129 ReSideRdrLeDetn185RdrDetnRng 0;
BA_ "GenSigStartValue" SG_ 129 ReSideRdrLeDetn185RdrDetnRng 10050;
BA_ "GenSigSendType" SG_ 129 ReSideRdrLeDetn185RdrDetnRngV 0;
BA_ "GenSigStartValue" SG_ 129 ReSideRdrLeDetn185RdrDetnRngV 4000;
BA_ "GenSigSendType" SG_ 129 ReSideRdrLeDetn185RdrDetnSameRV 0;
BA_ "GenSigSendType" SG_ 129 ReSideRdrLeDetn185RdrDetnSts 0;
BA_ "GenSigStartValue" SG_ 129 ReSideRdrLeDetn185RdrDetnSts 3;
BA_ "GenSigSendType" SG_ 129 ReSideRdrLeDetn186RdrDetnAmbigState 0;
BA_ "GenSigSendType" SG_ 129 ReSideRdrLeDetn186RdrDetnAssoTrkID 0;
BA_ "GenSigSendType" SG_ 129 ReSideRdrLeDetn186RdrDetnAzi 0;
BA_ "GenSigStartValue" SG_ 129 ReSideRdrLeDetn186RdrDetnAzi 900;
BA_ "GenSigDataID" SG_ 129 ReSideRdrLeDetn186RdrDetnChks "0x1228";
BA_ "GenSigFuncType" SG_ 129 ReSideRdrLeDetn186RdrDetnChks 15;
BA_ "GenSigSendType" SG_ 129 ReSideRdrLeDetn186RdrDetnChks 0;
BA_ "GenSigFuncType" SG_ 129 ReSideRdrLeDetn186RdrDetnCntr 16;
BA_ "GenSigSendType" SG_ 129 ReSideRdrLeDetn186RdrDetnCntr 0;
BA_ "GenSigSendType" SG_ 129 ReSideRdrLeDetn186RdrDetnConf 0;
BA_ "GenSigSendType" SG_ 129 ReSideRdrLeDetn186RdrDetnElevn 0;
BA_ "GenSigStartValue" SG_ 129 ReSideRdrLeDetn186RdrDetnElevn 15;
BA_ "GenSigSendType" SG_ 129 ReSideRdrLeDetn186RdrDetnPwr 0;
BA_ "GenSigSendType" SG_ 129 ReSideRdrLeDetn186RdrDetnRng 0;
BA_ "GenSigStartValue" SG_ 129 ReSideRdrLeDetn186RdrDetnRng 10050;
BA_ "GenSigSendType" SG_ 129 ReSideRdrLeDetn186RdrDetnRngV 0;
BA_ "GenSigStartValue" SG_ 129 ReSideRdrLeDetn186RdrDetnRngV 4000;
BA_ "GenSigSendType" SG_ 129 ReSideRdrLeDetn186RdrDetnSameRV 0;
BA_ "GenSigSendType" SG_ 129 ReSideRdrLeDetn186RdrDetnSts 0;
BA_ "GenSigStartValue" SG_ 129 ReSideRdrLeDetn186RdrDetnSts 3;
BA_ "GenSigSendType" SG_ 130 ReSideRdrLeDetn187RdrDetnAmbigState 0;
BA_ "GenSigSendType" SG_ 130 ReSideRdrLeDetn187RdrDetnAssoTrkID 0;
BA_ "GenSigSendType" SG_ 130 ReSideRdrLeDetn187RdrDetnAzi 0;
BA_ "GenSigStartValue" SG_ 130 ReSideRdrLeDetn187RdrDetnAzi 900;
BA_ "GenSigDataID" SG_ 130 ReSideRdrLeDetn187RdrDetnChks "0x1117";
BA_ "GenSigFuncType" SG_ 130 ReSideRdrLeDetn187RdrDetnChks 15;
BA_ "GenSigSendType" SG_ 130 ReSideRdrLeDetn187RdrDetnChks 0;
BA_ "GenSigFuncType" SG_ 130 ReSideRdrLeDetn187RdrDetnCntr 16;
BA_ "GenSigSendType" SG_ 130 ReSideRdrLeDetn187RdrDetnCntr 0;
BA_ "GenSigSendType" SG_ 130 ReSideRdrLeDetn187RdrDetnConf 0;
BA_ "GenSigSendType" SG_ 130 ReSideRdrLeDetn187RdrDetnElevn 0;
BA_ "GenSigStartValue" SG_ 130 ReSideRdrLeDetn187RdrDetnElevn 15;
BA_ "GenSigSendType" SG_ 130 ReSideRdrLeDetn187RdrDetnPwr 0;
BA_ "GenSigSendType" SG_ 130 ReSideRdrLeDetn187RdrDetnRng 0;
BA_ "GenSigStartValue" SG_ 130 ReSideRdrLeDetn187RdrDetnRng 10050;
BA_ "GenSigSendType" SG_ 130 ReSideRdrLeDetn187RdrDetnRngV 0;
BA_ "GenSigStartValue" SG_ 130 ReSideRdrLeDetn187RdrDetnRngV 4000;
BA_ "GenSigSendType" SG_ 130 ReSideRdrLeDetn187RdrDetnSameRV 0;
BA_ "GenSigSendType" SG_ 130 ReSideRdrLeDetn187RdrDetnSts 0;
BA_ "GenSigStartValue" SG_ 130 ReSideRdrLeDetn187RdrDetnSts 3;
BA_ "GenSigSendType" SG_ 130 ReSideRdrLeDetn188RdrDetnAmbigState 0;
BA_ "GenSigSendType" SG_ 130 ReSideRdrLeDetn188RdrDetnAssoTrkID 0;
BA_ "GenSigSendType" SG_ 130 ReSideRdrLeDetn188RdrDetnAzi 0;
BA_ "GenSigStartValue" SG_ 130 ReSideRdrLeDetn188RdrDetnAzi 900;
BA_ "GenSigDataID" SG_ 130 ReSideRdrLeDetn188RdrDetnChks "0x1118";
BA_ "GenSigFuncType" SG_ 130 ReSideRdrLeDetn188RdrDetnChks 15;
BA_ "GenSigSendType" SG_ 130 ReSideRdrLeDetn188RdrDetnChks 0;
BA_ "GenSigFuncType" SG_ 130 ReSideRdrLeDetn188RdrDetnCntr 16;
BA_ "GenSigSendType" SG_ 130 ReSideRdrLeDetn188RdrDetnCntr 0;
BA_ "GenSigSendType" SG_ 130 ReSideRdrLeDetn188RdrDetnConf 0;
BA_ "GenSigSendType" SG_ 130 ReSideRdrLeDetn188RdrDetnElevn 0;
BA_ "GenSigStartValue" SG_ 130 ReSideRdrLeDetn188RdrDetnElevn 15;
BA_ "GenSigSendType" SG_ 130 ReSideRdrLeDetn188RdrDetnPwr 0;
BA_ "GenSigSendType" SG_ 130 ReSideRdrLeDetn188RdrDetnRng 0;
BA_ "GenSigStartValue" SG_ 130 ReSideRdrLeDetn188RdrDetnRng 10050;
BA_ "GenSigSendType" SG_ 130 ReSideRdrLeDetn188RdrDetnRngV 0;
BA_ "GenSigStartValue" SG_ 130 ReSideRdrLeDetn188RdrDetnRngV 4000;
BA_ "GenSigSendType" SG_ 130 ReSideRdrLeDetn188RdrDetnSameRV 0;
BA_ "GenSigSendType" SG_ 130 ReSideRdrLeDetn188RdrDetnSts 0;
BA_ "GenSigStartValue" SG_ 130 ReSideRdrLeDetn188RdrDetnSts 3;
BA_ "GenSigSendType" SG_ 130 ReSideRdrLeDetn189RdrDetnAmbigState 0;
BA_ "GenSigSendType" SG_ 130 ReSideRdrLeDetn189RdrDetnAssoTrkID 0;
BA_ "GenSigSendType" SG_ 130 ReSideRdrLeDetn189RdrDetnAzi 0;
BA_ "GenSigStartValue" SG_ 130 ReSideRdrLeDetn189RdrDetnAzi 900;
BA_ "GenSigDataID" SG_ 130 ReSideRdrLeDetn189RdrDetnChks "0x1227";
BA_ "GenSigFuncType" SG_ 130 ReSideRdrLeDetn189RdrDetnChks 15;
BA_ "GenSigSendType" SG_ 130 ReSideRdrLeDetn189RdrDetnChks 0;
BA_ "GenSigFuncType" SG_ 130 ReSideRdrLeDetn189RdrDetnCntr 16;
BA_ "GenSigSendType" SG_ 130 ReSideRdrLeDetn189RdrDetnCntr 0;
BA_ "GenSigSendType" SG_ 130 ReSideRdrLeDetn189RdrDetnConf 0;
BA_ "GenSigSendType" SG_ 130 ReSideRdrLeDetn189RdrDetnElevn 0;
BA_ "GenSigStartValue" SG_ 130 ReSideRdrLeDetn189RdrDetnElevn 15;
BA_ "GenSigSendType" SG_ 130 ReSideRdrLeDetn189RdrDetnPwr 0;
BA_ "GenSigSendType" SG_ 130 ReSideRdrLeDetn189RdrDetnRng 0;
BA_ "GenSigStartValue" SG_ 130 ReSideRdrLeDetn189RdrDetnRng 10050;
BA_ "GenSigSendType" SG_ 130 ReSideRdrLeDetn189RdrDetnRngV 0;
BA_ "GenSigStartValue" SG_ 130 ReSideRdrLeDetn189RdrDetnRngV 4000;
BA_ "GenSigSendType" SG_ 130 ReSideRdrLeDetn189RdrDetnSameRV 0;
BA_ "GenSigSendType" SG_ 130 ReSideRdrLeDetn189RdrDetnSts 0;
BA_ "GenSigStartValue" SG_ 130 ReSideRdrLeDetn189RdrDetnSts 3;
BA_ "GenSigSendType" SG_ 130 ReSideRdrLeDetn190RdrDetnAmbigState 0;
BA_ "GenSigSendType" SG_ 130 ReSideRdrLeDetn190RdrDetnAssoTrkID 0;
BA_ "GenSigSendType" SG_ 130 ReSideRdrLeDetn190RdrDetnAzi 0;
BA_ "GenSigStartValue" SG_ 130 ReSideRdrLeDetn190RdrDetnAzi 900;
BA_ "GenSigDataID" SG_ 130 ReSideRdrLeDetn190RdrDetnChks "0x111A";
BA_ "GenSigFuncType" SG_ 130 ReSideRdrLeDetn190RdrDetnChks 15;
BA_ "GenSigSendType" SG_ 130 ReSideRdrLeDetn190RdrDetnChks 0;
BA_ "GenSigFuncType" SG_ 130 ReSideRdrLeDetn190RdrDetnCntr 16;
BA_ "GenSigSendType" SG_ 130 ReSideRdrLeDetn190RdrDetnCntr 0;
BA_ "GenSigSendType" SG_ 130 ReSideRdrLeDetn190RdrDetnConf 0;
BA_ "GenSigSendType" SG_ 130 ReSideRdrLeDetn190RdrDetnElevn 0;
BA_ "GenSigStartValue" SG_ 130 ReSideRdrLeDetn190RdrDetnElevn 15;
BA_ "GenSigSendType" SG_ 130 ReSideRdrLeDetn190RdrDetnPwr 0;
BA_ "GenSigSendType" SG_ 130 ReSideRdrLeDetn190RdrDetnRng 0;
BA_ "GenSigStartValue" SG_ 130 ReSideRdrLeDetn190RdrDetnRng 10050;
BA_ "GenSigSendType" SG_ 130 ReSideRdrLeDetn190RdrDetnRngV 0;
BA_ "GenSigStartValue" SG_ 130 ReSideRdrLeDetn190RdrDetnRngV 4000;
BA_ "GenSigSendType" SG_ 130 ReSideRdrLeDetn190RdrDetnSameRV 0;
BA_ "GenSigSendType" SG_ 130 ReSideRdrLeDetn190RdrDetnSts 0;
BA_ "GenSigStartValue" SG_ 130 ReSideRdrLeDetn190RdrDetnSts 3;
BA_ "GenSigSendType" SG_ 130 ReSideRdrLeDetn191RdrDetnAmbigState 0;
BA_ "GenSigSendType" SG_ 130 ReSideRdrLeDetn191RdrDetnAssoTrkID 0;
BA_ "GenSigSendType" SG_ 130 ReSideRdrLeDetn191RdrDetnAzi 0;
BA_ "GenSigStartValue" SG_ 130 ReSideRdrLeDetn191RdrDetnAzi 900;
BA_ "GenSigDataID" SG_ 130 ReSideRdrLeDetn191RdrDetnChks "0x1229";
BA_ "GenSigFuncType" SG_ 130 ReSideRdrLeDetn191RdrDetnChks 15;
BA_ "GenSigSendType" SG_ 130 ReSideRdrLeDetn191RdrDetnChks 0;
BA_ "GenSigFuncType" SG_ 130 ReSideRdrLeDetn191RdrDetnCntr 16;
BA_ "GenSigSendType" SG_ 130 ReSideRdrLeDetn191RdrDetnCntr 0;
BA_ "GenSigSendType" SG_ 130 ReSideRdrLeDetn191RdrDetnConf 0;
BA_ "GenSigSendType" SG_ 130 ReSideRdrLeDetn191RdrDetnElevn 0;
BA_ "GenSigStartValue" SG_ 130 ReSideRdrLeDetn191RdrDetnElevn 15;
BA_ "GenSigSendType" SG_ 130 ReSideRdrLeDetn191RdrDetnPwr 0;
BA_ "GenSigSendType" SG_ 130 ReSideRdrLeDetn191RdrDetnRng 0;
BA_ "GenSigStartValue" SG_ 130 ReSideRdrLeDetn191RdrDetnRng 10050;
BA_ "GenSigSendType" SG_ 130 ReSideRdrLeDetn191RdrDetnRngV 0;
BA_ "GenSigStartValue" SG_ 130 ReSideRdrLeDetn191RdrDetnRngV 4000;
BA_ "GenSigSendType" SG_ 130 ReSideRdrLeDetn191RdrDetnSameRV 0;
BA_ "GenSigSendType" SG_ 130 ReSideRdrLeDetn191RdrDetnSts 0;
BA_ "GenSigStartValue" SG_ 130 ReSideRdrLeDetn191RdrDetnSts 3;
BA_ "GenSigSendType" SG_ 130 ReSideRdrLeDetn192RdrDetnAmbigState 0;
BA_ "GenSigSendType" SG_ 130 ReSideRdrLeDetn192RdrDetnAssoTrkID 0;
BA_ "GenSigSendType" SG_ 130 ReSideRdrLeDetn192RdrDetnAzi 0;
BA_ "GenSigStartValue" SG_ 130 ReSideRdrLeDetn192RdrDetnAzi 900;
BA_ "GenSigDataID" SG_ 130 ReSideRdrLeDetn192RdrDetnChks "0x111C";
BA_ "GenSigFuncType" SG_ 130 ReSideRdrLeDetn192RdrDetnChks 15;
BA_ "GenSigSendType" SG_ 130 ReSideRdrLeDetn192RdrDetnChks 0;
BA_ "GenSigFuncType" SG_ 130 ReSideRdrLeDetn192RdrDetnCntr 16;
BA_ "GenSigSendType" SG_ 130 ReSideRdrLeDetn192RdrDetnCntr 0;
BA_ "GenSigSendType" SG_ 130 ReSideRdrLeDetn192RdrDetnConf 0;
BA_ "GenSigSendType" SG_ 130 ReSideRdrLeDetn192RdrDetnElevn 0;
BA_ "GenSigStartValue" SG_ 130 ReSideRdrLeDetn192RdrDetnElevn 15;
BA_ "GenSigSendType" SG_ 130 ReSideRdrLeDetn192RdrDetnPwr 0;
BA_ "GenSigSendType" SG_ 130 ReSideRdrLeDetn192RdrDetnRng 0;
BA_ "GenSigStartValue" SG_ 130 ReSideRdrLeDetn192RdrDetnRng 10050;
BA_ "GenSigSendType" SG_ 130 ReSideRdrLeDetn192RdrDetnRngV 0;
BA_ "GenSigStartValue" SG_ 130 ReSideRdrLeDetn192RdrDetnRngV 4000;
BA_ "GenSigSendType" SG_ 130 ReSideRdrLeDetn192RdrDetnSameRV 0;
BA_ "GenSigSendType" SG_ 130 ReSideRdrLeDetn192RdrDetnSts 0;
BA_ "GenSigStartValue" SG_ 130 ReSideRdrLeDetn192RdrDetnSts 3;
VAL_ 119 ReSideRdrLeDetn157RdrDetnAmbigState 0 "YesNo1_Yes" 1 "YesNo1_No";
VAL_ 119 ReSideRdrLeDetn157RdrDetnSameRV 0 "Mode6_0" 1 "Mode6_1" 2 "Mode6_2";
VAL_ 119 ReSideRdrLeDetn157RdrDetnSts 0 "RdrDetnSts_Ukwn" 1 "RdrDetnSts_Movg" 2 "RdrDetnSts_Staty" 3 "RdrDetnSts_Invalid";
VAL_ 119 ReSideRdrLeDetn158RdrDetnAmbigState 0 "YesNo1_Yes" 1 "YesNo1_No";
VAL_ 119 ReSideRdrLeDetn158RdrDetnSameRV 0 "Mode6_0" 1 "Mode6_1" 2 "Mode6_2";
VAL_ 119 ReSideRdrLeDetn158RdrDetnSts 0 "RdrDetnSts_Ukwn" 1 "RdrDetnSts_Movg" 2 "RdrDetnSts_Staty" 3 "RdrDetnSts_Invalid";
VAL_ 119 ReSideRdrLeDetn159RdrDetnAmbigState 0 "YesNo1_Yes" 1 "YesNo1_No";
VAL_ 119 ReSideRdrLeDetn159RdrDetnSameRV 0 "Mode6_0" 1 "Mode6_1" 2 "Mode6_2";
VAL_ 119 ReSideRdrLeDetn159RdrDetnSts 0 "RdrDetnSts_Ukwn" 1 "RdrDetnSts_Movg" 2 "RdrDetnSts_Staty" 3 "RdrDetnSts_Invalid";
VAL_ 119 ReSideRdrLeDetn160RdrDetnAmbigState 0 "YesNo1_Yes" 1 "YesNo1_No";
VAL_ 119 ReSideRdrLeDetn160RdrDetnSameRV 0 "Mode6_0" 1 "Mode6_1" 2 "Mode6_2";
VAL_ 119 ReSideRdrLeDetn160RdrDetnSts 0 "RdrDetnSts_Ukwn" 1 "RdrDetnSts_Movg" 2 "RdrDetnSts_Staty" 3 "RdrDetnSts_Invalid";
VAL_ 119 ReSideRdrLeDetn161RdrDetnAmbigState 0 "YesNo1_Yes" 1 "YesNo1_No";
VAL_ 119 ReSideRdrLeDetn161RdrDetnSameRV 0 "Mode6_0" 1 "Mode6_1" 2 "Mode6_2";
VAL_ 119 ReSideRdrLeDetn161RdrDetnSts 0 "RdrDetnSts_Ukwn" 1 "RdrDetnSts_Movg" 2 "RdrDetnSts_Staty" 3 "RdrDetnSts_Invalid";
VAL_ 119 ReSideRdrLeDetn162RdrDetnAmbigState 0 "YesNo1_Yes" 1 "YesNo1_No";
VAL_ 119 ReSideRdrLeDetn162RdrDetnSameRV 0 "Mode6_0" 1 "Mode6_1" 2 "Mode6_2";
VAL_ 119 ReSideRdrLeDetn162RdrDetnSts 0 "RdrDetnSts_Ukwn" 1 "RdrDetnSts_Movg" 2 "RdrDetnSts_Staty" 3 "RdrDetnSts_Invalid";
VAL_ 120 ReSideRdrLeDetn163RdrDetnAmbigState 0 "YesNo1_Yes" 1 "YesNo1_No";
VAL_ 120 ReSideRdrLeDetn163RdrDetnSameRV 0 "Mode6_0" 1 "Mode6_1" 2 "Mode6_2";
VAL_ 120 ReSideRdrLeDetn163RdrDetnSts 0 "RdrDetnSts_Ukwn" 1 "RdrDetnSts_Movg" 2 "RdrDetnSts_Staty" 3 "RdrDetnSts_Invalid";
VAL_ 120 ReSideRdrLeDetn164RdrDetnAmbigState 0 "YesNo1_Yes" 1 "YesNo1_No";
VAL_ 120 ReSideRdrLeDetn164RdrDetnSameRV 0 "Mode6_0" 1 "Mode6_1" 2 "Mode6_2";
VAL_ 120 ReSideRdrLeDetn164RdrDetnSts 0 "RdrDetnSts_Ukwn" 1 "RdrDetnSts_Movg" 2 "RdrDetnSts_Staty" 3 "RdrDetnSts_Invalid";
VAL_ 120 ReSideRdrLeDetn165RdrDetnAmbigState 0 "YesNo1_Yes" 1 "YesNo1_No";
VAL_ 120 ReSideRdrLeDetn165RdrDetnSameRV 0 "Mode6_0" 1 "Mode6_1" 2 "Mode6_2";
VAL_ 120 ReSideRdrLeDetn165RdrDetnSts 0 "RdrDetnSts_Ukwn" 1 "RdrDetnSts_Movg" 2 "RdrDetnSts_Staty" 3 "RdrDetnSts_Invalid";
VAL_ 120 ReSideRdrLeDetn166RdrDetnAmbigState 0 "YesNo1_Yes" 1 "YesNo1_No";
VAL_ 120 ReSideRdrLeDetn166RdrDetnSameRV 0 "Mode6_0" 1 "Mode6_1" 2 "Mode6_2";
VAL_ 120 ReSideRdrLeDetn166RdrDetnSts 0 "RdrDetnSts_Ukwn" 1 "RdrDetnSts_Movg" 2 "RdrDetnSts_Staty" 3 "RdrDetnSts_Invalid";
VAL_ 120 ReSideRdrLeDetn167RdrDetnAmbigState 0 "YesNo1_Yes" 1 "YesNo1_No";
VAL_ 120 ReSideRdrLeDetn167RdrDetnSameRV 0 "Mode6_0" 1 "Mode6_1" 2 "Mode6_2";
VAL_ 120 ReSideRdrLeDetn167RdrDetnSts 0 "RdrDetnSts_Ukwn" 1 "RdrDetnSts_Movg" 2 "RdrDetnSts_Staty" 3 "RdrDetnSts_Invalid";
VAL_ 120 ReSideRdrLeDetn168RdrDetnAmbigState 0 "YesNo1_Yes" 1 "YesNo1_No";
VAL_ 120 ReSideRdrLeDetn168RdrDetnSameRV 0 "Mode6_0" 1 "Mode6_1" 2 "Mode6_2";
VAL_ 120 ReSideRdrLeDetn168RdrDetnSts 0 "RdrDetnSts_Ukwn" 1 "RdrDetnSts_Movg" 2 "RdrDetnSts_Staty" 3 "RdrDetnSts_Invalid";
VAL_ 121 ReSideRdrLeDetn169RdrDetnAmbigState 0 "YesNo1_Yes" 1 "YesNo1_No";
VAL_ 121 ReSideRdrLeDetn169RdrDetnSameRV 0 "Mode6_0" 1 "Mode6_1" 2 "Mode6_2";
VAL_ 121 ReSideRdrLeDetn169RdrDetnSts 0 "RdrDetnSts_Ukwn" 1 "RdrDetnSts_Movg" 2 "RdrDetnSts_Staty" 3 "RdrDetnSts_Invalid";
VAL_ 121 ReSideRdrLeDetn170RdrDetnAmbigState 0 "YesNo1_Yes" 1 "YesNo1_No";
VAL_ 121 ReSideRdrLeDetn170RdrDetnSameRV 0 "Mode6_0" 1 "Mode6_1" 2 "Mode6_2";
VAL_ 121 ReSideRdrLeDetn170RdrDetnSts 0 "RdrDetnSts_Ukwn" 1 "RdrDetnSts_Movg" 2 "RdrDetnSts_Staty" 3 "RdrDetnSts_Invalid";
VAL_ 121 ReSideRdrLeDetn171RdrDetnAmbigState 0 "YesNo1_Yes" 1 "YesNo1_No";
VAL_ 121 ReSideRdrLeDetn171RdrDetnSameRV 0 "Mode6_0" 1 "Mode6_1" 2 "Mode6_2";
VAL_ 121 ReSideRdrLeDetn171RdrDetnSts 0 "RdrDetnSts_Ukwn" 1 "RdrDetnSts_Movg" 2 "RdrDetnSts_Staty" 3 "RdrDetnSts_Invalid";
VAL_ 121 ReSideRdrLeDetn172RdrDetnAmbigState 0 "YesNo1_Yes" 1 "YesNo1_No";
VAL_ 121 ReSideRdrLeDetn172RdrDetnSameRV 0 "Mode6_0" 1 "Mode6_1" 2 "Mode6_2";
VAL_ 121 ReSideRdrLeDetn172RdrDetnSts 0 "RdrDetnSts_Ukwn" 1 "RdrDetnSts_Movg" 2 "RdrDetnSts_Staty" 3 "RdrDetnSts_Invalid";
VAL_ 121 ReSideRdrLeDetn173RdrDetnAmbigState 0 "YesNo1_Yes" 1 "YesNo1_No";
VAL_ 121 ReSideRdrLeDetn173RdrDetnSameRV 0 "Mode6_0" 1 "Mode6_1" 2 "Mode6_2";
VAL_ 121 ReSideRdrLeDetn173RdrDetnSts 0 "RdrDetnSts_Ukwn" 1 "RdrDetnSts_Movg" 2 "RdrDetnSts_Staty" 3 "RdrDetnSts_Invalid";
VAL_ 121 ReSideRdrLeDetn174RdrDetnAmbigState 0 "YesNo1_Yes" 1 "YesNo1_No";
VAL_ 121 ReSideRdrLeDetn174RdrDetnSameRV 0 "Mode6_0" 1 "Mode6_1" 2 "Mode6_2";
VAL_ 121 ReSideRdrLeDetn174RdrDetnSts 0 "RdrDetnSts_Ukwn" 1 "RdrDetnSts_Movg" 2 "RdrDetnSts_Staty" 3 "RdrDetnSts_Invalid";
VAL_ 128 ReSideRdrLeDetn175RdrDetnAmbigState 0 "YesNo1_Yes" 1 "YesNo1_No";
VAL_ 128 ReSideRdrLeDetn175RdrDetnSameRV 0 "Mode6_0" 1 "Mode6_1" 2 "Mode6_2";
VAL_ 128 ReSideRdrLeDetn175RdrDetnSts 0 "RdrDetnSts_Ukwn" 1 "RdrDetnSts_Movg" 2 "RdrDetnSts_Staty" 3 "RdrDetnSts_Invalid";
VAL_ 128 ReSideRdrLeDetn176RdrDetnAmbigState 0 "YesNo1_Yes" 1 "YesNo1_No";
VAL_ 128 ReSideRdrLeDetn176RdrDetnSameRV 0 "Mode6_0" 1 "Mode6_1" 2 "Mode6_2";
VAL_ 128 ReSideRdrLeDetn176RdrDetnSts 0 "RdrDetnSts_Ukwn" 1 "RdrDetnSts_Movg" 2 "RdrDetnSts_Staty" 3 "RdrDetnSts_Invalid";
VAL_ 128 ReSideRdrLeDetn177RdrDetnAmbigState 0 "YesNo1_Yes" 1 "YesNo1_No";
VAL_ 128 ReSideRdrLeDetn177RdrDetnSameRV 0 "Mode6_0" 1 "Mode6_1" 2 "Mode6_2";
VAL_ 128 ReSideRdrLeDetn177RdrDetnSts 0 "RdrDetnSts_Ukwn" 1 "RdrDetnSts_Movg" 2 "RdrDetnSts_Staty" 3 "RdrDetnSts_Invalid";
VAL_ 128 ReSideRdrLeDetn178RdrDetnAmbigState 0 "YesNo1_Yes" 1 "YesNo1_No";
VAL_ 128 ReSideRdrLeDetn178RdrDetnSameRV 0 "Mode6_0" 1 "Mode6_1" 2 "Mode6_2";
VAL_ 128 ReSideRdrLeDetn178RdrDetnSts 0 "RdrDetnSts_Ukwn" 1 "RdrDetnSts_Movg" 2 "RdrDetnSts_Staty" 3 "RdrDetnSts_Invalid";
VAL_ 128 ReSideRdrLeDetn179RdrDetnAmbigState 0 "YesNo1_Yes" 1 "YesNo1_No";
VAL_ 128 ReSideRdrLeDetn179RdrDetnSameRV 0 "Mode6_0" 1 "Mode6_1" 2 "Mode6_2";
VAL_ 128 ReSideRdrLeDetn179RdrDetnSts 0 "RdrDetnSts_Ukwn" 1 "RdrDetnSts_Movg" 2 "RdrDetnSts_Staty" 3 "RdrDetnSts_Invalid";
VAL_ 128 ReSideRdrLeDetn180RdrDetnAmbigState 0 "YesNo1_Yes" 1 "YesNo1_No";
VAL_ 128 ReSideRdrLeDetn180RdrDetnSameRV 0 "Mode6_0" 1 "Mode6_1" 2 "Mode6_2";
VAL_ 128 ReSideRdrLeDetn180RdrDetnSts 0 "RdrDetnSts_Ukwn" 1 "RdrDetnSts_Movg" 2 "RdrDetnSts_Staty" 3 "RdrDetnSts_Invalid";
VAL_ 129 ReSideRdrLeDetn181RdrDetnAmbigState 0 "YesNo1_Yes" 1 "YesNo1_No";
VAL_ 129 ReSideRdrLeDetn181RdrDetnSameRV 0 "Mode6_0" 1 "Mode6_1" 2 "Mode6_2";
VAL_ 129 ReSideRdrLeDetn181RdrDetnSts 0 "RdrDetnSts_Ukwn" 1 "RdrDetnSts_Movg" 2 "RdrDetnSts_Staty" 3 "RdrDetnSts_Invalid";
VAL_ 129 ReSideRdrLeDetn182RdrDetnAmbigState 0 "YesNo1_Yes" 1 "YesNo1_No";
VAL_ 129 ReSideRdrLeDetn182RdrDetnSameRV 0 "Mode6_0" 1 "Mode6_1" 2 "Mode6_2";
VAL_ 129 ReSideRdrLeDetn182RdrDetnSts 0 "RdrDetnSts_Ukwn" 1 "RdrDetnSts_Movg" 2 "RdrDetnSts_Staty" 3 "RdrDetnSts_Invalid";
VAL_ 129 ReSideRdrLeDetn183RdrDetnAmbigState 0 "YesNo1_Yes" 1 "YesNo1_No";
VAL_ 129 ReSideRdrLeDetn183RdrDetnSameRV 0 "Mode6_0" 1 "Mode6_1" 2 "Mode6_2";
VAL_ 129 ReSideRdrLeDetn183RdrDetnSts 0 "RdrDetnSts_Ukwn" 1 "RdrDetnSts_Movg" 2 "RdrDetnSts_Staty" 3 "RdrDetnSts_Invalid";
VAL_ 129 ReSideRdrLeDetn184RdrDetnAmbigState 0 "YesNo1_Yes" 1 "YesNo1_No";
VAL_ 129 ReSideRdrLeDetn184RdrDetnSameRV 0 "Mode6_0" 1 "Mode6_1" 2 "Mode6_2";
VAL_ 129 ReSideRdrLeDetn184RdrDetnSts 0 "RdrDetnSts_Ukwn" 1 "RdrDetnSts_Movg" 2 "RdrDetnSts_Staty" 3 "RdrDetnSts_Invalid";
VAL_ 129 ReSideRdrLeDetn185RdrDetnAmbigState 0 "YesNo1_Yes" 1 "YesNo1_No";
VAL_ 129 ReSideRdrLeDetn185RdrDetnSameRV 0 "Mode6_0" 1 "Mode6_1" 2 "Mode6_2";
VAL_ 129 ReSideRdrLeDetn185RdrDetnSts 0 "RdrDetnSts_Ukwn" 1 "RdrDetnSts_Movg" 2 "RdrDetnSts_Staty" 3 "RdrDetnSts_Invalid";
VAL_ 129 ReSideRdrLeDetn186RdrDetnAmbigState 0 "YesNo1_Yes" 1 "YesNo1_No";
VAL_ 129 ReSideRdrLeDetn186RdrDetnSameRV 0 "Mode6_0" 1 "Mode6_1" 2 "Mode6_2";
VAL_ 129 ReSideRdrLeDetn186RdrDetnSts 0 "RdrDetnSts_Ukwn" 1 "RdrDetnSts_Movg" 2 "RdrDetnSts_Staty" 3 "RdrDetnSts_Invalid";
VAL_ 130 ReSideRdrLeDetn187RdrDetnAmbigState 0 "YesNo1_Yes" 1 "YesNo1_No";
VAL_ 130 ReSideRdrLeDetn187RdrDetnSameRV 0 "Mode6_0" 1 "Mode6_1" 2 "Mode6_2";
VAL_ 130 ReSideRdrLeDetn187RdrDetnSts 0 "RdrDetnSts_Ukwn" 1 "RdrDetnSts_Movg" 2 "RdrDetnSts_Staty" 3 "RdrDetnSts_Invalid";
VAL_ 130 ReSideRdrLeDetn188RdrDetnAmbigState 0 "YesNo1_Yes" 1 "YesNo1_No";
VAL_ 130 ReSideRdrLeDetn188RdrDetnSameRV 0 "Mode6_0" 1 "Mode6_1" 2 "Mode6_2";
VAL_ 130 ReSideRdrLeDetn188RdrDetnSts 0 "RdrDetnSts_Ukwn" 1 "RdrDetnSts_Movg" 2 "RdrDetnSts_Staty" 3 "RdrDetnSts_Invalid";
VAL_ 130 ReSideRdrLeDetn189RdrDetnAmbigState 0 "YesNo1_Yes" 1 "YesNo1_No";
VAL_ 130 ReSideRdrLeDetn189RdrDetnSameRV 0 "Mode6_0" 1 "Mode6_1" 2 "Mode6_2";
VAL_ 130 ReSideRdrLeDetn189RdrDetnSts 0 "RdrDetnSts_Ukwn" 1 "RdrDetnSts_Movg" 2 "RdrDetnSts_Staty" 3 "RdrDetnSts_Invalid";
VAL_ 130 ReSideRdrLeDetn190RdrDetnAmbigState 0 "YesNo1_Yes" 1 "YesNo1_No";
VAL_ 130 ReSideRdrLeDetn190RdrDetnSameRV 0 "Mode6_0" 1 "Mode6_1" 2 "Mode6_2";
VAL_ 130 ReSideRdrLeDetn190RdrDetnSts 0 "RdrDetnSts_Ukwn" 1 "RdrDetnSts_Movg" 2 "RdrDetnSts_Staty" 3 "RdrDetnSts_Invalid";
VAL_ 130 ReSideRdrLeDetn191RdrDetnAmbigState 0 "YesNo1_Yes" 1 "YesNo1_No";
VAL_ 130 ReSideRdrLeDetn191RdrDetnSameRV 0 "Mode6_0" 1 "Mode6_1" 2 "Mode6_2";
VAL_ 130 ReSideRdrLeDetn191RdrDetnSts 0 "RdrDetnSts_Ukwn" 1 "RdrDetnSts_Movg" 2 "RdrDetnSts_Staty" 3 "RdrDetnSts_Invalid";
VAL_ 130 ReSideRdrLeDetn192RdrDetnAmbigState 0 "YesNo1_Yes" 1 "YesNo1_No";
VAL_ 130 ReSideRdrLeDetn192RdrDetnSameRV 0 "Mode6_0" 1 "Mode6_1" 2 "Mode6_2";
VAL_ 130 ReSideRdrLeDetn192RdrDetnSts 0 "RdrDetnSts_Ukwn" 1 "RdrDetnSts_Movg" 2 "RdrDetnSts_Staty" 3 "RdrDetnSts_Invalid";
SIG_GROUP_ 119 ReSideRdrLeDetn157 1 : ReSideRdrLeDetn157RdrDetnAmbigState ReSideRdrLeDetn157RdrDetnAssoTrkID ReSideRdrLeDetn157RdrDetnAzi ReSideRdrLeDetn157RdrDetnChks ReSideRdrLeDetn157RdrDetnCntr ReSideRdrLeDetn157RdrDetnConf ReSideRdrLeDetn157RdrDetnElevn ReSideRdrLeDetn157RdrDetnPwr ReSideRdrLeDetn157RdrDetnRng ReSideRdrLeDetn157RdrDetnRngV ReSideRdrLeDetn157RdrDetnSameRV ReSideRdrLeDetn157RdrDetnSts;
SIG_GROUP_ 119 ReSideRdrLeDetn158 1 : ReSideRdrLeDetn158RdrDetnAmbigState ReSideRdrLeDetn158RdrDetnAssoTrkID ReSideRdrLeDetn158RdrDetnAzi ReSideRdrLeDetn158RdrDetnChks ReSideRdrLeDetn158RdrDetnCntr ReSideRdrLeDetn158RdrDetnConf ReSideRdrLeDetn158RdrDetnElevn ReSideRdrLeDetn158RdrDetnPwr ReSideRdrLeDetn158RdrDetnRng ReSideRdrLeDetn158RdrDetnRngV ReSideRdrLeDetn158RdrDetnSameRV ReSideRdrLeDetn158RdrDetnSts;
SIG_GROUP_ 119 ReSideRdrLeDetn159 1 : ReSideRdrLeDetn159RdrDetnAmbigState ReSideRdrLeDetn159RdrDetnAssoTrkID ReSideRdrLeDetn159RdrDetnAzi ReSideRdrLeDetn159RdrDetnChks ReSideRdrLeDetn159RdrDetnCntr ReSideRdrLeDetn159RdrDetnConf ReSideRdrLeDetn159RdrDetnElevn ReSideRdrLeDetn159RdrDetnPwr ReSideRdrLeDetn159RdrDetnRng ReSideRdrLeDetn159RdrDetnRngV ReSideRdrLeDetn159RdrDetnSameRV ReSideRdrLeDetn159RdrDetnSts;
SIG_GROUP_ 119 ReSideRdrLeDetn160 1 : ReSideRdrLeDetn160RdrDetnAmbigState ReSideRdrLeDetn160RdrDetnAssoTrkID ReSideRdrLeDetn160RdrDetnAzi ReSideRdrLeDetn160RdrDetnChks ReSideRdrLeDetn160RdrDetnCntr ReSideRdrLeDetn160RdrDetnConf ReSideRdrLeDetn160RdrDetnElevn ReSideRdrLeDetn160RdrDetnPwr ReSideRdrLeDetn160RdrDetnRng ReSideRdrLeDetn160RdrDetnRngV ReSideRdrLeDetn160RdrDetnSameRV ReSideRdrLeDetn160RdrDetnSts;
SIG_GROUP_ 119 ReSideRdrLeDetn161 1 : ReSideRdrLeDetn161RdrDetnAmbigState ReSideRdrLeDetn161RdrDetnAssoTrkID ReSideRdrLeDetn161RdrDetnAzi ReSideRdrLeDetn161RdrDetnChks ReSideRdrLeDetn161RdrDetnCntr ReSideRdrLeDetn161RdrDetnConf ReSideRdrLeDetn161RdrDetnElevn ReSideRdrLeDetn161RdrDetnPwr ReSideRdrLeDetn161RdrDetnRng ReSideRdrLeDetn161RdrDetnRngV ReSideRdrLeDetn161RdrDetnSameRV ReSideRdrLeDetn161RdrDetnSts;
SIG_GROUP_ 119 ReSideRdrLeDetn162 1 : ReSideRdrLeDetn162RdrDetnAmbigState ReSideRdrLeDetn162RdrDetnAssoTrkID ReSideRdrLeDetn162RdrDetnAzi ReSideRdrLeDetn162RdrDetnChks ReSideRdrLeDetn162RdrDetnCntr ReSideRdrLeDetn162RdrDetnConf ReSideRdrLeDetn162RdrDetnElevn ReSideRdrLeDetn162RdrDetnPwr ReSideRdrLeDetn162RdrDetnRng ReSideRdrLeDetn162RdrDetnRngV ReSideRdrLeDetn162RdrDetnSameRV ReSideRdrLeDetn162RdrDetnSts;
SIG_GROUP_ 120 ReSideRdrLeDetn163 1 : ReSideRdrLeDetn163RdrDetnAmbigState ReSideRdrLeDetn163RdrDetnAssoTrkID ReSideRdrLeDetn163RdrDetnAzi ReSideRdrLeDetn163RdrDetnChks ReSideRdrLeDetn163RdrDetnCntr ReSideRdrLeDetn163RdrDetnConf ReSideRdrLeDetn163RdrDetnElevn ReSideRdrLeDetn163RdrDetnPwr ReSideRdrLeDetn163RdrDetnRng ReSideRdrLeDetn163RdrDetnRngV ReSideRdrLeDetn163RdrDetnSameRV ReSideRdrLeDetn163RdrDetnSts;
SIG_GROUP_ 120 ReSideRdrLeDetn164 1 : ReSideRdrLeDetn164RdrDetnAmbigState ReSideRdrLeDetn164RdrDetnAssoTrkID ReSideRdrLeDetn164RdrDetnAzi ReSideRdrLeDetn164RdrDetnChks ReSideRdrLeDetn164RdrDetnCntr ReSideRdrLeDetn164RdrDetnConf ReSideRdrLeDetn164RdrDetnElevn ReSideRdrLeDetn164RdrDetnPwr ReSideRdrLeDetn164RdrDetnRng ReSideRdrLeDetn164RdrDetnRngV ReSideRdrLeDetn164RdrDetnSameRV ReSideRdrLeDetn164RdrDetnSts;
SIG_GROUP_ 120 ReSideRdrLeDetn165 1 : ReSideRdrLeDetn165RdrDetnAmbigState ReSideRdrLeDetn165RdrDetnAssoTrkID ReSideRdrLeDetn165RdrDetnAzi ReSideRdrLeDetn165RdrDetnChks ReSideRdrLeDetn165RdrDetnCntr ReSideRdrLeDetn165RdrDetnConf ReSideRdrLeDetn165RdrDetnElevn ReSideRdrLeDetn165RdrDetnPwr ReSideRdrLeDetn165RdrDetnRng ReSideRdrLeDetn165RdrDetnRngV ReSideRdrLeDetn165RdrDetnSameRV ReSideRdrLeDetn165RdrDetnSts;
SIG_GROUP_ 120 ReSideRdrLeDetn166 1 : ReSideRdrLeDetn166RdrDetnAmbigState ReSideRdrLeDetn166RdrDetnAssoTrkID ReSideRdrLeDetn166RdrDetnAzi ReSideRdrLeDetn166RdrDetnChks ReSideRdrLeDetn166RdrDetnCntr ReSideRdrLeDetn166RdrDetnConf ReSideRdrLeDetn166RdrDetnElevn ReSideRdrLeDetn166RdrDetnPwr ReSideRdrLeDetn166RdrDetnRng ReSideRdrLeDetn166RdrDetnRngV ReSideRdrLeDetn166RdrDetnSameRV ReSideRdrLeDetn166RdrDetnSts;
SIG_GROUP_ 120 ReSideRdrLeDetn167 1 : ReSideRdrLeDetn167RdrDetnAmbigState ReSideRdrLeDetn167RdrDetnAssoTrkID ReSideRdrLeDetn167RdrDetnAzi ReSideRdrLeDetn167RdrDetnChks ReSideRdrLeDetn167RdrDetnCntr ReSideRdrLeDetn167RdrDetnConf ReSideRdrLeDetn167RdrDetnElevn ReSideRdrLeDetn167RdrDetnPwr ReSideRdrLeDetn167RdrDetnRng ReSideRdrLeDetn167RdrDetnRngV ReSideRdrLeDetn167RdrDetnSameRV ReSideRdrLeDetn167RdrDetnSts;
SIG_GROUP_ 120 ReSideRdrLeDetn168 1 : ReSideRdrLeDetn168RdrDetnAmbigState ReSideRdrLeDetn168RdrDetnAssoTrkID ReSideRdrLeDetn168RdrDetnAzi ReSideRdrLeDetn168RdrDetnChks ReSideRdrLeDetn168RdrDetnCntr ReSideRdrLeDetn168RdrDetnConf ReSideRdrLeDetn168RdrDetnElevn ReSideRdrLeDetn168RdrDetnPwr ReSideRdrLeDetn168RdrDetnRng ReSideRdrLeDetn168RdrDetnRngV ReSideRdrLeDetn168RdrDetnSameRV ReSideRdrLeDetn168RdrDetnSts;
SIG_GROUP_ 121 ReSideRdrLeDetn169 1 : ReSideRdrLeDetn169RdrDetnAmbigState ReSideRdrLeDetn169RdrDetnAssoTrkID ReSideRdrLeDetn169RdrDetnAzi ReSideRdrLeDetn169RdrDetnChks ReSideRdrLeDetn169RdrDetnCntr ReSideRdrLeDetn169RdrDetnConf ReSideRdrLeDetn169RdrDetnElevn ReSideRdrLeDetn169RdrDetnPwr ReSideRdrLeDetn169RdrDetnRng ReSideRdrLeDetn169RdrDetnRngV ReSideRdrLeDetn169RdrDetnSameRV ReSideRdrLeDetn169RdrDetnSts;
SIG_GROUP_ 121 ReSideRdrLeDetn170 1 : ReSideRdrLeDetn170RdrDetnAmbigState ReSideRdrLeDetn170RdrDetnAssoTrkID ReSideRdrLeDetn170RdrDetnAzi ReSideRdrLeDetn170RdrDetnChks ReSideRdrLeDetn170RdrDetnCntr ReSideRdrLeDetn170RdrDetnConf ReSideRdrLeDetn170RdrDetnElevn ReSideRdrLeDetn170RdrDetnPwr ReSideRdrLeDetn170RdrDetnRng ReSideRdrLeDetn170RdrDetnRngV ReSideRdrLeDetn170RdrDetnSameRV ReSideRdrLeDetn170RdrDetnSts;
SIG_GROUP_ 121 ReSideRdrLeDetn171 1 : ReSideRdrLeDetn171RdrDetnAmbigState ReSideRdrLeDetn171RdrDetnAssoTrkID ReSideRdrLeDetn171RdrDetnAzi ReSideRdrLeDetn171RdrDetnChks ReSideRdrLeDetn171RdrDetnCntr ReSideRdrLeDetn171RdrDetnConf ReSideRdrLeDetn171RdrDetnElevn ReSideRdrLeDetn171RdrDetnPwr ReSideRdrLeDetn171RdrDetnRng ReSideRdrLeDetn171RdrDetnRngV ReSideRdrLeDetn171RdrDetnSameRV ReSideRdrLeDetn171RdrDetnSts;
SIG_GROUP_ 121 ReSideRdrLeDetn172 1 : ReSideRdrLeDetn172RdrDetnAmbigState ReSideRdrLeDetn172RdrDetnAssoTrkID ReSideRdrLeDetn172RdrDetnAzi ReSideRdrLeDetn172RdrDetnChks ReSideRdrLeDetn172RdrDetnCntr ReSideRdrLeDetn172RdrDetnConf ReSideRdrLeDetn172RdrDetnElevn ReSideRdrLeDetn172RdrDetnPwr ReSideRdrLeDetn172RdrDetnRng ReSideRdrLeDetn172RdrDetnRngV ReSideRdrLeDetn172RdrDetnSameRV ReSideRdrLeDetn172RdrDetnSts;
SIG_GROUP_ 121 ReSideRdrLeDetn173 1 : ReSideRdrLeDetn173RdrDetnAmbigState ReSideRdrLeDetn173RdrDetnAssoTrkID ReSideRdrLeDetn173RdrDetnAzi ReSideRdrLeDetn173RdrDetnChks ReSideRdrLeDetn173RdrDetnCntr ReSideRdrLeDetn173RdrDetnConf ReSideRdrLeDetn173RdrDetnElevn ReSideRdrLeDetn173RdrDetnPwr ReSideRdrLeDetn173RdrDetnRng ReSideRdrLeDetn173RdrDetnRngV ReSideRdrLeDetn173RdrDetnSameRV ReSideRdrLeDetn173RdrDetnSts;
SIG_GROUP_ 121 ReSideRdrLeDetn174 1 : ReSideRdrLeDetn174RdrDetnAmbigState ReSideRdrLeDetn174RdrDetnAssoTrkID ReSideRdrLeDetn174RdrDetnAzi ReSideRdrLeDetn174RdrDetnChks ReSideRdrLeDetn174RdrDetnCntr ReSideRdrLeDetn174RdrDetnConf ReSideRdrLeDetn174RdrDetnElevn ReSideRdrLeDetn174RdrDetnPwr ReSideRdrLeDetn174RdrDetnRng ReSideRdrLeDetn174RdrDetnRngV ReSideRdrLeDetn174RdrDetnSameRV ReSideRdrLeDetn174RdrDetnSts;
SIG_GROUP_ 128 ReSideRdrLeDetn175 1 : ReSideRdrLeDetn175RdrDetnAmbigState ReSideRdrLeDetn175RdrDetnAssoTrkID ReSideRdrLeDetn175RdrDetnAzi ReSideRdrLeDetn175RdrDetnChks ReSideRdrLeDetn175RdrDetnCntr ReSideRdrLeDetn175RdrDetnConf ReSideRdrLeDetn175RdrDetnElevn ReSideRdrLeDetn175RdrDetnPwr ReSideRdrLeDetn175RdrDetnRng ReSideRdrLeDetn175RdrDetnRngV ReSideRdrLeDetn175RdrDetnSameRV ReSideRdrLeDetn175RdrDetnSts;
SIG_GROUP_ 128 ReSideRdrLeDetn176 1 : ReSideRdrLeDetn176RdrDetnAmbigState ReSideRdrLeDetn176RdrDetnAssoTrkID ReSideRdrLeDetn176RdrDetnAzi ReSideRdrLeDetn176RdrDetnChks ReSideRdrLeDetn176RdrDetnCntr ReSideRdrLeDetn176RdrDetnConf ReSideRdrLeDetn176RdrDetnElevn ReSideRdrLeDetn176RdrDetnPwr ReSideRdrLeDetn176RdrDetnRng ReSideRdrLeDetn176RdrDetnRngV ReSideRdrLeDetn176RdrDetnSameRV ReSideRdrLeDetn176RdrDetnSts;
SIG_GROUP_ 128 ReSideRdrLeDetn177 1 : ReSideRdrLeDetn177RdrDetnAmbigState ReSideRdrLeDetn177RdrDetnAssoTrkID ReSideRdrLeDetn177RdrDetnAzi ReSideRdrLeDetn177RdrDetnChks ReSideRdrLeDetn177RdrDetnCntr ReSideRdrLeDetn177RdrDetnConf ReSideRdrLeDetn177RdrDetnElevn ReSideRdrLeDetn177RdrDetnPwr ReSideRdrLeDetn177RdrDetnRng ReSideRdrLeDetn177RdrDetnRngV ReSideRdrLeDetn177RdrDetnSameRV ReSideRdrLeDetn177RdrDetnSts;
SIG_GROUP_ 128 ReSideRdrLeDetn178 1 : ReSideRdrLeDetn178RdrDetnAmbigState ReSideRdrLeDetn178RdrDetnAssoTrkID ReSideRdrLeDetn178RdrDetnAzi ReSideRdrLeDetn178RdrDetnChks ReSideRdrLeDetn178RdrDetnCntr ReSideRdrLeDetn178RdrDetnConf ReSideRdrLeDetn178RdrDetnElevn ReSideRdrLeDetn178RdrDetnPwr ReSideRdrLeDetn178RdrDetnRng ReSideRdrLeDetn178RdrDetnRngV ReSideRdrLeDetn178RdrDetnSameRV ReSideRdrLeDetn178RdrDetnSts;
SIG_GROUP_ 128 ReSideRdrLeDetn179 1 : ReSideRdrLeDetn179RdrDetnAmbigState ReSideRdrLeDetn179RdrDetnAssoTrkID ReSideRdrLeDetn179RdrDetnAzi ReSideRdrLeDetn179RdrDetnChks ReSideRdrLeDetn179RdrDetnCntr ReSideRdrLeDetn179RdrDetnConf ReSideRdrLeDetn179RdrDetnElevn ReSideRdrLeDetn179RdrDetnPwr ReSideRdrLeDetn179RdrDetnRng ReSideRdrLeDetn179RdrDetnRngV ReSideRdrLeDetn179RdrDetnSameRV ReSideRdrLeDetn179RdrDetnSts;
SIG_GROUP_ 128 ReSideRdrLeDetn180 1 : ReSideRdrLeDetn180RdrDetnAmbigState ReSideRdrLeDetn180RdrDetnAssoTrkID ReSideRdrLeDetn180RdrDetnAzi ReSideRdrLeDetn180RdrDetnChks ReSideRdrLeDetn180RdrDetnCntr ReSideRdrLeDetn180RdrDetnConf ReSideRdrLeDetn180RdrDetnElevn ReSideRdrLeDetn180RdrDetnPwr ReSideRdrLeDetn180RdrDetnRng ReSideRdrLeDetn180RdrDetnRngV ReSideRdrLeDetn180RdrDetnSameRV ReSideRdrLeDetn180RdrDetnSts;
SIG_GROUP_ 129 ReSideRdrLeDetn181 1 : ReSideRdrLeDetn181RdrDetnAmbigState ReSideRdrLeDetn181RdrDetnAssoTrkID ReSideRdrLeDetn181RdrDetnAzi ReSideRdrLeDetn181RdrDetnChks ReSideRdrLeDetn181RdrDetnCntr ReSideRdrLeDetn181RdrDetnConf ReSideRdrLeDetn181RdrDetnElevn ReSideRdrLeDetn181RdrDetnPwr ReSideRdrLeDetn181RdrDetnRng ReSideRdrLeDetn181RdrDetnRngV ReSideRdrLeDetn181RdrDetnSameRV ReSideRdrLeDetn181RdrDetnSts;
SIG_GROUP_ 129 ReSideRdrLeDetn182 1 : ReSideRdrLeDetn182RdrDetnAmbigState ReSideRdrLeDetn182RdrDetnAssoTrkID ReSideRdrLeDetn182RdrDetnAzi ReSideRdrLeDetn182RdrDetnChks ReSideRdrLeDetn182RdrDetnCntr ReSideRdrLeDetn182RdrDetnConf ReSideRdrLeDetn182RdrDetnElevn ReSideRdrLeDetn182RdrDetnPwr ReSideRdrLeDetn182RdrDetnRng ReSideRdrLeDetn182RdrDetnRngV ReSideRdrLeDetn182RdrDetnSameRV ReSideRdrLeDetn182RdrDetnSts;
SIG_GROUP_ 129 ReSideRdrLeDetn183 1 : ReSideRdrLeDetn183RdrDetnAmbigState ReSideRdrLeDetn183RdrDetnAssoTrkID ReSideRdrLeDetn183RdrDetnAzi ReSideRdrLeDetn183RdrDetnChks ReSideRdrLeDetn183RdrDetnCntr ReSideRdrLeDetn183RdrDetnConf ReSideRdrLeDetn183RdrDetnElevn ReSideRdrLeDetn183RdrDetnPwr ReSideRdrLeDetn183RdrDetnRng ReSideRdrLeDetn183RdrDetnRngV ReSideRdrLeDetn183RdrDetnSameRV ReSideRdrLeDetn183RdrDetnSts;
SIG_GROUP_ 129 ReSideRdrLeDetn184 1 : ReSideRdrLeDetn184RdrDetnAmbigState ReSideRdrLeDetn184RdrDetnAssoTrkID ReSideRdrLeDetn184RdrDetnAzi ReSideRdrLeDetn184RdrDetnChks ReSideRdrLeDetn184RdrDetnCntr ReSideRdrLeDetn184RdrDetnConf ReSideRdrLeDetn184RdrDetnElevn ReSideRdrLeDetn184RdrDetnPwr ReSideRdrLeDetn184RdrDetnRng ReSideRdrLeDetn184RdrDetnRngV ReSideRdrLeDetn184RdrDetnSameRV ReSideRdrLeDetn184RdrDetnSts;
SIG_GROUP_ 129 ReSideRdrLeDetn185 1 : ReSideRdrLeDetn185RdrDetnAmbigState ReSideRdrLeDetn185RdrDetnAssoTrkID ReSideRdrLeDetn185RdrDetnAzi ReSideRdrLeDetn185RdrDetnChks ReSideRdrLeDetn185RdrDetnCntr ReSideRdrLeDetn185RdrDetnConf ReSideRdrLeDetn185RdrDetnElevn ReSideRdrLeDetn185RdrDetnPwr ReSideRdrLeDetn185RdrDetnRng ReSideRdrLeDetn185RdrDetnRngV ReSideRdrLeDetn185RdrDetnSameRV ReSideRdrLeDetn185RdrDetnSts;
SIG_GROUP_ 129 ReSideRdrLeDetn186 1 : ReSideRdrLeDetn186RdrDetnAmbigState ReSideRdrLeDetn186RdrDetnAssoTrkID ReSideRdrLeDetn186RdrDetnAzi ReSideRdrLeDetn186RdrDetnChks ReSideRdrLeDetn186RdrDetnCntr ReSideRdrLeDetn186RdrDetnConf ReSideRdrLeDetn186RdrDetnElevn ReSideRdrLeDetn186RdrDetnPwr ReSideRdrLeDetn186RdrDetnRng ReSideRdrLeDetn186RdrDetnRngV ReSideRdrLeDetn186RdrDetnSameRV ReSideRdrLeDetn186RdrDetnSts;
SIG_GROUP_ 130 ReSideRdrLeDetn187 1 : ReSideRdrLeDetn187RdrDetnAmbigState ReSideRdrLeDetn187RdrDetnAssoTrkID ReSideRdrLeDetn187RdrDetnAzi ReSideRdrLeDetn187RdrDetnChks ReSideRdrLeDetn187RdrDetnCntr ReSideRdrLeDetn187RdrDetnConf ReSideRdrLeDetn187RdrDetnElevn ReSideRdrLeDetn187RdrDetnPwr ReSideRdrLeDetn187RdrDetnRng ReSideRdrLeDetn187RdrDetnRngV ReSideRdrLeDetn187RdrDetnSameRV ReSideRdrLeDetn187RdrDetnSts;
SIG_GROUP_ 130 ReSideRdrLeDetn188 1 : ReSideRdrLeDetn188RdrDetnAmbigState ReSideRdrLeDetn188RdrDetnAssoTrkID ReSideRdrLeDetn188RdrDetnAzi ReSideRdrLeDetn188RdrDetnChks ReSideRdrLeDetn188RdrDetnCntr ReSideRdrLeDetn188RdrDetnConf ReSideRdrLeDetn188RdrDetnElevn ReSideRdrLeDetn188RdrDetnPwr ReSideRdrLeDetn188RdrDetnRng ReSideRdrLeDetn188RdrDetnRngV ReSideRdrLeDetn188RdrDetnSameRV ReSideRdrLeDetn188RdrDetnSts;
SIG_GROUP_ 130 ReSideRdrLeDetn189 1 : ReSideRdrLeDetn189RdrDetnAmbigState ReSideRdrLeDetn189RdrDetnAssoTrkID ReSideRdrLeDetn189RdrDetnAzi ReSideRdrLeDetn189RdrDetnChks ReSideRdrLeDetn189RdrDetnCntr ReSideRdrLeDetn189RdrDetnConf ReSideRdrLeDetn189RdrDetnElevn ReSideRdrLeDetn189RdrDetnPwr ReSideRdrLeDetn189RdrDetnRng ReSideRdrLeDetn189RdrDetnRngV ReSideRdrLeDetn189RdrDetnSameRV ReSideRdrLeDetn189RdrDetnSts;
SIG_GROUP_ 130 ReSideRdrLeDetn190 1 : ReSideRdrLeDetn190RdrDetnAmbigState ReSideRdrLeDetn190RdrDetnAssoTrkID ReSideRdrLeDetn190RdrDetnAzi ReSideRdrLeDetn190RdrDetnChks ReSideRdrLeDetn190RdrDetnCntr ReSideRdrLeDetn190RdrDetnConf ReSideRdrLeDetn190RdrDetnElevn ReSideRdrLeDetn190RdrDetnPwr ReSideRdrLeDetn190RdrDetnRng ReSideRdrLeDetn190RdrDetnRngV ReSideRdrLeDetn190RdrDetnSameRV ReSideRdrLeDetn190RdrDetnSts;
SIG_GROUP_ 130 ReSideRdrLeDetn191 1 : ReSideRdrLeDetn191RdrDetnAmbigState ReSideRdrLeDetn191RdrDetnAssoTrkID ReSideRdrLeDetn191RdrDetnAzi ReSideRdrLeDetn191RdrDetnChks ReSideRdrLeDetn191RdrDetnCntr ReSideRdrLeDetn191RdrDetnConf ReSideRdrLeDetn191RdrDetnElevn ReSideRdrLeDetn191RdrDetnPwr ReSideRdrLeDetn191RdrDetnRng ReSideRdrLeDetn191RdrDetnRngV ReSideRdrLeDetn191RdrDetnSameRV ReSideRdrLeDetn191RdrDetnSts;
SIG_GROUP_ 130 ReSideRdrLeDetn192 1 : ReSideRdrLeDetn192RdrDetnAmbigState ReSideRdrLeDetn192RdrDetnAssoTrkID ReSideRdrLeDetn192RdrDetnAzi ReSideRdrLeDetn192RdrDetnChks ReSideRdrLeDetn192RdrDetnCntr ReSideRdrLeDetn192RdrDetnConf ReSideRdrLeDetn192RdrDetnElevn ReSideRdrLeDetn192RdrDetnPwr ReSideRdrLeDetn192RdrDetnRng ReSideRdrLeDetn192RdrDetnRngV ReSideRdrLeDetn192RdrDetnSameRV ReSideRdrLeDetn192RdrDetnSts;
