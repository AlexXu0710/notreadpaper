// *************************************************************************** *
// *                                                                           *
// * Description:         CANDB File                                           *
// * Generated at:        2023-03-30 16:08                                     *
// * System:              ZSDB123101                                           *
// * Variant:             CS1E                                                 *
// * Network:             Private_CANFD5                                       *
// *                                                                           *
// *************************************************************************** *
VERSION "Private_CANFD5"

NS_ :

BS_ :

BU_ :  ASDM SODL

BO_ 1074 SODLPrivateCANFD5Fr32 : 64 SODL
 SG_ ReSideRdrLe20Obj32_UB : 298|1@0+ (1,0) [0|1] "" ASDM
 SG_ ReSideRdrLe20Obj32Heading : 39|12@0+ (0.1,-180.0) [-180.0|180.0] "Deg" ASDM
 SG_ ReSideRdrLe20Obj32ObjBoxCenterLat : 111|9@0+ (0.1,-25.0) [-25.0|25.0] "m" ASDM
 SG_ ReSideRdrLe20Obj32ObjBoxCenterLgt : 23|9@0+ (0.1,-25.0) [-25.0|25.0] "m" ASDM
 SG_ ReSideRdrLe20Obj32ObservationHist : 79|32@0+ (1.0,0.0) [0.0|4294967295.0] "Unitless" ASDM
 SG_ ReSideRdrLe20Obj32QualityBits : 127|18@0+ (1.0,0.0) [0.0|262143.0] "Unitless" ASDM
 SG_ ReSideRdrLe20Obj32RdrObjAx : 55|8@0- (0.1,0.0) [-12.8|12.700000000000001] "m/s^2" ASDM
 SG_ ReSideRdrLe20Obj32RdrObjAy : 63|8@0- (0.1,0.0) [-12.8|12.700000000000001] "m/s^2" ASDM
 SG_ ReSideRdrLe20Obj32RdrObjBoxLength : 151|9@0+ (0.1,0.0) [0.0|50.0] "m" ASDM
 SG_ ReSideRdrLe20Obj32RdrObjBoxWidth : 279|9@0+ (0.1,0.0) [0.0|50.0] "m" ASDM
 SG_ ReSideRdrLe20Obj32RdrObjChks : 7|8@0+ (1.0,0.0) [0.0|255.0] "Unitless" ASDM
 SG_ ReSideRdrLe20Obj32RdrObjCntr : 15|4@0+ (1.0,0.0) [0.0|15.0] "Unitless" ASDM
 SG_ ReSideRdrLe20Obj32RdrObjCoastCnt : 158|5@0+ (1.0,0.0) [0.0|31.0] "Unitless" ASDM
 SG_ ReSideRdrLe20Obj32RdrObjConf : 11|4@0+ (7.0,0.0) [0.0|105.0] "%" ASDM
 SG_ ReSideRdrLe20Obj32RdrObjDx : 207|13@0+ (0.05,-200.0) [-200.0|200.0] "m" ASDM
 SG_ ReSideRdrLe20Obj32RdrObjDxStdDe : 71|8@0+ (0.05,0.0) [0.0|12.700000000000001] "m" ASDM
 SG_ ReSideRdrLe20Obj32RdrObjDy : 295|13@0+ (0.05,-200.0) [-200.0|200.0] "m" ASDM
 SG_ ReSideRdrLe20Obj32RdrObjDyStdDe : 167|8@0+ (0.05,0.0) [0.0|12.700000000000001] "m" ASDM
 SG_ ReSideRdrLe20Obj32RdrObjElevnConf : 43|4@0+ (7.0,0.0) [0.0|105.0] "%" ASDM
 SG_ ReSideRdrLe20Obj32RdrObjElevnSts : 153|2@0+ (1,0) [0|3] "" ASDM
 SG_ ReSideRdrLe20Obj32RdrObjID : 223|8@0+ (1.0,0.0) [0.0|255.0] "Unitless" ASDM
 SG_ ReSideRdrLe20Obj32RdrObjIsInFreeSpace : 280|1@0+ (1,0) [0|1] "" ASDM
 SG_ ReSideRdrLe20Obj32RdrObjMirrProblty : 263|4@0+ (7.0,0.0) [0.0|105.0] "%" ASDM
 SG_ ReSideRdrLe20Obj32RdrObjMtnPat : 210|3@0+ (1,0) [0|7] "" ASDM
 SG_ ReSideRdrLe20Obj32RdrObjNotRealProblty : 259|4@0+ (7.0,0.0) [0.0|105.0] "%" ASDM
 SG_ ReSideRdrLe20Obj32RdrObjStatyCnt : 30|7@0+ (1.0,0.0) [0.0|127.0] "Unitless" ASDM
 SG_ ReSideRdrLe20Obj32RdrObjTiAlv : 118|7@0+ (1.0,0.0) [0.0|127.0] "Unitless" ASDM
 SG_ ReSideRdrLe20Obj32RdrObjTrackSts : 177|2@0+ (1,0) [0|3] "" ASDM
 SG_ ReSideRdrLe20Obj32RdrObjTyp : 235|4@0+ (1,0) [0|15] "" ASDM
 SG_ ReSideRdrLe20Obj32RdrObjTypConfBike : 251|4@0+ (7.0,0.0) [0.0|105.0] "%" ASDM
 SG_ ReSideRdrLe20Obj32RdrObjTypConfPed : 271|4@0+ (7.0,0.0) [0.0|105.0] "%" ASDM
 SG_ ReSideRdrLe20Obj32RdrObjTypConfVeh : 267|4@0+ (7.0,0.0) [0.0|105.0] "%" ASDM
 SG_ ReSideRdrLe20Obj32RdrObjUsedTracker : 193|2@0+ (1,0) [0|3] "" ASDM
 SG_ ReSideRdrLe20Obj32RdrObjVx : 175|14@0+ (0.02,-128.0) [-128.0|128.0] "m/s" ASDM
 SG_ ReSideRdrLe20Obj32RdrObjVxStdDe : 141|6@0+ (0.05,0.0) [0.0|2.0] "m/s" ASDM
 SG_ ReSideRdrLe20Obj32RdrObjVy : 191|14@0+ (0.02,-128.0) [-128.0|128.0] "m/s" ASDM
 SG_ ReSideRdrLe20Obj32RdrObjVyStdDe : 286|6@0+ (0.05,0.0) [0.0|2.0] "m/s" ASDM
 SG_ ReSideRdrLe20Obj32RelVx : 231|12@0+ (0.02,-35.6) [-35.6|35.6] "m/s" ASDM
 SG_ ReSideRdrLe20Obj32RelVy : 247|12@0+ (0.02,-35.6) [-35.6|35.6] "m/s" ASDM

BO_ 1075 SODLPrivateCANFD5Fr33 : 64 SODL
 SG_ ReSideRdrLe20Sts_UB : 175|1@0+ (1,0) [0|1] "" ASDM
 SG_ ReSideRdrLe20StsForDim : 173|3@0+ (1,0) [0|7] "" ASDM
 SG_ ReSideRdrLe20StsForDim_UB : 174|1@0+ (1,0) [0|1] "" ASDM
 SG_ ReSideRdrLe20StsRdrNrDetn : 47|8@0+ (1.0,0.0) [0.0|255.0] "Unitless" ASDM
 SG_ ReSideRdrLe20StsRdrNrObj : 55|8@0+ (1.0,0.0) [0.0|255.0] "Unitless" ASDM
 SG_ ReSideRdrLe20StsRdrStsBlkd0bin : 24|1@0+ (1,0) [0|1] "" ASDM
 SG_ ReSideRdrLe20StsRdrStsBlkdConf : 31|7@0+ (1.0,0.0) [0.0|100.0] "%" ASDM
 SG_ ReSideRdrLe20StsRdrStsChks : 7|8@0+ (1.0,0.0) [0.0|255.0] "Unitless" ASDM
 SG_ ReSideRdrLe20StsRdrStsCntr : 15|4@0+ (1.0,0.0) [0.0|15.0] "Unitless" ASDM
 SG_ ReSideRdrLe20StsRdrStsDstbc : 39|7@0+ (1.0,0.0) [0.0|100.0] "%" ASDM
 SG_ ReSideRdrLe20StsRdrStsEna : 32|1@0+ (1,0) [0|1] "" ASDM
 SG_ ReSideRdrLe20StsRdrStsFaulty : 143|1@0+ (1,0) [0|1] "" ASDM
 SG_ ReSideRdrLe20StsRdrStsLatency : 127|16@0+ (1.0,0.0) [0.0|65535.0] "Unitless" ASDM
 SG_ ReSideRdrLe20StsRdrStslfVersMajor : 11|4@0+ (1.0,0.0) [0.0|15.0] "Unitless" ASDM
 SG_ ReSideRdrLe20StsRdrStslfVersMinor : 23|4@0+ (1.0,0.0) [0.0|15.0] "Unitless" ASDM
 SG_ ReSideRdrLe20StsRdrStsMisAlign : 19|3@0+ (1,0) [0|7] "" ASDM
 SG_ ReSideRdrLe20StsRdrStsMissCom : 16|1@0+ (1,0) [0|1] "" ASDM
 SG_ ReSideRdrLe20StsRdrStsTiStamp20 : 63|32@0+ (1.0,0.0) [0.0|4294967295.0] "s" ASDM
 SG_ ReSideRdrLe20StsRdrStsTiStampHi20 : 159|16@0+ (1.0,0.0) [0.0|65535.0] "s" ASDM
 SG_ ReSideRdrLe20StsRdrStsTiStampNano20 : 95|32@0+ (1.0,0.0) [0.0|4294967295.0] "ns" ASDM
 SG_ ReSideRdrLe20StsRdrStsTiStampStsGlbTiBas : 142|1@0+ (1,0) [0|1] "" ASDM
 SG_ ReSideRdrLe20StsRdrStsTiStampStsSyncToGateway : 141|1@0+ (1,0) [0|1] "" ASDM
 SG_ ReSideRdrLe20StsRdrStsTiStampStsTiLeap : 151|1@0+ (1,0) [0|1] "" ASDM
 SG_ ReSideRdrLe20StsRdrStsTiStampStsTiOut : 150|1@0+ (1,0) [0|1] "" ASDM
 SG_ ReSideRdrLe20StsRdrStsWhlSpdCmpFac : 140|5@0+ (0.005,0.92) [0.92|1.075] "Unitless" ASDM
 SG_ ReSideRdrLe20StsRdrSysSftyFlt : 149|2@0+ (1,0) [0|3] "" ASDM

BO_ 81 SODLPrivateCANFD5Fr34 : 64 SODL
 SG_ ReSideRdrLeDetn1_UB : 487|1@0+ (1,0) [0|1] "" ASDM
 SG_ ReSideRdrLeDetn1RdrDetnAmbigState : 72|1@0+ (1,0) [0|1] "" ASDM
 SG_ ReSideRdrLeDetn1RdrDetnAssoTrkID : 79|7@0+ (1.0,0.0) [0.0|127.0] "Unitless" ASDM
 SG_ ReSideRdrLeDetn1RdrDetnAzi : 34|11@0+ (0.1,-90.0) [-90.0|90.0] "Deg" ASDM
 SG_ ReSideRdrLeDetn1RdrDetnChks : 7|8@0+ (1.0,0.0) [0.0|255.0] "Unitless" ASDM
 SG_ ReSideRdrLeDetn1RdrDetnCntr : 15|4@0+ (1.0,0.0) [0.0|15.0] "Unitless" ASDM
 SG_ ReSideRdrLeDetn1RdrDetnConf : 11|7@0+ (1.0,0.0) [0.0|100.0] "%" ASDM
 SG_ ReSideRdrLeDetn1RdrDetnElevn : 20|5@0+ (1.0,-15.0) [-15.0|15.0] "Deg" ASDM
 SG_ ReSideRdrLeDetn1RdrDetnPwr : 71|6@0+ (1.0,0.0) [0.0|63.0] "dB" ASDM
 SG_ ReSideRdrLeDetn1RdrDetnRng : 55|14@0+ (0.02,-1.0) [-1.0|200.0] "m" ASDM
 SG_ ReSideRdrLeDetn1RdrDetnRngV : 31|13@0+ (0.02,-80.0) [-80.0|80.0] "m/s" ASDM
 SG_ ReSideRdrLeDetn1RdrDetnSameRV : 65|2@0+ (1,0) [0|3] "" ASDM
 SG_ ReSideRdrLeDetn1RdrDetnSts : 57|2@0+ (1,0) [0|3] "" ASDM
 SG_ ReSideRdrLeDetn2_UB : 486|1@0+ (1,0) [0|1] "" ASDM
 SG_ ReSideRdrLeDetn2RdrDetnAmbigState : 152|1@0+ (1,0) [0|1] "" ASDM
 SG_ ReSideRdrLeDetn2RdrDetnAssoTrkID : 159|7@0+ (1.0,0.0) [0.0|127.0] "Unitless" ASDM
 SG_ ReSideRdrLeDetn2RdrDetnAzi : 114|11@0+ (0.1,-90.0) [-90.0|90.0] "Deg" ASDM
 SG_ ReSideRdrLeDetn2RdrDetnChks : 87|8@0+ (1.0,0.0) [0.0|255.0] "Unitless" ASDM
 SG_ ReSideRdrLeDetn2RdrDetnCntr : 95|4@0+ (1.0,0.0) [0.0|15.0] "Unitless" ASDM
 SG_ ReSideRdrLeDetn2RdrDetnConf : 91|7@0+ (1.0,0.0) [0.0|100.0] "%" ASDM
 SG_ ReSideRdrLeDetn2RdrDetnElevn : 100|5@0+ (1.0,-15.0) [-15.0|15.0] "Deg" ASDM
 SG_ ReSideRdrLeDetn2RdrDetnPwr : 151|6@0+ (1.0,0.0) [0.0|63.0] "dB" ASDM
 SG_ ReSideRdrLeDetn2RdrDetnRng : 135|14@0+ (0.02,-1.0) [-1.0|200.0] "m" ASDM
 SG_ ReSideRdrLeDetn2RdrDetnRngV : 111|13@0+ (0.02,-80.0) [-80.0|80.0] "m/s" ASDM
 SG_ ReSideRdrLeDetn2RdrDetnSameRV : 145|2@0+ (1,0) [0|3] "" ASDM
 SG_ ReSideRdrLeDetn2RdrDetnSts : 137|2@0+ (1,0) [0|3] "" ASDM
 SG_ ReSideRdrLeDetn3_UB : 485|1@0+ (1,0) [0|1] "" ASDM
 SG_ ReSideRdrLeDetn3RdrDetnAmbigState : 232|1@0+ (1,0) [0|1] "" ASDM
 SG_ ReSideRdrLeDetn3RdrDetnAssoTrkID : 239|7@0+ (1.0,0.0) [0.0|127.0] "Unitless" ASDM
 SG_ ReSideRdrLeDetn3RdrDetnAzi : 194|11@0+ (0.1,-90.0) [-90.0|90.0] "Deg" ASDM
 SG_ ReSideRdrLeDetn3RdrDetnChks : 167|8@0+ (1.0,0.0) [0.0|255.0] "Unitless" ASDM
 SG_ ReSideRdrLeDetn3RdrDetnCntr : 175|4@0+ (1.0,0.0) [0.0|15.0] "Unitless" ASDM
 SG_ ReSideRdrLeDetn3RdrDetnConf : 171|7@0+ (1.0,0.0) [0.0|100.0] "%" ASDM
 SG_ ReSideRdrLeDetn3RdrDetnElevn : 180|5@0+ (1.0,-15.0) [-15.0|15.0] "Deg" ASDM
 SG_ ReSideRdrLeDetn3RdrDetnPwr : 231|6@0+ (1.0,0.0) [0.0|63.0] "dB" ASDM
 SG_ ReSideRdrLeDetn3RdrDetnRng : 215|14@0+ (0.02,-1.0) [-1.0|200.0] "m" ASDM
 SG_ ReSideRdrLeDetn3RdrDetnRngV : 191|13@0+ (0.02,-80.0) [-80.0|80.0] "m/s" ASDM
 SG_ ReSideRdrLeDetn3RdrDetnSameRV : 225|2@0+ (1,0) [0|3] "" ASDM
 SG_ ReSideRdrLeDetn3RdrDetnSts : 217|2@0+ (1,0) [0|3] "" ASDM
 SG_ ReSideRdrLeDetn4_UB : 484|1@0+ (1,0) [0|1] "" ASDM
 SG_ ReSideRdrLeDetn4RdrDetnAmbigState : 312|1@0+ (1,0) [0|1] "" ASDM
 SG_ ReSideRdrLeDetn4RdrDetnAssoTrkID : 319|7@0+ (1.0,0.0) [0.0|127.0] "Unitless" ASDM
 SG_ ReSideRdrLeDetn4RdrDetnAzi : 274|11@0+ (0.1,-90.0) [-90.0|90.0] "Deg" ASDM
 SG_ ReSideRdrLeDetn4RdrDetnChks : 247|8@0+ (1.0,0.0) [0.0|255.0] "Unitless" ASDM
 SG_ ReSideRdrLeDetn4RdrDetnCntr : 255|4@0+ (1.0,0.0) [0.0|15.0] "Unitless" ASDM
 SG_ ReSideRdrLeDetn4RdrDetnConf : 251|7@0+ (1.0,0.0) [0.0|100.0] "%" ASDM
 SG_ ReSideRdrLeDetn4RdrDetnElevn : 260|5@0+ (1.0,-15.0) [-15.0|15.0] "Deg" ASDM
 SG_ ReSideRdrLeDetn4RdrDetnPwr : 311|6@0+ (1.0,0.0) [0.0|63.0] "dB" ASDM
 SG_ ReSideRdrLeDetn4RdrDetnRng : 295|14@0+ (0.02,-1.0) [-1.0|200.0] "m" ASDM
 SG_ ReSideRdrLeDetn4RdrDetnRngV : 271|13@0+ (0.02,-80.0) [-80.0|80.0] "m/s" ASDM
 SG_ ReSideRdrLeDetn4RdrDetnSameRV : 305|2@0+ (1,0) [0|3] "" ASDM
 SG_ ReSideRdrLeDetn4RdrDetnSts : 297|2@0+ (1,0) [0|3] "" ASDM
 SG_ ReSideRdrLeDetn5_UB : 483|1@0+ (1,0) [0|1] "" ASDM
 SG_ ReSideRdrLeDetn5RdrDetnAmbigState : 392|1@0+ (1,0) [0|1] "" ASDM
 SG_ ReSideRdrLeDetn5RdrDetnAssoTrkID : 399|7@0+ (1.0,0.0) [0.0|127.0] "Unitless" ASDM
 SG_ ReSideRdrLeDetn5RdrDetnAzi : 354|11@0+ (0.1,-90.0) [-90.0|90.0] "Deg" ASDM
 SG_ ReSideRdrLeDetn5RdrDetnChks : 327|8@0+ (1.0,0.0) [0.0|255.0] "Unitless" ASDM
 SG_ ReSideRdrLeDetn5RdrDetnCntr : 335|4@0+ (1.0,0.0) [0.0|15.0] "Unitless" ASDM
 SG_ ReSideRdrLeDetn5RdrDetnConf : 331|7@0+ (1.0,0.0) [0.0|100.0] "%" ASDM
 SG_ ReSideRdrLeDetn5RdrDetnElevn : 340|5@0+ (1.0,-15.0) [-15.0|15.0] "Deg" ASDM
 SG_ ReSideRdrLeDetn5RdrDetnPwr : 391|6@0+ (1.0,0.0) [0.0|63.0] "dB" ASDM
 SG_ ReSideRdrLeDetn5RdrDetnRng : 375|14@0+ (0.02,-1.0) [-1.0|200.0] "m" ASDM
 SG_ ReSideRdrLeDetn5RdrDetnRngV : 351|13@0+ (0.02,-80.0) [-80.0|80.0] "m/s" ASDM
 SG_ ReSideRdrLeDetn5RdrDetnSameRV : 385|2@0+ (1,0) [0|3] "" ASDM
 SG_ ReSideRdrLeDetn5RdrDetnSts : 377|2@0+ (1,0) [0|3] "" ASDM
 SG_ ReSideRdrLeDetn6_UB : 482|1@0+ (1,0) [0|1] "" ASDM
 SG_ ReSideRdrLeDetn6RdrDetnAmbigState : 472|1@0+ (1,0) [0|1] "" ASDM
 SG_ ReSideRdrLeDetn6RdrDetnAssoTrkID : 479|7@0+ (1.0,0.0) [0.0|127.0] "Unitless" ASDM
 SG_ ReSideRdrLeDetn6RdrDetnAzi : 434|11@0+ (0.1,-90.0) [-90.0|90.0] "Deg" ASDM
 SG_ ReSideRdrLeDetn6RdrDetnChks : 407|8@0+ (1.0,0.0) [0.0|255.0] "Unitless" ASDM
 SG_ ReSideRdrLeDetn6RdrDetnCntr : 415|4@0+ (1.0,0.0) [0.0|15.0] "Unitless" ASDM
 SG_ ReSideRdrLeDetn6RdrDetnConf : 411|7@0+ (1.0,0.0) [0.0|100.0] "%" ASDM
 SG_ ReSideRdrLeDetn6RdrDetnElevn : 420|5@0+ (1.0,-15.0) [-15.0|15.0] "Deg" ASDM
 SG_ ReSideRdrLeDetn6RdrDetnPwr : 471|6@0+ (1.0,0.0) [0.0|63.0] "dB" ASDM
 SG_ ReSideRdrLeDetn6RdrDetnRng : 455|14@0+ (0.02,-1.0) [-1.0|200.0] "m" ASDM
 SG_ ReSideRdrLeDetn6RdrDetnRngV : 431|13@0+ (0.02,-80.0) [-80.0|80.0] "m/s" ASDM
 SG_ ReSideRdrLeDetn6RdrDetnSameRV : 465|2@0+ (1,0) [0|3] "" ASDM
 SG_ ReSideRdrLeDetn6RdrDetnSts : 457|2@0+ (1,0) [0|3] "" ASDM

BO_ 82 SODLPrivateCANFD5Fr35 : 64 SODL
 SG_ ReSideRdrLeDetn10_UB : 484|1@0+ (1,0) [0|1] "" ASDM
 SG_ ReSideRdrLeDetn10RdrDetnAmbigState : 312|1@0+ (1,0) [0|1] "" ASDM
 SG_ ReSideRdrLeDetn10RdrDetnAssoTrkID : 319|7@0+ (1.0,0.0) [0.0|127.0] "Unitless" ASDM
 SG_ ReSideRdrLeDetn10RdrDetnAzi : 274|11@0+ (0.1,-90.0) [-90.0|90.0] "Deg" ASDM
 SG_ ReSideRdrLeDetn10RdrDetnChks : 247|8@0+ (1.0,0.0) [0.0|255.0] "Unitless" ASDM
 SG_ ReSideRdrLeDetn10RdrDetnCntr : 255|4@0+ (1.0,0.0) [0.0|15.0] "Unitless" ASDM
 SG_ ReSideRdrLeDetn10RdrDetnConf : 251|7@0+ (1.0,0.0) [0.0|100.0] "%" ASDM
 SG_ ReSideRdrLeDetn10RdrDetnElevn : 260|5@0+ (1.0,-15.0) [-15.0|15.0] "Deg" ASDM
 SG_ ReSideRdrLeDetn10RdrDetnPwr : 311|6@0+ (1.0,0.0) [0.0|63.0] "dB" ASDM
 SG_ ReSideRdrLeDetn10RdrDetnRng : 295|14@0+ (0.02,-1.0) [-1.0|200.0] "m" ASDM
 SG_ ReSideRdrLeDetn10RdrDetnRngV : 271|13@0+ (0.02,-80.0) [-80.0|80.0] "m/s" ASDM
 SG_ ReSideRdrLeDetn10RdrDetnSameRV : 305|2@0+ (1,0) [0|3] "" ASDM
 SG_ ReSideRdrLeDetn10RdrDetnSts : 297|2@0+ (1,0) [0|3] "" ASDM
 SG_ ReSideRdrLeDetn11_UB : 483|1@0+ (1,0) [0|1] "" ASDM
 SG_ ReSideRdrLeDetn11RdrDetnAmbigState : 392|1@0+ (1,0) [0|1] "" ASDM
 SG_ ReSideRdrLeDetn11RdrDetnAssoTrkID : 399|7@0+ (1.0,0.0) [0.0|127.0] "Unitless" ASDM
 SG_ ReSideRdrLeDetn11RdrDetnAzi : 354|11@0+ (0.1,-90.0) [-90.0|90.0] "Deg" ASDM
 SG_ ReSideRdrLeDetn11RdrDetnChks : 327|8@0+ (1.0,0.0) [0.0|255.0] "Unitless" ASDM
 SG_ ReSideRdrLeDetn11RdrDetnCntr : 335|4@0+ (1.0,0.0) [0.0|15.0] "Unitless" ASDM
 SG_ ReSideRdrLeDetn11RdrDetnConf : 331|7@0+ (1.0,0.0) [0.0|100.0] "%" ASDM
 SG_ ReSideRdrLeDetn11RdrDetnElevn : 340|5@0+ (1.0,-15.0) [-15.0|15.0] "Deg" ASDM
 SG_ ReSideRdrLeDetn11RdrDetnPwr : 391|6@0+ (1.0,0.0) [0.0|63.0] "dB" ASDM
 SG_ ReSideRdrLeDetn11RdrDetnRng : 375|14@0+ (0.02,-1.0) [-1.0|200.0] "m" ASDM
 SG_ ReSideRdrLeDetn11RdrDetnRngV : 351|13@0+ (0.02,-80.0) [-80.0|80.0] "m/s" ASDM
 SG_ ReSideRdrLeDetn11RdrDetnSameRV : 385|2@0+ (1,0) [0|3] "" ASDM
 SG_ ReSideRdrLeDetn11RdrDetnSts : 377|2@0+ (1,0) [0|3] "" ASDM
 SG_ ReSideRdrLeDetn12_UB : 482|1@0+ (1,0) [0|1] "" ASDM
 SG_ ReSideRdrLeDetn12RdrDetnAmbigState : 472|1@0+ (1,0) [0|1] "" ASDM
 SG_ ReSideRdrLeDetn12RdrDetnAssoTrkID : 479|7@0+ (1.0,0.0) [0.0|127.0] "Unitless" ASDM
 SG_ ReSideRdrLeDetn12RdrDetnAzi : 434|11@0+ (0.1,-90.0) [-90.0|90.0] "Deg" ASDM
 SG_ ReSideRdrLeDetn12RdrDetnChks : 407|8@0+ (1.0,0.0) [0.0|255.0] "Unitless" ASDM
 SG_ ReSideRdrLeDetn12RdrDetnCntr : 415|4@0+ (1.0,0.0) [0.0|15.0] "Unitless" ASDM
 SG_ ReSideRdrLeDetn12RdrDetnConf : 411|7@0+ (1.0,0.0) [0.0|100.0] "%" ASDM
 SG_ ReSideRdrLeDetn12RdrDetnElevn : 420|5@0+ (1.0,-15.0) [-15.0|15.0] "Deg" ASDM
 SG_ ReSideRdrLeDetn12RdrDetnPwr : 471|6@0+ (1.0,0.0) [0.0|63.0] "dB" ASDM
 SG_ ReSideRdrLeDetn12RdrDetnRng : 455|14@0+ (0.02,-1.0) [-1.0|200.0] "m" ASDM
 SG_ ReSideRdrLeDetn12RdrDetnRngV : 431|13@0+ (0.02,-80.0) [-80.0|80.0] "m/s" ASDM
 SG_ ReSideRdrLeDetn12RdrDetnSameRV : 465|2@0+ (1,0) [0|3] "" ASDM
 SG_ ReSideRdrLeDetn12RdrDetnSts : 457|2@0+ (1,0) [0|3] "" ASDM
 SG_ ReSideRdrLeDetn7_UB : 487|1@0+ (1,0) [0|1] "" ASDM
 SG_ ReSideRdrLeDetn7RdrDetnAmbigState : 72|1@0+ (1,0) [0|1] "" ASDM
 SG_ ReSideRdrLeDetn7RdrDetnAssoTrkID : 79|7@0+ (1.0,0.0) [0.0|127.0] "Unitless" ASDM
 SG_ ReSideRdrLeDetn7RdrDetnAzi : 34|11@0+ (0.1,-90.0) [-90.0|90.0] "Deg" ASDM
 SG_ ReSideRdrLeDetn7RdrDetnChks : 7|8@0+ (1.0,0.0) [0.0|255.0] "Unitless" ASDM
 SG_ ReSideRdrLeDetn7RdrDetnCntr : 15|4@0+ (1.0,0.0) [0.0|15.0] "Unitless" ASDM
 SG_ ReSideRdrLeDetn7RdrDetnConf : 11|7@0+ (1.0,0.0) [0.0|100.0] "%" ASDM
 SG_ ReSideRdrLeDetn7RdrDetnElevn : 20|5@0+ (1.0,-15.0) [-15.0|15.0] "Deg" ASDM
 SG_ ReSideRdrLeDetn7RdrDetnPwr : 71|6@0+ (1.0,0.0) [0.0|63.0] "dB" ASDM
 SG_ ReSideRdrLeDetn7RdrDetnRng : 55|14@0+ (0.02,-1.0) [-1.0|200.0] "m" ASDM
 SG_ ReSideRdrLeDetn7RdrDetnRngV : 31|13@0+ (0.02,-80.0) [-80.0|80.0] "m/s" ASDM
 SG_ ReSideRdrLeDetn7RdrDetnSameRV : 65|2@0+ (1,0) [0|3] "" ASDM
 SG_ ReSideRdrLeDetn7RdrDetnSts : 57|2@0+ (1,0) [0|3] "" ASDM
 SG_ ReSideRdrLeDetn8_UB : 486|1@0+ (1,0) [0|1] "" ASDM
 SG_ ReSideRdrLeDetn8RdrDetnAmbigState : 152|1@0+ (1,0) [0|1] "" ASDM
 SG_ ReSideRdrLeDetn8RdrDetnAssoTrkID : 159|7@0+ (1.0,0.0) [0.0|127.0] "Unitless" ASDM
 SG_ ReSideRdrLeDetn8RdrDetnAzi : 114|11@0+ (0.1,-90.0) [-90.0|90.0] "Deg" ASDM
 SG_ ReSideRdrLeDetn8RdrDetnChks : 87|8@0+ (1.0,0.0) [0.0|255.0] "Unitless" ASDM
 SG_ ReSideRdrLeDetn8RdrDetnCntr : 95|4@0+ (1.0,0.0) [0.0|15.0] "Unitless" ASDM
 SG_ ReSideRdrLeDetn8RdrDetnConf : 91|7@0+ (1.0,0.0) [0.0|100.0] "%" ASDM
 SG_ ReSideRdrLeDetn8RdrDetnElevn : 100|5@0+ (1.0,-15.0) [-15.0|15.0] "Deg" ASDM
 SG_ ReSideRdrLeDetn8RdrDetnPwr : 151|6@0+ (1.0,0.0) [0.0|63.0] "dB" ASDM
 SG_ ReSideRdrLeDetn8RdrDetnRng : 135|14@0+ (0.02,-1.0) [-1.0|200.0] "m" ASDM
 SG_ ReSideRdrLeDetn8RdrDetnRngV : 111|13@0+ (0.02,-80.0) [-80.0|80.0] "m/s" ASDM
 SG_ ReSideRdrLeDetn8RdrDetnSameRV : 145|2@0+ (1,0) [0|3] "" ASDM
 SG_ ReSideRdrLeDetn8RdrDetnSts : 137|2@0+ (1,0) [0|3] "" ASDM
 SG_ ReSideRdrLeDetn9_UB : 485|1@0+ (1,0) [0|1] "" ASDM
 SG_ ReSideRdrLeDetn9RdrDetnAmbigState : 232|1@0+ (1,0) [0|1] "" ASDM
 SG_ ReSideRdrLeDetn9RdrDetnAssoTrkID : 239|7@0+ (1.0,0.0) [0.0|127.0] "Unitless" ASDM
 SG_ ReSideRdrLeDetn9RdrDetnAzi : 194|11@0+ (0.1,-90.0) [-90.0|90.0] "Deg" ASDM
 SG_ ReSideRdrLeDetn9RdrDetnChks : 167|8@0+ (1.0,0.0) [0.0|255.0] "Unitless" ASDM
 SG_ ReSideRdrLeDetn9RdrDetnCntr : 175|4@0+ (1.0,0.0) [0.0|15.0] "Unitless" ASDM
 SG_ ReSideRdrLeDetn9RdrDetnConf : 171|7@0+ (1.0,0.0) [0.0|100.0] "%" ASDM
 SG_ ReSideRdrLeDetn9RdrDetnElevn : 180|5@0+ (1.0,-15.0) [-15.0|15.0] "Deg" ASDM
 SG_ ReSideRdrLeDetn9RdrDetnPwr : 231|6@0+ (1.0,0.0) [0.0|63.0] "dB" ASDM
 SG_ ReSideRdrLeDetn9RdrDetnRng : 215|14@0+ (0.02,-1.0) [-1.0|200.0] "m" ASDM
 SG_ ReSideRdrLeDetn9RdrDetnRngV : 191|13@0+ (0.02,-80.0) [-80.0|80.0] "m/s" ASDM
 SG_ ReSideRdrLeDetn9RdrDetnSameRV : 225|2@0+ (1,0) [0|3] "" ASDM
 SG_ ReSideRdrLeDetn9RdrDetnSts : 217|2@0+ (1,0) [0|3] "" ASDM

BO_ 83 SODLPrivateCANFD5Fr36 : 64 SODL
 SG_ ReSideRdrLeDetn13_UB : 487|1@0+ (1,0) [0|1] "" ASDM
 SG_ ReSideRdrLeDetn13RdrDetnAmbigState : 72|1@0+ (1,0) [0|1] "" ASDM
 SG_ ReSideRdrLeDetn13RdrDetnAssoTrkID : 79|7@0+ (1.0,0.0) [0.0|127.0] "Unitless" ASDM
 SG_ ReSideRdrLeDetn13RdrDetnAzi : 34|11@0+ (0.1,-90.0) [-90.0|90.0] "Deg" ASDM
 SG_ ReSideRdrLeDetn13RdrDetnChks : 7|8@0+ (1.0,0.0) [0.0|255.0] "Unitless" ASDM
 SG_ ReSideRdrLeDetn13RdrDetnCntr : 15|4@0+ (1.0,0.0) [0.0|15.0] "Unitless" ASDM
 SG_ ReSideRdrLeDetn13RdrDetnConf : 11|7@0+ (1.0,0.0) [0.0|100.0] "%" ASDM
 SG_ ReSideRdrLeDetn13RdrDetnElevn : 20|5@0+ (1.0,-15.0) [-15.0|15.0] "Deg" ASDM
 SG_ ReSideRdrLeDetn13RdrDetnPwr : 71|6@0+ (1.0,0.0) [0.0|63.0] "dB" ASDM
 SG_ ReSideRdrLeDetn13RdrDetnRng : 55|14@0+ (0.02,-1.0) [-1.0|200.0] "m" ASDM
 SG_ ReSideRdrLeDetn13RdrDetnRngV : 31|13@0+ (0.02,-80.0) [-80.0|80.0] "m/s" ASDM
 SG_ ReSideRdrLeDetn13RdrDetnSameRV : 65|2@0+ (1,0) [0|3] "" ASDM
 SG_ ReSideRdrLeDetn13RdrDetnSts : 57|2@0+ (1,0) [0|3] "" ASDM
 SG_ ReSideRdrLeDetn14_UB : 486|1@0+ (1,0) [0|1] "" ASDM
 SG_ ReSideRdrLeDetn14RdrDetnAmbigState : 152|1@0+ (1,0) [0|1] "" ASDM
 SG_ ReSideRdrLeDetn14RdrDetnAssoTrkID : 159|7@0+ (1.0,0.0) [0.0|127.0] "Unitless" ASDM
 SG_ ReSideRdrLeDetn14RdrDetnAzi : 114|11@0+ (0.1,-90.0) [-90.0|90.0] "Deg" ASDM
 SG_ ReSideRdrLeDetn14RdrDetnChks : 87|8@0+ (1.0,0.0) [0.0|255.0] "Unitless" ASDM
 SG_ ReSideRdrLeDetn14RdrDetnCntr : 95|4@0+ (1.0,0.0) [0.0|15.0] "Unitless" ASDM
 SG_ ReSideRdrLeDetn14RdrDetnConf : 91|7@0+ (1.0,0.0) [0.0|100.0] "%" ASDM
 SG_ ReSideRdrLeDetn14RdrDetnElevn : 100|5@0+ (1.0,-15.0) [-15.0|15.0] "Deg" ASDM
 SG_ ReSideRdrLeDetn14RdrDetnPwr : 151|6@0+ (1.0,0.0) [0.0|63.0] "dB" ASDM
 SG_ ReSideRdrLeDetn14RdrDetnRng : 135|14@0+ (0.02,-1.0) [-1.0|200.0] "m" ASDM
 SG_ ReSideRdrLeDetn14RdrDetnRngV : 111|13@0+ (0.02,-80.0) [-80.0|80.0] "m/s" ASDM
 SG_ ReSideRdrLeDetn14RdrDetnSameRV : 145|2@0+ (1,0) [0|3] "" ASDM
 SG_ ReSideRdrLeDetn14RdrDetnSts : 137|2@0+ (1,0) [0|3] "" ASDM
 SG_ ReSideRdrLeDetn15_UB : 485|1@0+ (1,0) [0|1] "" ASDM
 SG_ ReSideRdrLeDetn15RdrDetnAmbigState : 232|1@0+ (1,0) [0|1] "" ASDM
 SG_ ReSideRdrLeDetn15RdrDetnAssoTrkID : 239|7@0+ (1.0,0.0) [0.0|127.0] "Unitless" ASDM
 SG_ ReSideRdrLeDetn15RdrDetnAzi : 194|11@0+ (0.1,-90.0) [-90.0|90.0] "Deg" ASDM
 SG_ ReSideRdrLeDetn15RdrDetnChks : 167|8@0+ (1.0,0.0) [0.0|255.0] "Unitless" ASDM
 SG_ ReSideRdrLeDetn15RdrDetnCntr : 175|4@0+ (1.0,0.0) [0.0|15.0] "Unitless" ASDM
 SG_ ReSideRdrLeDetn15RdrDetnConf : 171|7@0+ (1.0,0.0) [0.0|100.0] "%" ASDM
 SG_ ReSideRdrLeDetn15RdrDetnElevn : 180|5@0+ (1.0,-15.0) [-15.0|15.0] "Deg" ASDM
 SG_ ReSideRdrLeDetn15RdrDetnPwr : 231|6@0+ (1.0,0.0) [0.0|63.0] "dB" ASDM
 SG_ ReSideRdrLeDetn15RdrDetnRng : 215|14@0+ (0.02,-1.0) [-1.0|200.0] "m" ASDM
 SG_ ReSideRdrLeDetn15RdrDetnRngV : 191|13@0+ (0.02,-80.0) [-80.0|80.0] "m/s" ASDM
 SG_ ReSideRdrLeDetn15RdrDetnSameRV : 225|2@0+ (1,0) [0|3] "" ASDM
 SG_ ReSideRdrLeDetn15RdrDetnSts : 217|2@0+ (1,0) [0|3] "" ASDM
 SG_ ReSideRdrLeDetn16_UB : 484|1@0+ (1,0) [0|1] "" ASDM
 SG_ ReSideRdrLeDetn16RdrDetnAmbigState : 312|1@0+ (1,0) [0|1] "" ASDM
 SG_ ReSideRdrLeDetn16RdrDetnAssoTrkID : 319|7@0+ (1.0,0.0) [0.0|127.0] "Unitless" ASDM
 SG_ ReSideRdrLeDetn16RdrDetnAzi : 274|11@0+ (0.1,-90.0) [-90.0|90.0] "Deg" ASDM
 SG_ ReSideRdrLeDetn16RdrDetnChks : 247|8@0+ (1.0,0.0) [0.0|255.0] "Unitless" ASDM
 SG_ ReSideRdrLeDetn16RdrDetnCntr : 255|4@0+ (1.0,0.0) [0.0|15.0] "Unitless" ASDM
 SG_ ReSideRdrLeDetn16RdrDetnConf : 251|7@0+ (1.0,0.0) [0.0|100.0] "%" ASDM
 SG_ ReSideRdrLeDetn16RdrDetnElevn : 260|5@0+ (1.0,-15.0) [-15.0|15.0] "Deg" ASDM
 SG_ ReSideRdrLeDetn16RdrDetnPwr : 311|6@0+ (1.0,0.0) [0.0|63.0] "dB" ASDM
 SG_ ReSideRdrLeDetn16RdrDetnRng : 295|14@0+ (0.02,-1.0) [-1.0|200.0] "m" ASDM
 SG_ ReSideRdrLeDetn16RdrDetnRngV : 271|13@0+ (0.02,-80.0) [-80.0|80.0] "m/s" ASDM
 SG_ ReSideRdrLeDetn16RdrDetnSameRV : 305|2@0+ (1,0) [0|3] "" ASDM
 SG_ ReSideRdrLeDetn16RdrDetnSts : 297|2@0+ (1,0) [0|3] "" ASDM
 SG_ ReSideRdrLeDetn17_UB : 483|1@0+ (1,0) [0|1] "" ASDM
 SG_ ReSideRdrLeDetn17RdrDetnAmbigState : 392|1@0+ (1,0) [0|1] "" ASDM
 SG_ ReSideRdrLeDetn17RdrDetnAssoTrkID : 399|7@0+ (1.0,0.0) [0.0|127.0] "Unitless" ASDM
 SG_ ReSideRdrLeDetn17RdrDetnAzi : 354|11@0+ (0.1,-90.0) [-90.0|90.0] "Deg" ASDM
 SG_ ReSideRdrLeDetn17RdrDetnChks : 327|8@0+ (1.0,0.0) [0.0|255.0] "Unitless" ASDM
 SG_ ReSideRdrLeDetn17RdrDetnCntr : 335|4@0+ (1.0,0.0) [0.0|15.0] "Unitless" ASDM
 SG_ ReSideRdrLeDetn17RdrDetnConf : 331|7@0+ (1.0,0.0) [0.0|100.0] "%" ASDM
 SG_ ReSideRdrLeDetn17RdrDetnElevn : 340|5@0+ (1.0,-15.0) [-15.0|15.0] "Deg" ASDM
 SG_ ReSideRdrLeDetn17RdrDetnPwr : 391|6@0+ (1.0,0.0) [0.0|63.0] "dB" ASDM
 SG_ ReSideRdrLeDetn17RdrDetnRng : 375|14@0+ (0.02,-1.0) [-1.0|200.0] "m" ASDM
 SG_ ReSideRdrLeDetn17RdrDetnRngV : 351|13@0+ (0.02,-80.0) [-80.0|80.0] "m/s" ASDM
 SG_ ReSideRdrLeDetn17RdrDetnSameRV : 385|2@0+ (1,0) [0|3] "" ASDM
 SG_ ReSideRdrLeDetn17RdrDetnSts : 377|2@0+ (1,0) [0|3] "" ASDM
 SG_ ReSideRdrLeDetn18_UB : 482|1@0+ (1,0) [0|1] "" ASDM
 SG_ ReSideRdrLeDetn18RdrDetnAmbigState : 472|1@0+ (1,0) [0|1] "" ASDM
 SG_ ReSideRdrLeDetn18RdrDetnAssoTrkID : 479|7@0+ (1.0,0.0) [0.0|127.0] "Unitless" ASDM
 SG_ ReSideRdrLeDetn18RdrDetnAzi : 434|11@0+ (0.1,-90.0) [-90.0|90.0] "Deg" ASDM
 SG_ ReSideRdrLeDetn18RdrDetnChks : 407|8@0+ (1.0,0.0) [0.0|255.0] "Unitless" ASDM
 SG_ ReSideRdrLeDetn18RdrDetnCntr : 415|4@0+ (1.0,0.0) [0.0|15.0] "Unitless" ASDM
 SG_ ReSideRdrLeDetn18RdrDetnConf : 411|7@0+ (1.0,0.0) [0.0|100.0] "%" ASDM
 SG_ ReSideRdrLeDetn18RdrDetnElevn : 420|5@0+ (1.0,-15.0) [-15.0|15.0] "Deg" ASDM
 SG_ ReSideRdrLeDetn18RdrDetnPwr : 471|6@0+ (1.0,0.0) [0.0|63.0] "dB" ASDM
 SG_ ReSideRdrLeDetn18RdrDetnRng : 455|14@0+ (0.02,-1.0) [-1.0|200.0] "m" ASDM
 SG_ ReSideRdrLeDetn18RdrDetnRngV : 431|13@0+ (0.02,-80.0) [-80.0|80.0] "m/s" ASDM
 SG_ ReSideRdrLeDetn18RdrDetnSameRV : 465|2@0+ (1,0) [0|3] "" ASDM
 SG_ ReSideRdrLeDetn18RdrDetnSts : 457|2@0+ (1,0) [0|3] "" ASDM

BO_ 84 SODLPrivateCANFD5Fr37 : 64 SODL
 SG_ ReSideRdrLeDetn19_UB : 487|1@0+ (1,0) [0|1] "" ASDM
 SG_ ReSideRdrLeDetn19RdrDetnAmbigState : 72|1@0+ (1,0) [0|1] "" ASDM
 SG_ ReSideRdrLeDetn19RdrDetnAssoTrkID : 79|7@0+ (1.0,0.0) [0.0|127.0] "Unitless" ASDM
 SG_ ReSideRdrLeDetn19RdrDetnAzi : 34|11@0+ (0.1,-90.0) [-90.0|90.0] "Deg" ASDM
 SG_ ReSideRdrLeDetn19RdrDetnChks : 7|8@0+ (1.0,0.0) [0.0|255.0] "Unitless" ASDM
 SG_ ReSideRdrLeDetn19RdrDetnCntr : 15|4@0+ (1.0,0.0) [0.0|15.0] "Unitless" ASDM
 SG_ ReSideRdrLeDetn19RdrDetnConf : 11|7@0+ (1.0,0.0) [0.0|100.0] "%" ASDM
 SG_ ReSideRdrLeDetn19RdrDetnElevn : 20|5@0+ (1.0,-15.0) [-15.0|15.0] "Deg" ASDM
 SG_ ReSideRdrLeDetn19RdrDetnPwr : 71|6@0+ (1.0,0.0) [0.0|63.0] "dB" ASDM
 SG_ ReSideRdrLeDetn19RdrDetnRng : 55|14@0+ (0.02,-1.0) [-1.0|200.0] "m" ASDM
 SG_ ReSideRdrLeDetn19RdrDetnRngV : 31|13@0+ (0.02,-80.0) [-80.0|80.0] "m/s" ASDM
 SG_ ReSideRdrLeDetn19RdrDetnSameRV : 65|2@0+ (1,0) [0|3] "" ASDM
 SG_ ReSideRdrLeDetn19RdrDetnSts : 57|2@0+ (1,0) [0|3] "" ASDM
 SG_ ReSideRdrLeDetn20_UB : 486|1@0+ (1,0) [0|1] "" ASDM
 SG_ ReSideRdrLeDetn20RdrDetnAmbigState : 152|1@0+ (1,0) [0|1] "" ASDM
 SG_ ReSideRdrLeDetn20RdrDetnAssoTrkID : 159|7@0+ (1.0,0.0) [0.0|127.0] "Unitless" ASDM
 SG_ ReSideRdrLeDetn20RdrDetnAzi : 114|11@0+ (0.1,-90.0) [-90.0|90.0] "Deg" ASDM
 SG_ ReSideRdrLeDetn20RdrDetnChks : 87|8@0+ (1.0,0.0) [0.0|255.0] "Unitless" ASDM
 SG_ ReSideRdrLeDetn20RdrDetnCntr : 95|4@0+ (1.0,0.0) [0.0|15.0] "Unitless" ASDM
 SG_ ReSideRdrLeDetn20RdrDetnConf : 91|7@0+ (1.0,0.0) [0.0|100.0] "%" ASDM
 SG_ ReSideRdrLeDetn20RdrDetnElevn : 100|5@0+ (1.0,-15.0) [-15.0|15.0] "Deg" ASDM
 SG_ ReSideRdrLeDetn20RdrDetnPwr : 151|6@0+ (1.0,0.0) [0.0|63.0] "dB" ASDM
 SG_ ReSideRdrLeDetn20RdrDetnRng : 135|14@0+ (0.02,-1.0) [-1.0|200.0] "m" ASDM
 SG_ ReSideRdrLeDetn20RdrDetnRngV : 111|13@0+ (0.02,-80.0) [-80.0|80.0] "m/s" ASDM
 SG_ ReSideRdrLeDetn20RdrDetnSameRV : 145|2@0+ (1,0) [0|3] "" ASDM
 SG_ ReSideRdrLeDetn20RdrDetnSts : 137|2@0+ (1,0) [0|3] "" ASDM
 SG_ ReSideRdrLeDetn21_UB : 485|1@0+ (1,0) [0|1] "" ASDM
 SG_ ReSideRdrLeDetn21RdrDetnAmbigState : 232|1@0+ (1,0) [0|1] "" ASDM
 SG_ ReSideRdrLeDetn21RdrDetnAssoTrkID : 239|7@0+ (1.0,0.0) [0.0|127.0] "Unitless" ASDM
 SG_ ReSideRdrLeDetn21RdrDetnAzi : 194|11@0+ (0.1,-90.0) [-90.0|90.0] "Deg" ASDM
 SG_ ReSideRdrLeDetn21RdrDetnChks : 167|8@0+ (1.0,0.0) [0.0|255.0] "Unitless" ASDM
 SG_ ReSideRdrLeDetn21RdrDetnCntr : 175|4@0+ (1.0,0.0) [0.0|15.0] "Unitless" ASDM
 SG_ ReSideRdrLeDetn21RdrDetnConf : 171|7@0+ (1.0,0.0) [0.0|100.0] "%" ASDM
 SG_ ReSideRdrLeDetn21RdrDetnElevn : 180|5@0+ (1.0,-15.0) [-15.0|15.0] "Deg" ASDM
 SG_ ReSideRdrLeDetn21RdrDetnPwr : 231|6@0+ (1.0,0.0) [0.0|63.0] "dB" ASDM
 SG_ ReSideRdrLeDetn21RdrDetnRng : 215|14@0+ (0.02,-1.0) [-1.0|200.0] "m" ASDM
 SG_ ReSideRdrLeDetn21RdrDetnRngV : 191|13@0+ (0.02,-80.0) [-80.0|80.0] "m/s" ASDM
 SG_ ReSideRdrLeDetn21RdrDetnSameRV : 225|2@0+ (1,0) [0|3] "" ASDM
 SG_ ReSideRdrLeDetn21RdrDetnSts : 217|2@0+ (1,0) [0|3] "" ASDM
 SG_ ReSideRdrLeDetn22_UB : 484|1@0+ (1,0) [0|1] "" ASDM
 SG_ ReSideRdrLeDetn22RdrDetnAmbigState : 312|1@0+ (1,0) [0|1] "" ASDM
 SG_ ReSideRdrLeDetn22RdrDetnAssoTrkID : 319|7@0+ (1.0,0.0) [0.0|127.0] "Unitless" ASDM
 SG_ ReSideRdrLeDetn22RdrDetnAzi : 274|11@0+ (0.1,-90.0) [-90.0|90.0] "Deg" ASDM
 SG_ ReSideRdrLeDetn22RdrDetnChks : 247|8@0+ (1.0,0.0) [0.0|255.0] "Unitless" ASDM
 SG_ ReSideRdrLeDetn22RdrDetnCntr : 255|4@0+ (1.0,0.0) [0.0|15.0] "Unitless" ASDM
 SG_ ReSideRdrLeDetn22RdrDetnConf : 251|7@0+ (1.0,0.0) [0.0|100.0] "%" ASDM
 SG_ ReSideRdrLeDetn22RdrDetnElevn : 260|5@0+ (1.0,-15.0) [-15.0|15.0] "Deg" ASDM
 SG_ ReSideRdrLeDetn22RdrDetnPwr : 311|6@0+ (1.0,0.0) [0.0|63.0] "dB" ASDM
 SG_ ReSideRdrLeDetn22RdrDetnRng : 295|14@0+ (0.02,-1.0) [-1.0|200.0] "m" ASDM
 SG_ ReSideRdrLeDetn22RdrDetnRngV : 271|13@0+ (0.02,-80.0) [-80.0|80.0] "m/s" ASDM
 SG_ ReSideRdrLeDetn22RdrDetnSameRV : 305|2@0+ (1,0) [0|3] "" ASDM
 SG_ ReSideRdrLeDetn22RdrDetnSts : 297|2@0+ (1,0) [0|3] "" ASDM
 SG_ ReSideRdrLeDetn23_UB : 483|1@0+ (1,0) [0|1] "" ASDM
 SG_ ReSideRdrLeDetn23RdrDetnAmbigState : 392|1@0+ (1,0) [0|1] "" ASDM
 SG_ ReSideRdrLeDetn23RdrDetnAssoTrkID : 399|7@0+ (1.0,0.0) [0.0|127.0] "Unitless" ASDM
 SG_ ReSideRdrLeDetn23RdrDetnAzi : 354|11@0+ (0.1,-90.0) [-90.0|90.0] "Deg" ASDM
 SG_ ReSideRdrLeDetn23RdrDetnChks : 327|8@0+ (1.0,0.0) [0.0|255.0] "Unitless" ASDM
 SG_ ReSideRdrLeDetn23RdrDetnCntr : 335|4@0+ (1.0,0.0) [0.0|15.0] "Unitless" ASDM
 SG_ ReSideRdrLeDetn23RdrDetnConf : 331|7@0+ (1.0,0.0) [0.0|100.0] "%" ASDM
 SG_ ReSideRdrLeDetn23RdrDetnElevn : 340|5@0+ (1.0,-15.0) [-15.0|15.0] "Deg" ASDM
 SG_ ReSideRdrLeDetn23RdrDetnPwr : 391|6@0+ (1.0,0.0) [0.0|63.0] "dB" ASDM
 SG_ ReSideRdrLeDetn23RdrDetnRng : 375|14@0+ (0.02,-1.0) [-1.0|200.0] "m" ASDM
 SG_ ReSideRdrLeDetn23RdrDetnRngV : 351|13@0+ (0.02,-80.0) [-80.0|80.0] "m/s" ASDM
 SG_ ReSideRdrLeDetn23RdrDetnSameRV : 385|2@0+ (1,0) [0|3] "" ASDM
 SG_ ReSideRdrLeDetn23RdrDetnSts : 377|2@0+ (1,0) [0|3] "" ASDM
 SG_ ReSideRdrLeDetn24_UB : 482|1@0+ (1,0) [0|1] "" ASDM
 SG_ ReSideRdrLeDetn24RdrDetnAmbigState : 472|1@0+ (1,0) [0|1] "" ASDM
 SG_ ReSideRdrLeDetn24RdrDetnAssoTrkID : 479|7@0+ (1.0,0.0) [0.0|127.0] "Unitless" ASDM
 SG_ ReSideRdrLeDetn24RdrDetnAzi : 434|11@0+ (0.1,-90.0) [-90.0|90.0] "Deg" ASDM
 SG_ ReSideRdrLeDetn24RdrDetnChks : 407|8@0+ (1.0,0.0) [0.0|255.0] "Unitless" ASDM
 SG_ ReSideRdrLeDetn24RdrDetnCntr : 415|4@0+ (1.0,0.0) [0.0|15.0] "Unitless" ASDM
 SG_ ReSideRdrLeDetn24RdrDetnConf : 411|7@0+ (1.0,0.0) [0.0|100.0] "%" ASDM
 SG_ ReSideRdrLeDetn24RdrDetnElevn : 420|5@0+ (1.0,-15.0) [-15.0|15.0] "Deg" ASDM
 SG_ ReSideRdrLeDetn24RdrDetnPwr : 471|6@0+ (1.0,0.0) [0.0|63.0] "dB" ASDM
 SG_ ReSideRdrLeDetn24RdrDetnRng : 455|14@0+ (0.02,-1.0) [-1.0|200.0] "m" ASDM
 SG_ ReSideRdrLeDetn24RdrDetnRngV : 431|13@0+ (0.02,-80.0) [-80.0|80.0] "m/s" ASDM
 SG_ ReSideRdrLeDetn24RdrDetnSameRV : 465|2@0+ (1,0) [0|3] "" ASDM
 SG_ ReSideRdrLeDetn24RdrDetnSts : 457|2@0+ (1,0) [0|3] "" ASDM

BO_ 85 SODLPrivateCANFD5Fr38 : 64 SODL
 SG_ ReSideRdrLeDetn25_UB : 487|1@0+ (1,0) [0|1] "" ASDM
 SG_ ReSideRdrLeDetn25RdrDetnAmbigState : 72|1@0+ (1,0) [0|1] "" ASDM
 SG_ ReSideRdrLeDetn25RdrDetnAssoTrkID : 79|7@0+ (1.0,0.0) [0.0|127.0] "Unitless" ASDM
 SG_ ReSideRdrLeDetn25RdrDetnAzi : 34|11@0+ (0.1,-90.0) [-90.0|90.0] "Deg" ASDM
 SG_ ReSideRdrLeDetn25RdrDetnChks : 7|8@0+ (1.0,0.0) [0.0|255.0] "Unitless" ASDM
 SG_ ReSideRdrLeDetn25RdrDetnCntr : 15|4@0+ (1.0,0.0) [0.0|15.0] "Unitless" ASDM
 SG_ ReSideRdrLeDetn25RdrDetnConf : 11|7@0+ (1.0,0.0) [0.0|100.0] "%" ASDM
 SG_ ReSideRdrLeDetn25RdrDetnElevn : 20|5@0+ (1.0,-15.0) [-15.0|15.0] "Deg" ASDM
 SG_ ReSideRdrLeDetn25RdrDetnPwr : 71|6@0+ (1.0,0.0) [0.0|63.0] "dB" ASDM
 SG_ ReSideRdrLeDetn25RdrDetnRng : 55|14@0+ (0.02,-1.0) [-1.0|200.0] "m" ASDM
 SG_ ReSideRdrLeDetn25RdrDetnRngV : 31|13@0+ (0.02,-80.0) [-80.0|80.0] "m/s" ASDM
 SG_ ReSideRdrLeDetn25RdrDetnSameRV : 65|2@0+ (1,0) [0|3] "" ASDM
 SG_ ReSideRdrLeDetn25RdrDetnSts : 57|2@0+ (1,0) [0|3] "" ASDM
 SG_ ReSideRdrLeDetn26_UB : 486|1@0+ (1,0) [0|1] "" ASDM
 SG_ ReSideRdrLeDetn26RdrDetnAmbigState : 152|1@0+ (1,0) [0|1] "" ASDM
 SG_ ReSideRdrLeDetn26RdrDetnAssoTrkID : 159|7@0+ (1.0,0.0) [0.0|127.0] "Unitless" ASDM
 SG_ ReSideRdrLeDetn26RdrDetnAzi : 114|11@0+ (0.1,-90.0) [-90.0|90.0] "Deg" ASDM
 SG_ ReSideRdrLeDetn26RdrDetnChks : 87|8@0+ (1.0,0.0) [0.0|255.0] "Unitless" ASDM
 SG_ ReSideRdrLeDetn26RdrDetnCntr : 95|4@0+ (1.0,0.0) [0.0|15.0] "Unitless" ASDM
 SG_ ReSideRdrLeDetn26RdrDetnConf : 91|7@0+ (1.0,0.0) [0.0|100.0] "%" ASDM
 SG_ ReSideRdrLeDetn26RdrDetnElevn : 100|5@0+ (1.0,-15.0) [-15.0|15.0] "Deg" ASDM
 SG_ ReSideRdrLeDetn26RdrDetnPwr : 151|6@0+ (1.0,0.0) [0.0|63.0] "dB" ASDM
 SG_ ReSideRdrLeDetn26RdrDetnRng : 135|14@0+ (0.02,-1.0) [-1.0|200.0] "m" ASDM
 SG_ ReSideRdrLeDetn26RdrDetnRngV : 111|13@0+ (0.02,-80.0) [-80.0|80.0] "m/s" ASDM
 SG_ ReSideRdrLeDetn26RdrDetnSameRV : 145|2@0+ (1,0) [0|3] "" ASDM
 SG_ ReSideRdrLeDetn26RdrDetnSts : 137|2@0+ (1,0) [0|3] "" ASDM
 SG_ ReSideRdrLeDetn27_UB : 485|1@0+ (1,0) [0|1] "" ASDM
 SG_ ReSideRdrLeDetn27RdrDetnAmbigState : 232|1@0+ (1,0) [0|1] "" ASDM
 SG_ ReSideRdrLeDetn27RdrDetnAssoTrkID : 239|7@0+ (1.0,0.0) [0.0|127.0] "Unitless" ASDM
 SG_ ReSideRdrLeDetn27RdrDetnAzi : 194|11@0+ (0.1,-90.0) [-90.0|90.0] "Deg" ASDM
 SG_ ReSideRdrLeDetn27RdrDetnChks : 167|8@0+ (1.0,0.0) [0.0|255.0] "Unitless" ASDM
 SG_ ReSideRdrLeDetn27RdrDetnCntr : 175|4@0+ (1.0,0.0) [0.0|15.0] "Unitless" ASDM
 SG_ ReSideRdrLeDetn27RdrDetnConf : 171|7@0+ (1.0,0.0) [0.0|100.0] "%" ASDM
 SG_ ReSideRdrLeDetn27RdrDetnElevn : 180|5@0+ (1.0,-15.0) [-15.0|15.0] "Deg" ASDM
 SG_ ReSideRdrLeDetn27RdrDetnPwr : 231|6@0+ (1.0,0.0) [0.0|63.0] "dB" ASDM
 SG_ ReSideRdrLeDetn27RdrDetnRng : 215|14@0+ (0.02,-1.0) [-1.0|200.0] "m" ASDM
 SG_ ReSideRdrLeDetn27RdrDetnRngV : 191|13@0+ (0.02,-80.0) [-80.0|80.0] "m/s" ASDM
 SG_ ReSideRdrLeDetn27RdrDetnSameRV : 225|2@0+ (1,0) [0|3] "" ASDM
 SG_ ReSideRdrLeDetn27RdrDetnSts : 217|2@0+ (1,0) [0|3] "" ASDM
 SG_ ReSideRdrLeDetn28_UB : 484|1@0+ (1,0) [0|1] "" ASDM
 SG_ ReSideRdrLeDetn28RdrDetnAmbigState : 312|1@0+ (1,0) [0|1] "" ASDM
 SG_ ReSideRdrLeDetn28RdrDetnAssoTrkID : 319|7@0+ (1.0,0.0) [0.0|127.0] "Unitless" ASDM
 SG_ ReSideRdrLeDetn28RdrDetnAzi : 274|11@0+ (0.1,-90.0) [-90.0|90.0] "Deg" ASDM
 SG_ ReSideRdrLeDetn28RdrDetnChks : 247|8@0+ (1.0,0.0) [0.0|255.0] "Unitless" ASDM
 SG_ ReSideRdrLeDetn28RdrDetnCntr : 255|4@0+ (1.0,0.0) [0.0|15.0] "Unitless" ASDM
 SG_ ReSideRdrLeDetn28RdrDetnConf : 251|7@0+ (1.0,0.0) [0.0|100.0] "%" ASDM
 SG_ ReSideRdrLeDetn28RdrDetnElevn : 260|5@0+ (1.0,-15.0) [-15.0|15.0] "Deg" ASDM
 SG_ ReSideRdrLeDetn28RdrDetnPwr : 311|6@0+ (1.0,0.0) [0.0|63.0] "dB" ASDM
 SG_ ReSideRdrLeDetn28RdrDetnRng : 295|14@0+ (0.02,-1.0) [-1.0|200.0] "m" ASDM
 SG_ ReSideRdrLeDetn28RdrDetnRngV : 271|13@0+ (0.02,-80.0) [-80.0|80.0] "m/s" ASDM
 SG_ ReSideRdrLeDetn28RdrDetnSameRV : 305|2@0+ (1,0) [0|3] "" ASDM
 SG_ ReSideRdrLeDetn28RdrDetnSts : 297|2@0+ (1,0) [0|3] "" ASDM
 SG_ ReSideRdrLeDetn29_UB : 483|1@0+ (1,0) [0|1] "" ASDM
 SG_ ReSideRdrLeDetn29RdrDetnAmbigState : 392|1@0+ (1,0) [0|1] "" ASDM
 SG_ ReSideRdrLeDetn29RdrDetnAssoTrkID : 399|7@0+ (1.0,0.0) [0.0|127.0] "Unitless" ASDM
 SG_ ReSideRdrLeDetn29RdrDetnAzi : 354|11@0+ (0.1,-90.0) [-90.0|90.0] "Deg" ASDM
 SG_ ReSideRdrLeDetn29RdrDetnChks : 327|8@0+ (1.0,0.0) [0.0|255.0] "Unitless" ASDM
 SG_ ReSideRdrLeDetn29RdrDetnCntr : 335|4@0+ (1.0,0.0) [0.0|15.0] "Unitless" ASDM
 SG_ ReSideRdrLeDetn29RdrDetnConf : 331|7@0+ (1.0,0.0) [0.0|100.0] "%" ASDM
 SG_ ReSideRdrLeDetn29RdrDetnElevn : 340|5@0+ (1.0,-15.0) [-15.0|15.0] "Deg" ASDM
 SG_ ReSideRdrLeDetn29RdrDetnPwr : 391|6@0+ (1.0,0.0) [0.0|63.0] "dB" ASDM
 SG_ ReSideRdrLeDetn29RdrDetnRng : 375|14@0+ (0.02,-1.0) [-1.0|200.0] "m" ASDM
 SG_ ReSideRdrLeDetn29RdrDetnRngV : 351|13@0+ (0.02,-80.0) [-80.0|80.0] "m/s" ASDM
 SG_ ReSideRdrLeDetn29RdrDetnSameRV : 385|2@0+ (1,0) [0|3] "" ASDM
 SG_ ReSideRdrLeDetn29RdrDetnSts : 377|2@0+ (1,0) [0|3] "" ASDM
 SG_ ReSideRdrLeDetn30_UB : 482|1@0+ (1,0) [0|1] "" ASDM
 SG_ ReSideRdrLeDetn30RdrDetnAmbigState : 472|1@0+ (1,0) [0|1] "" ASDM
 SG_ ReSideRdrLeDetn30RdrDetnAssoTrkID : 479|7@0+ (1.0,0.0) [0.0|127.0] "Unitless" ASDM
 SG_ ReSideRdrLeDetn30RdrDetnAzi : 434|11@0+ (0.1,-90.0) [-90.0|90.0] "Deg" ASDM
 SG_ ReSideRdrLeDetn30RdrDetnChks : 407|8@0+ (1.0,0.0) [0.0|255.0] "Unitless" ASDM
 SG_ ReSideRdrLeDetn30RdrDetnCntr : 415|4@0+ (1.0,0.0) [0.0|15.0] "Unitless" ASDM
 SG_ ReSideRdrLeDetn30RdrDetnConf : 411|7@0+ (1.0,0.0) [0.0|100.0] "%" ASDM
 SG_ ReSideRdrLeDetn30RdrDetnElevn : 420|5@0+ (1.0,-15.0) [-15.0|15.0] "Deg" ASDM
 SG_ ReSideRdrLeDetn30RdrDetnPwr : 471|6@0+ (1.0,0.0) [0.0|63.0] "dB" ASDM
 SG_ ReSideRdrLeDetn30RdrDetnRng : 455|14@0+ (0.02,-1.0) [-1.0|200.0] "m" ASDM
 SG_ ReSideRdrLeDetn30RdrDetnRngV : 431|13@0+ (0.02,-80.0) [-80.0|80.0] "m/s" ASDM
 SG_ ReSideRdrLeDetn30RdrDetnSameRV : 465|2@0+ (1,0) [0|3] "" ASDM
 SG_ ReSideRdrLeDetn30RdrDetnSts : 457|2@0+ (1,0) [0|3] "" ASDM

BO_ 86 SODLPrivateCANFD5Fr39 : 64 SODL
 SG_ ReSideRdrLeDetn31_UB : 487|1@0+ (1,0) [0|1] "" ASDM
 SG_ ReSideRdrLeDetn31RdrDetnAmbigState : 72|1@0+ (1,0) [0|1] "" ASDM
 SG_ ReSideRdrLeDetn31RdrDetnAssoTrkID : 79|7@0+ (1.0,0.0) [0.0|127.0] "Unitless" ASDM
 SG_ ReSideRdrLeDetn31RdrDetnAzi : 34|11@0+ (0.1,-90.0) [-90.0|90.0] "Deg" ASDM
 SG_ ReSideRdrLeDetn31RdrDetnChks : 7|8@0+ (1.0,0.0) [0.0|255.0] "Unitless" ASDM
 SG_ ReSideRdrLeDetn31RdrDetnCntr : 15|4@0+ (1.0,0.0) [0.0|15.0] "Unitless" ASDM
 SG_ ReSideRdrLeDetn31RdrDetnConf : 11|7@0+ (1.0,0.0) [0.0|100.0] "%" ASDM
 SG_ ReSideRdrLeDetn31RdrDetnElevn : 20|5@0+ (1.0,-15.0) [-15.0|15.0] "Deg" ASDM
 SG_ ReSideRdrLeDetn31RdrDetnPwr : 71|6@0+ (1.0,0.0) [0.0|63.0] "dB" ASDM
 SG_ ReSideRdrLeDetn31RdrDetnRng : 55|14@0+ (0.02,-1.0) [-1.0|200.0] "m" ASDM
 SG_ ReSideRdrLeDetn31RdrDetnRngV : 31|13@0+ (0.02,-80.0) [-80.0|80.0] "m/s" ASDM
 SG_ ReSideRdrLeDetn31RdrDetnSameRV : 65|2@0+ (1,0) [0|3] "" ASDM
 SG_ ReSideRdrLeDetn31RdrDetnSts : 57|2@0+ (1,0) [0|3] "" ASDM
 SG_ ReSideRdrLeDetn32_UB : 486|1@0+ (1,0) [0|1] "" ASDM
 SG_ ReSideRdrLeDetn32RdrDetnAmbigState : 152|1@0+ (1,0) [0|1] "" ASDM
 SG_ ReSideRdrLeDetn32RdrDetnAssoTrkID : 159|7@0+ (1.0,0.0) [0.0|127.0] "Unitless" ASDM
 SG_ ReSideRdrLeDetn32RdrDetnAzi : 114|11@0+ (0.1,-90.0) [-90.0|90.0] "Deg" ASDM
 SG_ ReSideRdrLeDetn32RdrDetnChks : 87|8@0+ (1.0,0.0) [0.0|255.0] "Unitless" ASDM
 SG_ ReSideRdrLeDetn32RdrDetnCntr : 95|4@0+ (1.0,0.0) [0.0|15.0] "Unitless" ASDM
 SG_ ReSideRdrLeDetn32RdrDetnConf : 91|7@0+ (1.0,0.0) [0.0|100.0] "%" ASDM
 SG_ ReSideRdrLeDetn32RdrDetnElevn : 100|5@0+ (1.0,-15.0) [-15.0|15.0] "Deg" ASDM
 SG_ ReSideRdrLeDetn32RdrDetnPwr : 151|6@0+ (1.0,0.0) [0.0|63.0] "dB" ASDM
 SG_ ReSideRdrLeDetn32RdrDetnRng : 135|14@0+ (0.02,-1.0) [-1.0|200.0] "m" ASDM
 SG_ ReSideRdrLeDetn32RdrDetnRngV : 111|13@0+ (0.02,-80.0) [-80.0|80.0] "m/s" ASDM
 SG_ ReSideRdrLeDetn32RdrDetnSameRV : 145|2@0+ (1,0) [0|3] "" ASDM
 SG_ ReSideRdrLeDetn32RdrDetnSts : 137|2@0+ (1,0) [0|3] "" ASDM
 SG_ ReSideRdrLeDetn33_UB : 485|1@0+ (1,0) [0|1] "" ASDM
 SG_ ReSideRdrLeDetn33RdrDetnAmbigState : 232|1@0+ (1,0) [0|1] "" ASDM
 SG_ ReSideRdrLeDetn33RdrDetnAssoTrkID : 239|7@0+ (1.0,0.0) [0.0|127.0] "Unitless" ASDM
 SG_ ReSideRdrLeDetn33RdrDetnAzi : 194|11@0+ (0.1,-90.0) [-90.0|90.0] "Deg" ASDM
 SG_ ReSideRdrLeDetn33RdrDetnChks : 167|8@0+ (1.0,0.0) [0.0|255.0] "Unitless" ASDM
 SG_ ReSideRdrLeDetn33RdrDetnCntr : 175|4@0+ (1.0,0.0) [0.0|15.0] "Unitless" ASDM
 SG_ ReSideRdrLeDetn33RdrDetnConf : 171|7@0+ (1.0,0.0) [0.0|100.0] "%" ASDM
 SG_ ReSideRdrLeDetn33RdrDetnElevn : 180|5@0+ (1.0,-15.0) [-15.0|15.0] "Deg" ASDM
 SG_ ReSideRdrLeDetn33RdrDetnPwr : 231|6@0+ (1.0,0.0) [0.0|63.0] "dB" ASDM
 SG_ ReSideRdrLeDetn33RdrDetnRng : 215|14@0+ (0.02,-1.0) [-1.0|200.0] "m" ASDM
 SG_ ReSideRdrLeDetn33RdrDetnRngV : 191|13@0+ (0.02,-80.0) [-80.0|80.0] "m/s" ASDM
 SG_ ReSideRdrLeDetn33RdrDetnSameRV : 225|2@0+ (1,0) [0|3] "" ASDM
 SG_ ReSideRdrLeDetn33RdrDetnSts : 217|2@0+ (1,0) [0|3] "" ASDM
 SG_ ReSideRdrLeDetn34_UB : 484|1@0+ (1,0) [0|1] "" ASDM
 SG_ ReSideRdrLeDetn34RdrDetnAmbigState : 312|1@0+ (1,0) [0|1] "" ASDM
 SG_ ReSideRdrLeDetn34RdrDetnAssoTrkID : 319|7@0+ (1.0,0.0) [0.0|127.0] "Unitless" ASDM
 SG_ ReSideRdrLeDetn34RdrDetnAzi : 274|11@0+ (0.1,-90.0) [-90.0|90.0] "Deg" ASDM
 SG_ ReSideRdrLeDetn34RdrDetnChks : 247|8@0+ (1.0,0.0) [0.0|255.0] "Unitless" ASDM
 SG_ ReSideRdrLeDetn34RdrDetnCntr : 255|4@0+ (1.0,0.0) [0.0|15.0] "Unitless" ASDM
 SG_ ReSideRdrLeDetn34RdrDetnConf : 251|7@0+ (1.0,0.0) [0.0|100.0] "%" ASDM
 SG_ ReSideRdrLeDetn34RdrDetnElevn : 260|5@0+ (1.0,-15.0) [-15.0|15.0] "Deg" ASDM
 SG_ ReSideRdrLeDetn34RdrDetnPwr : 311|6@0+ (1.0,0.0) [0.0|63.0] "dB" ASDM
 SG_ ReSideRdrLeDetn34RdrDetnRng : 295|14@0+ (0.02,-1.0) [-1.0|200.0] "m" ASDM
 SG_ ReSideRdrLeDetn34RdrDetnRngV : 271|13@0+ (0.02,-80.0) [-80.0|80.0] "m/s" ASDM
 SG_ ReSideRdrLeDetn34RdrDetnSameRV : 305|2@0+ (1,0) [0|3] "" ASDM
 SG_ ReSideRdrLeDetn34RdrDetnSts : 297|2@0+ (1,0) [0|3] "" ASDM
 SG_ ReSideRdrLeDetn35_UB : 483|1@0+ (1,0) [0|1] "" ASDM
 SG_ ReSideRdrLeDetn35RdrDetnAmbigState : 392|1@0+ (1,0) [0|1] "" ASDM
 SG_ ReSideRdrLeDetn35RdrDetnAssoTrkID : 399|7@0+ (1.0,0.0) [0.0|127.0] "Unitless" ASDM
 SG_ ReSideRdrLeDetn35RdrDetnAzi : 354|11@0+ (0.1,-90.0) [-90.0|90.0] "Deg" ASDM
 SG_ ReSideRdrLeDetn35RdrDetnChks : 327|8@0+ (1.0,0.0) [0.0|255.0] "Unitless" ASDM
 SG_ ReSideRdrLeDetn35RdrDetnCntr : 335|4@0+ (1.0,0.0) [0.0|15.0] "Unitless" ASDM
 SG_ ReSideRdrLeDetn35RdrDetnConf : 331|7@0+ (1.0,0.0) [0.0|100.0] "%" ASDM
 SG_ ReSideRdrLeDetn35RdrDetnElevn : 340|5@0+ (1.0,-15.0) [-15.0|15.0] "Deg" ASDM
 SG_ ReSideRdrLeDetn35RdrDetnPwr : 391|6@0+ (1.0,0.0) [0.0|63.0] "dB" ASDM
 SG_ ReSideRdrLeDetn35RdrDetnRng : 375|14@0+ (0.02,-1.0) [-1.0|200.0] "m" ASDM
 SG_ ReSideRdrLeDetn35RdrDetnRngV : 351|13@0+ (0.02,-80.0) [-80.0|80.0] "m/s" ASDM
 SG_ ReSideRdrLeDetn35RdrDetnSameRV : 385|2@0+ (1,0) [0|3] "" ASDM
 SG_ ReSideRdrLeDetn35RdrDetnSts : 377|2@0+ (1,0) [0|3] "" ASDM
 SG_ ReSideRdrLeDetn36_UB : 482|1@0+ (1,0) [0|1] "" ASDM
 SG_ ReSideRdrLeDetn36RdrDetnAmbigState : 472|1@0+ (1,0) [0|1] "" ASDM
 SG_ ReSideRdrLeDetn36RdrDetnAssoTrkID : 479|7@0+ (1.0,0.0) [0.0|127.0] "Unitless" ASDM
 SG_ ReSideRdrLeDetn36RdrDetnAzi : 434|11@0+ (0.1,-90.0) [-90.0|90.0] "Deg" ASDM
 SG_ ReSideRdrLeDetn36RdrDetnChks : 407|8@0+ (1.0,0.0) [0.0|255.0] "Unitless" ASDM
 SG_ ReSideRdrLeDetn36RdrDetnCntr : 415|4@0+ (1.0,0.0) [0.0|15.0] "Unitless" ASDM
 SG_ ReSideRdrLeDetn36RdrDetnConf : 411|7@0+ (1.0,0.0) [0.0|100.0] "%" ASDM
 SG_ ReSideRdrLeDetn36RdrDetnElevn : 420|5@0+ (1.0,-15.0) [-15.0|15.0] "Deg" ASDM
 SG_ ReSideRdrLeDetn36RdrDetnPwr : 471|6@0+ (1.0,0.0) [0.0|63.0] "dB" ASDM
 SG_ ReSideRdrLeDetn36RdrDetnRng : 455|14@0+ (0.02,-1.0) [-1.0|200.0] "m" ASDM
 SG_ ReSideRdrLeDetn36RdrDetnRngV : 431|13@0+ (0.02,-80.0) [-80.0|80.0] "m/s" ASDM
 SG_ ReSideRdrLeDetn36RdrDetnSameRV : 465|2@0+ (1,0) [0|3] "" ASDM
 SG_ ReSideRdrLeDetn36RdrDetnSts : 457|2@0+ (1,0) [0|3] "" ASDM

CM_ SG_ 1074 ReSideRdrLe20Obj32Heading "Refer to the data element description in FrntSideRdrLeObj1 with the same data element name.";
CM_ SG_ 1074 ReSideRdrLe20Obj32ObjBoxCenterLat "Refer to the data element description in FrntSideRdrLeObj1 with the same data element name.";
CM_ SG_ 1074 ReSideRdrLe20Obj32ObjBoxCenterLgt "Refer to the data element description in FrntSideRdrLeObj1 with the same data element name.";
CM_ SG_ 1074 ReSideRdrLe20Obj32ObservationHist "Refer to the data element description in FrntSideRdrLeObj1 with the same data element name.";
CM_ SG_ 1074 ReSideRdrLe20Obj32QualityBits "Refer to the data element description in FrntSideRdrLeObj1 with the same data element name.";
CM_ SG_ 1074 ReSideRdrLe20Obj32RdrObjAx "Refer to the data element description in FrntSideRdrLeObj1 with the same data element name.";
CM_ SG_ 1074 ReSideRdrLe20Obj32RdrObjAy "Refer to the data element description in FrntSideRdrLeObj1 with the same data element name.";
CM_ SG_ 1074 ReSideRdrLe20Obj32RdrObjBoxLength "Refer to the data element description in FrntSideRdrLeObj1 with the same data element name.";
CM_ SG_ 1074 ReSideRdrLe20Obj32RdrObjBoxWidth "Refer to the data element description in FrntSideRdrLeObj1 with the same data element name.";
CM_ SG_ 1074 ReSideRdrLe20Obj32RdrObjChks "Refer to the data element description in FrntSideRdrLeObj1 with the same data element name.";
CM_ SG_ 1074 ReSideRdrLe20Obj32RdrObjCntr "Refer to the data element description in FrntSideRdrLeObj1 with the same data element name.";
CM_ SG_ 1074 ReSideRdrLe20Obj32RdrObjCoastCnt "Refer to the data element description in FrntSideRdrLeObj1 with the same data element name.";
CM_ SG_ 1074 ReSideRdrLe20Obj32RdrObjConf "Refer to the data element description in FrntSideRdrLeObj1 with the same data element name.";
CM_ SG_ 1074 ReSideRdrLe20Obj32RdrObjDx "Refer to the data element description in FrntSideRdrLeObj1 with the same data element name.";
CM_ SG_ 1074 ReSideRdrLe20Obj32RdrObjDxStdDe "Refer to the data element description in FrntSideRdrLeObj1 with the same data element name.";
CM_ SG_ 1074 ReSideRdrLe20Obj32RdrObjDy "Refer to the data element description in FrntSideRdrLeObj1 with the same data element name.";
CM_ SG_ 1074 ReSideRdrLe20Obj32RdrObjDyStdDe "Refer to the data element description in FrntSideRdrLeObj1 with the same data element name.";
CM_ SG_ 1074 ReSideRdrLe20Obj32RdrObjElevnConf "Refer to the data element description in FrntSideRdrLeObj1 with the same data element name.";
CM_ SG_ 1074 ReSideRdrLe20Obj32RdrObjElevnSts "Refer to the data element description in FrntSideRdrLeObj1 with the same data element name.";
CM_ SG_ 1074 ReSideRdrLe20Obj32RdrObjID "Refer to the data element description in FrntSideRdrLeObj1 with the same data element name.";
CM_ SG_ 1074 ReSideRdrLe20Obj32RdrObjIsInFreeSpace "Refer to the data element description in FrntSideRdrLeObj1 with the same data element name.";
CM_ SG_ 1074 ReSideRdrLe20Obj32RdrObjMirrProblty "Refer to the data element description in FrntSideRdrLeObj1 with the same data element name.";
CM_ SG_ 1074 ReSideRdrLe20Obj32RdrObjMtnPat "Refer to the data element description in FrntSideRdrLeObj1 with the same data element name.";
CM_ SG_ 1074 ReSideRdrLe20Obj32RdrObjNotRealProblty "Refer to the data element description in FrntSideRdrLeObj1 with the same data element name.";
CM_ SG_ 1074 ReSideRdrLe20Obj32RdrObjStatyCnt "Refer to the data element description in FrntSideRdrLeObj1 with the same data element name.";
CM_ SG_ 1074 ReSideRdrLe20Obj32RdrObjTiAlv "Refer to the data element description in FrntSideRdrLeObj1 with the same data element name.";
CM_ SG_ 1074 ReSideRdrLe20Obj32RdrObjTrackSts "Refer to the data element description in FrntSideRdrLeObj1 with the same data element name.";
CM_ SG_ 1074 ReSideRdrLe20Obj32RdrObjTyp "Refer to the data element description in FrntSideRdrLeObj1 with the same data element name.";
CM_ SG_ 1074 ReSideRdrLe20Obj32RdrObjTypConfBike "Refer to the data element description in FrntSideRdrLeObj1 with the same data element name.";
CM_ SG_ 1074 ReSideRdrLe20Obj32RdrObjTypConfPed "Refer to the data element description in FrntSideRdrLeObj1 with the same data element name.";
CM_ SG_ 1074 ReSideRdrLe20Obj32RdrObjTypConfVeh "Refer to the data element description in FrntSideRdrLeObj1 with the same data element name.";
CM_ SG_ 1074 ReSideRdrLe20Obj32RdrObjUsedTracker "Refer to the data element description in FrntSideRdrLeObj1 with the same data element name.";
CM_ SG_ 1074 ReSideRdrLe20Obj32RdrObjVx "Refer to the data element description in FrntSideRdrLeObj1 with the same data element name.";
CM_ SG_ 1074 ReSideRdrLe20Obj32RdrObjVxStdDe "Refer to the data element description in FrntSideRdrLeObj1 with the same data element name.";
CM_ SG_ 1074 ReSideRdrLe20Obj32RdrObjVy "Refer to the data element description in FrntSideRdrLeObj1 with the same data element name.";
CM_ SG_ 1074 ReSideRdrLe20Obj32RdrObjVyStdDe "Refer to the data element description in FrntSideRdrLeObj1 with the same data element name.";
CM_ SG_ 1074 ReSideRdrLe20Obj32RelVx "Refer to the data element description in FrntSideRdrLeObj1 with the same data element name.";
CM_ SG_ 1074 ReSideRdrLe20Obj32RelVy "Refer to the data element description in FrntSideRdrLeObj1 with the same data element name.";
CM_ SG_ 1075 ReSideRdrLe20StsForDim "Rear side left radar state information which will be shown on DIM or IHU";
CM_ SG_ 1075 ReSideRdrLe20StsRdrNrDetn "Number of detections";
CM_ SG_ 1075 ReSideRdrLe20StsRdrNrObj "Number of objects";
CM_ SG_ 1075 ReSideRdrLe20StsRdrStsBlkd0bin "Blockage flag for 0bin";
CM_ SG_ 1075 ReSideRdrLe20StsRdrStsBlkdConf "Confidence of radar blockage";
CM_ SG_ 1075 ReSideRdrLe20StsRdrStsChks "Checksum";
CM_ SG_ 1075 ReSideRdrLe20StsRdrStsCntr "Counter";
CM_ SG_ 1075 ReSideRdrLe20StsRdrStsDstbc "Indication of radar interference, 0 means no interference, 100 means the radar fully saturated from interference";
CM_ SG_ 1075 ReSideRdrLe20StsRdrStsEna "Indication whether radar functionality is enabled";
CM_ SG_ 1075 ReSideRdrLe20StsRdrStsFaulty "Indication whether radar is faulty";
CM_ SG_ 1075 ReSideRdrLe20StsRdrStsLatency "The time instance starting from the end of the last measurement acquisition per cycle to the CAN-FD frames being outputted on the CAN-FD bus";
CM_ SG_ 1075 ReSideRdrLe20StsRdrStslfVersMajor "Reserve";
CM_ SG_ 1075 ReSideRdrLe20StsRdrStslfVersMinor "Reserve";
CM_ SG_ 1075 ReSideRdrLe20StsRdrStsMisAlign "Indication whether 0, calibration not start. 1, successfully calibrated in factory or after-sales. 2, successfully auto-calibrated. 3, misalignment degree is larger than threshold, static calibration fail. 4, can not be calibrated statically cause other reason. 5, auto-calibrate fail (cause misalignment degree is larger than threshold or other reason). 6, misalignment degree is larger than threshold, dynamic calibration fail in factory or after-sales. 7, can not be calibrated dynamically cause other reason.";
CM_ SG_ 1075 ReSideRdrLe20StsRdrStsMissCom "Signal used to detect missing communication from radar";
CM_ SG_ 1075 ReSideRdrLe20StsRdrStsTiStamp20 "Timestamp; Seconds part of the time";
CM_ SG_ 1075 ReSideRdrLe20StsRdrStsTiStampHi20 "Timestamp; Seconds part of the time";
CM_ SG_ 1075 ReSideRdrLe20StsRdrStsTiStampNano20 "Timestamp; Nano Seconds part of the time";
CM_ SG_ 1075 ReSideRdrLe20StsRdrStsTiStampStsGlbTiBas "Timestamp";
CM_ SG_ 1075 ReSideRdrLe20StsRdrStsTiStampStsSyncToGateway "Time synchronization status - synchronized to gateway";
CM_ SG_ 1075 ReSideRdrLe20StsRdrStsTiStampStsTiLeap "Time synchronization status - time leap";
CM_ SG_ 1075 ReSideRdrLe20StsRdrStsTiStampStsTiOut "Time synchronization status - time out";
CM_ SG_ 1075 ReSideRdrLe20StsRdrStsWhlSpdCmpFac "Estimated compensation factor for host speed.";
CM_ SG_ 1075 ReSideRdrLe20StsRdrSysSftyFlt "Safety faulty status";
CM_ SG_ 81 ReSideRdrLeDetn1RdrDetnAmbigState "Dection ambiguous status";
CM_ SG_ 81 ReSideRdrLeDetn1RdrDetnAssoTrkID "Associated tracker ID
";
CM_ SG_ 81 ReSideRdrLeDetn1RdrDetnAzi "Azimuth Angle";
CM_ SG_ 81 ReSideRdrLeDetn1RdrDetnChks "CRC";
CM_ SG_ 81 ReSideRdrLeDetn1RdrDetnCntr "Counter";
CM_ SG_ 81 ReSideRdrLeDetn1RdrDetnConf "Quality";
CM_ SG_ 81 ReSideRdrLeDetn1RdrDetnElevn "Elevation Angle";
CM_ SG_ 81 ReSideRdrLeDetn1RdrDetnPwr "Signal noise ratio";
CM_ SG_ 81 ReSideRdrLeDetn1RdrDetnRng "Range";
CM_ SG_ 81 ReSideRdrLeDetn1RdrDetnRngV "Range Velocity";
CM_ SG_ 81 ReSideRdrLeDetn1RdrDetnSameRV "object with same distance and speed";
CM_ SG_ 81 ReSideRdrLeDetn1RdrDetnSts "Detection type";
CM_ SG_ 81 ReSideRdrLeDetn2RdrDetnAmbigState "Dection ambiguous status";
CM_ SG_ 81 ReSideRdrLeDetn2RdrDetnAssoTrkID "Associated tracker ID
";
CM_ SG_ 81 ReSideRdrLeDetn2RdrDetnAzi "Refer to the data element description in ReSideRdrLeDetn1 with the same data element name";
CM_ SG_ 81 ReSideRdrLeDetn2RdrDetnChks "Refer to the data element description in ReSideRdrLeDetn1 with the same data element name";
CM_ SG_ 81 ReSideRdrLeDetn2RdrDetnCntr "Refer to the data element description in ReSideRdrLeDetn1 with the same data element name";
CM_ SG_ 81 ReSideRdrLeDetn2RdrDetnConf "Refer to the data element description in ReSideRdrLeDetn1 with the same data element name";
CM_ SG_ 81 ReSideRdrLeDetn2RdrDetnElevn "Refer to the data element description in ReSideRdrLeDetn1 with the same data element name";
CM_ SG_ 81 ReSideRdrLeDetn2RdrDetnPwr "Refer to the data element description in ReSideRdrLeDetn1 with the same data element name";
CM_ SG_ 81 ReSideRdrLeDetn2RdrDetnRng "Refer to the data element description in ReSideRdrLeDetn1 with the same data element name";
CM_ SG_ 81 ReSideRdrLeDetn2RdrDetnRngV "Range Velocity";
CM_ SG_ 81 ReSideRdrLeDetn2RdrDetnSameRV "object with same distance and speed";
CM_ SG_ 81 ReSideRdrLeDetn2RdrDetnSts "Refer to the data element description in ReSideRdrLeDetn1 with the same data element name";
CM_ SG_ 81 ReSideRdrLeDetn3RdrDetnAmbigState "Dection ambiguous status";
CM_ SG_ 81 ReSideRdrLeDetn3RdrDetnAssoTrkID "Associated tracker ID
";
CM_ SG_ 81 ReSideRdrLeDetn3RdrDetnAzi "Refer to the data element description in ReSideRdrLeDetn1 with the same data element name";
CM_ SG_ 81 ReSideRdrLeDetn3RdrDetnChks "Refer to the data element description in ReSideRdrLeDetn1 with the same data element name";
CM_ SG_ 81 ReSideRdrLeDetn3RdrDetnCntr "Refer to the data element description in ReSideRdrLeDetn1 with the same data element name";
CM_ SG_ 81 ReSideRdrLeDetn3RdrDetnConf "Refer to the data element description in ReSideRdrLeDetn1 with the same data element name";
CM_ SG_ 81 ReSideRdrLeDetn3RdrDetnElevn "Refer to the data element description in ReSideRdrLeDetn1 with the same data element name";
CM_ SG_ 81 ReSideRdrLeDetn3RdrDetnPwr "Refer to the data element description in ReSideRdrLeDetn1 with the same data element name";
CM_ SG_ 81 ReSideRdrLeDetn3RdrDetnRng "Refer to the data element description in ReSideRdrLeDetn1 with the same data element name";
CM_ SG_ 81 ReSideRdrLeDetn3RdrDetnRngV "Range Velocity";
CM_ SG_ 81 ReSideRdrLeDetn3RdrDetnSameRV "object with same distance and speed";
CM_ SG_ 81 ReSideRdrLeDetn3RdrDetnSts "Refer to the data element description in ReSideRdrLeDetn1 with the same data element name";
CM_ SG_ 81 ReSideRdrLeDetn4RdrDetnAmbigState "Dection ambiguous status";
CM_ SG_ 81 ReSideRdrLeDetn4RdrDetnAssoTrkID "Associated tracker ID
";
CM_ SG_ 81 ReSideRdrLeDetn4RdrDetnAzi "Refer to the data element description in ReSideRdrLeDetn1 with the same data element name";
CM_ SG_ 81 ReSideRdrLeDetn4RdrDetnChks "Refer to the data element description in ReSideRdrLeDetn1 with the same data element name";
CM_ SG_ 81 ReSideRdrLeDetn4RdrDetnCntr "Refer to the data element description in ReSideRdrLeDetn1 with the same data element name";
CM_ SG_ 81 ReSideRdrLeDetn4RdrDetnConf "Refer to the data element description in ReSideRdrLeDetn1 with the same data element name";
CM_ SG_ 81 ReSideRdrLeDetn4RdrDetnElevn "Refer to the data element description in ReSideRdrLeDetn1 with the same data element name";
CM_ SG_ 81 ReSideRdrLeDetn4RdrDetnPwr "Refer to the data element description in ReSideRdrLeDetn1 with the same data element name";
CM_ SG_ 81 ReSideRdrLeDetn4RdrDetnRng "Refer to the data element description in ReSideRdrLeDetn1 with the same data element name";
CM_ SG_ 81 ReSideRdrLeDetn4RdrDetnRngV "Range Velocity";
CM_ SG_ 81 ReSideRdrLeDetn4RdrDetnSameRV "object with same distance and speed";
CM_ SG_ 81 ReSideRdrLeDetn4RdrDetnSts "Refer to the data element description in ReSideRdrLeDetn1 with the same data element name";
CM_ SG_ 81 ReSideRdrLeDetn5RdrDetnAmbigState "Dection ambiguous status";
CM_ SG_ 81 ReSideRdrLeDetn5RdrDetnAssoTrkID "Associated tracker ID
";
CM_ SG_ 81 ReSideRdrLeDetn5RdrDetnAzi "Refer to the data element description in ReSideRdrLeDetn1 with the same data element name";
CM_ SG_ 81 ReSideRdrLeDetn5RdrDetnChks "Refer to the data element description in ReSideRdrLeDetn1 with the same data element name";
CM_ SG_ 81 ReSideRdrLeDetn5RdrDetnCntr "Refer to the data element description in ReSideRdrLeDetn1 with the same data element name";
CM_ SG_ 81 ReSideRdrLeDetn5RdrDetnConf "Refer to the data element description in ReSideRdrLeDetn1 with the same data element name";
CM_ SG_ 81 ReSideRdrLeDetn5RdrDetnElevn "Refer to the data element description in ReSideRdrLeDetn1 with the same data element name";
CM_ SG_ 81 ReSideRdrLeDetn5RdrDetnPwr "Refer to the data element description in ReSideRdrLeDetn1 with the same data element name";
CM_ SG_ 81 ReSideRdrLeDetn5RdrDetnRng "Refer to the data element description in ReSideRdrLeDetn1 with the same data element name";
CM_ SG_ 81 ReSideRdrLeDetn5RdrDetnRngV "Range Velocity";
CM_ SG_ 81 ReSideRdrLeDetn5RdrDetnSameRV "object with same distance and speed";
CM_ SG_ 81 ReSideRdrLeDetn5RdrDetnSts "Refer to the data element description in ReSideRdrLeDetn1 with the same data element name";
CM_ SG_ 81 ReSideRdrLeDetn6RdrDetnAmbigState "Dection ambiguous status";
CM_ SG_ 81 ReSideRdrLeDetn6RdrDetnAssoTrkID "Associated tracker ID
";
CM_ SG_ 81 ReSideRdrLeDetn6RdrDetnAzi "Refer to the data element description in ReSideRdrLeDetn1 with the same data element name";
CM_ SG_ 81 ReSideRdrLeDetn6RdrDetnChks "Refer to the data element description in ReSideRdrLeDetn1 with the same data element name";
CM_ SG_ 81 ReSideRdrLeDetn6RdrDetnCntr "Refer to the data element description in ReSideRdrLeDetn1 with the same data element name";
CM_ SG_ 81 ReSideRdrLeDetn6RdrDetnConf "Refer to the data element description in ReSideRdrLeDetn1 with the same data element name";
CM_ SG_ 81 ReSideRdrLeDetn6RdrDetnElevn "Refer to the data element description in ReSideRdrLeDetn1 with the same data element name";
CM_ SG_ 81 ReSideRdrLeDetn6RdrDetnPwr "Refer to the data element description in ReSideRdrLeDetn1 with the same data element name";
CM_ SG_ 81 ReSideRdrLeDetn6RdrDetnRng "Refer to the data element description in ReSideRdrLeDetn1 with the same data element name";
CM_ SG_ 81 ReSideRdrLeDetn6RdrDetnRngV "Range Velocity";
CM_ SG_ 81 ReSideRdrLeDetn6RdrDetnSameRV "object with same distance and speed";
CM_ SG_ 81 ReSideRdrLeDetn6RdrDetnSts "Refer to the data element description in ReSideRdrLeDetn1 with the same data element name";
CM_ SG_ 82 ReSideRdrLeDetn10RdrDetnAmbigState "Dection ambiguous status";
CM_ SG_ 82 ReSideRdrLeDetn10RdrDetnAssoTrkID "Associated tracker ID
";
CM_ SG_ 82 ReSideRdrLeDetn10RdrDetnAzi "Refer to the data element description in ReSideRdrLeDetn1 with the same data element name";
CM_ SG_ 82 ReSideRdrLeDetn10RdrDetnChks "Refer to the data element description in ReSideRdrLeDetn1 with the same data element name";
CM_ SG_ 82 ReSideRdrLeDetn10RdrDetnCntr "Refer to the data element description in ReSideRdrLeDetn1 with the same data element name";
CM_ SG_ 82 ReSideRdrLeDetn10RdrDetnConf "Refer to the data element description in ReSideRdrLeDetn1 with the same data element name";
CM_ SG_ 82 ReSideRdrLeDetn10RdrDetnElevn "Refer to the data element description in ReSideRdrLeDetn1 with the same data element name";
CM_ SG_ 82 ReSideRdrLeDetn10RdrDetnPwr "Refer to the data element description in ReSideRdrLeDetn1 with the same data element name";
CM_ SG_ 82 ReSideRdrLeDetn10RdrDetnRng "Refer to the data element description in ReSideRdrLeDetn1 with the same data element name";
CM_ SG_ 82 ReSideRdrLeDetn10RdrDetnRngV "Range Velocity";
CM_ SG_ 82 ReSideRdrLeDetn10RdrDetnSameRV "object with same distance and speed";
CM_ SG_ 82 ReSideRdrLeDetn10RdrDetnSts "Refer to the data element description in ReSideRdrLeDetn1 with the same data element name";
CM_ SG_ 82 ReSideRdrLeDetn11RdrDetnAmbigState "Dection ambiguous status";
CM_ SG_ 82 ReSideRdrLeDetn11RdrDetnAssoTrkID "Associated tracker ID
";
CM_ SG_ 82 ReSideRdrLeDetn11RdrDetnAzi "Refer to the data element description in ReSideRdrLeDetn1 with the same data element name";
CM_ SG_ 82 ReSideRdrLeDetn11RdrDetnChks "Refer to the data element description in ReSideRdrLeDetn1 with the same data element name";
CM_ SG_ 82 ReSideRdrLeDetn11RdrDetnCntr "Refer to the data element description in ReSideRdrLeDetn1 with the same data element name";
CM_ SG_ 82 ReSideRdrLeDetn11RdrDetnConf "Refer to the data element description in ReSideRdrLeDetn1 with the same data element name";
CM_ SG_ 82 ReSideRdrLeDetn11RdrDetnElevn "Refer to the data element description in ReSideRdrLeDetn1 with the same data element name";
CM_ SG_ 82 ReSideRdrLeDetn11RdrDetnPwr "Refer to the data element description in ReSideRdrLeDetn1 with the same data element name";
CM_ SG_ 82 ReSideRdrLeDetn11RdrDetnRng "Refer to the data element description in ReSideRdrLeDetn1 with the same data element name";
CM_ SG_ 82 ReSideRdrLeDetn11RdrDetnRngV "Range Velocity";
CM_ SG_ 82 ReSideRdrLeDetn11RdrDetnSameRV "object with same distance and speed";
CM_ SG_ 82 ReSideRdrLeDetn11RdrDetnSts "Refer to the data element description in ReSideRdrLeDetn1 with the same data element name";
CM_ SG_ 82 ReSideRdrLeDetn12RdrDetnAmbigState "Dection ambiguous status";
CM_ SG_ 82 ReSideRdrLeDetn12RdrDetnAssoTrkID "Associated tracker ID
";
CM_ SG_ 82 ReSideRdrLeDetn12RdrDetnAzi "Refer to the data element description in ReSideRdrLeDetn1 with the same data element name";
CM_ SG_ 82 ReSideRdrLeDetn12RdrDetnChks "Refer to the data element description in ReSideRdrLeDetn1 with the same data element name";
CM_ SG_ 82 ReSideRdrLeDetn12RdrDetnCntr "Refer to the data element description in ReSideRdrLeDetn1 with the same data element name";
CM_ SG_ 82 ReSideRdrLeDetn12RdrDetnConf "Refer to the data element description in ReSideRdrLeDetn1 with the same data element name";
CM_ SG_ 82 ReSideRdrLeDetn12RdrDetnElevn "Refer to the data element description in ReSideRdrLeDetn1 with the same data element name";
CM_ SG_ 82 ReSideRdrLeDetn12RdrDetnPwr "Refer to the data element description in ReSideRdrLeDetn1 with the same data element name";
CM_ SG_ 82 ReSideRdrLeDetn12RdrDetnRng "Refer to the data element description in ReSideRdrLeDetn1 with the same data element name";
CM_ SG_ 82 ReSideRdrLeDetn12RdrDetnRngV "Range Velocity";
CM_ SG_ 82 ReSideRdrLeDetn12RdrDetnSameRV "object with same distance and speed";
CM_ SG_ 82 ReSideRdrLeDetn12RdrDetnSts "Refer to the data element description in ReSideRdrLeDetn1 with the same data element name";
CM_ SG_ 82 ReSideRdrLeDetn7RdrDetnAmbigState "Dection ambiguous status";
CM_ SG_ 82 ReSideRdrLeDetn7RdrDetnAssoTrkID "Associated tracker ID
";
CM_ SG_ 82 ReSideRdrLeDetn7RdrDetnAzi "Refer to the data element description in ReSideRdrLeDetn1 with the same data element name";
CM_ SG_ 82 ReSideRdrLeDetn7RdrDetnChks "Refer to the data element description in ReSideRdrLeDetn1 with the same data element name";
CM_ SG_ 82 ReSideRdrLeDetn7RdrDetnCntr "Refer to the data element description in ReSideRdrLeDetn1 with the same data element name";
CM_ SG_ 82 ReSideRdrLeDetn7RdrDetnConf "Refer to the data element description in ReSideRdrLeDetn1 with the same data element name";
CM_ SG_ 82 ReSideRdrLeDetn7RdrDetnElevn "Refer to the data element description in ReSideRdrLeDetn1 with the same data element name";
CM_ SG_ 82 ReSideRdrLeDetn7RdrDetnPwr "Refer to the data element description in ReSideRdrLeDetn1 with the same data element name";
CM_ SG_ 82 ReSideRdrLeDetn7RdrDetnRng "Refer to the data element description in ReSideRdrLeDetn1 with the same data element name";
CM_ SG_ 82 ReSideRdrLeDetn7RdrDetnRngV "Range Velocity";
CM_ SG_ 82 ReSideRdrLeDetn7RdrDetnSameRV "object with same distance and speed";
CM_ SG_ 82 ReSideRdrLeDetn7RdrDetnSts "Refer to the data element description in ReSideRdrLeDetn1 with the same data element name";
CM_ SG_ 82 ReSideRdrLeDetn8RdrDetnAmbigState "Dection ambiguous status";
CM_ SG_ 82 ReSideRdrLeDetn8RdrDetnAssoTrkID "Associated tracker ID
";
CM_ SG_ 82 ReSideRdrLeDetn8RdrDetnAzi "Refer to the data element description in ReSideRdrLeDetn1 with the same data element name";
CM_ SG_ 82 ReSideRdrLeDetn8RdrDetnChks "Refer to the data element description in ReSideRdrLeDetn1 with the same data element name";
CM_ SG_ 82 ReSideRdrLeDetn8RdrDetnCntr "Refer to the data element description in ReSideRdrLeDetn1 with the same data element name";
CM_ SG_ 82 ReSideRdrLeDetn8RdrDetnConf "Refer to the data element description in ReSideRdrLeDetn1 with the same data element name";
CM_ SG_ 82 ReSideRdrLeDetn8RdrDetnElevn "Refer to the data element description in ReSideRdrLeDetn1 with the same data element name";
CM_ SG_ 82 ReSideRdrLeDetn8RdrDetnPwr "Refer to the data element description in ReSideRdrLeDetn1 with the same data element name";
CM_ SG_ 82 ReSideRdrLeDetn8RdrDetnRng "Refer to the data element description in ReSideRdrLeDetn1 with the same data element name";
CM_ SG_ 82 ReSideRdrLeDetn8RdrDetnRngV "Range Velocity";
CM_ SG_ 82 ReSideRdrLeDetn8RdrDetnSameRV "object with same distance and speed";
CM_ SG_ 82 ReSideRdrLeDetn8RdrDetnSts "Refer to the data element description in ReSideRdrLeDetn1 with the same data element name";
CM_ SG_ 82 ReSideRdrLeDetn9RdrDetnAmbigState "Dection ambiguous status";
CM_ SG_ 82 ReSideRdrLeDetn9RdrDetnAssoTrkID "Associated tracker ID
";
CM_ SG_ 82 ReSideRdrLeDetn9RdrDetnAzi "Refer to the data element description in ReSideRdrLeDetn1 with the same data element name";
CM_ SG_ 82 ReSideRdrLeDetn9RdrDetnChks "Refer to the data element description in ReSideRdrLeDetn1 with the same data element name";
CM_ SG_ 82 ReSideRdrLeDetn9RdrDetnCntr "Refer to the data element description in ReSideRdrLeDetn1 with the same data element name";
CM_ SG_ 82 ReSideRdrLeDetn9RdrDetnConf "Refer to the data element description in ReSideRdrLeDetn1 with the same data element name";
CM_ SG_ 82 ReSideRdrLeDetn9RdrDetnElevn "Refer to the data element description in ReSideRdrLeDetn1 with the same data element name";
CM_ SG_ 82 ReSideRdrLeDetn9RdrDetnPwr "Refer to the data element description in ReSideRdrLeDetn1 with the same data element name";
CM_ SG_ 82 ReSideRdrLeDetn9RdrDetnRng "Refer to the data element description in ReSideRdrLeDetn1 with the same data element name";
CM_ SG_ 82 ReSideRdrLeDetn9RdrDetnRngV "Range Velocity";
CM_ SG_ 82 ReSideRdrLeDetn9RdrDetnSameRV "object with same distance and speed";
CM_ SG_ 82 ReSideRdrLeDetn9RdrDetnSts "Refer to the data element description in ReSideRdrLeDetn1 with the same data element name";
CM_ SG_ 83 ReSideRdrLeDetn13RdrDetnAmbigState "Dection ambiguous status";
CM_ SG_ 83 ReSideRdrLeDetn13RdrDetnAssoTrkID "Associated tracker ID
";
CM_ SG_ 83 ReSideRdrLeDetn13RdrDetnAzi "Refer to the data element description in ReSideRdrLeDetn1 with the same data element name";
CM_ SG_ 83 ReSideRdrLeDetn13RdrDetnChks "Refer to the data element description in ReSideRdrLeDetn1 with the same data element name";
CM_ SG_ 83 ReSideRdrLeDetn13RdrDetnCntr "Refer to the data element description in ReSideRdrLeDetn1 with the same data element name";
CM_ SG_ 83 ReSideRdrLeDetn13RdrDetnConf "Refer to the data element description in ReSideRdrLeDetn1 with the same data element name";
CM_ SG_ 83 ReSideRdrLeDetn13RdrDetnElevn "Refer to the data element description in ReSideRdrLeDetn1 with the same data element name";
CM_ SG_ 83 ReSideRdrLeDetn13RdrDetnPwr "Refer to the data element description in ReSideRdrLeDetn1 with the same data element name";
CM_ SG_ 83 ReSideRdrLeDetn13RdrDetnRng "Refer to the data element description in ReSideRdrLeDetn1 with the same data element name";
CM_ SG_ 83 ReSideRdrLeDetn13RdrDetnRngV "Range Velocity";
CM_ SG_ 83 ReSideRdrLeDetn13RdrDetnSameRV "object with same distance and speed";
CM_ SG_ 83 ReSideRdrLeDetn13RdrDetnSts "Refer to the data element description in ReSideRdrLeDetn1 with the same data element name";
CM_ SG_ 83 ReSideRdrLeDetn14RdrDetnAmbigState "Dection ambiguous status";
CM_ SG_ 83 ReSideRdrLeDetn14RdrDetnAssoTrkID "Associated tracker ID
";
CM_ SG_ 83 ReSideRdrLeDetn14RdrDetnAzi "Refer to the data element description in ReSideRdrLeDetn1 with the same data element name";
CM_ SG_ 83 ReSideRdrLeDetn14RdrDetnChks "Refer to the data element description in ReSideRdrLeDetn1 with the same data element name";
CM_ SG_ 83 ReSideRdrLeDetn14RdrDetnCntr "Refer to the data element description in ReSideRdrLeDetn1 with the same data element name";
CM_ SG_ 83 ReSideRdrLeDetn14RdrDetnConf "Refer to the data element description in ReSideRdrLeDetn1 with the same data element name";
CM_ SG_ 83 ReSideRdrLeDetn14RdrDetnElevn "Refer to the data element description in ReSideRdrLeDetn1 with the same data element name";
CM_ SG_ 83 ReSideRdrLeDetn14RdrDetnPwr "Refer to the data element description in ReSideRdrLeDetn1 with the same data element name";
CM_ SG_ 83 ReSideRdrLeDetn14RdrDetnRng "Refer to the data element description in ReSideRdrLeDetn1 with the same data element name";
CM_ SG_ 83 ReSideRdrLeDetn14RdrDetnRngV "Range Velocity";
CM_ SG_ 83 ReSideRdrLeDetn14RdrDetnSameRV "object with same distance and speed";
CM_ SG_ 83 ReSideRdrLeDetn14RdrDetnSts "Refer to the data element description in ReSideRdrLeDetn1 with the same data element name";
CM_ SG_ 83 ReSideRdrLeDetn15RdrDetnAmbigState "Dection ambiguous status";
CM_ SG_ 83 ReSideRdrLeDetn15RdrDetnAssoTrkID "Associated tracker ID
";
CM_ SG_ 83 ReSideRdrLeDetn15RdrDetnAzi "Refer to the data element description in ReSideRdrLeDetn1 with the same data element name";
CM_ SG_ 83 ReSideRdrLeDetn15RdrDetnChks "Refer to the data element description in ReSideRdrLeDetn1 with the same data element name";
CM_ SG_ 83 ReSideRdrLeDetn15RdrDetnCntr "Refer to the data element description in ReSideRdrLeDetn1 with the same data element name";
CM_ SG_ 83 ReSideRdrLeDetn15RdrDetnConf "Refer to the data element description in ReSideRdrLeDetn1 with the same data element name";
CM_ SG_ 83 ReSideRdrLeDetn15RdrDetnElevn "Refer to the data element description in ReSideRdrLeDetn1 with the same data element name";
CM_ SG_ 83 ReSideRdrLeDetn15RdrDetnPwr "Refer to the data element description in ReSideRdrLeDetn1 with the same data element name";
CM_ SG_ 83 ReSideRdrLeDetn15RdrDetnRng "Refer to the data element description in ReSideRdrLeDetn1 with the same data element name";
CM_ SG_ 83 ReSideRdrLeDetn15RdrDetnRngV "Range Velocity";
CM_ SG_ 83 ReSideRdrLeDetn15RdrDetnSameRV "object with same distance and speed";
CM_ SG_ 83 ReSideRdrLeDetn15RdrDetnSts "Refer to the data element description in ReSideRdrLeDetn1 with the same data element name";
CM_ SG_ 83 ReSideRdrLeDetn16RdrDetnAmbigState "Dection ambiguous status";
CM_ SG_ 83 ReSideRdrLeDetn16RdrDetnAssoTrkID "Associated tracker ID
";
CM_ SG_ 83 ReSideRdrLeDetn16RdrDetnAzi "Refer to the data element description in ReSideRdrLeDetn1 with the same data element name";
CM_ SG_ 83 ReSideRdrLeDetn16RdrDetnChks "Refer to the data element description in ReSideRdrLeDetn1 with the same data element name";
CM_ SG_ 83 ReSideRdrLeDetn16RdrDetnCntr "Refer to the data element description in ReSideRdrLeDetn1 with the same data element name";
CM_ SG_ 83 ReSideRdrLeDetn16RdrDetnConf "Refer to the data element description in ReSideRdrLeDetn1 with the same data element name";
CM_ SG_ 83 ReSideRdrLeDetn16RdrDetnElevn "Refer to the data element description in ReSideRdrLeDetn1 with the same data element name";
CM_ SG_ 83 ReSideRdrLeDetn16RdrDetnPwr "Refer to the data element description in ReSideRdrLeDetn1 with the same data element name";
CM_ SG_ 83 ReSideRdrLeDetn16RdrDetnRng "Refer to the data element description in ReSideRdrLeDetn1 with the same data element name";
CM_ SG_ 83 ReSideRdrLeDetn16RdrDetnRngV "Range Velocity";
CM_ SG_ 83 ReSideRdrLeDetn16RdrDetnSameRV "object with same distance and speed";
CM_ SG_ 83 ReSideRdrLeDetn16RdrDetnSts "Refer to the data element description in ReSideRdrLeDetn1 with the same data element name";
CM_ SG_ 83 ReSideRdrLeDetn17RdrDetnAmbigState "Dection ambiguous status";
CM_ SG_ 83 ReSideRdrLeDetn17RdrDetnAssoTrkID "Associated tracker ID
";
CM_ SG_ 83 ReSideRdrLeDetn17RdrDetnAzi "Refer to the data element description in ReSideRdrLeDetn1 with the same data element name";
CM_ SG_ 83 ReSideRdrLeDetn17RdrDetnChks "Refer to the data element description in ReSideRdrLeDetn1 with the same data element name";
CM_ SG_ 83 ReSideRdrLeDetn17RdrDetnCntr "Refer to the data element description in ReSideRdrLeDetn1 with the same data element name";
CM_ SG_ 83 ReSideRdrLeDetn17RdrDetnConf "Refer to the data element description in ReSideRdrLeDetn1 with the same data element name";
CM_ SG_ 83 ReSideRdrLeDetn17RdrDetnElevn "Refer to the data element description in ReSideRdrLeDetn1 with the same data element name";
CM_ SG_ 83 ReSideRdrLeDetn17RdrDetnPwr "Refer to the data element description in ReSideRdrLeDetn1 with the same data element name";
CM_ SG_ 83 ReSideRdrLeDetn17RdrDetnRng "Refer to the data element description in ReSideRdrLeDetn1 with the same data element name";
CM_ SG_ 83 ReSideRdrLeDetn17RdrDetnRngV "Range Velocity";
CM_ SG_ 83 ReSideRdrLeDetn17RdrDetnSameRV "object with same distance and speed";
CM_ SG_ 83 ReSideRdrLeDetn17RdrDetnSts "Refer to the data element description in ReSideRdrLeDetn1 with the same data element name";
CM_ SG_ 83 ReSideRdrLeDetn18RdrDetnAmbigState "Dection ambiguous status";
CM_ SG_ 83 ReSideRdrLeDetn18RdrDetnAssoTrkID "Associated tracker ID
";
CM_ SG_ 83 ReSideRdrLeDetn18RdrDetnAzi "Refer to the data element description in ReSideRdrLeDetn1 with the same data element name";
CM_ SG_ 83 ReSideRdrLeDetn18RdrDetnChks "Refer to the data element description in ReSideRdrLeDetn1 with the same data element name";
CM_ SG_ 83 ReSideRdrLeDetn18RdrDetnCntr "Refer to the data element description in ReSideRdrLeDetn1 with the same data element name";
CM_ SG_ 83 ReSideRdrLeDetn18RdrDetnConf "Refer to the data element description in ReSideRdrLeDetn1 with the same data element name";
CM_ SG_ 83 ReSideRdrLeDetn18RdrDetnElevn "Refer to the data element description in ReSideRdrLeDetn1 with the same data element name";
CM_ SG_ 83 ReSideRdrLeDetn18RdrDetnPwr "Refer to the data element description in ReSideRdrLeDetn1 with the same data element name";
CM_ SG_ 83 ReSideRdrLeDetn18RdrDetnRng "Refer to the data element description in ReSideRdrLeDetn1 with the same data element name";
CM_ SG_ 83 ReSideRdrLeDetn18RdrDetnRngV "Range Velocity";
CM_ SG_ 83 ReSideRdrLeDetn18RdrDetnSameRV "object with same distance and speed";
CM_ SG_ 83 ReSideRdrLeDetn18RdrDetnSts "Refer to the data element description in ReSideRdrLeDetn1 with the same data element name";
CM_ SG_ 84 ReSideRdrLeDetn19RdrDetnAmbigState "Dection ambiguous status";
CM_ SG_ 84 ReSideRdrLeDetn19RdrDetnAssoTrkID "Associated tracker ID
";
CM_ SG_ 84 ReSideRdrLeDetn19RdrDetnAzi "Refer to the data element description in ReSideRdrLeDetn1 with the same data element name";
CM_ SG_ 84 ReSideRdrLeDetn19RdrDetnChks "Refer to the data element description in ReSideRdrLeDetn1 with the same data element name";
CM_ SG_ 84 ReSideRdrLeDetn19RdrDetnCntr "Refer to the data element description in ReSideRdrLeDetn1 with the same data element name";
CM_ SG_ 84 ReSideRdrLeDetn19RdrDetnConf "Refer to the data element description in ReSideRdrLeDetn1 with the same data element name";
CM_ SG_ 84 ReSideRdrLeDetn19RdrDetnElevn "Refer to the data element description in ReSideRdrLeDetn1 with the same data element name";
CM_ SG_ 84 ReSideRdrLeDetn19RdrDetnPwr "Refer to the data element description in ReSideRdrLeDetn1 with the same data element name";
CM_ SG_ 84 ReSideRdrLeDetn19RdrDetnRng "Refer to the data element description in ReSideRdrLeDetn1 with the same data element name";
CM_ SG_ 84 ReSideRdrLeDetn19RdrDetnRngV "Range Velocity";
CM_ SG_ 84 ReSideRdrLeDetn19RdrDetnSameRV "object with same distance and speed";
CM_ SG_ 84 ReSideRdrLeDetn19RdrDetnSts "Refer to the data element description in ReSideRdrLeDetn1 with the same data element name";
CM_ SG_ 84 ReSideRdrLeDetn20RdrDetnAmbigState "Dection ambiguous status";
CM_ SG_ 84 ReSideRdrLeDetn20RdrDetnAssoTrkID "Associated tracker ID
";
CM_ SG_ 84 ReSideRdrLeDetn20RdrDetnAzi "Refer to the data element description in ReSideRdrLeDetn1 with the same data element name";
CM_ SG_ 84 ReSideRdrLeDetn20RdrDetnChks "Refer to the data element description in ReSideRdrLeDetn1 with the same data element name";
CM_ SG_ 84 ReSideRdrLeDetn20RdrDetnCntr "Refer to the data element description in ReSideRdrLeDetn1 with the same data element name";
CM_ SG_ 84 ReSideRdrLeDetn20RdrDetnConf "Refer to the data element description in ReSideRdrLeDetn1 with the same data element name";
CM_ SG_ 84 ReSideRdrLeDetn20RdrDetnElevn "Refer to the data element description in ReSideRdrLeDetn1 with the same data element name";
CM_ SG_ 84 ReSideRdrLeDetn20RdrDetnPwr "Refer to the data element description in ReSideRdrLeDetn1 with the same data element name";
CM_ SG_ 84 ReSideRdrLeDetn20RdrDetnRng "Refer to the data element description in ReSideRdrLeDetn1 with the same data element name";
CM_ SG_ 84 ReSideRdrLeDetn20RdrDetnRngV "Range Velocity";
CM_ SG_ 84 ReSideRdrLeDetn20RdrDetnSameRV "object with same distance and speed";
CM_ SG_ 84 ReSideRdrLeDetn20RdrDetnSts "Refer to the data element description in ReSideRdrLeDetn1 with the same data element name";
CM_ SG_ 84 ReSideRdrLeDetn21RdrDetnAmbigState "Dection ambiguous status";
CM_ SG_ 84 ReSideRdrLeDetn21RdrDetnAssoTrkID "Associated tracker ID
";
CM_ SG_ 84 ReSideRdrLeDetn21RdrDetnAzi "Refer to the data element description in ReSideRdrLeDetn1 with the same data element name";
CM_ SG_ 84 ReSideRdrLeDetn21RdrDetnChks "Refer to the data element description in ReSideRdrLeDetn1 with the same data element name";
CM_ SG_ 84 ReSideRdrLeDetn21RdrDetnCntr "Refer to the data element description in ReSideRdrLeDetn1 with the same data element name";
CM_ SG_ 84 ReSideRdrLeDetn21RdrDetnConf "Refer to the data element description in ReSideRdrLeDetn1 with the same data element name";
CM_ SG_ 84 ReSideRdrLeDetn21RdrDetnElevn "Refer to the data element description in ReSideRdrLeDetn1 with the same data element name";
CM_ SG_ 84 ReSideRdrLeDetn21RdrDetnPwr "Refer to the data element description in ReSideRdrLeDetn1 with the same data element name";
CM_ SG_ 84 ReSideRdrLeDetn21RdrDetnRng "Refer to the data element description in ReSideRdrLeDetn1 with the same data element name";
CM_ SG_ 84 ReSideRdrLeDetn21RdrDetnRngV "Range Velocity";
CM_ SG_ 84 ReSideRdrLeDetn21RdrDetnSameRV "object with same distance and speed";
CM_ SG_ 84 ReSideRdrLeDetn21RdrDetnSts "Refer to the data element description in ReSideRdrLeDetn1 with the same data element name";
CM_ SG_ 84 ReSideRdrLeDetn22RdrDetnAmbigState "Dection ambiguous status";
CM_ SG_ 84 ReSideRdrLeDetn22RdrDetnAssoTrkID "Associated tracker ID
";
CM_ SG_ 84 ReSideRdrLeDetn22RdrDetnAzi "Refer to the data element description in ReSideRdrLeDetn1 with the same data element name";
CM_ SG_ 84 ReSideRdrLeDetn22RdrDetnChks "Refer to the data element description in ReSideRdrLeDetn1 with the same data element name";
CM_ SG_ 84 ReSideRdrLeDetn22RdrDetnCntr "Refer to the data element description in ReSideRdrLeDetn1 with the same data element name";
CM_ SG_ 84 ReSideRdrLeDetn22RdrDetnConf "Refer to the data element description in ReSideRdrLeDetn1 with the same data element name";
CM_ SG_ 84 ReSideRdrLeDetn22RdrDetnElevn "Refer to the data element description in ReSideRdrLeDetn1 with the same data element name";
CM_ SG_ 84 ReSideRdrLeDetn22RdrDetnPwr "Refer to the data element description in ReSideRdrLeDetn1 with the same data element name";
CM_ SG_ 84 ReSideRdrLeDetn22RdrDetnRng "Refer to the data element description in ReSideRdrLeDetn1 with the same data element name";
CM_ SG_ 84 ReSideRdrLeDetn22RdrDetnRngV "Range Velocity";
CM_ SG_ 84 ReSideRdrLeDetn22RdrDetnSameRV "object with same distance and speed";
CM_ SG_ 84 ReSideRdrLeDetn22RdrDetnSts "Refer to the data element description in ReSideRdrLeDetn1 with the same data element name";
CM_ SG_ 84 ReSideRdrLeDetn23RdrDetnAmbigState "Dection ambiguous status";
CM_ SG_ 84 ReSideRdrLeDetn23RdrDetnAssoTrkID "Associated tracker ID
";
CM_ SG_ 84 ReSideRdrLeDetn23RdrDetnAzi "Refer to the data element description in ReSideRdrLeDetn1 with the same data element name";
CM_ SG_ 84 ReSideRdrLeDetn23RdrDetnChks "Refer to the data element description in ReSideRdrLeDetn1 with the same data element name";
CM_ SG_ 84 ReSideRdrLeDetn23RdrDetnCntr "Refer to the data element description in ReSideRdrLeDetn1 with the same data element name";
CM_ SG_ 84 ReSideRdrLeDetn23RdrDetnConf "Refer to the data element description in ReSideRdrLeDetn1 with the same data element name";
CM_ SG_ 84 ReSideRdrLeDetn23RdrDetnElevn "Refer to the data element description in ReSideRdrLeDetn1 with the same data element name";
CM_ SG_ 84 ReSideRdrLeDetn23RdrDetnPwr "Refer to the data element description in ReSideRdrLeDetn1 with the same data element name";
CM_ SG_ 84 ReSideRdrLeDetn23RdrDetnRng "Refer to the data element description in ReSideRdrLeDetn1 with the same data element name";
CM_ SG_ 84 ReSideRdrLeDetn23RdrDetnRngV "Range Velocity";
CM_ SG_ 84 ReSideRdrLeDetn23RdrDetnSameRV "object with same distance and speed";
CM_ SG_ 84 ReSideRdrLeDetn23RdrDetnSts "Refer to the data element description in ReSideRdrLeDetn1 with the same data element name";
CM_ SG_ 84 ReSideRdrLeDetn24RdrDetnAmbigState "Dection ambiguous status";
CM_ SG_ 84 ReSideRdrLeDetn24RdrDetnAssoTrkID "Associated tracker ID
";
CM_ SG_ 84 ReSideRdrLeDetn24RdrDetnAzi "Refer to the data element description in ReSideRdrLeDetn1 with the same data element name";
CM_ SG_ 84 ReSideRdrLeDetn24RdrDetnChks "Refer to the data element description in ReSideRdrLeDetn1 with the same data element name";
CM_ SG_ 84 ReSideRdrLeDetn24RdrDetnCntr "Refer to the data element description in ReSideRdrLeDetn1 with the same data element name";
CM_ SG_ 84 ReSideRdrLeDetn24RdrDetnConf "Refer to the data element description in ReSideRdrLeDetn1 with the same data element name";
CM_ SG_ 84 ReSideRdrLeDetn24RdrDetnElevn "Refer to the data element description in ReSideRdrLeDetn1 with the same data element name";
CM_ SG_ 84 ReSideRdrLeDetn24RdrDetnPwr "Refer to the data element description in ReSideRdrLeDetn1 with the same data element name";
CM_ SG_ 84 ReSideRdrLeDetn24RdrDetnRng "Refer to the data element description in ReSideRdrLeDetn1 with the same data element name";
CM_ SG_ 84 ReSideRdrLeDetn24RdrDetnRngV "Range Velocity";
CM_ SG_ 84 ReSideRdrLeDetn24RdrDetnSameRV "object with same distance and speed";
CM_ SG_ 84 ReSideRdrLeDetn24RdrDetnSts "Refer to the data element description in ReSideRdrLeDetn1 with the same data element name";
CM_ SG_ 85 ReSideRdrLeDetn25RdrDetnAmbigState "Dection ambiguous status";
CM_ SG_ 85 ReSideRdrLeDetn25RdrDetnAssoTrkID "Associated tracker ID
";
CM_ SG_ 85 ReSideRdrLeDetn25RdrDetnAzi "Refer to the data element description in ReSideRdrLeDetn1 with the same data element name";
CM_ SG_ 85 ReSideRdrLeDetn25RdrDetnChks "Refer to the data element description in ReSideRdrLeDetn1 with the same data element name";
CM_ SG_ 85 ReSideRdrLeDetn25RdrDetnCntr "Refer to the data element description in ReSideRdrLeDetn1 with the same data element name";
CM_ SG_ 85 ReSideRdrLeDetn25RdrDetnConf "Refer to the data element description in ReSideRdrLeDetn1 with the same data element name";
CM_ SG_ 85 ReSideRdrLeDetn25RdrDetnElevn "Refer to the data element description in ReSideRdrLeDetn1 with the same data element name";
CM_ SG_ 85 ReSideRdrLeDetn25RdrDetnPwr "Refer to the data element description in ReSideRdrLeDetn1 with the same data element name";
CM_ SG_ 85 ReSideRdrLeDetn25RdrDetnRng "Refer to the data element description in ReSideRdrLeDetn1 with the same data element name";
CM_ SG_ 85 ReSideRdrLeDetn25RdrDetnRngV "Range Velocity";
CM_ SG_ 85 ReSideRdrLeDetn25RdrDetnSameRV "object with same distance and speed";
CM_ SG_ 85 ReSideRdrLeDetn25RdrDetnSts "Refer to the data element description in ReSideRdrLeDetn1 with the same data element name";
CM_ SG_ 85 ReSideRdrLeDetn26RdrDetnAmbigState "Dection ambiguous status";
CM_ SG_ 85 ReSideRdrLeDetn26RdrDetnAssoTrkID "Associated tracker ID
";
CM_ SG_ 85 ReSideRdrLeDetn26RdrDetnAzi "Refer to the data element description in ReSideRdrLeDetn1 with the same data element name";
CM_ SG_ 85 ReSideRdrLeDetn26RdrDetnChks "Refer to the data element description in ReSideRdrLeDetn1 with the same data element name";
CM_ SG_ 85 ReSideRdrLeDetn26RdrDetnCntr "Refer to the data element description in ReSideRdrLeDetn1 with the same data element name";
CM_ SG_ 85 ReSideRdrLeDetn26RdrDetnConf "Refer to the data element description in ReSideRdrLeDetn1 with the same data element name";
CM_ SG_ 85 ReSideRdrLeDetn26RdrDetnElevn "Refer to the data element description in ReSideRdrLeDetn1 with the same data element name";
CM_ SG_ 85 ReSideRdrLeDetn26RdrDetnPwr "Refer to the data element description in ReSideRdrLeDetn1 with the same data element name";
CM_ SG_ 85 ReSideRdrLeDetn26RdrDetnRng "Refer to the data element description in ReSideRdrLeDetn1 with the same data element name";
CM_ SG_ 85 ReSideRdrLeDetn26RdrDetnRngV "Range Velocity";
CM_ SG_ 85 ReSideRdrLeDetn26RdrDetnSameRV "object with same distance and speed";
CM_ SG_ 85 ReSideRdrLeDetn26RdrDetnSts "Refer to the data element description in ReSideRdrLeDetn1 with the same data element name";
CM_ SG_ 85 ReSideRdrLeDetn27RdrDetnAmbigState "Dection ambiguous status";
CM_ SG_ 85 ReSideRdrLeDetn27RdrDetnAssoTrkID "Associated tracker ID
";
CM_ SG_ 85 ReSideRdrLeDetn27RdrDetnAzi "Refer to the data element description in ReSideRdrLeDetn1 with the same data element name";
CM_ SG_ 85 ReSideRdrLeDetn27RdrDetnChks "Refer to the data element description in ReSideRdrLeDetn1 with the same data element name";
CM_ SG_ 85 ReSideRdrLeDetn27RdrDetnCntr "Refer to the data element description in ReSideRdrLeDetn1 with the same data element name";
CM_ SG_ 85 ReSideRdrLeDetn27RdrDetnConf "Refer to the data element description in ReSideRdrLeDetn1 with the same data element name";
CM_ SG_ 85 ReSideRdrLeDetn27RdrDetnElevn "Refer to the data element description in ReSideRdrLeDetn1 with the same data element name";
CM_ SG_ 85 ReSideRdrLeDetn27RdrDetnPwr "Refer to the data element description in ReSideRdrLeDetn1 with the same data element name";
CM_ SG_ 85 ReSideRdrLeDetn27RdrDetnRng "Refer to the data element description in ReSideRdrLeDetn1 with the same data element name";
CM_ SG_ 85 ReSideRdrLeDetn27RdrDetnRngV "Range Velocity";
CM_ SG_ 85 ReSideRdrLeDetn27RdrDetnSameRV "object with same distance and speed";
CM_ SG_ 85 ReSideRdrLeDetn27RdrDetnSts "Refer to the data element description in ReSideRdrLeDetn1 with the same data element name";
CM_ SG_ 85 ReSideRdrLeDetn28RdrDetnAmbigState "Dection ambiguous status";
CM_ SG_ 85 ReSideRdrLeDetn28RdrDetnAssoTrkID "Associated tracker ID
";
CM_ SG_ 85 ReSideRdrLeDetn28RdrDetnAzi "Refer to the data element description in ReSideRdrLeDetn1 with the same data element name";
CM_ SG_ 85 ReSideRdrLeDetn28RdrDetnChks "Refer to the data element description in ReSideRdrLeDetn1 with the same data element name";
CM_ SG_ 85 ReSideRdrLeDetn28RdrDetnCntr "Refer to the data element description in ReSideRdrLeDetn1 with the same data element name";
CM_ SG_ 85 ReSideRdrLeDetn28RdrDetnConf "Refer to the data element description in ReSideRdrLeDetn1 with the same data element name";
CM_ SG_ 85 ReSideRdrLeDetn28RdrDetnElevn "Refer to the data element description in ReSideRdrLeDetn1 with the same data element name";
CM_ SG_ 85 ReSideRdrLeDetn28RdrDetnPwr "Refer to the data element description in ReSideRdrLeDetn1 with the same data element name";
CM_ SG_ 85 ReSideRdrLeDetn28RdrDetnRng "Refer to the data element description in ReSideRdrLeDetn1 with the same data element name";
CM_ SG_ 85 ReSideRdrLeDetn28RdrDetnRngV "Range Velocity";
CM_ SG_ 85 ReSideRdrLeDetn28RdrDetnSameRV "object with same distance and speed";
CM_ SG_ 85 ReSideRdrLeDetn28RdrDetnSts "Refer to the data element description in ReSideRdrLeDetn1 with the same data element name";
CM_ SG_ 85 ReSideRdrLeDetn29RdrDetnAmbigState "Dection ambiguous status";
CM_ SG_ 85 ReSideRdrLeDetn29RdrDetnAssoTrkID "Associated tracker ID
";
CM_ SG_ 85 ReSideRdrLeDetn29RdrDetnAzi "Refer to the data element description in ReSideRdrLeDetn1 with the same data element name";
CM_ SG_ 85 ReSideRdrLeDetn29RdrDetnChks "Refer to the data element description in ReSideRdrLeDetn1 with the same data element name";
CM_ SG_ 85 ReSideRdrLeDetn29RdrDetnCntr "Refer to the data element description in ReSideRdrLeDetn1 with the same data element name";
CM_ SG_ 85 ReSideRdrLeDetn29RdrDetnConf "Refer to the data element description in ReSideRdrLeDetn1 with the same data element name";
CM_ SG_ 85 ReSideRdrLeDetn29RdrDetnElevn "Refer to the data element description in ReSideRdrLeDetn1 with the same data element name";
CM_ SG_ 85 ReSideRdrLeDetn29RdrDetnPwr "Refer to the data element description in ReSideRdrLeDetn1 with the same data element name";
CM_ SG_ 85 ReSideRdrLeDetn29RdrDetnRng "Refer to the data element description in ReSideRdrLeDetn1 with the same data element name";
CM_ SG_ 85 ReSideRdrLeDetn29RdrDetnRngV "Range Velocity";
CM_ SG_ 85 ReSideRdrLeDetn29RdrDetnSameRV "object with same distance and speed";
CM_ SG_ 85 ReSideRdrLeDetn29RdrDetnSts "Refer to the data element description in ReSideRdrLeDetn1 with the same data element name";
CM_ SG_ 85 ReSideRdrLeDetn30RdrDetnAmbigState "Dection ambiguous status";
CM_ SG_ 85 ReSideRdrLeDetn30RdrDetnAssoTrkID "Associated tracker ID
";
CM_ SG_ 85 ReSideRdrLeDetn30RdrDetnAzi "Refer to the data element description in ReSideRdrLeDetn1 with the same data element name";
CM_ SG_ 85 ReSideRdrLeDetn30RdrDetnChks "Refer to the data element description in ReSideRdrLeDetn1 with the same data element name";
CM_ SG_ 85 ReSideRdrLeDetn30RdrDetnCntr "Refer to the data element description in ReSideRdrLeDetn1 with the same data element name";
CM_ SG_ 85 ReSideRdrLeDetn30RdrDetnConf "Refer to the data element description in ReSideRdrLeDetn1 with the same data element name";
CM_ SG_ 85 ReSideRdrLeDetn30RdrDetnElevn "Refer to the data element description in ReSideRdrLeDetn1 with the same data element name";
CM_ SG_ 85 ReSideRdrLeDetn30RdrDetnPwr "Refer to the data element description in ReSideRdrLeDetn1 with the same data element name";
CM_ SG_ 85 ReSideRdrLeDetn30RdrDetnRng "Refer to the data element description in ReSideRdrLeDetn1 with the same data element name";
CM_ SG_ 85 ReSideRdrLeDetn30RdrDetnRngV "Range Velocity";
CM_ SG_ 85 ReSideRdrLeDetn30RdrDetnSameRV "object with same distance and speed";
CM_ SG_ 85 ReSideRdrLeDetn30RdrDetnSts "Refer to the data element description in ReSideRdrLeDetn1 with the same data element name";
CM_ SG_ 86 ReSideRdrLeDetn31RdrDetnAmbigState "Dection ambiguous status";
CM_ SG_ 86 ReSideRdrLeDetn31RdrDetnAssoTrkID "Associated tracker ID
";
CM_ SG_ 86 ReSideRdrLeDetn31RdrDetnAzi "Refer to the data element description in ReSideRdrLeDetn1 with the same data element name";
CM_ SG_ 86 ReSideRdrLeDetn31RdrDetnChks "Refer to the data element description in ReSideRdrLeDetn1 with the same data element name";
CM_ SG_ 86 ReSideRdrLeDetn31RdrDetnCntr "Refer to the data element description in ReSideRdrLeDetn1 with the same data element name";
CM_ SG_ 86 ReSideRdrLeDetn31RdrDetnConf "Refer to the data element description in ReSideRdrLeDetn1 with the same data element name";
CM_ SG_ 86 ReSideRdrLeDetn31RdrDetnElevn "Refer to the data element description in ReSideRdrLeDetn1 with the same data element name";
CM_ SG_ 86 ReSideRdrLeDetn31RdrDetnPwr "Refer to the data element description in ReSideRdrLeDetn1 with the same data element name";
CM_ SG_ 86 ReSideRdrLeDetn31RdrDetnRng "Refer to the data element description in ReSideRdrLeDetn1 with the same data element name";
CM_ SG_ 86 ReSideRdrLeDetn31RdrDetnRngV "Range Velocity";
CM_ SG_ 86 ReSideRdrLeDetn31RdrDetnSameRV "object with same distance and speed";
CM_ SG_ 86 ReSideRdrLeDetn31RdrDetnSts "Refer to the data element description in ReSideRdrLeDetn1 with the same data element name";
CM_ SG_ 86 ReSideRdrLeDetn32RdrDetnAmbigState "Dection ambiguous status";
CM_ SG_ 86 ReSideRdrLeDetn32RdrDetnAssoTrkID "Associated tracker ID
";
CM_ SG_ 86 ReSideRdrLeDetn32RdrDetnAzi "Refer to the data element description in ReSideRdrLeDetn1 with the same data element name";
CM_ SG_ 86 ReSideRdrLeDetn32RdrDetnChks "Refer to the data element description in ReSideRdrLeDetn1 with the same data element name";
CM_ SG_ 86 ReSideRdrLeDetn32RdrDetnCntr "Refer to the data element description in ReSideRdrLeDetn1 with the same data element name";
CM_ SG_ 86 ReSideRdrLeDetn32RdrDetnConf "Refer to the data element description in ReSideRdrLeDetn1 with the same data element name";
CM_ SG_ 86 ReSideRdrLeDetn32RdrDetnElevn "Refer to the data element description in ReSideRdrLeDetn1 with the same data element name";
CM_ SG_ 86 ReSideRdrLeDetn32RdrDetnPwr "Refer to the data element description in ReSideRdrLeDetn1 with the same data element name";
CM_ SG_ 86 ReSideRdrLeDetn32RdrDetnRng "Refer to the data element description in ReSideRdrLeDetn1 with the same data element name";
CM_ SG_ 86 ReSideRdrLeDetn32RdrDetnRngV "Range Velocity";
CM_ SG_ 86 ReSideRdrLeDetn32RdrDetnSameRV "object with same distance and speed";
CM_ SG_ 86 ReSideRdrLeDetn32RdrDetnSts "Refer to the data element description in ReSideRdrLeDetn1 with the same data element name";
CM_ SG_ 86 ReSideRdrLeDetn33RdrDetnAmbigState "Dection ambiguous status";
CM_ SG_ 86 ReSideRdrLeDetn33RdrDetnAssoTrkID "Associated tracker ID
";
CM_ SG_ 86 ReSideRdrLeDetn33RdrDetnAzi "Refer to the data element description in ReSideRdrLeDetn1 with the same data element name";
CM_ SG_ 86 ReSideRdrLeDetn33RdrDetnChks "Refer to the data element description in ReSideRdrLeDetn1 with the same data element name";
CM_ SG_ 86 ReSideRdrLeDetn33RdrDetnCntr "Refer to the data element description in ReSideRdrLeDetn1 with the same data element name";
CM_ SG_ 86 ReSideRdrLeDetn33RdrDetnConf "Refer to the data element description in ReSideRdrLeDetn1 with the same data element name";
CM_ SG_ 86 ReSideRdrLeDetn33RdrDetnElevn "Refer to the data element description in ReSideRdrLeDetn1 with the same data element name";
CM_ SG_ 86 ReSideRdrLeDetn33RdrDetnPwr "Refer to the data element description in ReSideRdrLeDetn1 with the same data element name";
CM_ SG_ 86 ReSideRdrLeDetn33RdrDetnRng "Refer to the data element description in ReSideRdrLeDetn1 with the same data element name";
CM_ SG_ 86 ReSideRdrLeDetn33RdrDetnRngV "Range Velocity";
CM_ SG_ 86 ReSideRdrLeDetn33RdrDetnSameRV "object with same distance and speed";
CM_ SG_ 86 ReSideRdrLeDetn33RdrDetnSts "Refer to the data element description in ReSideRdrLeDetn1 with the same data element name";
CM_ SG_ 86 ReSideRdrLeDetn34RdrDetnAmbigState "Dection ambiguous status";
CM_ SG_ 86 ReSideRdrLeDetn34RdrDetnAssoTrkID "Associated tracker ID
";
CM_ SG_ 86 ReSideRdrLeDetn34RdrDetnAzi "Refer to the data element description in ReSideRdrLeDetn1 with the same data element name";
CM_ SG_ 86 ReSideRdrLeDetn34RdrDetnChks "Refer to the data element description in ReSideRdrLeDetn1 with the same data element name";
CM_ SG_ 86 ReSideRdrLeDetn34RdrDetnCntr "Refer to the data element description in ReSideRdrLeDetn1 with the same data element name";
CM_ SG_ 86 ReSideRdrLeDetn34RdrDetnConf "Refer to the data element description in ReSideRdrLeDetn1 with the same data element name";
CM_ SG_ 86 ReSideRdrLeDetn34RdrDetnElevn "Refer to the data element description in ReSideRdrLeDetn1 with the same data element name";
CM_ SG_ 86 ReSideRdrLeDetn34RdrDetnPwr "Refer to the data element description in ReSideRdrLeDetn1 with the same data element name";
CM_ SG_ 86 ReSideRdrLeDetn34RdrDetnRng "Refer to the data element description in ReSideRdrLeDetn1 with the same data element name";
CM_ SG_ 86 ReSideRdrLeDetn34RdrDetnRngV "Range Velocity";
CM_ SG_ 86 ReSideRdrLeDetn34RdrDetnSameRV "object with same distance and speed";
CM_ SG_ 86 ReSideRdrLeDetn34RdrDetnSts "Refer to the data element description in ReSideRdrLeDetn1 with the same data element name";
CM_ SG_ 86 ReSideRdrLeDetn35RdrDetnAmbigState "Dection ambiguous status";
CM_ SG_ 86 ReSideRdrLeDetn35RdrDetnAssoTrkID "Associated tracker ID
";
CM_ SG_ 86 ReSideRdrLeDetn35RdrDetnAzi "Refer to the data element description in ReSideRdrLeDetn1 with the same data element name";
CM_ SG_ 86 ReSideRdrLeDetn35RdrDetnChks "Refer to the data element description in ReSideRdrLeDetn1 with the same data element name";
CM_ SG_ 86 ReSideRdrLeDetn35RdrDetnCntr "Refer to the data element description in ReSideRdrLeDetn1 with the same data element name";
CM_ SG_ 86 ReSideRdrLeDetn35RdrDetnConf "Refer to the data element description in ReSideRdrLeDetn1 with the same data element name";
CM_ SG_ 86 ReSideRdrLeDetn35RdrDetnElevn "Refer to the data element description in ReSideRdrLeDetn1 with the same data element name";
CM_ SG_ 86 ReSideRdrLeDetn35RdrDetnPwr "Refer to the data element description in ReSideRdrLeDetn1 with the same data element name";
CM_ SG_ 86 ReSideRdrLeDetn35RdrDetnRng "Refer to the data element description in ReSideRdrLeDetn1 with the same data element name";
CM_ SG_ 86 ReSideRdrLeDetn35RdrDetnRngV "Range Velocity";
CM_ SG_ 86 ReSideRdrLeDetn35RdrDetnSameRV "object with same distance and speed";
CM_ SG_ 86 ReSideRdrLeDetn35RdrDetnSts "Refer to the data element description in ReSideRdrLeDetn1 with the same data element name";
CM_ SG_ 86 ReSideRdrLeDetn36RdrDetnAmbigState "Dection ambiguous status";
CM_ SG_ 86 ReSideRdrLeDetn36RdrDetnAssoTrkID "Associated tracker ID
";
CM_ SG_ 86 ReSideRdrLeDetn36RdrDetnAzi "Refer to the data element description in ReSideRdrLeDetn1 with the same data element name";
CM_ SG_ 86 ReSideRdrLeDetn36RdrDetnChks "Refer to the data element description in ReSideRdrLeDetn1 with the same data element name";
CM_ SG_ 86 ReSideRdrLeDetn36RdrDetnCntr "Refer to the data element description in ReSideRdrLeDetn1 with the same data element name";
CM_ SG_ 86 ReSideRdrLeDetn36RdrDetnConf "Refer to the data element description in ReSideRdrLeDetn1 with the same data element name";
CM_ SG_ 86 ReSideRdrLeDetn36RdrDetnElevn "Refer to the data element description in ReSideRdrLeDetn1 with the same data element name";
CM_ SG_ 86 ReSideRdrLeDetn36RdrDetnPwr "Refer to the data element description in ReSideRdrLeDetn1 with the same data element name";
CM_ SG_ 86 ReSideRdrLeDetn36RdrDetnRng "Refer to the data element description in ReSideRdrLeDetn1 with the same data element name";
CM_ SG_ 86 ReSideRdrLeDetn36RdrDetnRngV "Range Velocity";
CM_ SG_ 86 ReSideRdrLeDetn36RdrDetnSameRV "object with same distance and speed";
CM_ SG_ 86 ReSideRdrLeDetn36RdrDetnSts "Refer to the data element description in ReSideRdrLeDetn1 with the same data element name";
BA_DEF_ BO_ "CANFD_BRS" ENUM "0","1";
BA_DEF_ BO_ "GenMsgCycleTime" INT 0 65536; // [ms]
BA_DEF_ BO_ "GenMsgDelayTime" INT 0 65536; // [ms]
BA_DEF_ BO_ "GenMsgSendType" ENUM "cyclic", "spontaneous", "not-used", "not-used", "not-used", "cyclicAndSpontaneous", "not-used", "cyclicIfActive", "NoMsgSendType"; // [us]
BA_DEF_ BO_ "GenMsgStartDelayTime" INT 0 65536; // [ms]
BA_DEF_ BO_ "VFrameFormat" ENUM "StandardCAN","ExtendedCAN","reserved","J1939PG","reserved","reserved","reserved","reserved","reserved","reserved","reserved","reserved","reserved","reserved","StandardCAN_FD","ExtendedCAN_FD";
BA_DEF_ SG_ "GenSigSendType" ENUM "Cyclic","OnWrite","OnWriteWithRepetition","OnChange","OnChangeWithRepetition","IfActive","IfActiveWithRepetition","NoSigSendType";
BA_DEF_ SG_ "GenSigStartValue" HEX 0 80000000;
BA_DEF_ BO_ "GenMsgILSupport" ENUM "No","Yes";
BA_DEF_ BO_ "NmAsrMessage" ENUM "No","Yes";
BA_DEF_ SG_ "GenSigFuncType" ENUM "NoFunction","n/a","n/a","n/a","n/a","n/a","n/a","n/a","n/a","n/a","n/a","n/a","n/a","n/a","n/a","CHK","CNTR","n/a","n/a","n/a","CNTR_AR_01","CRC_AR_01_BOTH","CRC_AR_01_ALT","CRC_AR_01_LOW","CRC_AR_01_NIBBLE","CNTR_AR_04","CRC_AR_04A","CNTR_AR_05","CRC_AR_05";
BA_DEF_ SG_ "GenSigDataID" STRING;
BA_DEF_DEF_ "CANFD_BRS" "1";
BA_DEF_DEF_ "GenSigStartValue" 0;
BA_DEF_DEF_ "VFrameFormat" "J1939PG";
BA_DEF_DEF_ "GenSigSendType" "NoSigSendType";
BA_DEF_DEF_ "GenMsgCycleTime" 0;
BA_DEF_DEF_ "GenMsgDelayTime" 0;
BA_DEF_DEF_ "GenMsgStartDelayTime" 0;
BA_DEF_DEF_ "GenMsgSendType" "NoMsgSendType";
BA_DEF_DEF_ "GenMsgILSupport" "Yes";
BA_DEF_DEF_ "NmAsrMessage" "No";
BA_DEF_DEF_ "GenSigFuncType" "NoFunction";
BA_DEF_DEF_ "GenSigDataID" "";
// Frame: SODLPrivateCANFD5Fr32
BA_ "GenMsgCycleTime" BO_ 1074 50 ;
BA_ "GenMsgSendType" BO_ 1074 0;
BA_ "VFrameFormat" BO_ 1074 14;
// Frame: SODLPrivateCANFD5Fr33
BA_ "GenMsgCycleTime" BO_ 1075 50 ;
BA_ "GenMsgSendType" BO_ 1075 0;
BA_ "VFrameFormat" BO_ 1075 14;
// Frame: SODLPrivateCANFD5Fr34
BA_ "GenMsgCycleTime" BO_ 81 50 ;
BA_ "GenMsgSendType" BO_ 81 0;
BA_ "VFrameFormat" BO_ 81 14;
// Frame: SODLPrivateCANFD5Fr35
BA_ "GenMsgCycleTime" BO_ 82 50 ;
BA_ "GenMsgSendType" BO_ 82 0;
BA_ "VFrameFormat" BO_ 82 14;
// Frame: SODLPrivateCANFD5Fr36
BA_ "GenMsgCycleTime" BO_ 83 50 ;
BA_ "GenMsgSendType" BO_ 83 0;
BA_ "VFrameFormat" BO_ 83 14;
// Frame: SODLPrivateCANFD5Fr37
BA_ "GenMsgCycleTime" BO_ 84 50 ;
BA_ "GenMsgSendType" BO_ 84 0;
BA_ "VFrameFormat" BO_ 84 14;
// Frame: SODLPrivateCANFD5Fr38
BA_ "GenMsgCycleTime" BO_ 85 50 ;
BA_ "GenMsgSendType" BO_ 85 0;
BA_ "VFrameFormat" BO_ 85 14;
// Frame: SODLPrivateCANFD5Fr39
BA_ "GenMsgCycleTime" BO_ 86 50 ;
BA_ "GenMsgSendType" BO_ 86 0;
BA_ "VFrameFormat" BO_ 86 14;
BA_ "GenSigSendType" SG_ 1074 ReSideRdrLe20Obj32Heading 0;
BA_ "GenSigStartValue" SG_ 1074 ReSideRdrLe20Obj32Heading 1800;
BA_ "GenSigSendType" SG_ 1074 ReSideRdrLe20Obj32ObjBoxCenterLat 0;
BA_ "GenSigStartValue" SG_ 1074 ReSideRdrLe20Obj32ObjBoxCenterLat 250;
BA_ "GenSigSendType" SG_ 1074 ReSideRdrLe20Obj32ObjBoxCenterLgt 0;
BA_ "GenSigStartValue" SG_ 1074 ReSideRdrLe20Obj32ObjBoxCenterLgt 250;
BA_ "GenSigSendType" SG_ 1074 ReSideRdrLe20Obj32ObservationHist 0;
BA_ "GenSigSendType" SG_ 1074 ReSideRdrLe20Obj32QualityBits 0;
BA_ "GenSigSendType" SG_ 1074 ReSideRdrLe20Obj32RdrObjAx 0;
BA_ "GenSigSendType" SG_ 1074 ReSideRdrLe20Obj32RdrObjAy 0;
BA_ "GenSigSendType" SG_ 1074 ReSideRdrLe20Obj32RdrObjBoxLength 0;
BA_ "GenSigSendType" SG_ 1074 ReSideRdrLe20Obj32RdrObjBoxWidth 0;
BA_ "GenSigDataID" SG_ 1074 ReSideRdrLe20Obj32RdrObjChks "0x12B3";
BA_ "GenSigFuncType" SG_ 1074 ReSideRdrLe20Obj32RdrObjChks 15;
BA_ "GenSigSendType" SG_ 1074 ReSideRdrLe20Obj32RdrObjChks 0;
BA_ "GenSigFuncType" SG_ 1074 ReSideRdrLe20Obj32RdrObjCntr 16;
BA_ "GenSigSendType" SG_ 1074 ReSideRdrLe20Obj32RdrObjCntr 0;
BA_ "GenSigSendType" SG_ 1074 ReSideRdrLe20Obj32RdrObjCoastCnt 0;
BA_ "GenSigStartValue" SG_ 1074 ReSideRdrLe20Obj32RdrObjCoastCnt 31;
BA_ "GenSigSendType" SG_ 1074 ReSideRdrLe20Obj32RdrObjConf 0;
BA_ "GenSigSendType" SG_ 1074 ReSideRdrLe20Obj32RdrObjDx 0;
BA_ "GenSigSendType" SG_ 1074 ReSideRdrLe20Obj32RdrObjDxStdDe 0;
BA_ "GenSigSendType" SG_ 1074 ReSideRdrLe20Obj32RdrObjDy 0;
BA_ "GenSigStartValue" SG_ 1074 ReSideRdrLe20Obj32RdrObjDy 4000;
BA_ "GenSigSendType" SG_ 1074 ReSideRdrLe20Obj32RdrObjDyStdDe 0;
BA_ "GenSigSendType" SG_ 1074 ReSideRdrLe20Obj32RdrObjElevnConf 0;
BA_ "GenSigSendType" SG_ 1074 ReSideRdrLe20Obj32RdrObjElevnSts 0;
BA_ "GenSigSendType" SG_ 1074 ReSideRdrLe20Obj32RdrObjID 0;
BA_ "GenSigSendType" SG_ 1074 ReSideRdrLe20Obj32RdrObjIsInFreeSpace 0;
BA_ "GenSigStartValue" SG_ 1074 ReSideRdrLe20Obj32RdrObjIsInFreeSpace 1;
BA_ "GenSigSendType" SG_ 1074 ReSideRdrLe20Obj32RdrObjMirrProblty 0;
BA_ "GenSigSendType" SG_ 1074 ReSideRdrLe20Obj32RdrObjMtnPat 0;
BA_ "GenSigStartValue" SG_ 1074 ReSideRdrLe20Obj32RdrObjMtnPat 3;
BA_ "GenSigSendType" SG_ 1074 ReSideRdrLe20Obj32RdrObjNotRealProblty 0;
BA_ "GenSigSendType" SG_ 1074 ReSideRdrLe20Obj32RdrObjStatyCnt 0;
BA_ "GenSigSendType" SG_ 1074 ReSideRdrLe20Obj32RdrObjTiAlv 0;
BA_ "GenSigSendType" SG_ 1074 ReSideRdrLe20Obj32RdrObjTrackSts 0;
BA_ "GenSigSendType" SG_ 1074 ReSideRdrLe20Obj32RdrObjTyp 0;
BA_ "GenSigSendType" SG_ 1074 ReSideRdrLe20Obj32RdrObjTypConfBike 0;
BA_ "GenSigSendType" SG_ 1074 ReSideRdrLe20Obj32RdrObjTypConfPed 0;
BA_ "GenSigSendType" SG_ 1074 ReSideRdrLe20Obj32RdrObjTypConfVeh 0;
BA_ "GenSigSendType" SG_ 1074 ReSideRdrLe20Obj32RdrObjUsedTracker 0;
BA_ "GenSigStartValue" SG_ 1074 ReSideRdrLe20Obj32RdrObjUsedTracker 3;
BA_ "GenSigSendType" SG_ 1074 ReSideRdrLe20Obj32RdrObjVx 0;
BA_ "GenSigStartValue" SG_ 1074 ReSideRdrLe20Obj32RdrObjVx 6400;
BA_ "GenSigSendType" SG_ 1074 ReSideRdrLe20Obj32RdrObjVxStdDe 0;
BA_ "GenSigSendType" SG_ 1074 ReSideRdrLe20Obj32RdrObjVy 0;
BA_ "GenSigStartValue" SG_ 1074 ReSideRdrLe20Obj32RdrObjVy 6400;
BA_ "GenSigSendType" SG_ 1074 ReSideRdrLe20Obj32RdrObjVyStdDe 0;
BA_ "GenSigSendType" SG_ 1074 ReSideRdrLe20Obj32RelVx 0;
BA_ "GenSigStartValue" SG_ 1074 ReSideRdrLe20Obj32RelVx 1780;
BA_ "GenSigSendType" SG_ 1074 ReSideRdrLe20Obj32RelVy 0;
BA_ "GenSigStartValue" SG_ 1074 ReSideRdrLe20Obj32RelVy 1780;
BA_ "GenSigSendType" SG_ 1075 ReSideRdrLe20StsForDim 0;
BA_ "GenSigStartValue" SG_ 1075 ReSideRdrLe20StsForDim 1;
BA_ "GenSigSendType" SG_ 1075 ReSideRdrLe20StsRdrNrDetn 0;
BA_ "GenSigSendType" SG_ 1075 ReSideRdrLe20StsRdrNrObj 0;
BA_ "GenSigSendType" SG_ 1075 ReSideRdrLe20StsRdrStsBlkd0bin 0;
BA_ "GenSigSendType" SG_ 1075 ReSideRdrLe20StsRdrStsBlkdConf 0;
BA_ "GenSigDataID" SG_ 1075 ReSideRdrLe20StsRdrStsChks "0x12B4";
BA_ "GenSigFuncType" SG_ 1075 ReSideRdrLe20StsRdrStsChks 15;
BA_ "GenSigSendType" SG_ 1075 ReSideRdrLe20StsRdrStsChks 0;
BA_ "GenSigFuncType" SG_ 1075 ReSideRdrLe20StsRdrStsCntr 16;
BA_ "GenSigSendType" SG_ 1075 ReSideRdrLe20StsRdrStsCntr 0;
BA_ "GenSigSendType" SG_ 1075 ReSideRdrLe20StsRdrStsDstbc 0;
BA_ "GenSigSendType" SG_ 1075 ReSideRdrLe20StsRdrStsEna 0;
BA_ "GenSigSendType" SG_ 1075 ReSideRdrLe20StsRdrStsFaulty 0;
BA_ "GenSigSendType" SG_ 1075 ReSideRdrLe20StsRdrStsLatency 0;
BA_ "GenSigSendType" SG_ 1075 ReSideRdrLe20StsRdrStsMisAlign 0;
BA_ "GenSigSendType" SG_ 1075 ReSideRdrLe20StsRdrStsMissCom 0;
BA_ "GenSigSendType" SG_ 1075 ReSideRdrLe20StsRdrStsTiStamp20 0;
BA_ "GenSigSendType" SG_ 1075 ReSideRdrLe20StsRdrStsTiStampHi20 0;
BA_ "GenSigSendType" SG_ 1075 ReSideRdrLe20StsRdrStsTiStampNano20 0;
BA_ "GenSigSendType" SG_ 1075 ReSideRdrLe20StsRdrStsTiStampStsGlbTiBas 0;
BA_ "GenSigSendType" SG_ 1075 ReSideRdrLe20StsRdrStsTiStampStsSyncToGateway 0;
BA_ "GenSigSendType" SG_ 1075 ReSideRdrLe20StsRdrStsTiStampStsTiLeap 0;
BA_ "GenSigSendType" SG_ 1075 ReSideRdrLe20StsRdrStsTiStampStsTiOut 0;
BA_ "GenSigSendType" SG_ 1075 ReSideRdrLe20StsRdrStsWhlSpdCmpFac 0;
BA_ "GenSigSendType" SG_ 1075 ReSideRdrLe20StsRdrStslfVersMajor 0;
BA_ "GenSigSendType" SG_ 1075 ReSideRdrLe20StsRdrStslfVersMinor 0;
BA_ "GenSigSendType" SG_ 1075 ReSideRdrLe20StsRdrSysSftyFlt 0;
BA_ "GenSigSendType" SG_ 82 ReSideRdrLeDetn10RdrDetnAmbigState 0;
BA_ "GenSigSendType" SG_ 82 ReSideRdrLeDetn10RdrDetnAssoTrkID 0;
BA_ "GenSigSendType" SG_ 82 ReSideRdrLeDetn10RdrDetnAzi 0;
BA_ "GenSigStartValue" SG_ 82 ReSideRdrLeDetn10RdrDetnAzi 900;
BA_ "GenSigDataID" SG_ 82 ReSideRdrLeDetn10RdrDetnChks "0x99B";
BA_ "GenSigFuncType" SG_ 82 ReSideRdrLeDetn10RdrDetnChks 15;
BA_ "GenSigSendType" SG_ 82 ReSideRdrLeDetn10RdrDetnChks 0;
BA_ "GenSigFuncType" SG_ 82 ReSideRdrLeDetn10RdrDetnCntr 16;
BA_ "GenSigSendType" SG_ 82 ReSideRdrLeDetn10RdrDetnCntr 0;
BA_ "GenSigSendType" SG_ 82 ReSideRdrLeDetn10RdrDetnConf 0;
BA_ "GenSigSendType" SG_ 82 ReSideRdrLeDetn10RdrDetnElevn 0;
BA_ "GenSigStartValue" SG_ 82 ReSideRdrLeDetn10RdrDetnElevn 15;
BA_ "GenSigSendType" SG_ 82 ReSideRdrLeDetn10RdrDetnPwr 0;
BA_ "GenSigSendType" SG_ 82 ReSideRdrLeDetn10RdrDetnRng 0;
BA_ "GenSigStartValue" SG_ 82 ReSideRdrLeDetn10RdrDetnRng 10050;
BA_ "GenSigSendType" SG_ 82 ReSideRdrLeDetn10RdrDetnRngV 0;
BA_ "GenSigStartValue" SG_ 82 ReSideRdrLeDetn10RdrDetnRngV 4000;
BA_ "GenSigSendType" SG_ 82 ReSideRdrLeDetn10RdrDetnSameRV 0;
BA_ "GenSigSendType" SG_ 82 ReSideRdrLeDetn10RdrDetnSts 0;
BA_ "GenSigStartValue" SG_ 82 ReSideRdrLeDetn10RdrDetnSts 3;
BA_ "GenSigSendType" SG_ 82 ReSideRdrLeDetn11RdrDetnAmbigState 0;
BA_ "GenSigSendType" SG_ 82 ReSideRdrLeDetn11RdrDetnAssoTrkID 0;
BA_ "GenSigSendType" SG_ 82 ReSideRdrLeDetn11RdrDetnAzi 0;
BA_ "GenSigStartValue" SG_ 82 ReSideRdrLeDetn11RdrDetnAzi 900;
BA_ "GenSigDataID" SG_ 82 ReSideRdrLeDetn11RdrDetnChks "0x99C";
BA_ "GenSigFuncType" SG_ 82 ReSideRdrLeDetn11RdrDetnChks 15;
BA_ "GenSigSendType" SG_ 82 ReSideRdrLeDetn11RdrDetnChks 0;
BA_ "GenSigFuncType" SG_ 82 ReSideRdrLeDetn11RdrDetnCntr 16;
BA_ "GenSigSendType" SG_ 82 ReSideRdrLeDetn11RdrDetnCntr 0;
BA_ "GenSigSendType" SG_ 82 ReSideRdrLeDetn11RdrDetnConf 0;
BA_ "GenSigSendType" SG_ 82 ReSideRdrLeDetn11RdrDetnElevn 0;
BA_ "GenSigStartValue" SG_ 82 ReSideRdrLeDetn11RdrDetnElevn 15;
BA_ "GenSigSendType" SG_ 82 ReSideRdrLeDetn11RdrDetnPwr 0;
BA_ "GenSigSendType" SG_ 82 ReSideRdrLeDetn11RdrDetnRng 0;
BA_ "GenSigStartValue" SG_ 82 ReSideRdrLeDetn11RdrDetnRng 10050;
BA_ "GenSigSendType" SG_ 82 ReSideRdrLeDetn11RdrDetnRngV 0;
BA_ "GenSigStartValue" SG_ 82 ReSideRdrLeDetn11RdrDetnRngV 4000;
BA_ "GenSigSendType" SG_ 82 ReSideRdrLeDetn11RdrDetnSameRV 0;
BA_ "GenSigSendType" SG_ 82 ReSideRdrLeDetn11RdrDetnSts 0;
BA_ "GenSigStartValue" SG_ 82 ReSideRdrLeDetn11RdrDetnSts 3;
BA_ "GenSigSendType" SG_ 82 ReSideRdrLeDetn12RdrDetnAmbigState 0;
BA_ "GenSigSendType" SG_ 82 ReSideRdrLeDetn12RdrDetnAssoTrkID 0;
BA_ "GenSigSendType" SG_ 82 ReSideRdrLeDetn12RdrDetnAzi 0;
BA_ "GenSigStartValue" SG_ 82 ReSideRdrLeDetn12RdrDetnAzi 900;
BA_ "GenSigDataID" SG_ 82 ReSideRdrLeDetn12RdrDetnChks "0x99D";
BA_ "GenSigFuncType" SG_ 82 ReSideRdrLeDetn12RdrDetnChks 15;
BA_ "GenSigSendType" SG_ 82 ReSideRdrLeDetn12RdrDetnChks 0;
BA_ "GenSigFuncType" SG_ 82 ReSideRdrLeDetn12RdrDetnCntr 16;
BA_ "GenSigSendType" SG_ 82 ReSideRdrLeDetn12RdrDetnCntr 0;
BA_ "GenSigSendType" SG_ 82 ReSideRdrLeDetn12RdrDetnConf 0;
BA_ "GenSigSendType" SG_ 82 ReSideRdrLeDetn12RdrDetnElevn 0;
BA_ "GenSigStartValue" SG_ 82 ReSideRdrLeDetn12RdrDetnElevn 15;
BA_ "GenSigSendType" SG_ 82 ReSideRdrLeDetn12RdrDetnPwr 0;
BA_ "GenSigSendType" SG_ 82 ReSideRdrLeDetn12RdrDetnRng 0;
BA_ "GenSigStartValue" SG_ 82 ReSideRdrLeDetn12RdrDetnRng 10050;
BA_ "GenSigSendType" SG_ 82 ReSideRdrLeDetn12RdrDetnRngV 0;
BA_ "GenSigStartValue" SG_ 82 ReSideRdrLeDetn12RdrDetnRngV 4000;
BA_ "GenSigSendType" SG_ 82 ReSideRdrLeDetn12RdrDetnSameRV 0;
BA_ "GenSigSendType" SG_ 82 ReSideRdrLeDetn12RdrDetnSts 0;
BA_ "GenSigStartValue" SG_ 82 ReSideRdrLeDetn12RdrDetnSts 3;
BA_ "GenSigSendType" SG_ 83 ReSideRdrLeDetn13RdrDetnAmbigState 0;
BA_ "GenSigSendType" SG_ 83 ReSideRdrLeDetn13RdrDetnAssoTrkID 0;
BA_ "GenSigSendType" SG_ 83 ReSideRdrLeDetn13RdrDetnAzi 0;
BA_ "GenSigStartValue" SG_ 83 ReSideRdrLeDetn13RdrDetnAzi 900;
BA_ "GenSigDataID" SG_ 83 ReSideRdrLeDetn13RdrDetnChks "0x99E";
BA_ "GenSigFuncType" SG_ 83 ReSideRdrLeDetn13RdrDetnChks 15;
BA_ "GenSigSendType" SG_ 83 ReSideRdrLeDetn13RdrDetnChks 0;
BA_ "GenSigFuncType" SG_ 83 ReSideRdrLeDetn13RdrDetnCntr 16;
BA_ "GenSigSendType" SG_ 83 ReSideRdrLeDetn13RdrDetnCntr 0;
BA_ "GenSigSendType" SG_ 83 ReSideRdrLeDetn13RdrDetnConf 0;
BA_ "GenSigSendType" SG_ 83 ReSideRdrLeDetn13RdrDetnElevn 0;
BA_ "GenSigStartValue" SG_ 83 ReSideRdrLeDetn13RdrDetnElevn 15;
BA_ "GenSigSendType" SG_ 83 ReSideRdrLeDetn13RdrDetnPwr 0;
BA_ "GenSigSendType" SG_ 83 ReSideRdrLeDetn13RdrDetnRng 0;
BA_ "GenSigStartValue" SG_ 83 ReSideRdrLeDetn13RdrDetnRng 10050;
BA_ "GenSigSendType" SG_ 83 ReSideRdrLeDetn13RdrDetnRngV 0;
BA_ "GenSigStartValue" SG_ 83 ReSideRdrLeDetn13RdrDetnRngV 4000;
BA_ "GenSigSendType" SG_ 83 ReSideRdrLeDetn13RdrDetnSameRV 0;
BA_ "GenSigSendType" SG_ 83 ReSideRdrLeDetn13RdrDetnSts 0;
BA_ "GenSigStartValue" SG_ 83 ReSideRdrLeDetn13RdrDetnSts 3;
BA_ "GenSigSendType" SG_ 83 ReSideRdrLeDetn14RdrDetnAmbigState 0;
BA_ "GenSigSendType" SG_ 83 ReSideRdrLeDetn14RdrDetnAssoTrkID 0;
BA_ "GenSigSendType" SG_ 83 ReSideRdrLeDetn14RdrDetnAzi 0;
BA_ "GenSigStartValue" SG_ 83 ReSideRdrLeDetn14RdrDetnAzi 900;
BA_ "GenSigDataID" SG_ 83 ReSideRdrLeDetn14RdrDetnChks "0x99F";
BA_ "GenSigFuncType" SG_ 83 ReSideRdrLeDetn14RdrDetnChks 15;
BA_ "GenSigSendType" SG_ 83 ReSideRdrLeDetn14RdrDetnChks 0;
BA_ "GenSigFuncType" SG_ 83 ReSideRdrLeDetn14RdrDetnCntr 16;
BA_ "GenSigSendType" SG_ 83 ReSideRdrLeDetn14RdrDetnCntr 0;
BA_ "GenSigSendType" SG_ 83 ReSideRdrLeDetn14RdrDetnConf 0;
BA_ "GenSigSendType" SG_ 83 ReSideRdrLeDetn14RdrDetnElevn 0;
BA_ "GenSigStartValue" SG_ 83 ReSideRdrLeDetn14RdrDetnElevn 15;
BA_ "GenSigSendType" SG_ 83 ReSideRdrLeDetn14RdrDetnPwr 0;
BA_ "GenSigSendType" SG_ 83 ReSideRdrLeDetn14RdrDetnRng 0;
BA_ "GenSigStartValue" SG_ 83 ReSideRdrLeDetn14RdrDetnRng 10050;
BA_ "GenSigSendType" SG_ 83 ReSideRdrLeDetn14RdrDetnRngV 0;
BA_ "GenSigStartValue" SG_ 83 ReSideRdrLeDetn14RdrDetnRngV 4000;
BA_ "GenSigSendType" SG_ 83 ReSideRdrLeDetn14RdrDetnSameRV 0;
BA_ "GenSigSendType" SG_ 83 ReSideRdrLeDetn14RdrDetnSts 0;
BA_ "GenSigStartValue" SG_ 83 ReSideRdrLeDetn14RdrDetnSts 3;
BA_ "GenSigSendType" SG_ 83 ReSideRdrLeDetn15RdrDetnAmbigState 0;
BA_ "GenSigSendType" SG_ 83 ReSideRdrLeDetn15RdrDetnAssoTrkID 0;
BA_ "GenSigSendType" SG_ 83 ReSideRdrLeDetn15RdrDetnAzi 0;
BA_ "GenSigStartValue" SG_ 83 ReSideRdrLeDetn15RdrDetnAzi 900;
BA_ "GenSigDataID" SG_ 83 ReSideRdrLeDetn15RdrDetnChks "0x9A0";
BA_ "GenSigFuncType" SG_ 83 ReSideRdrLeDetn15RdrDetnChks 15;
BA_ "GenSigSendType" SG_ 83 ReSideRdrLeDetn15RdrDetnChks 0;
BA_ "GenSigFuncType" SG_ 83 ReSideRdrLeDetn15RdrDetnCntr 16;
BA_ "GenSigSendType" SG_ 83 ReSideRdrLeDetn15RdrDetnCntr 0;
BA_ "GenSigSendType" SG_ 83 ReSideRdrLeDetn15RdrDetnConf 0;
BA_ "GenSigSendType" SG_ 83 ReSideRdrLeDetn15RdrDetnElevn 0;
BA_ "GenSigStartValue" SG_ 83 ReSideRdrLeDetn15RdrDetnElevn 15;
BA_ "GenSigSendType" SG_ 83 ReSideRdrLeDetn15RdrDetnPwr 0;
BA_ "GenSigSendType" SG_ 83 ReSideRdrLeDetn15RdrDetnRng 0;
BA_ "GenSigStartValue" SG_ 83 ReSideRdrLeDetn15RdrDetnRng 10050;
BA_ "GenSigSendType" SG_ 83 ReSideRdrLeDetn15RdrDetnRngV 0;
BA_ "GenSigStartValue" SG_ 83 ReSideRdrLeDetn15RdrDetnRngV 4000;
BA_ "GenSigSendType" SG_ 83 ReSideRdrLeDetn15RdrDetnSameRV 0;
BA_ "GenSigSendType" SG_ 83 ReSideRdrLeDetn15RdrDetnSts 0;
BA_ "GenSigStartValue" SG_ 83 ReSideRdrLeDetn15RdrDetnSts 3;
BA_ "GenSigSendType" SG_ 83 ReSideRdrLeDetn16RdrDetnAmbigState 0;
BA_ "GenSigSendType" SG_ 83 ReSideRdrLeDetn16RdrDetnAssoTrkID 0;
BA_ "GenSigSendType" SG_ 83 ReSideRdrLeDetn16RdrDetnAzi 0;
BA_ "GenSigStartValue" SG_ 83 ReSideRdrLeDetn16RdrDetnAzi 900;
BA_ "GenSigDataID" SG_ 83 ReSideRdrLeDetn16RdrDetnChks "0x9A1";
BA_ "GenSigFuncType" SG_ 83 ReSideRdrLeDetn16RdrDetnChks 15;
BA_ "GenSigSendType" SG_ 83 ReSideRdrLeDetn16RdrDetnChks 0;
BA_ "GenSigFuncType" SG_ 83 ReSideRdrLeDetn16RdrDetnCntr 16;
BA_ "GenSigSendType" SG_ 83 ReSideRdrLeDetn16RdrDetnCntr 0;
BA_ "GenSigSendType" SG_ 83 ReSideRdrLeDetn16RdrDetnConf 0;
BA_ "GenSigSendType" SG_ 83 ReSideRdrLeDetn16RdrDetnElevn 0;
BA_ "GenSigStartValue" SG_ 83 ReSideRdrLeDetn16RdrDetnElevn 15;
BA_ "GenSigSendType" SG_ 83 ReSideRdrLeDetn16RdrDetnPwr 0;
BA_ "GenSigSendType" SG_ 83 ReSideRdrLeDetn16RdrDetnRng 0;
BA_ "GenSigStartValue" SG_ 83 ReSideRdrLeDetn16RdrDetnRng 10050;
BA_ "GenSigSendType" SG_ 83 ReSideRdrLeDetn16RdrDetnRngV 0;
BA_ "GenSigStartValue" SG_ 83 ReSideRdrLeDetn16RdrDetnRngV 4000;
BA_ "GenSigSendType" SG_ 83 ReSideRdrLeDetn16RdrDetnSameRV 0;
BA_ "GenSigSendType" SG_ 83 ReSideRdrLeDetn16RdrDetnSts 0;
BA_ "GenSigStartValue" SG_ 83 ReSideRdrLeDetn16RdrDetnSts 3;
BA_ "GenSigSendType" SG_ 83 ReSideRdrLeDetn17RdrDetnAmbigState 0;
BA_ "GenSigSendType" SG_ 83 ReSideRdrLeDetn17RdrDetnAssoTrkID 0;
BA_ "GenSigSendType" SG_ 83 ReSideRdrLeDetn17RdrDetnAzi 0;
BA_ "GenSigStartValue" SG_ 83 ReSideRdrLeDetn17RdrDetnAzi 900;
BA_ "GenSigDataID" SG_ 83 ReSideRdrLeDetn17RdrDetnChks "0x9A2";
BA_ "GenSigFuncType" SG_ 83 ReSideRdrLeDetn17RdrDetnChks 15;
BA_ "GenSigSendType" SG_ 83 ReSideRdrLeDetn17RdrDetnChks 0;
BA_ "GenSigFuncType" SG_ 83 ReSideRdrLeDetn17RdrDetnCntr 16;
BA_ "GenSigSendType" SG_ 83 ReSideRdrLeDetn17RdrDetnCntr 0;
BA_ "GenSigSendType" SG_ 83 ReSideRdrLeDetn17RdrDetnConf 0;
BA_ "GenSigSendType" SG_ 83 ReSideRdrLeDetn17RdrDetnElevn 0;
BA_ "GenSigStartValue" SG_ 83 ReSideRdrLeDetn17RdrDetnElevn 15;
BA_ "GenSigSendType" SG_ 83 ReSideRdrLeDetn17RdrDetnPwr 0;
BA_ "GenSigSendType" SG_ 83 ReSideRdrLeDetn17RdrDetnRng 0;
BA_ "GenSigStartValue" SG_ 83 ReSideRdrLeDetn17RdrDetnRng 10050;
BA_ "GenSigSendType" SG_ 83 ReSideRdrLeDetn17RdrDetnRngV 0;
BA_ "GenSigStartValue" SG_ 83 ReSideRdrLeDetn17RdrDetnRngV 4000;
BA_ "GenSigSendType" SG_ 83 ReSideRdrLeDetn17RdrDetnSameRV 0;
BA_ "GenSigSendType" SG_ 83 ReSideRdrLeDetn17RdrDetnSts 0;
BA_ "GenSigStartValue" SG_ 83 ReSideRdrLeDetn17RdrDetnSts 3;
BA_ "GenSigSendType" SG_ 83 ReSideRdrLeDetn18RdrDetnAmbigState 0;
BA_ "GenSigSendType" SG_ 83 ReSideRdrLeDetn18RdrDetnAssoTrkID 0;
BA_ "GenSigSendType" SG_ 83 ReSideRdrLeDetn18RdrDetnAzi 0;
BA_ "GenSigStartValue" SG_ 83 ReSideRdrLeDetn18RdrDetnAzi 900;
BA_ "GenSigDataID" SG_ 83 ReSideRdrLeDetn18RdrDetnChks "0x9A3";
BA_ "GenSigFuncType" SG_ 83 ReSideRdrLeDetn18RdrDetnChks 15;
BA_ "GenSigSendType" SG_ 83 ReSideRdrLeDetn18RdrDetnChks 0;
BA_ "GenSigFuncType" SG_ 83 ReSideRdrLeDetn18RdrDetnCntr 16;
BA_ "GenSigSendType" SG_ 83 ReSideRdrLeDetn18RdrDetnCntr 0;
BA_ "GenSigSendType" SG_ 83 ReSideRdrLeDetn18RdrDetnConf 0;
BA_ "GenSigSendType" SG_ 83 ReSideRdrLeDetn18RdrDetnElevn 0;
BA_ "GenSigStartValue" SG_ 83 ReSideRdrLeDetn18RdrDetnElevn 15;
BA_ "GenSigSendType" SG_ 83 ReSideRdrLeDetn18RdrDetnPwr 0;
BA_ "GenSigSendType" SG_ 83 ReSideRdrLeDetn18RdrDetnRng 0;
BA_ "GenSigStartValue" SG_ 83 ReSideRdrLeDetn18RdrDetnRng 10050;
BA_ "GenSigSendType" SG_ 83 ReSideRdrLeDetn18RdrDetnRngV 0;
BA_ "GenSigStartValue" SG_ 83 ReSideRdrLeDetn18RdrDetnRngV 4000;
BA_ "GenSigSendType" SG_ 83 ReSideRdrLeDetn18RdrDetnSameRV 0;
BA_ "GenSigSendType" SG_ 83 ReSideRdrLeDetn18RdrDetnSts 0;
BA_ "GenSigStartValue" SG_ 83 ReSideRdrLeDetn18RdrDetnSts 3;
BA_ "GenSigSendType" SG_ 84 ReSideRdrLeDetn19RdrDetnAmbigState 0;
BA_ "GenSigSendType" SG_ 84 ReSideRdrLeDetn19RdrDetnAssoTrkID 0;
BA_ "GenSigSendType" SG_ 84 ReSideRdrLeDetn19RdrDetnAzi 0;
BA_ "GenSigStartValue" SG_ 84 ReSideRdrLeDetn19RdrDetnAzi 900;
BA_ "GenSigDataID" SG_ 84 ReSideRdrLeDetn19RdrDetnChks "0x9A4";
BA_ "GenSigFuncType" SG_ 84 ReSideRdrLeDetn19RdrDetnChks 15;
BA_ "GenSigSendType" SG_ 84 ReSideRdrLeDetn19RdrDetnChks 0;
BA_ "GenSigFuncType" SG_ 84 ReSideRdrLeDetn19RdrDetnCntr 16;
BA_ "GenSigSendType" SG_ 84 ReSideRdrLeDetn19RdrDetnCntr 0;
BA_ "GenSigSendType" SG_ 84 ReSideRdrLeDetn19RdrDetnConf 0;
BA_ "GenSigSendType" SG_ 84 ReSideRdrLeDetn19RdrDetnElevn 0;
BA_ "GenSigStartValue" SG_ 84 ReSideRdrLeDetn19RdrDetnElevn 15;
BA_ "GenSigSendType" SG_ 84 ReSideRdrLeDetn19RdrDetnPwr 0;
BA_ "GenSigSendType" SG_ 84 ReSideRdrLeDetn19RdrDetnRng 0;
BA_ "GenSigStartValue" SG_ 84 ReSideRdrLeDetn19RdrDetnRng 10050;
BA_ "GenSigSendType" SG_ 84 ReSideRdrLeDetn19RdrDetnRngV 0;
BA_ "GenSigStartValue" SG_ 84 ReSideRdrLeDetn19RdrDetnRngV 4000;
BA_ "GenSigSendType" SG_ 84 ReSideRdrLeDetn19RdrDetnSameRV 0;
BA_ "GenSigSendType" SG_ 84 ReSideRdrLeDetn19RdrDetnSts 0;
BA_ "GenSigStartValue" SG_ 84 ReSideRdrLeDetn19RdrDetnSts 3;
BA_ "GenSigSendType" SG_ 81 ReSideRdrLeDetn1RdrDetnAmbigState 0;
BA_ "GenSigSendType" SG_ 81 ReSideRdrLeDetn1RdrDetnAssoTrkID 0;
BA_ "GenSigSendType" SG_ 81 ReSideRdrLeDetn1RdrDetnAzi 0;
BA_ "GenSigStartValue" SG_ 81 ReSideRdrLeDetn1RdrDetnAzi 900;
BA_ "GenSigDataID" SG_ 81 ReSideRdrLeDetn1RdrDetnChks "0x992";
BA_ "GenSigFuncType" SG_ 81 ReSideRdrLeDetn1RdrDetnChks 15;
BA_ "GenSigSendType" SG_ 81 ReSideRdrLeDetn1RdrDetnChks 0;
BA_ "GenSigFuncType" SG_ 81 ReSideRdrLeDetn1RdrDetnCntr 16;
BA_ "GenSigSendType" SG_ 81 ReSideRdrLeDetn1RdrDetnCntr 0;
BA_ "GenSigSendType" SG_ 81 ReSideRdrLeDetn1RdrDetnConf 0;
BA_ "GenSigSendType" SG_ 81 ReSideRdrLeDetn1RdrDetnElevn 0;
BA_ "GenSigStartValue" SG_ 81 ReSideRdrLeDetn1RdrDetnElevn 15;
BA_ "GenSigSendType" SG_ 81 ReSideRdrLeDetn1RdrDetnPwr 0;
BA_ "GenSigSendType" SG_ 81 ReSideRdrLeDetn1RdrDetnRng 0;
BA_ "GenSigStartValue" SG_ 81 ReSideRdrLeDetn1RdrDetnRng 10050;
BA_ "GenSigSendType" SG_ 81 ReSideRdrLeDetn1RdrDetnRngV 0;
BA_ "GenSigStartValue" SG_ 81 ReSideRdrLeDetn1RdrDetnRngV 4000;
BA_ "GenSigSendType" SG_ 81 ReSideRdrLeDetn1RdrDetnSameRV 0;
BA_ "GenSigSendType" SG_ 81 ReSideRdrLeDetn1RdrDetnSts 0;
BA_ "GenSigStartValue" SG_ 81 ReSideRdrLeDetn1RdrDetnSts 3;
BA_ "GenSigSendType" SG_ 84 ReSideRdrLeDetn20RdrDetnAmbigState 0;
BA_ "GenSigSendType" SG_ 84 ReSideRdrLeDetn20RdrDetnAssoTrkID 0;
BA_ "GenSigSendType" SG_ 84 ReSideRdrLeDetn20RdrDetnAzi 0;
BA_ "GenSigStartValue" SG_ 84 ReSideRdrLeDetn20RdrDetnAzi 900;
BA_ "GenSigDataID" SG_ 84 ReSideRdrLeDetn20RdrDetnChks "0x9A5";
BA_ "GenSigFuncType" SG_ 84 ReSideRdrLeDetn20RdrDetnChks 15;
BA_ "GenSigSendType" SG_ 84 ReSideRdrLeDetn20RdrDetnChks 0;
BA_ "GenSigFuncType" SG_ 84 ReSideRdrLeDetn20RdrDetnCntr 16;
BA_ "GenSigSendType" SG_ 84 ReSideRdrLeDetn20RdrDetnCntr 0;
BA_ "GenSigSendType" SG_ 84 ReSideRdrLeDetn20RdrDetnConf 0;
BA_ "GenSigSendType" SG_ 84 ReSideRdrLeDetn20RdrDetnElevn 0;
BA_ "GenSigStartValue" SG_ 84 ReSideRdrLeDetn20RdrDetnElevn 15;
BA_ "GenSigSendType" SG_ 84 ReSideRdrLeDetn20RdrDetnPwr 0;
BA_ "GenSigSendType" SG_ 84 ReSideRdrLeDetn20RdrDetnRng 0;
BA_ "GenSigStartValue" SG_ 84 ReSideRdrLeDetn20RdrDetnRng 10050;
BA_ "GenSigSendType" SG_ 84 ReSideRdrLeDetn20RdrDetnRngV 0;
BA_ "GenSigStartValue" SG_ 84 ReSideRdrLeDetn20RdrDetnRngV 4000;
BA_ "GenSigSendType" SG_ 84 ReSideRdrLeDetn20RdrDetnSameRV 0;
BA_ "GenSigSendType" SG_ 84 ReSideRdrLeDetn20RdrDetnSts 0;
BA_ "GenSigStartValue" SG_ 84 ReSideRdrLeDetn20RdrDetnSts 3;
BA_ "GenSigSendType" SG_ 84 ReSideRdrLeDetn21RdrDetnAmbigState 0;
BA_ "GenSigSendType" SG_ 84 ReSideRdrLeDetn21RdrDetnAssoTrkID 0;
BA_ "GenSigSendType" SG_ 84 ReSideRdrLeDetn21RdrDetnAzi 0;
BA_ "GenSigStartValue" SG_ 84 ReSideRdrLeDetn21RdrDetnAzi 900;
BA_ "GenSigDataID" SG_ 84 ReSideRdrLeDetn21RdrDetnChks "0x9A6";
BA_ "GenSigFuncType" SG_ 84 ReSideRdrLeDetn21RdrDetnChks 15;
BA_ "GenSigSendType" SG_ 84 ReSideRdrLeDetn21RdrDetnChks 0;
BA_ "GenSigFuncType" SG_ 84 ReSideRdrLeDetn21RdrDetnCntr 16;
BA_ "GenSigSendType" SG_ 84 ReSideRdrLeDetn21RdrDetnCntr 0;
BA_ "GenSigSendType" SG_ 84 ReSideRdrLeDetn21RdrDetnConf 0;
BA_ "GenSigSendType" SG_ 84 ReSideRdrLeDetn21RdrDetnElevn 0;
BA_ "GenSigStartValue" SG_ 84 ReSideRdrLeDetn21RdrDetnElevn 15;
BA_ "GenSigSendType" SG_ 84 ReSideRdrLeDetn21RdrDetnPwr 0;
BA_ "GenSigSendType" SG_ 84 ReSideRdrLeDetn21RdrDetnRng 0;
BA_ "GenSigStartValue" SG_ 84 ReSideRdrLeDetn21RdrDetnRng 10050;
BA_ "GenSigSendType" SG_ 84 ReSideRdrLeDetn21RdrDetnRngV 0;
BA_ "GenSigStartValue" SG_ 84 ReSideRdrLeDetn21RdrDetnRngV 4000;
BA_ "GenSigSendType" SG_ 84 ReSideRdrLeDetn21RdrDetnSameRV 0;
BA_ "GenSigSendType" SG_ 84 ReSideRdrLeDetn21RdrDetnSts 0;
BA_ "GenSigStartValue" SG_ 84 ReSideRdrLeDetn21RdrDetnSts 3;
BA_ "GenSigSendType" SG_ 84 ReSideRdrLeDetn22RdrDetnAmbigState 0;
BA_ "GenSigSendType" SG_ 84 ReSideRdrLeDetn22RdrDetnAssoTrkID 0;
BA_ "GenSigSendType" SG_ 84 ReSideRdrLeDetn22RdrDetnAzi 0;
BA_ "GenSigStartValue" SG_ 84 ReSideRdrLeDetn22RdrDetnAzi 900;
BA_ "GenSigDataID" SG_ 84 ReSideRdrLeDetn22RdrDetnChks "0x9A7";
BA_ "GenSigFuncType" SG_ 84 ReSideRdrLeDetn22RdrDetnChks 15;
BA_ "GenSigSendType" SG_ 84 ReSideRdrLeDetn22RdrDetnChks 0;
BA_ "GenSigFuncType" SG_ 84 ReSideRdrLeDetn22RdrDetnCntr 16;
BA_ "GenSigSendType" SG_ 84 ReSideRdrLeDetn22RdrDetnCntr 0;
BA_ "GenSigSendType" SG_ 84 ReSideRdrLeDetn22RdrDetnConf 0;
BA_ "GenSigSendType" SG_ 84 ReSideRdrLeDetn22RdrDetnElevn 0;
BA_ "GenSigStartValue" SG_ 84 ReSideRdrLeDetn22RdrDetnElevn 15;
BA_ "GenSigSendType" SG_ 84 ReSideRdrLeDetn22RdrDetnPwr 0;
BA_ "GenSigSendType" SG_ 84 ReSideRdrLeDetn22RdrDetnRng 0;
BA_ "GenSigStartValue" SG_ 84 ReSideRdrLeDetn22RdrDetnRng 10050;
BA_ "GenSigSendType" SG_ 84 ReSideRdrLeDetn22RdrDetnRngV 0;
BA_ "GenSigStartValue" SG_ 84 ReSideRdrLeDetn22RdrDetnRngV 4000;
BA_ "GenSigSendType" SG_ 84 ReSideRdrLeDetn22RdrDetnSameRV 0;
BA_ "GenSigSendType" SG_ 84 ReSideRdrLeDetn22RdrDetnSts 0;
BA_ "GenSigStartValue" SG_ 84 ReSideRdrLeDetn22RdrDetnSts 3;
BA_ "GenSigSendType" SG_ 84 ReSideRdrLeDetn23RdrDetnAmbigState 0;
BA_ "GenSigSendType" SG_ 84 ReSideRdrLeDetn23RdrDetnAssoTrkID 0;
BA_ "GenSigSendType" SG_ 84 ReSideRdrLeDetn23RdrDetnAzi 0;
BA_ "GenSigStartValue" SG_ 84 ReSideRdrLeDetn23RdrDetnAzi 900;
BA_ "GenSigDataID" SG_ 84 ReSideRdrLeDetn23RdrDetnChks "0x9A8";
BA_ "GenSigFuncType" SG_ 84 ReSideRdrLeDetn23RdrDetnChks 15;
BA_ "GenSigSendType" SG_ 84 ReSideRdrLeDetn23RdrDetnChks 0;
BA_ "GenSigFuncType" SG_ 84 ReSideRdrLeDetn23RdrDetnCntr 16;
BA_ "GenSigSendType" SG_ 84 ReSideRdrLeDetn23RdrDetnCntr 0;
BA_ "GenSigSendType" SG_ 84 ReSideRdrLeDetn23RdrDetnConf 0;
BA_ "GenSigSendType" SG_ 84 ReSideRdrLeDetn23RdrDetnElevn 0;
BA_ "GenSigStartValue" SG_ 84 ReSideRdrLeDetn23RdrDetnElevn 15;
BA_ "GenSigSendType" SG_ 84 ReSideRdrLeDetn23RdrDetnPwr 0;
BA_ "GenSigSendType" SG_ 84 ReSideRdrLeDetn23RdrDetnRng 0;
BA_ "GenSigStartValue" SG_ 84 ReSideRdrLeDetn23RdrDetnRng 10050;
BA_ "GenSigSendType" SG_ 84 ReSideRdrLeDetn23RdrDetnRngV 0;
BA_ "GenSigStartValue" SG_ 84 ReSideRdrLeDetn23RdrDetnRngV 4000;
BA_ "GenSigSendType" SG_ 84 ReSideRdrLeDetn23RdrDetnSameRV 0;
BA_ "GenSigSendType" SG_ 84 ReSideRdrLeDetn23RdrDetnSts 0;
BA_ "GenSigStartValue" SG_ 84 ReSideRdrLeDetn23RdrDetnSts 3;
BA_ "GenSigSendType" SG_ 84 ReSideRdrLeDetn24RdrDetnAmbigState 0;
BA_ "GenSigSendType" SG_ 84 ReSideRdrLeDetn24RdrDetnAssoTrkID 0;
BA_ "GenSigSendType" SG_ 84 ReSideRdrLeDetn24RdrDetnAzi 0;
BA_ "GenSigStartValue" SG_ 84 ReSideRdrLeDetn24RdrDetnAzi 900;
BA_ "GenSigDataID" SG_ 84 ReSideRdrLeDetn24RdrDetnChks "0x9A9";
BA_ "GenSigFuncType" SG_ 84 ReSideRdrLeDetn24RdrDetnChks 15;
BA_ "GenSigSendType" SG_ 84 ReSideRdrLeDetn24RdrDetnChks 0;
BA_ "GenSigFuncType" SG_ 84 ReSideRdrLeDetn24RdrDetnCntr 16;
BA_ "GenSigSendType" SG_ 84 ReSideRdrLeDetn24RdrDetnCntr 0;
BA_ "GenSigSendType" SG_ 84 ReSideRdrLeDetn24RdrDetnConf 0;
BA_ "GenSigSendType" SG_ 84 ReSideRdrLeDetn24RdrDetnElevn 0;
BA_ "GenSigStartValue" SG_ 84 ReSideRdrLeDetn24RdrDetnElevn 15;
BA_ "GenSigSendType" SG_ 84 ReSideRdrLeDetn24RdrDetnPwr 0;
BA_ "GenSigSendType" SG_ 84 ReSideRdrLeDetn24RdrDetnRng 0;
BA_ "GenSigStartValue" SG_ 84 ReSideRdrLeDetn24RdrDetnRng 10050;
BA_ "GenSigSendType" SG_ 84 ReSideRdrLeDetn24RdrDetnRngV 0;
BA_ "GenSigStartValue" SG_ 84 ReSideRdrLeDetn24RdrDetnRngV 4000;
BA_ "GenSigSendType" SG_ 84 ReSideRdrLeDetn24RdrDetnSameRV 0;
BA_ "GenSigSendType" SG_ 84 ReSideRdrLeDetn24RdrDetnSts 0;
BA_ "GenSigStartValue" SG_ 84 ReSideRdrLeDetn24RdrDetnSts 3;
BA_ "GenSigSendType" SG_ 85 ReSideRdrLeDetn25RdrDetnAmbigState 0;
BA_ "GenSigSendType" SG_ 85 ReSideRdrLeDetn25RdrDetnAssoTrkID 0;
BA_ "GenSigSendType" SG_ 85 ReSideRdrLeDetn25RdrDetnAzi 0;
BA_ "GenSigStartValue" SG_ 85 ReSideRdrLeDetn25RdrDetnAzi 900;
BA_ "GenSigDataID" SG_ 85 ReSideRdrLeDetn25RdrDetnChks "0x9AA";
BA_ "GenSigFuncType" SG_ 85 ReSideRdrLeDetn25RdrDetnChks 15;
BA_ "GenSigSendType" SG_ 85 ReSideRdrLeDetn25RdrDetnChks 0;
BA_ "GenSigFuncType" SG_ 85 ReSideRdrLeDetn25RdrDetnCntr 16;
BA_ "GenSigSendType" SG_ 85 ReSideRdrLeDetn25RdrDetnCntr 0;
BA_ "GenSigSendType" SG_ 85 ReSideRdrLeDetn25RdrDetnConf 0;
BA_ "GenSigSendType" SG_ 85 ReSideRdrLeDetn25RdrDetnElevn 0;
BA_ "GenSigStartValue" SG_ 85 ReSideRdrLeDetn25RdrDetnElevn 15;
BA_ "GenSigSendType" SG_ 85 ReSideRdrLeDetn25RdrDetnPwr 0;
BA_ "GenSigSendType" SG_ 85 ReSideRdrLeDetn25RdrDetnRng 0;
BA_ "GenSigStartValue" SG_ 85 ReSideRdrLeDetn25RdrDetnRng 10050;
BA_ "GenSigSendType" SG_ 85 ReSideRdrLeDetn25RdrDetnRngV 0;
BA_ "GenSigStartValue" SG_ 85 ReSideRdrLeDetn25RdrDetnRngV 4000;
BA_ "GenSigSendType" SG_ 85 ReSideRdrLeDetn25RdrDetnSameRV 0;
BA_ "GenSigSendType" SG_ 85 ReSideRdrLeDetn25RdrDetnSts 0;
BA_ "GenSigStartValue" SG_ 85 ReSideRdrLeDetn25RdrDetnSts 3;
BA_ "GenSigSendType" SG_ 85 ReSideRdrLeDetn26RdrDetnAmbigState 0;
BA_ "GenSigSendType" SG_ 85 ReSideRdrLeDetn26RdrDetnAssoTrkID 0;
BA_ "GenSigSendType" SG_ 85 ReSideRdrLeDetn26RdrDetnAzi 0;
BA_ "GenSigStartValue" SG_ 85 ReSideRdrLeDetn26RdrDetnAzi 900;
BA_ "GenSigDataID" SG_ 85 ReSideRdrLeDetn26RdrDetnChks "0x9AB";
BA_ "GenSigFuncType" SG_ 85 ReSideRdrLeDetn26RdrDetnChks 15;
BA_ "GenSigSendType" SG_ 85 ReSideRdrLeDetn26RdrDetnChks 0;
BA_ "GenSigFuncType" SG_ 85 ReSideRdrLeDetn26RdrDetnCntr 16;
BA_ "GenSigSendType" SG_ 85 ReSideRdrLeDetn26RdrDetnCntr 0;
BA_ "GenSigSendType" SG_ 85 ReSideRdrLeDetn26RdrDetnConf 0;
BA_ "GenSigSendType" SG_ 85 ReSideRdrLeDetn26RdrDetnElevn 0;
BA_ "GenSigStartValue" SG_ 85 ReSideRdrLeDetn26RdrDetnElevn 15;
BA_ "GenSigSendType" SG_ 85 ReSideRdrLeDetn26RdrDetnPwr 0;
BA_ "GenSigSendType" SG_ 85 ReSideRdrLeDetn26RdrDetnRng 0;
BA_ "GenSigStartValue" SG_ 85 ReSideRdrLeDetn26RdrDetnRng 10050;
BA_ "GenSigSendType" SG_ 85 ReSideRdrLeDetn26RdrDetnRngV 0;
BA_ "GenSigStartValue" SG_ 85 ReSideRdrLeDetn26RdrDetnRngV 4000;
BA_ "GenSigSendType" SG_ 85 ReSideRdrLeDetn26RdrDetnSameRV 0;
BA_ "GenSigSendType" SG_ 85 ReSideRdrLeDetn26RdrDetnSts 0;
BA_ "GenSigStartValue" SG_ 85 ReSideRdrLeDetn26RdrDetnSts 3;
BA_ "GenSigSendType" SG_ 85 ReSideRdrLeDetn27RdrDetnAmbigState 0;
BA_ "GenSigSendType" SG_ 85 ReSideRdrLeDetn27RdrDetnAssoTrkID 0;
BA_ "GenSigSendType" SG_ 85 ReSideRdrLeDetn27RdrDetnAzi 0;
BA_ "GenSigStartValue" SG_ 85 ReSideRdrLeDetn27RdrDetnAzi 900;
BA_ "GenSigDataID" SG_ 85 ReSideRdrLeDetn27RdrDetnChks "0x9AC";
BA_ "GenSigFuncType" SG_ 85 ReSideRdrLeDetn27RdrDetnChks 15;
BA_ "GenSigSendType" SG_ 85 ReSideRdrLeDetn27RdrDetnChks 0;
BA_ "GenSigFuncType" SG_ 85 ReSideRdrLeDetn27RdrDetnCntr 16;
BA_ "GenSigSendType" SG_ 85 ReSideRdrLeDetn27RdrDetnCntr 0;
BA_ "GenSigSendType" SG_ 85 ReSideRdrLeDetn27RdrDetnConf 0;
BA_ "GenSigSendType" SG_ 85 ReSideRdrLeDetn27RdrDetnElevn 0;
BA_ "GenSigStartValue" SG_ 85 ReSideRdrLeDetn27RdrDetnElevn 15;
BA_ "GenSigSendType" SG_ 85 ReSideRdrLeDetn27RdrDetnPwr 0;
BA_ "GenSigSendType" SG_ 85 ReSideRdrLeDetn27RdrDetnRng 0;
BA_ "GenSigStartValue" SG_ 85 ReSideRdrLeDetn27RdrDetnRng 10050;
BA_ "GenSigSendType" SG_ 85 ReSideRdrLeDetn27RdrDetnRngV 0;
BA_ "GenSigStartValue" SG_ 85 ReSideRdrLeDetn27RdrDetnRngV 4000;
BA_ "GenSigSendType" SG_ 85 ReSideRdrLeDetn27RdrDetnSameRV 0;
BA_ "GenSigSendType" SG_ 85 ReSideRdrLeDetn27RdrDetnSts 0;
BA_ "GenSigStartValue" SG_ 85 ReSideRdrLeDetn27RdrDetnSts 3;
BA_ "GenSigSendType" SG_ 85 ReSideRdrLeDetn28RdrDetnAmbigState 0;
BA_ "GenSigSendType" SG_ 85 ReSideRdrLeDetn28RdrDetnAssoTrkID 0;
BA_ "GenSigSendType" SG_ 85 ReSideRdrLeDetn28RdrDetnAzi 0;
BA_ "GenSigStartValue" SG_ 85 ReSideRdrLeDetn28RdrDetnAzi 900;
BA_ "GenSigDataID" SG_ 85 ReSideRdrLeDetn28RdrDetnChks "0x9AD";
BA_ "GenSigFuncType" SG_ 85 ReSideRdrLeDetn28RdrDetnChks 15;
BA_ "GenSigSendType" SG_ 85 ReSideRdrLeDetn28RdrDetnChks 0;
BA_ "GenSigFuncType" SG_ 85 ReSideRdrLeDetn28RdrDetnCntr 16;
BA_ "GenSigSendType" SG_ 85 ReSideRdrLeDetn28RdrDetnCntr 0;
BA_ "GenSigSendType" SG_ 85 ReSideRdrLeDetn28RdrDetnConf 0;
BA_ "GenSigSendType" SG_ 85 ReSideRdrLeDetn28RdrDetnElevn 0;
BA_ "GenSigStartValue" SG_ 85 ReSideRdrLeDetn28RdrDetnElevn 15;
BA_ "GenSigSendType" SG_ 85 ReSideRdrLeDetn28RdrDetnPwr 0;
BA_ "GenSigSendType" SG_ 85 ReSideRdrLeDetn28RdrDetnRng 0;
BA_ "GenSigStartValue" SG_ 85 ReSideRdrLeDetn28RdrDetnRng 10050;
BA_ "GenSigSendType" SG_ 85 ReSideRdrLeDetn28RdrDetnRngV 0;
BA_ "GenSigStartValue" SG_ 85 ReSideRdrLeDetn28RdrDetnRngV 4000;
BA_ "GenSigSendType" SG_ 85 ReSideRdrLeDetn28RdrDetnSameRV 0;
BA_ "GenSigSendType" SG_ 85 ReSideRdrLeDetn28RdrDetnSts 0;
BA_ "GenSigStartValue" SG_ 85 ReSideRdrLeDetn28RdrDetnSts 3;
BA_ "GenSigSendType" SG_ 85 ReSideRdrLeDetn29RdrDetnAmbigState 0;
BA_ "GenSigSendType" SG_ 85 ReSideRdrLeDetn29RdrDetnAssoTrkID 0;
BA_ "GenSigSendType" SG_ 85 ReSideRdrLeDetn29RdrDetnAzi 0;
BA_ "GenSigStartValue" SG_ 85 ReSideRdrLeDetn29RdrDetnAzi 900;
BA_ "GenSigDataID" SG_ 85 ReSideRdrLeDetn29RdrDetnChks "0x9AE";
BA_ "GenSigFuncType" SG_ 85 ReSideRdrLeDetn29RdrDetnChks 15;
BA_ "GenSigSendType" SG_ 85 ReSideRdrLeDetn29RdrDetnChks 0;
BA_ "GenSigFuncType" SG_ 85 ReSideRdrLeDetn29RdrDetnCntr 16;
BA_ "GenSigSendType" SG_ 85 ReSideRdrLeDetn29RdrDetnCntr 0;
BA_ "GenSigSendType" SG_ 85 ReSideRdrLeDetn29RdrDetnConf 0;
BA_ "GenSigSendType" SG_ 85 ReSideRdrLeDetn29RdrDetnElevn 0;
BA_ "GenSigStartValue" SG_ 85 ReSideRdrLeDetn29RdrDetnElevn 15;
BA_ "GenSigSendType" SG_ 85 ReSideRdrLeDetn29RdrDetnPwr 0;
BA_ "GenSigSendType" SG_ 85 ReSideRdrLeDetn29RdrDetnRng 0;
BA_ "GenSigStartValue" SG_ 85 ReSideRdrLeDetn29RdrDetnRng 10050;
BA_ "GenSigSendType" SG_ 85 ReSideRdrLeDetn29RdrDetnRngV 0;
BA_ "GenSigStartValue" SG_ 85 ReSideRdrLeDetn29RdrDetnRngV 4000;
BA_ "GenSigSendType" SG_ 85 ReSideRdrLeDetn29RdrDetnSameRV 0;
BA_ "GenSigSendType" SG_ 85 ReSideRdrLeDetn29RdrDetnSts 0;
BA_ "GenSigStartValue" SG_ 85 ReSideRdrLeDetn29RdrDetnSts 3;
BA_ "GenSigSendType" SG_ 81 ReSideRdrLeDetn2RdrDetnAmbigState 0;
BA_ "GenSigSendType" SG_ 81 ReSideRdrLeDetn2RdrDetnAssoTrkID 0;
BA_ "GenSigSendType" SG_ 81 ReSideRdrLeDetn2RdrDetnAzi 0;
BA_ "GenSigStartValue" SG_ 81 ReSideRdrLeDetn2RdrDetnAzi 900;
BA_ "GenSigDataID" SG_ 81 ReSideRdrLeDetn2RdrDetnChks "0x993";
BA_ "GenSigFuncType" SG_ 81 ReSideRdrLeDetn2RdrDetnChks 15;
BA_ "GenSigSendType" SG_ 81 ReSideRdrLeDetn2RdrDetnChks 0;
BA_ "GenSigFuncType" SG_ 81 ReSideRdrLeDetn2RdrDetnCntr 16;
BA_ "GenSigSendType" SG_ 81 ReSideRdrLeDetn2RdrDetnCntr 0;
BA_ "GenSigSendType" SG_ 81 ReSideRdrLeDetn2RdrDetnConf 0;
BA_ "GenSigSendType" SG_ 81 ReSideRdrLeDetn2RdrDetnElevn 0;
BA_ "GenSigStartValue" SG_ 81 ReSideRdrLeDetn2RdrDetnElevn 15;
BA_ "GenSigSendType" SG_ 81 ReSideRdrLeDetn2RdrDetnPwr 0;
BA_ "GenSigSendType" SG_ 81 ReSideRdrLeDetn2RdrDetnRng 0;
BA_ "GenSigStartValue" SG_ 81 ReSideRdrLeDetn2RdrDetnRng 10050;
BA_ "GenSigSendType" SG_ 81 ReSideRdrLeDetn2RdrDetnRngV 0;
BA_ "GenSigStartValue" SG_ 81 ReSideRdrLeDetn2RdrDetnRngV 4000;
BA_ "GenSigSendType" SG_ 81 ReSideRdrLeDetn2RdrDetnSameRV 0;
BA_ "GenSigSendType" SG_ 81 ReSideRdrLeDetn2RdrDetnSts 0;
BA_ "GenSigStartValue" SG_ 81 ReSideRdrLeDetn2RdrDetnSts 3;
BA_ "GenSigSendType" SG_ 85 ReSideRdrLeDetn30RdrDetnAmbigState 0;
BA_ "GenSigSendType" SG_ 85 ReSideRdrLeDetn30RdrDetnAssoTrkID 0;
BA_ "GenSigSendType" SG_ 85 ReSideRdrLeDetn30RdrDetnAzi 0;
BA_ "GenSigStartValue" SG_ 85 ReSideRdrLeDetn30RdrDetnAzi 900;
BA_ "GenSigDataID" SG_ 85 ReSideRdrLeDetn30RdrDetnChks "0x9AF";
BA_ "GenSigFuncType" SG_ 85 ReSideRdrLeDetn30RdrDetnChks 15;
BA_ "GenSigSendType" SG_ 85 ReSideRdrLeDetn30RdrDetnChks 0;
BA_ "GenSigFuncType" SG_ 85 ReSideRdrLeDetn30RdrDetnCntr 16;
BA_ "GenSigSendType" SG_ 85 ReSideRdrLeDetn30RdrDetnCntr 0;
BA_ "GenSigSendType" SG_ 85 ReSideRdrLeDetn30RdrDetnConf 0;
BA_ "GenSigSendType" SG_ 85 ReSideRdrLeDetn30RdrDetnElevn 0;
BA_ "GenSigStartValue" SG_ 85 ReSideRdrLeDetn30RdrDetnElevn 15;
BA_ "GenSigSendType" SG_ 85 ReSideRdrLeDetn30RdrDetnPwr 0;
BA_ "GenSigSendType" SG_ 85 ReSideRdrLeDetn30RdrDetnRng 0;
BA_ "GenSigStartValue" SG_ 85 ReSideRdrLeDetn30RdrDetnRng 10050;
BA_ "GenSigSendType" SG_ 85 ReSideRdrLeDetn30RdrDetnRngV 0;
BA_ "GenSigStartValue" SG_ 85 ReSideRdrLeDetn30RdrDetnRngV 4000;
BA_ "GenSigSendType" SG_ 85 ReSideRdrLeDetn30RdrDetnSameRV 0;
BA_ "GenSigSendType" SG_ 85 ReSideRdrLeDetn30RdrDetnSts 0;
BA_ "GenSigStartValue" SG_ 85 ReSideRdrLeDetn30RdrDetnSts 3;
BA_ "GenSigSendType" SG_ 86 ReSideRdrLeDetn31RdrDetnAmbigState 0;
BA_ "GenSigSendType" SG_ 86 ReSideRdrLeDetn31RdrDetnAssoTrkID 0;
BA_ "GenSigSendType" SG_ 86 ReSideRdrLeDetn31RdrDetnAzi 0;
BA_ "GenSigStartValue" SG_ 86 ReSideRdrLeDetn31RdrDetnAzi 900;
BA_ "GenSigDataID" SG_ 86 ReSideRdrLeDetn31RdrDetnChks "0x9B0";
BA_ "GenSigFuncType" SG_ 86 ReSideRdrLeDetn31RdrDetnChks 15;
BA_ "GenSigSendType" SG_ 86 ReSideRdrLeDetn31RdrDetnChks 0;
BA_ "GenSigFuncType" SG_ 86 ReSideRdrLeDetn31RdrDetnCntr 16;
BA_ "GenSigSendType" SG_ 86 ReSideRdrLeDetn31RdrDetnCntr 0;
BA_ "GenSigSendType" SG_ 86 ReSideRdrLeDetn31RdrDetnConf 0;
BA_ "GenSigSendType" SG_ 86 ReSideRdrLeDetn31RdrDetnElevn 0;
BA_ "GenSigStartValue" SG_ 86 ReSideRdrLeDetn31RdrDetnElevn 15;
BA_ "GenSigSendType" SG_ 86 ReSideRdrLeDetn31RdrDetnPwr 0;
BA_ "GenSigSendType" SG_ 86 ReSideRdrLeDetn31RdrDetnRng 0;
BA_ "GenSigStartValue" SG_ 86 ReSideRdrLeDetn31RdrDetnRng 10050;
BA_ "GenSigSendType" SG_ 86 ReSideRdrLeDetn31RdrDetnRngV 0;
BA_ "GenSigStartValue" SG_ 86 ReSideRdrLeDetn31RdrDetnRngV 4000;
BA_ "GenSigSendType" SG_ 86 ReSideRdrLeDetn31RdrDetnSameRV 0;
BA_ "GenSigSendType" SG_ 86 ReSideRdrLeDetn31RdrDetnSts 0;
BA_ "GenSigStartValue" SG_ 86 ReSideRdrLeDetn31RdrDetnSts 3;
BA_ "GenSigSendType" SG_ 86 ReSideRdrLeDetn32RdrDetnAmbigState 0;
BA_ "GenSigSendType" SG_ 86 ReSideRdrLeDetn32RdrDetnAssoTrkID 0;
BA_ "GenSigSendType" SG_ 86 ReSideRdrLeDetn32RdrDetnAzi 0;
BA_ "GenSigStartValue" SG_ 86 ReSideRdrLeDetn32RdrDetnAzi 900;
BA_ "GenSigDataID" SG_ 86 ReSideRdrLeDetn32RdrDetnChks "0x9B1";
BA_ "GenSigFuncType" SG_ 86 ReSideRdrLeDetn32RdrDetnChks 15;
BA_ "GenSigSendType" SG_ 86 ReSideRdrLeDetn32RdrDetnChks 0;
BA_ "GenSigFuncType" SG_ 86 ReSideRdrLeDetn32RdrDetnCntr 16;
BA_ "GenSigSendType" SG_ 86 ReSideRdrLeDetn32RdrDetnCntr 0;
BA_ "GenSigSendType" SG_ 86 ReSideRdrLeDetn32RdrDetnConf 0;
BA_ "GenSigSendType" SG_ 86 ReSideRdrLeDetn32RdrDetnElevn 0;
BA_ "GenSigStartValue" SG_ 86 ReSideRdrLeDetn32RdrDetnElevn 15;
BA_ "GenSigSendType" SG_ 86 ReSideRdrLeDetn32RdrDetnPwr 0;
BA_ "GenSigSendType" SG_ 86 ReSideRdrLeDetn32RdrDetnRng 0;
BA_ "GenSigStartValue" SG_ 86 ReSideRdrLeDetn32RdrDetnRng 10050;
BA_ "GenSigSendType" SG_ 86 ReSideRdrLeDetn32RdrDetnRngV 0;
BA_ "GenSigStartValue" SG_ 86 ReSideRdrLeDetn32RdrDetnRngV 4000;
BA_ "GenSigSendType" SG_ 86 ReSideRdrLeDetn32RdrDetnSameRV 0;
BA_ "GenSigSendType" SG_ 86 ReSideRdrLeDetn32RdrDetnSts 0;
BA_ "GenSigStartValue" SG_ 86 ReSideRdrLeDetn32RdrDetnSts 3;
BA_ "GenSigSendType" SG_ 86 ReSideRdrLeDetn33RdrDetnAmbigState 0;
BA_ "GenSigSendType" SG_ 86 ReSideRdrLeDetn33RdrDetnAssoTrkID 0;
BA_ "GenSigSendType" SG_ 86 ReSideRdrLeDetn33RdrDetnAzi 0;
BA_ "GenSigStartValue" SG_ 86 ReSideRdrLeDetn33RdrDetnAzi 900;
BA_ "GenSigDataID" SG_ 86 ReSideRdrLeDetn33RdrDetnChks "0x9B2";
BA_ "GenSigFuncType" SG_ 86 ReSideRdrLeDetn33RdrDetnChks 15;
BA_ "GenSigSendType" SG_ 86 ReSideRdrLeDetn33RdrDetnChks 0;
BA_ "GenSigFuncType" SG_ 86 ReSideRdrLeDetn33RdrDetnCntr 16;
BA_ "GenSigSendType" SG_ 86 ReSideRdrLeDetn33RdrDetnCntr 0;
BA_ "GenSigSendType" SG_ 86 ReSideRdrLeDetn33RdrDetnConf 0;
BA_ "GenSigSendType" SG_ 86 ReSideRdrLeDetn33RdrDetnElevn 0;
BA_ "GenSigStartValue" SG_ 86 ReSideRdrLeDetn33RdrDetnElevn 15;
BA_ "GenSigSendType" SG_ 86 ReSideRdrLeDetn33RdrDetnPwr 0;
BA_ "GenSigSendType" SG_ 86 ReSideRdrLeDetn33RdrDetnRng 0;
BA_ "GenSigStartValue" SG_ 86 ReSideRdrLeDetn33RdrDetnRng 10050;
BA_ "GenSigSendType" SG_ 86 ReSideRdrLeDetn33RdrDetnRngV 0;
BA_ "GenSigStartValue" SG_ 86 ReSideRdrLeDetn33RdrDetnRngV 4000;
BA_ "GenSigSendType" SG_ 86 ReSideRdrLeDetn33RdrDetnSameRV 0;
BA_ "GenSigSendType" SG_ 86 ReSideRdrLeDetn33RdrDetnSts 0;
BA_ "GenSigStartValue" SG_ 86 ReSideRdrLeDetn33RdrDetnSts 3;
BA_ "GenSigSendType" SG_ 86 ReSideRdrLeDetn34RdrDetnAmbigState 0;
BA_ "GenSigSendType" SG_ 86 ReSideRdrLeDetn34RdrDetnAssoTrkID 0;
BA_ "GenSigSendType" SG_ 86 ReSideRdrLeDetn34RdrDetnAzi 0;
BA_ "GenSigStartValue" SG_ 86 ReSideRdrLeDetn34RdrDetnAzi 900;
BA_ "GenSigDataID" SG_ 86 ReSideRdrLeDetn34RdrDetnChks "0x9B3";
BA_ "GenSigFuncType" SG_ 86 ReSideRdrLeDetn34RdrDetnChks 15;
BA_ "GenSigSendType" SG_ 86 ReSideRdrLeDetn34RdrDetnChks 0;
BA_ "GenSigFuncType" SG_ 86 ReSideRdrLeDetn34RdrDetnCntr 16;
BA_ "GenSigSendType" SG_ 86 ReSideRdrLeDetn34RdrDetnCntr 0;
BA_ "GenSigSendType" SG_ 86 ReSideRdrLeDetn34RdrDetnConf 0;
BA_ "GenSigSendType" SG_ 86 ReSideRdrLeDetn34RdrDetnElevn 0;
BA_ "GenSigStartValue" SG_ 86 ReSideRdrLeDetn34RdrDetnElevn 15;
BA_ "GenSigSendType" SG_ 86 ReSideRdrLeDetn34RdrDetnPwr 0;
BA_ "GenSigSendType" SG_ 86 ReSideRdrLeDetn34RdrDetnRng 0;
BA_ "GenSigStartValue" SG_ 86 ReSideRdrLeDetn34RdrDetnRng 10050;
BA_ "GenSigSendType" SG_ 86 ReSideRdrLeDetn34RdrDetnRngV 0;
BA_ "GenSigStartValue" SG_ 86 ReSideRdrLeDetn34RdrDetnRngV 4000;
BA_ "GenSigSendType" SG_ 86 ReSideRdrLeDetn34RdrDetnSameRV 0;
BA_ "GenSigSendType" SG_ 86 ReSideRdrLeDetn34RdrDetnSts 0;
BA_ "GenSigStartValue" SG_ 86 ReSideRdrLeDetn34RdrDetnSts 3;
BA_ "GenSigSendType" SG_ 86 ReSideRdrLeDetn35RdrDetnAmbigState 0;
BA_ "GenSigSendType" SG_ 86 ReSideRdrLeDetn35RdrDetnAssoTrkID 0;
BA_ "GenSigSendType" SG_ 86 ReSideRdrLeDetn35RdrDetnAzi 0;
BA_ "GenSigStartValue" SG_ 86 ReSideRdrLeDetn35RdrDetnAzi 900;
BA_ "GenSigDataID" SG_ 86 ReSideRdrLeDetn35RdrDetnChks "0x9B4";
BA_ "GenSigFuncType" SG_ 86 ReSideRdrLeDetn35RdrDetnChks 15;
BA_ "GenSigSendType" SG_ 86 ReSideRdrLeDetn35RdrDetnChks 0;
BA_ "GenSigFuncType" SG_ 86 ReSideRdrLeDetn35RdrDetnCntr 16;
BA_ "GenSigSendType" SG_ 86 ReSideRdrLeDetn35RdrDetnCntr 0;
BA_ "GenSigSendType" SG_ 86 ReSideRdrLeDetn35RdrDetnConf 0;
BA_ "GenSigSendType" SG_ 86 ReSideRdrLeDetn35RdrDetnElevn 0;
BA_ "GenSigStartValue" SG_ 86 ReSideRdrLeDetn35RdrDetnElevn 15;
BA_ "GenSigSendType" SG_ 86 ReSideRdrLeDetn35RdrDetnPwr 0;
BA_ "GenSigSendType" SG_ 86 ReSideRdrLeDetn35RdrDetnRng 0;
BA_ "GenSigStartValue" SG_ 86 ReSideRdrLeDetn35RdrDetnRng 10050;
BA_ "GenSigSendType" SG_ 86 ReSideRdrLeDetn35RdrDetnRngV 0;
BA_ "GenSigStartValue" SG_ 86 ReSideRdrLeDetn35RdrDetnRngV 4000;
BA_ "GenSigSendType" SG_ 86 ReSideRdrLeDetn35RdrDetnSameRV 0;
BA_ "GenSigSendType" SG_ 86 ReSideRdrLeDetn35RdrDetnSts 0;
BA_ "GenSigStartValue" SG_ 86 ReSideRdrLeDetn35RdrDetnSts 3;
BA_ "GenSigSendType" SG_ 86 ReSideRdrLeDetn36RdrDetnAmbigState 0;
BA_ "GenSigSendType" SG_ 86 ReSideRdrLeDetn36RdrDetnAssoTrkID 0;
BA_ "GenSigSendType" SG_ 86 ReSideRdrLeDetn36RdrDetnAzi 0;
BA_ "GenSigStartValue" SG_ 86 ReSideRdrLeDetn36RdrDetnAzi 900;
BA_ "GenSigDataID" SG_ 86 ReSideRdrLeDetn36RdrDetnChks "0x9B5";
BA_ "GenSigFuncType" SG_ 86 ReSideRdrLeDetn36RdrDetnChks 15;
BA_ "GenSigSendType" SG_ 86 ReSideRdrLeDetn36RdrDetnChks 0;
BA_ "GenSigFuncType" SG_ 86 ReSideRdrLeDetn36RdrDetnCntr 16;
BA_ "GenSigSendType" SG_ 86 ReSideRdrLeDetn36RdrDetnCntr 0;
BA_ "GenSigSendType" SG_ 86 ReSideRdrLeDetn36RdrDetnConf 0;
BA_ "GenSigSendType" SG_ 86 ReSideRdrLeDetn36RdrDetnElevn 0;
BA_ "GenSigStartValue" SG_ 86 ReSideRdrLeDetn36RdrDetnElevn 15;
BA_ "GenSigSendType" SG_ 86 ReSideRdrLeDetn36RdrDetnPwr 0;
BA_ "GenSigSendType" SG_ 86 ReSideRdrLeDetn36RdrDetnRng 0;
BA_ "GenSigStartValue" SG_ 86 ReSideRdrLeDetn36RdrDetnRng 10050;
BA_ "GenSigSendType" SG_ 86 ReSideRdrLeDetn36RdrDetnRngV 0;
BA_ "GenSigStartValue" SG_ 86 ReSideRdrLeDetn36RdrDetnRngV 4000;
BA_ "GenSigSendType" SG_ 86 ReSideRdrLeDetn36RdrDetnSameRV 0;
BA_ "GenSigSendType" SG_ 86 ReSideRdrLeDetn36RdrDetnSts 0;
BA_ "GenSigStartValue" SG_ 86 ReSideRdrLeDetn36RdrDetnSts 3;
BA_ "GenSigSendType" SG_ 81 ReSideRdrLeDetn3RdrDetnAmbigState 0;
BA_ "GenSigSendType" SG_ 81 ReSideRdrLeDetn3RdrDetnAssoTrkID 0;
BA_ "GenSigSendType" SG_ 81 ReSideRdrLeDetn3RdrDetnAzi 0;
BA_ "GenSigStartValue" SG_ 81 ReSideRdrLeDetn3RdrDetnAzi 900;
BA_ "GenSigDataID" SG_ 81 ReSideRdrLeDetn3RdrDetnChks "0x994";
BA_ "GenSigFuncType" SG_ 81 ReSideRdrLeDetn3RdrDetnChks 15;
BA_ "GenSigSendType" SG_ 81 ReSideRdrLeDetn3RdrDetnChks 0;
BA_ "GenSigFuncType" SG_ 81 ReSideRdrLeDetn3RdrDetnCntr 16;
BA_ "GenSigSendType" SG_ 81 ReSideRdrLeDetn3RdrDetnCntr 0;
BA_ "GenSigSendType" SG_ 81 ReSideRdrLeDetn3RdrDetnConf 0;
BA_ "GenSigSendType" SG_ 81 ReSideRdrLeDetn3RdrDetnElevn 0;
BA_ "GenSigStartValue" SG_ 81 ReSideRdrLeDetn3RdrDetnElevn 15;
BA_ "GenSigSendType" SG_ 81 ReSideRdrLeDetn3RdrDetnPwr 0;
BA_ "GenSigSendType" SG_ 81 ReSideRdrLeDetn3RdrDetnRng 0;
BA_ "GenSigStartValue" SG_ 81 ReSideRdrLeDetn3RdrDetnRng 10050;
BA_ "GenSigSendType" SG_ 81 ReSideRdrLeDetn3RdrDetnRngV 0;
BA_ "GenSigStartValue" SG_ 81 ReSideRdrLeDetn3RdrDetnRngV 4000;
BA_ "GenSigSendType" SG_ 81 ReSideRdrLeDetn3RdrDetnSameRV 0;
BA_ "GenSigSendType" SG_ 81 ReSideRdrLeDetn3RdrDetnSts 0;
BA_ "GenSigStartValue" SG_ 81 ReSideRdrLeDetn3RdrDetnSts 3;
BA_ "GenSigSendType" SG_ 81 ReSideRdrLeDetn4RdrDetnAmbigState 0;
BA_ "GenSigSendType" SG_ 81 ReSideRdrLeDetn4RdrDetnAssoTrkID 0;
BA_ "GenSigSendType" SG_ 81 ReSideRdrLeDetn4RdrDetnAzi 0;
BA_ "GenSigStartValue" SG_ 81 ReSideRdrLeDetn4RdrDetnAzi 900;
BA_ "GenSigDataID" SG_ 81 ReSideRdrLeDetn4RdrDetnChks "0x995";
BA_ "GenSigFuncType" SG_ 81 ReSideRdrLeDetn4RdrDetnChks 15;
BA_ "GenSigSendType" SG_ 81 ReSideRdrLeDetn4RdrDetnChks 0;
BA_ "GenSigFuncType" SG_ 81 ReSideRdrLeDetn4RdrDetnCntr 16;
BA_ "GenSigSendType" SG_ 81 ReSideRdrLeDetn4RdrDetnCntr 0;
BA_ "GenSigSendType" SG_ 81 ReSideRdrLeDetn4RdrDetnConf 0;
BA_ "GenSigSendType" SG_ 81 ReSideRdrLeDetn4RdrDetnElevn 0;
BA_ "GenSigStartValue" SG_ 81 ReSideRdrLeDetn4RdrDetnElevn 15;
BA_ "GenSigSendType" SG_ 81 ReSideRdrLeDetn4RdrDetnPwr 0;
BA_ "GenSigSendType" SG_ 81 ReSideRdrLeDetn4RdrDetnRng 0;
BA_ "GenSigStartValue" SG_ 81 ReSideRdrLeDetn4RdrDetnRng 10050;
BA_ "GenSigSendType" SG_ 81 ReSideRdrLeDetn4RdrDetnRngV 0;
BA_ "GenSigStartValue" SG_ 81 ReSideRdrLeDetn4RdrDetnRngV 4000;
BA_ "GenSigSendType" SG_ 81 ReSideRdrLeDetn4RdrDetnSameRV 0;
BA_ "GenSigSendType" SG_ 81 ReSideRdrLeDetn4RdrDetnSts 0;
BA_ "GenSigStartValue" SG_ 81 ReSideRdrLeDetn4RdrDetnSts 3;
BA_ "GenSigSendType" SG_ 81 ReSideRdrLeDetn5RdrDetnAmbigState 0;
BA_ "GenSigSendType" SG_ 81 ReSideRdrLeDetn5RdrDetnAssoTrkID 0;
BA_ "GenSigSendType" SG_ 81 ReSideRdrLeDetn5RdrDetnAzi 0;
BA_ "GenSigStartValue" SG_ 81 ReSideRdrLeDetn5RdrDetnAzi 900;
BA_ "GenSigDataID" SG_ 81 ReSideRdrLeDetn5RdrDetnChks "0x996";
BA_ "GenSigFuncType" SG_ 81 ReSideRdrLeDetn5RdrDetnChks 15;
BA_ "GenSigSendType" SG_ 81 ReSideRdrLeDetn5RdrDetnChks 0;
BA_ "GenSigFuncType" SG_ 81 ReSideRdrLeDetn5RdrDetnCntr 16;
BA_ "GenSigSendType" SG_ 81 ReSideRdrLeDetn5RdrDetnCntr 0;
BA_ "GenSigSendType" SG_ 81 ReSideRdrLeDetn5RdrDetnConf 0;
BA_ "GenSigSendType" SG_ 81 ReSideRdrLeDetn5RdrDetnElevn 0;
BA_ "GenSigStartValue" SG_ 81 ReSideRdrLeDetn5RdrDetnElevn 15;
BA_ "GenSigSendType" SG_ 81 ReSideRdrLeDetn5RdrDetnPwr 0;
BA_ "GenSigSendType" SG_ 81 ReSideRdrLeDetn5RdrDetnRng 0;
BA_ "GenSigStartValue" SG_ 81 ReSideRdrLeDetn5RdrDetnRng 10050;
BA_ "GenSigSendType" SG_ 81 ReSideRdrLeDetn5RdrDetnRngV 0;
BA_ "GenSigStartValue" SG_ 81 ReSideRdrLeDetn5RdrDetnRngV 4000;
BA_ "GenSigSendType" SG_ 81 ReSideRdrLeDetn5RdrDetnSameRV 0;
BA_ "GenSigSendType" SG_ 81 ReSideRdrLeDetn5RdrDetnSts 0;
BA_ "GenSigStartValue" SG_ 81 ReSideRdrLeDetn5RdrDetnSts 3;
BA_ "GenSigSendType" SG_ 81 ReSideRdrLeDetn6RdrDetnAmbigState 0;
BA_ "GenSigSendType" SG_ 81 ReSideRdrLeDetn6RdrDetnAssoTrkID 0;
BA_ "GenSigSendType" SG_ 81 ReSideRdrLeDetn6RdrDetnAzi 0;
BA_ "GenSigStartValue" SG_ 81 ReSideRdrLeDetn6RdrDetnAzi 900;
BA_ "GenSigDataID" SG_ 81 ReSideRdrLeDetn6RdrDetnChks "0x997";
BA_ "GenSigFuncType" SG_ 81 ReSideRdrLeDetn6RdrDetnChks 15;
BA_ "GenSigSendType" SG_ 81 ReSideRdrLeDetn6RdrDetnChks 0;
BA_ "GenSigFuncType" SG_ 81 ReSideRdrLeDetn6RdrDetnCntr 16;
BA_ "GenSigSendType" SG_ 81 ReSideRdrLeDetn6RdrDetnCntr 0;
BA_ "GenSigSendType" SG_ 81 ReSideRdrLeDetn6RdrDetnConf 0;
BA_ "GenSigSendType" SG_ 81 ReSideRdrLeDetn6RdrDetnElevn 0;
BA_ "GenSigStartValue" SG_ 81 ReSideRdrLeDetn6RdrDetnElevn 15;
BA_ "GenSigSendType" SG_ 81 ReSideRdrLeDetn6RdrDetnPwr 0;
BA_ "GenSigSendType" SG_ 81 ReSideRdrLeDetn6RdrDetnRng 0;
BA_ "GenSigStartValue" SG_ 81 ReSideRdrLeDetn6RdrDetnRng 10050;
BA_ "GenSigSendType" SG_ 81 ReSideRdrLeDetn6RdrDetnRngV 0;
BA_ "GenSigStartValue" SG_ 81 ReSideRdrLeDetn6RdrDetnRngV 4000;
BA_ "GenSigSendType" SG_ 81 ReSideRdrLeDetn6RdrDetnSameRV 0;
BA_ "GenSigSendType" SG_ 81 ReSideRdrLeDetn6RdrDetnSts 0;
BA_ "GenSigStartValue" SG_ 81 ReSideRdrLeDetn6RdrDetnSts 3;
BA_ "GenSigSendType" SG_ 82 ReSideRdrLeDetn7RdrDetnAmbigState 0;
BA_ "GenSigSendType" SG_ 82 ReSideRdrLeDetn7RdrDetnAssoTrkID 0;
BA_ "GenSigSendType" SG_ 82 ReSideRdrLeDetn7RdrDetnAzi 0;
BA_ "GenSigStartValue" SG_ 82 ReSideRdrLeDetn7RdrDetnAzi 900;
BA_ "GenSigDataID" SG_ 82 ReSideRdrLeDetn7RdrDetnChks "0x998";
BA_ "GenSigFuncType" SG_ 82 ReSideRdrLeDetn7RdrDetnChks 15;
BA_ "GenSigSendType" SG_ 82 ReSideRdrLeDetn7RdrDetnChks 0;
BA_ "GenSigFuncType" SG_ 82 ReSideRdrLeDetn7RdrDetnCntr 16;
BA_ "GenSigSendType" SG_ 82 ReSideRdrLeDetn7RdrDetnCntr 0;
BA_ "GenSigSendType" SG_ 82 ReSideRdrLeDetn7RdrDetnConf 0;
BA_ "GenSigSendType" SG_ 82 ReSideRdrLeDetn7RdrDetnElevn 0;
BA_ "GenSigStartValue" SG_ 82 ReSideRdrLeDetn7RdrDetnElevn 15;
BA_ "GenSigSendType" SG_ 82 ReSideRdrLeDetn7RdrDetnPwr 0;
BA_ "GenSigSendType" SG_ 82 ReSideRdrLeDetn7RdrDetnRng 0;
BA_ "GenSigStartValue" SG_ 82 ReSideRdrLeDetn7RdrDetnRng 10050;
BA_ "GenSigSendType" SG_ 82 ReSideRdrLeDetn7RdrDetnRngV 0;
BA_ "GenSigStartValue" SG_ 82 ReSideRdrLeDetn7RdrDetnRngV 4000;
BA_ "GenSigSendType" SG_ 82 ReSideRdrLeDetn7RdrDetnSameRV 0;
BA_ "GenSigSendType" SG_ 82 ReSideRdrLeDetn7RdrDetnSts 0;
BA_ "GenSigStartValue" SG_ 82 ReSideRdrLeDetn7RdrDetnSts 3;
BA_ "GenSigSendType" SG_ 82 ReSideRdrLeDetn8RdrDetnAmbigState 0;
BA_ "GenSigSendType" SG_ 82 ReSideRdrLeDetn8RdrDetnAssoTrkID 0;
BA_ "GenSigSendType" SG_ 82 ReSideRdrLeDetn8RdrDetnAzi 0;
BA_ "GenSigStartValue" SG_ 82 ReSideRdrLeDetn8RdrDetnAzi 900;
BA_ "GenSigDataID" SG_ 82 ReSideRdrLeDetn8RdrDetnChks "0x999";
BA_ "GenSigFuncType" SG_ 82 ReSideRdrLeDetn8RdrDetnChks 15;
BA_ "GenSigSendType" SG_ 82 ReSideRdrLeDetn8RdrDetnChks 0;
BA_ "GenSigFuncType" SG_ 82 ReSideRdrLeDetn8RdrDetnCntr 16;
BA_ "GenSigSendType" SG_ 82 ReSideRdrLeDetn8RdrDetnCntr 0;
BA_ "GenSigSendType" SG_ 82 ReSideRdrLeDetn8RdrDetnConf 0;
BA_ "GenSigSendType" SG_ 82 ReSideRdrLeDetn8RdrDetnElevn 0;
BA_ "GenSigStartValue" SG_ 82 ReSideRdrLeDetn8RdrDetnElevn 15;
BA_ "GenSigSendType" SG_ 82 ReSideRdrLeDetn8RdrDetnPwr 0;
BA_ "GenSigSendType" SG_ 82 ReSideRdrLeDetn8RdrDetnRng 0;
BA_ "GenSigStartValue" SG_ 82 ReSideRdrLeDetn8RdrDetnRng 10050;
BA_ "GenSigSendType" SG_ 82 ReSideRdrLeDetn8RdrDetnRngV 0;
BA_ "GenSigStartValue" SG_ 82 ReSideRdrLeDetn8RdrDetnRngV 4000;
BA_ "GenSigSendType" SG_ 82 ReSideRdrLeDetn8RdrDetnSameRV 0;
BA_ "GenSigSendType" SG_ 82 ReSideRdrLeDetn8RdrDetnSts 0;
BA_ "GenSigStartValue" SG_ 82 ReSideRdrLeDetn8RdrDetnSts 3;
BA_ "GenSigSendType" SG_ 82 ReSideRdrLeDetn9RdrDetnAmbigState 0;
BA_ "GenSigSendType" SG_ 82 ReSideRdrLeDetn9RdrDetnAssoTrkID 0;
BA_ "GenSigSendType" SG_ 82 ReSideRdrLeDetn9RdrDetnAzi 0;
BA_ "GenSigStartValue" SG_ 82 ReSideRdrLeDetn9RdrDetnAzi 900;
BA_ "GenSigDataID" SG_ 82 ReSideRdrLeDetn9RdrDetnChks "0x99A";
BA_ "GenSigFuncType" SG_ 82 ReSideRdrLeDetn9RdrDetnChks 15;
BA_ "GenSigSendType" SG_ 82 ReSideRdrLeDetn9RdrDetnChks 0;
BA_ "GenSigFuncType" SG_ 82 ReSideRdrLeDetn9RdrDetnCntr 16;
BA_ "GenSigSendType" SG_ 82 ReSideRdrLeDetn9RdrDetnCntr 0;
BA_ "GenSigSendType" SG_ 82 ReSideRdrLeDetn9RdrDetnConf 0;
BA_ "GenSigSendType" SG_ 82 ReSideRdrLeDetn9RdrDetnElevn 0;
BA_ "GenSigStartValue" SG_ 82 ReSideRdrLeDetn9RdrDetnElevn 15;
BA_ "GenSigSendType" SG_ 82 ReSideRdrLeDetn9RdrDetnPwr 0;
BA_ "GenSigSendType" SG_ 82 ReSideRdrLeDetn9RdrDetnRng 0;
BA_ "GenSigStartValue" SG_ 82 ReSideRdrLeDetn9RdrDetnRng 10050;
BA_ "GenSigSendType" SG_ 82 ReSideRdrLeDetn9RdrDetnRngV 0;
BA_ "GenSigStartValue" SG_ 82 ReSideRdrLeDetn9RdrDetnRngV 4000;
BA_ "GenSigSendType" SG_ 82 ReSideRdrLeDetn9RdrDetnSameRV 0;
BA_ "GenSigSendType" SG_ 82 ReSideRdrLeDetn9RdrDetnSts 0;
BA_ "GenSigStartValue" SG_ 82 ReSideRdrLeDetn9RdrDetnSts 3;
VAL_ 1074 ReSideRdrLe20Obj32RdrObjElevnSts 0 "RdrObjElevnSts_Unknown" 1 "RdrObjElevnSts_OverRidable" 2 "RdrObjElevnSts_Rlv" 3 "RdrObjElevnSts_UnderRidable";
VAL_ 1074 ReSideRdrLe20Obj32RdrObjIsInFreeSpace 0 "YesNo2_No" 1 "YesNo2_Yes";
VAL_ 1074 ReSideRdrLe20Obj32RdrObjMtnPat 0 "RdrObjMtnPat_Ukwn" 1 "RdrObjMtnPat_Staty" 2 "RdrObjMtnPat_StatyFromMovg" 3 "RdrObjMtnPat_Movg" 4 "RdrObjMtnPat_Receding" 5 "RdrObjMtnPat_Oncoming" 6 "RdrObjMtnPat_CrossingFromLe" 7 "RdrObjMtnPat_CrossingFromRi";
VAL_ 1074 ReSideRdrLe20Obj32RdrObjTrackSts 0 "RdrObjTrackSts_Invld" 1 "RdrObjTrackSts_Updated" 2 "RdrObjTrackSts_New" 3 "RdrObjTrackSts_Coasted";
VAL_ 1074 ReSideRdrLe20Obj32RdrObjTyp 0 "RdrObjTyp_Ukwn" 1 "RdrObjTyp_Car" 2 "RdrObjTyp_MotorCycle" 3 "RdrObjTyp_Truck" 4 "RdrObjTyp_Ped" 5 "RdrObjTyp_ObstdVert1" 6 "RdrObjTyp_ObstdVert2" 7 "RdrObjTyp_Anim" 8 "RdrObjTyp_ObjGen" 9 "RdrObjTyp_Bicycle" 10 "RdrObjTyp_VehofUkwnClass" 11 "RdrObjTyp_Reserved";
VAL_ 1074 ReSideRdrLe20Obj32RdrObjUsedTracker 0 "RdrObjUsedTracker_Stationary" 1 "RdrObjUsedTracker_MovingCVModel" 2 "RdrObjUsedTracker_MovingCTModel" 3 "RdrObjUsedTracker_Undefined";
VAL_ 1075 ReSideRdrLe20StsForDim 0 "RsdsMstSt_Cfg" 1 "RsdsMstSt_StrtUp" 2 "RsdsMstSt_Runng" 3 "RsdsMstSt_Blkd" 4 "RsdsMstSt_Faulty" 5 "RsdsMstSt_Shutdown" 6 "RsdsMstSt_Hot" 7 "RsdsMstSt_Cal";
VAL_ 1075 ReSideRdrLe20StsRdrStsBlkd0bin 0 "YesNo2_No" 1 "YesNo2_Yes";
VAL_ 1075 ReSideRdrLe20StsRdrStsEna 0 "YesNo2_No" 1 "YesNo2_Yes";
VAL_ 1075 ReSideRdrLe20StsRdrStsFaulty 0 "YesNo2_No" 1 "YesNo2_Yes";
VAL_ 1075 ReSideRdrLe20StsRdrStsMisAlign 0 "MisAlign_CalibrationNotStart" 1 "MisAlign_SuccessfullyCalibratedInFactoryOrAftersales" 2 "MisAlign_SuccessfullyAutoCalibrated" 3 "MisAlign_MisalignmentDegreeIsLargerThanThreshold_StaticCalibrationFail" 4 "MisAlign_CanNotBeCalibratedStaticallyCauseOtherReason" 5 "MisAlign_AutoCalibrateFail_CauseMisalignmentDegreeIsLargerThanThresholdOrOtherReason" 6 "MisAlign_MisalignmentDegreeIsLargerThanThreshold_DynamicCalibrationFailInFactoryOrAftersales" 7 "MisAlign_CanNotBeCalibratedDynamicallyCauseOtherReason";
VAL_ 1075 ReSideRdrLe20StsRdrStsMissCom 0 "YesNo2_No" 1 "YesNo2_Yes";
VAL_ 1075 ReSideRdrLe20StsRdrStsTiStampStsGlbTiBas 0 "YesNo2_No" 1 "YesNo2_Yes";
VAL_ 1075 ReSideRdrLe20StsRdrStsTiStampStsSyncToGateway 0 "YesNo2_No" 1 "YesNo2_Yes";
VAL_ 1075 ReSideRdrLe20StsRdrStsTiStampStsTiLeap 0 "YesNo2_No" 1 "YesNo2_Yes";
VAL_ 1075 ReSideRdrLe20StsRdrStsTiStampStsTiOut 0 "YesNo2_No" 1 "YesNo2_Yes";
VAL_ 1075 ReSideRdrLe20StsRdrSysSftyFlt 0 "SftyFlt_Undefined" 1 "SftyFlt_NoSafetyFault" 2 "SftyFlt_SafetyFault" 3 "SftyFlt_Reserved";
VAL_ 81 ReSideRdrLeDetn1RdrDetnAmbigState 0 "YesNo1_Yes" 1 "YesNo1_No";
VAL_ 81 ReSideRdrLeDetn1RdrDetnSameRV 0 "Mode6_0" 1 "Mode6_1" 2 "Mode6_2";
VAL_ 81 ReSideRdrLeDetn1RdrDetnSts 0 "RdrDetnSts_Ukwn" 1 "RdrDetnSts_Movg" 2 "RdrDetnSts_Staty" 3 "RdrDetnSts_Invalid";
VAL_ 81 ReSideRdrLeDetn2RdrDetnAmbigState 0 "YesNo1_Yes" 1 "YesNo1_No";
VAL_ 81 ReSideRdrLeDetn2RdrDetnSameRV 0 "Mode6_0" 1 "Mode6_1" 2 "Mode6_2";
VAL_ 81 ReSideRdrLeDetn2RdrDetnSts 0 "RdrDetnSts_Ukwn" 1 "RdrDetnSts_Movg" 2 "RdrDetnSts_Staty" 3 "RdrDetnSts_Invalid";
VAL_ 81 ReSideRdrLeDetn3RdrDetnAmbigState 0 "YesNo1_Yes" 1 "YesNo1_No";
VAL_ 81 ReSideRdrLeDetn3RdrDetnSameRV 0 "Mode6_0" 1 "Mode6_1" 2 "Mode6_2";
VAL_ 81 ReSideRdrLeDetn3RdrDetnSts 0 "RdrDetnSts_Ukwn" 1 "RdrDetnSts_Movg" 2 "RdrDetnSts_Staty" 3 "RdrDetnSts_Invalid";
VAL_ 81 ReSideRdrLeDetn4RdrDetnAmbigState 0 "YesNo1_Yes" 1 "YesNo1_No";
VAL_ 81 ReSideRdrLeDetn4RdrDetnSameRV 0 "Mode6_0" 1 "Mode6_1" 2 "Mode6_2";
VAL_ 81 ReSideRdrLeDetn4RdrDetnSts 0 "RdrDetnSts_Ukwn" 1 "RdrDetnSts_Movg" 2 "RdrDetnSts_Staty" 3 "RdrDetnSts_Invalid";
VAL_ 81 ReSideRdrLeDetn5RdrDetnAmbigState 0 "YesNo1_Yes" 1 "YesNo1_No";
VAL_ 81 ReSideRdrLeDetn5RdrDetnSameRV 0 "Mode6_0" 1 "Mode6_1" 2 "Mode6_2";
VAL_ 81 ReSideRdrLeDetn5RdrDetnSts 0 "RdrDetnSts_Ukwn" 1 "RdrDetnSts_Movg" 2 "RdrDetnSts_Staty" 3 "RdrDetnSts_Invalid";
VAL_ 81 ReSideRdrLeDetn6RdrDetnAmbigState 0 "YesNo1_Yes" 1 "YesNo1_No";
VAL_ 81 ReSideRdrLeDetn6RdrDetnSameRV 0 "Mode6_0" 1 "Mode6_1" 2 "Mode6_2";
VAL_ 81 ReSideRdrLeDetn6RdrDetnSts 0 "RdrDetnSts_Ukwn" 1 "RdrDetnSts_Movg" 2 "RdrDetnSts_Staty" 3 "RdrDetnSts_Invalid";
VAL_ 82 ReSideRdrLeDetn10RdrDetnAmbigState 0 "YesNo1_Yes" 1 "YesNo1_No";
VAL_ 82 ReSideRdrLeDetn10RdrDetnSameRV 0 "Mode6_0" 1 "Mode6_1" 2 "Mode6_2";
VAL_ 82 ReSideRdrLeDetn10RdrDetnSts 0 "RdrDetnSts_Ukwn" 1 "RdrDetnSts_Movg" 2 "RdrDetnSts_Staty" 3 "RdrDetnSts_Invalid";
VAL_ 82 ReSideRdrLeDetn11RdrDetnAmbigState 0 "YesNo1_Yes" 1 "YesNo1_No";
VAL_ 82 ReSideRdrLeDetn11RdrDetnSameRV 0 "Mode6_0" 1 "Mode6_1" 2 "Mode6_2";
VAL_ 82 ReSideRdrLeDetn11RdrDetnSts 0 "RdrDetnSts_Ukwn" 1 "RdrDetnSts_Movg" 2 "RdrDetnSts_Staty" 3 "RdrDetnSts_Invalid";
VAL_ 82 ReSideRdrLeDetn12RdrDetnAmbigState 0 "YesNo1_Yes" 1 "YesNo1_No";
VAL_ 82 ReSideRdrLeDetn12RdrDetnSameRV 0 "Mode6_0" 1 "Mode6_1" 2 "Mode6_2";
VAL_ 82 ReSideRdrLeDetn12RdrDetnSts 0 "RdrDetnSts_Ukwn" 1 "RdrDetnSts_Movg" 2 "RdrDetnSts_Staty" 3 "RdrDetnSts_Invalid";
VAL_ 82 ReSideRdrLeDetn7RdrDetnAmbigState 0 "YesNo1_Yes" 1 "YesNo1_No";
VAL_ 82 ReSideRdrLeDetn7RdrDetnSameRV 0 "Mode6_0" 1 "Mode6_1" 2 "Mode6_2";
VAL_ 82 ReSideRdrLeDetn7RdrDetnSts 0 "RdrDetnSts_Ukwn" 1 "RdrDetnSts_Movg" 2 "RdrDetnSts_Staty" 3 "RdrDetnSts_Invalid";
VAL_ 82 ReSideRdrLeDetn8RdrDetnAmbigState 0 "YesNo1_Yes" 1 "YesNo1_No";
VAL_ 82 ReSideRdrLeDetn8RdrDetnSameRV 0 "Mode6_0" 1 "Mode6_1" 2 "Mode6_2";
VAL_ 82 ReSideRdrLeDetn8RdrDetnSts 0 "RdrDetnSts_Ukwn" 1 "RdrDetnSts_Movg" 2 "RdrDetnSts_Staty" 3 "RdrDetnSts_Invalid";
VAL_ 82 ReSideRdrLeDetn9RdrDetnAmbigState 0 "YesNo1_Yes" 1 "YesNo1_No";
VAL_ 82 ReSideRdrLeDetn9RdrDetnSameRV 0 "Mode6_0" 1 "Mode6_1" 2 "Mode6_2";
VAL_ 82 ReSideRdrLeDetn9RdrDetnSts 0 "RdrDetnSts_Ukwn" 1 "RdrDetnSts_Movg" 2 "RdrDetnSts_Staty" 3 "RdrDetnSts_Invalid";
VAL_ 83 ReSideRdrLeDetn13RdrDetnAmbigState 0 "YesNo1_Yes" 1 "YesNo1_No";
VAL_ 83 ReSideRdrLeDetn13RdrDetnSameRV 0 "Mode6_0" 1 "Mode6_1" 2 "Mode6_2";
VAL_ 83 ReSideRdrLeDetn13RdrDetnSts 0 "RdrDetnSts_Ukwn" 1 "RdrDetnSts_Movg" 2 "RdrDetnSts_Staty" 3 "RdrDetnSts_Invalid";
VAL_ 83 ReSideRdrLeDetn14RdrDetnAmbigState 0 "YesNo1_Yes" 1 "YesNo1_No";
VAL_ 83 ReSideRdrLeDetn14RdrDetnSameRV 0 "Mode6_0" 1 "Mode6_1" 2 "Mode6_2";
VAL_ 83 ReSideRdrLeDetn14RdrDetnSts 0 "RdrDetnSts_Ukwn" 1 "RdrDetnSts_Movg" 2 "RdrDetnSts_Staty" 3 "RdrDetnSts_Invalid";
VAL_ 83 ReSideRdrLeDetn15RdrDetnAmbigState 0 "YesNo1_Yes" 1 "YesNo1_No";
VAL_ 83 ReSideRdrLeDetn15RdrDetnSameRV 0 "Mode6_0" 1 "Mode6_1" 2 "Mode6_2";
VAL_ 83 ReSideRdrLeDetn15RdrDetnSts 0 "RdrDetnSts_Ukwn" 1 "RdrDetnSts_Movg" 2 "RdrDetnSts_Staty" 3 "RdrDetnSts_Invalid";
VAL_ 83 ReSideRdrLeDetn16RdrDetnAmbigState 0 "YesNo1_Yes" 1 "YesNo1_No";
VAL_ 83 ReSideRdrLeDetn16RdrDetnSameRV 0 "Mode6_0" 1 "Mode6_1" 2 "Mode6_2";
VAL_ 83 ReSideRdrLeDetn16RdrDetnSts 0 "RdrDetnSts_Ukwn" 1 "RdrDetnSts_Movg" 2 "RdrDetnSts_Staty" 3 "RdrDetnSts_Invalid";
VAL_ 83 ReSideRdrLeDetn17RdrDetnAmbigState 0 "YesNo1_Yes" 1 "YesNo1_No";
VAL_ 83 ReSideRdrLeDetn17RdrDetnSameRV 0 "Mode6_0" 1 "Mode6_1" 2 "Mode6_2";
VAL_ 83 ReSideRdrLeDetn17RdrDetnSts 0 "RdrDetnSts_Ukwn" 1 "RdrDetnSts_Movg" 2 "RdrDetnSts_Staty" 3 "RdrDetnSts_Invalid";
VAL_ 83 ReSideRdrLeDetn18RdrDetnAmbigState 0 "YesNo1_Yes" 1 "YesNo1_No";
VAL_ 83 ReSideRdrLeDetn18RdrDetnSameRV 0 "Mode6_0" 1 "Mode6_1" 2 "Mode6_2";
VAL_ 83 ReSideRdrLeDetn18RdrDetnSts 0 "RdrDetnSts_Ukwn" 1 "RdrDetnSts_Movg" 2 "RdrDetnSts_Staty" 3 "RdrDetnSts_Invalid";
VAL_ 84 ReSideRdrLeDetn19RdrDetnAmbigState 0 "YesNo1_Yes" 1 "YesNo1_No";
VAL_ 84 ReSideRdrLeDetn19RdrDetnSameRV 0 "Mode6_0" 1 "Mode6_1" 2 "Mode6_2";
VAL_ 84 ReSideRdrLeDetn19RdrDetnSts 0 "RdrDetnSts_Ukwn" 1 "RdrDetnSts_Movg" 2 "RdrDetnSts_Staty" 3 "RdrDetnSts_Invalid";
VAL_ 84 ReSideRdrLeDetn20RdrDetnAmbigState 0 "YesNo1_Yes" 1 "YesNo1_No";
VAL_ 84 ReSideRdrLeDetn20RdrDetnSameRV 0 "Mode6_0" 1 "Mode6_1" 2 "Mode6_2";
VAL_ 84 ReSideRdrLeDetn20RdrDetnSts 0 "RdrDetnSts_Ukwn" 1 "RdrDetnSts_Movg" 2 "RdrDetnSts_Staty" 3 "RdrDetnSts_Invalid";
VAL_ 84 ReSideRdrLeDetn21RdrDetnAmbigState 0 "YesNo1_Yes" 1 "YesNo1_No";
VAL_ 84 ReSideRdrLeDetn21RdrDetnSameRV 0 "Mode6_0" 1 "Mode6_1" 2 "Mode6_2";
VAL_ 84 ReSideRdrLeDetn21RdrDetnSts 0 "RdrDetnSts_Ukwn" 1 "RdrDetnSts_Movg" 2 "RdrDetnSts_Staty" 3 "RdrDetnSts_Invalid";
VAL_ 84 ReSideRdrLeDetn22RdrDetnAmbigState 0 "YesNo1_Yes" 1 "YesNo1_No";
VAL_ 84 ReSideRdrLeDetn22RdrDetnSameRV 0 "Mode6_0" 1 "Mode6_1" 2 "Mode6_2";
VAL_ 84 ReSideRdrLeDetn22RdrDetnSts 0 "RdrDetnSts_Ukwn" 1 "RdrDetnSts_Movg" 2 "RdrDetnSts_Staty" 3 "RdrDetnSts_Invalid";
VAL_ 84 ReSideRdrLeDetn23RdrDetnAmbigState 0 "YesNo1_Yes" 1 "YesNo1_No";
VAL_ 84 ReSideRdrLeDetn23RdrDetnSameRV 0 "Mode6_0" 1 "Mode6_1" 2 "Mode6_2";
VAL_ 84 ReSideRdrLeDetn23RdrDetnSts 0 "RdrDetnSts_Ukwn" 1 "RdrDetnSts_Movg" 2 "RdrDetnSts_Staty" 3 "RdrDetnSts_Invalid";
VAL_ 84 ReSideRdrLeDetn24RdrDetnAmbigState 0 "YesNo1_Yes" 1 "YesNo1_No";
VAL_ 84 ReSideRdrLeDetn24RdrDetnSameRV 0 "Mode6_0" 1 "Mode6_1" 2 "Mode6_2";
VAL_ 84 ReSideRdrLeDetn24RdrDetnSts 0 "RdrDetnSts_Ukwn" 1 "RdrDetnSts_Movg" 2 "RdrDetnSts_Staty" 3 "RdrDetnSts_Invalid";
VAL_ 85 ReSideRdrLeDetn25RdrDetnAmbigState 0 "YesNo1_Yes" 1 "YesNo1_No";
VAL_ 85 ReSideRdrLeDetn25RdrDetnSameRV 0 "Mode6_0" 1 "Mode6_1" 2 "Mode6_2";
VAL_ 85 ReSideRdrLeDetn25RdrDetnSts 0 "RdrDetnSts_Ukwn" 1 "RdrDetnSts_Movg" 2 "RdrDetnSts_Staty" 3 "RdrDetnSts_Invalid";
VAL_ 85 ReSideRdrLeDetn26RdrDetnAmbigState 0 "YesNo1_Yes" 1 "YesNo1_No";
VAL_ 85 ReSideRdrLeDetn26RdrDetnSameRV 0 "Mode6_0" 1 "Mode6_1" 2 "Mode6_2";
VAL_ 85 ReSideRdrLeDetn26RdrDetnSts 0 "RdrDetnSts_Ukwn" 1 "RdrDetnSts_Movg" 2 "RdrDetnSts_Staty" 3 "RdrDetnSts_Invalid";
VAL_ 85 ReSideRdrLeDetn27RdrDetnAmbigState 0 "YesNo1_Yes" 1 "YesNo1_No";
VAL_ 85 ReSideRdrLeDetn27RdrDetnSameRV 0 "Mode6_0" 1 "Mode6_1" 2 "Mode6_2";
VAL_ 85 ReSideRdrLeDetn27RdrDetnSts 0 "RdrDetnSts_Ukwn" 1 "RdrDetnSts_Movg" 2 "RdrDetnSts_Staty" 3 "RdrDetnSts_Invalid";
VAL_ 85 ReSideRdrLeDetn28RdrDetnAmbigState 0 "YesNo1_Yes" 1 "YesNo1_No";
VAL_ 85 ReSideRdrLeDetn28RdrDetnSameRV 0 "Mode6_0" 1 "Mode6_1" 2 "Mode6_2";
VAL_ 85 ReSideRdrLeDetn28RdrDetnSts 0 "RdrDetnSts_Ukwn" 1 "RdrDetnSts_Movg" 2 "RdrDetnSts_Staty" 3 "RdrDetnSts_Invalid";
VAL_ 85 ReSideRdrLeDetn29RdrDetnAmbigState 0 "YesNo1_Yes" 1 "YesNo1_No";
VAL_ 85 ReSideRdrLeDetn29RdrDetnSameRV 0 "Mode6_0" 1 "Mode6_1" 2 "Mode6_2";
VAL_ 85 ReSideRdrLeDetn29RdrDetnSts 0 "RdrDetnSts_Ukwn" 1 "RdrDetnSts_Movg" 2 "RdrDetnSts_Staty" 3 "RdrDetnSts_Invalid";
VAL_ 85 ReSideRdrLeDetn30RdrDetnAmbigState 0 "YesNo1_Yes" 1 "YesNo1_No";
VAL_ 85 ReSideRdrLeDetn30RdrDetnSameRV 0 "Mode6_0" 1 "Mode6_1" 2 "Mode6_2";
VAL_ 85 ReSideRdrLeDetn30RdrDetnSts 0 "RdrDetnSts_Ukwn" 1 "RdrDetnSts_Movg" 2 "RdrDetnSts_Staty" 3 "RdrDetnSts_Invalid";
VAL_ 86 ReSideRdrLeDetn31RdrDetnAmbigState 0 "YesNo1_Yes" 1 "YesNo1_No";
VAL_ 86 ReSideRdrLeDetn31RdrDetnSameRV 0 "Mode6_0" 1 "Mode6_1" 2 "Mode6_2";
VAL_ 86 ReSideRdrLeDetn31RdrDetnSts 0 "RdrDetnSts_Ukwn" 1 "RdrDetnSts_Movg" 2 "RdrDetnSts_Staty" 3 "RdrDetnSts_Invalid";
VAL_ 86 ReSideRdrLeDetn32RdrDetnAmbigState 0 "YesNo1_Yes" 1 "YesNo1_No";
VAL_ 86 ReSideRdrLeDetn32RdrDetnSameRV 0 "Mode6_0" 1 "Mode6_1" 2 "Mode6_2";
VAL_ 86 ReSideRdrLeDetn32RdrDetnSts 0 "RdrDetnSts_Ukwn" 1 "RdrDetnSts_Movg" 2 "RdrDetnSts_Staty" 3 "RdrDetnSts_Invalid";
VAL_ 86 ReSideRdrLeDetn33RdrDetnAmbigState 0 "YesNo1_Yes" 1 "YesNo1_No";
VAL_ 86 ReSideRdrLeDetn33RdrDetnSameRV 0 "Mode6_0" 1 "Mode6_1" 2 "Mode6_2";
VAL_ 86 ReSideRdrLeDetn33RdrDetnSts 0 "RdrDetnSts_Ukwn" 1 "RdrDetnSts_Movg" 2 "RdrDetnSts_Staty" 3 "RdrDetnSts_Invalid";
VAL_ 86 ReSideRdrLeDetn34RdrDetnAmbigState 0 "YesNo1_Yes" 1 "YesNo1_No";
VAL_ 86 ReSideRdrLeDetn34RdrDetnSameRV 0 "Mode6_0" 1 "Mode6_1" 2 "Mode6_2";
VAL_ 86 ReSideRdrLeDetn34RdrDetnSts 0 "RdrDetnSts_Ukwn" 1 "RdrDetnSts_Movg" 2 "RdrDetnSts_Staty" 3 "RdrDetnSts_Invalid";
VAL_ 86 ReSideRdrLeDetn35RdrDetnAmbigState 0 "YesNo1_Yes" 1 "YesNo1_No";
VAL_ 86 ReSideRdrLeDetn35RdrDetnSameRV 0 "Mode6_0" 1 "Mode6_1" 2 "Mode6_2";
VAL_ 86 ReSideRdrLeDetn35RdrDetnSts 0 "RdrDetnSts_Ukwn" 1 "RdrDetnSts_Movg" 2 "RdrDetnSts_Staty" 3 "RdrDetnSts_Invalid";
VAL_ 86 ReSideRdrLeDetn36RdrDetnAmbigState 0 "YesNo1_Yes" 1 "YesNo1_No";
VAL_ 86 ReSideRdrLeDetn36RdrDetnSameRV 0 "Mode6_0" 1 "Mode6_1" 2 "Mode6_2";
VAL_ 86 ReSideRdrLeDetn36RdrDetnSts 0 "RdrDetnSts_Ukwn" 1 "RdrDetnSts_Movg" 2 "RdrDetnSts_Staty" 3 "RdrDetnSts_Invalid";
SIG_GROUP_ 1074 ReSideRdrLe20Obj32 1 : ReSideRdrLe20Obj32Heading ReSideRdrLe20Obj32ObjBoxCenterLat ReSideRdrLe20Obj32ObjBoxCenterLgt ReSideRdrLe20Obj32ObservationHist ReSideRdrLe20Obj32QualityBits ReSideRdrLe20Obj32RdrObjAx ReSideRdrLe20Obj32RdrObjAy ReSideRdrLe20Obj32RdrObjBoxLength ReSideRdrLe20Obj32RdrObjBoxWidth ReSideRdrLe20Obj32RdrObjChks ReSideRdrLe20Obj32RdrObjCntr ReSideRdrLe20Obj32RdrObjCoastCnt ReSideRdrLe20Obj32RdrObjConf ReSideRdrLe20Obj32RdrObjDx ReSideRdrLe20Obj32RdrObjDxStdDe ReSideRdrLe20Obj32RdrObjDy ReSideRdrLe20Obj32RdrObjDyStdDe ReSideRdrLe20Obj32RdrObjElevnConf ReSideRdrLe20Obj32RdrObjElevnSts ReSideRdrLe20Obj32RdrObjID ReSideRdrLe20Obj32RdrObjIsInFreeSpace ReSideRdrLe20Obj32RdrObjMirrProblty ReSideRdrLe20Obj32RdrObjMtnPat ReSideRdrLe20Obj32RdrObjNotRealProblty ReSideRdrLe20Obj32RdrObjStatyCnt ReSideRdrLe20Obj32RdrObjTiAlv ReSideRdrLe20Obj32RdrObjTrackSts ReSideRdrLe20Obj32RdrObjTyp ReSideRdrLe20Obj32RdrObjTypConfBike ReSideRdrLe20Obj32RdrObjTypConfPed ReSideRdrLe20Obj32RdrObjTypConfVeh ReSideRdrLe20Obj32RdrObjUsedTracker ReSideRdrLe20Obj32RdrObjVx ReSideRdrLe20Obj32RdrObjVxStdDe ReSideRdrLe20Obj32RdrObjVy ReSideRdrLe20Obj32RdrObjVyStdDe ReSideRdrLe20Obj32RelVx ReSideRdrLe20Obj32RelVy;
SIG_GROUP_ 1075 ReSideRdrLe20Sts 1 : ReSideRdrLe20StsRdrNrDetn ReSideRdrLe20StsRdrNrObj ReSideRdrLe20StsRdrStsBlkd0bin ReSideRdrLe20StsRdrStsBlkdConf ReSideRdrLe20StsRdrStsChks ReSideRdrLe20StsRdrStsCntr ReSideRdrLe20StsRdrStsDstbc ReSideRdrLe20StsRdrStsEna ReSideRdrLe20StsRdrStsFaulty ReSideRdrLe20StsRdrStsLatency ReSideRdrLe20StsRdrStslfVersMajor ReSideRdrLe20StsRdrStslfVersMinor ReSideRdrLe20StsRdrStsMisAlign ReSideRdrLe20StsRdrStsMissCom ReSideRdrLe20StsRdrStsTiStamp20 ReSideRdrLe20StsRdrStsTiStampHi20 ReSideRdrLe20StsRdrStsTiStampNano20 ReSideRdrLe20StsRdrStsTiStampStsGlbTiBas ReSideRdrLe20StsRdrStsTiStampStsSyncToGateway ReSideRdrLe20StsRdrStsTiStampStsTiLeap ReSideRdrLe20StsRdrStsTiStampStsTiOut ReSideRdrLe20StsRdrStsWhlSpdCmpFac ReSideRdrLe20StsRdrSysSftyFlt;
SIG_GROUP_ 81 ReSideRdrLeDetn1 1 : ReSideRdrLeDetn1RdrDetnAmbigState ReSideRdrLeDetn1RdrDetnAssoTrkID ReSideRdrLeDetn1RdrDetnAzi ReSideRdrLeDetn1RdrDetnChks ReSideRdrLeDetn1RdrDetnCntr ReSideRdrLeDetn1RdrDetnConf ReSideRdrLeDetn1RdrDetnElevn ReSideRdrLeDetn1RdrDetnPwr ReSideRdrLeDetn1RdrDetnRng ReSideRdrLeDetn1RdrDetnRngV ReSideRdrLeDetn1RdrDetnSameRV ReSideRdrLeDetn1RdrDetnSts;
SIG_GROUP_ 82 ReSideRdrLeDetn10 1 : ReSideRdrLeDetn10RdrDetnAmbigState ReSideRdrLeDetn10RdrDetnAssoTrkID ReSideRdrLeDetn10RdrDetnAzi ReSideRdrLeDetn10RdrDetnChks ReSideRdrLeDetn10RdrDetnCntr ReSideRdrLeDetn10RdrDetnConf ReSideRdrLeDetn10RdrDetnElevn ReSideRdrLeDetn10RdrDetnPwr ReSideRdrLeDetn10RdrDetnRng ReSideRdrLeDetn10RdrDetnRngV ReSideRdrLeDetn10RdrDetnSameRV ReSideRdrLeDetn10RdrDetnSts;
SIG_GROUP_ 82 ReSideRdrLeDetn11 1 : ReSideRdrLeDetn11RdrDetnAmbigState ReSideRdrLeDetn11RdrDetnAssoTrkID ReSideRdrLeDetn11RdrDetnAzi ReSideRdrLeDetn11RdrDetnChks ReSideRdrLeDetn11RdrDetnCntr ReSideRdrLeDetn11RdrDetnConf ReSideRdrLeDetn11RdrDetnElevn ReSideRdrLeDetn11RdrDetnPwr ReSideRdrLeDetn11RdrDetnRng ReSideRdrLeDetn11RdrDetnRngV ReSideRdrLeDetn11RdrDetnSameRV ReSideRdrLeDetn11RdrDetnSts;
SIG_GROUP_ 82 ReSideRdrLeDetn12 1 : ReSideRdrLeDetn12RdrDetnAmbigState ReSideRdrLeDetn12RdrDetnAssoTrkID ReSideRdrLeDetn12RdrDetnAzi ReSideRdrLeDetn12RdrDetnChks ReSideRdrLeDetn12RdrDetnCntr ReSideRdrLeDetn12RdrDetnConf ReSideRdrLeDetn12RdrDetnElevn ReSideRdrLeDetn12RdrDetnPwr ReSideRdrLeDetn12RdrDetnRng ReSideRdrLeDetn12RdrDetnRngV ReSideRdrLeDetn12RdrDetnSameRV ReSideRdrLeDetn12RdrDetnSts;
SIG_GROUP_ 83 ReSideRdrLeDetn13 1 : ReSideRdrLeDetn13RdrDetnAmbigState ReSideRdrLeDetn13RdrDetnAssoTrkID ReSideRdrLeDetn13RdrDetnAzi ReSideRdrLeDetn13RdrDetnChks ReSideRdrLeDetn13RdrDetnCntr ReSideRdrLeDetn13RdrDetnConf ReSideRdrLeDetn13RdrDetnElevn ReSideRdrLeDetn13RdrDetnPwr ReSideRdrLeDetn13RdrDetnRng ReSideRdrLeDetn13RdrDetnRngV ReSideRdrLeDetn13RdrDetnSameRV ReSideRdrLeDetn13RdrDetnSts;
SIG_GROUP_ 83 ReSideRdrLeDetn14 1 : ReSideRdrLeDetn14RdrDetnAmbigState ReSideRdrLeDetn14RdrDetnAssoTrkID ReSideRdrLeDetn14RdrDetnAzi ReSideRdrLeDetn14RdrDetnChks ReSideRdrLeDetn14RdrDetnCntr ReSideRdrLeDetn14RdrDetnConf ReSideRdrLeDetn14RdrDetnElevn ReSideRdrLeDetn14RdrDetnPwr ReSideRdrLeDetn14RdrDetnRng ReSideRdrLeDetn14RdrDetnRngV ReSideRdrLeDetn14RdrDetnSameRV ReSideRdrLeDetn14RdrDetnSts;
SIG_GROUP_ 83 ReSideRdrLeDetn15 1 : ReSideRdrLeDetn15RdrDetnAmbigState ReSideRdrLeDetn15RdrDetnAssoTrkID ReSideRdrLeDetn15RdrDetnAzi ReSideRdrLeDetn15RdrDetnChks ReSideRdrLeDetn15RdrDetnCntr ReSideRdrLeDetn15RdrDetnConf ReSideRdrLeDetn15RdrDetnElevn ReSideRdrLeDetn15RdrDetnPwr ReSideRdrLeDetn15RdrDetnRng ReSideRdrLeDetn15RdrDetnRngV ReSideRdrLeDetn15RdrDetnSameRV ReSideRdrLeDetn15RdrDetnSts;
SIG_GROUP_ 83 ReSideRdrLeDetn16 1 : ReSideRdrLeDetn16RdrDetnAmbigState ReSideRdrLeDetn16RdrDetnAssoTrkID ReSideRdrLeDetn16RdrDetnAzi ReSideRdrLeDetn16RdrDetnChks ReSideRdrLeDetn16RdrDetnCntr ReSideRdrLeDetn16RdrDetnConf ReSideRdrLeDetn16RdrDetnElevn ReSideRdrLeDetn16RdrDetnPwr ReSideRdrLeDetn16RdrDetnRng ReSideRdrLeDetn16RdrDetnRngV ReSideRdrLeDetn16RdrDetnSameRV ReSideRdrLeDetn16RdrDetnSts;
SIG_GROUP_ 83 ReSideRdrLeDetn17 1 : ReSideRdrLeDetn17RdrDetnAmbigState ReSideRdrLeDetn17RdrDetnAssoTrkID ReSideRdrLeDetn17RdrDetnAzi ReSideRdrLeDetn17RdrDetnChks ReSideRdrLeDetn17RdrDetnCntr ReSideRdrLeDetn17RdrDetnConf ReSideRdrLeDetn17RdrDetnElevn ReSideRdrLeDetn17RdrDetnPwr ReSideRdrLeDetn17RdrDetnRng ReSideRdrLeDetn17RdrDetnRngV ReSideRdrLeDetn17RdrDetnSameRV ReSideRdrLeDetn17RdrDetnSts;
SIG_GROUP_ 83 ReSideRdrLeDetn18 1 : ReSideRdrLeDetn18RdrDetnAmbigState ReSideRdrLeDetn18RdrDetnAssoTrkID ReSideRdrLeDetn18RdrDetnAzi ReSideRdrLeDetn18RdrDetnChks ReSideRdrLeDetn18RdrDetnCntr ReSideRdrLeDetn18RdrDetnConf ReSideRdrLeDetn18RdrDetnElevn ReSideRdrLeDetn18RdrDetnPwr ReSideRdrLeDetn18RdrDetnRng ReSideRdrLeDetn18RdrDetnRngV ReSideRdrLeDetn18RdrDetnSameRV ReSideRdrLeDetn18RdrDetnSts;
SIG_GROUP_ 84 ReSideRdrLeDetn19 1 : ReSideRdrLeDetn19RdrDetnAmbigState ReSideRdrLeDetn19RdrDetnAssoTrkID ReSideRdrLeDetn19RdrDetnAzi ReSideRdrLeDetn19RdrDetnChks ReSideRdrLeDetn19RdrDetnCntr ReSideRdrLeDetn19RdrDetnConf ReSideRdrLeDetn19RdrDetnElevn ReSideRdrLeDetn19RdrDetnPwr ReSideRdrLeDetn19RdrDetnRng ReSideRdrLeDetn19RdrDetnRngV ReSideRdrLeDetn19RdrDetnSameRV ReSideRdrLeDetn19RdrDetnSts;
SIG_GROUP_ 81 ReSideRdrLeDetn2 1 : ReSideRdrLeDetn2RdrDetnAmbigState ReSideRdrLeDetn2RdrDetnAssoTrkID ReSideRdrLeDetn2RdrDetnAzi ReSideRdrLeDetn2RdrDetnChks ReSideRdrLeDetn2RdrDetnCntr ReSideRdrLeDetn2RdrDetnConf ReSideRdrLeDetn2RdrDetnElevn ReSideRdrLeDetn2RdrDetnPwr ReSideRdrLeDetn2RdrDetnRng ReSideRdrLeDetn2RdrDetnRngV ReSideRdrLeDetn2RdrDetnSameRV ReSideRdrLeDetn2RdrDetnSts;
SIG_GROUP_ 84 ReSideRdrLeDetn20 1 : ReSideRdrLeDetn20RdrDetnAmbigState ReSideRdrLeDetn20RdrDetnAssoTrkID ReSideRdrLeDetn20RdrDetnAzi ReSideRdrLeDetn20RdrDetnChks ReSideRdrLeDetn20RdrDetnCntr ReSideRdrLeDetn20RdrDetnConf ReSideRdrLeDetn20RdrDetnElevn ReSideRdrLeDetn20RdrDetnPwr ReSideRdrLeDetn20RdrDetnRng ReSideRdrLeDetn20RdrDetnRngV ReSideRdrLeDetn20RdrDetnSameRV ReSideRdrLeDetn20RdrDetnSts;
SIG_GROUP_ 84 ReSideRdrLeDetn21 1 : ReSideRdrLeDetn21RdrDetnAmbigState ReSideRdrLeDetn21RdrDetnAssoTrkID ReSideRdrLeDetn21RdrDetnAzi ReSideRdrLeDetn21RdrDetnChks ReSideRdrLeDetn21RdrDetnCntr ReSideRdrLeDetn21RdrDetnConf ReSideRdrLeDetn21RdrDetnElevn ReSideRdrLeDetn21RdrDetnPwr ReSideRdrLeDetn21RdrDetnRng ReSideRdrLeDetn21RdrDetnRngV ReSideRdrLeDetn21RdrDetnSameRV ReSideRdrLeDetn21RdrDetnSts;
SIG_GROUP_ 84 ReSideRdrLeDetn22 1 : ReSideRdrLeDetn22RdrDetnAmbigState ReSideRdrLeDetn22RdrDetnAssoTrkID ReSideRdrLeDetn22RdrDetnAzi ReSideRdrLeDetn22RdrDetnChks ReSideRdrLeDetn22RdrDetnCntr ReSideRdrLeDetn22RdrDetnConf ReSideRdrLeDetn22RdrDetnElevn ReSideRdrLeDetn22RdrDetnPwr ReSideRdrLeDetn22RdrDetnRng ReSideRdrLeDetn22RdrDetnRngV ReSideRdrLeDetn22RdrDetnSameRV ReSideRdrLeDetn22RdrDetnSts;
SIG_GROUP_ 84 ReSideRdrLeDetn23 1 : ReSideRdrLeDetn23RdrDetnAmbigState ReSideRdrLeDetn23RdrDetnAssoTrkID ReSideRdrLeDetn23RdrDetnAzi ReSideRdrLeDetn23RdrDetnChks ReSideRdrLeDetn23RdrDetnCntr ReSideRdrLeDetn23RdrDetnConf ReSideRdrLeDetn23RdrDetnElevn ReSideRdrLeDetn23RdrDetnPwr ReSideRdrLeDetn23RdrDetnRng ReSideRdrLeDetn23RdrDetnRngV ReSideRdrLeDetn23RdrDetnSameRV ReSideRdrLeDetn23RdrDetnSts;
SIG_GROUP_ 84 ReSideRdrLeDetn24 1 : ReSideRdrLeDetn24RdrDetnAmbigState ReSideRdrLeDetn24RdrDetnAssoTrkID ReSideRdrLeDetn24RdrDetnAzi ReSideRdrLeDetn24RdrDetnChks ReSideRdrLeDetn24RdrDetnCntr ReSideRdrLeDetn24RdrDetnConf ReSideRdrLeDetn24RdrDetnElevn ReSideRdrLeDetn24RdrDetnPwr ReSideRdrLeDetn24RdrDetnRng ReSideRdrLeDetn24RdrDetnRngV ReSideRdrLeDetn24RdrDetnSameRV ReSideRdrLeDetn24RdrDetnSts;
SIG_GROUP_ 85 ReSideRdrLeDetn25 1 : ReSideRdrLeDetn25RdrDetnAmbigState ReSideRdrLeDetn25RdrDetnAssoTrkID ReSideRdrLeDetn25RdrDetnAzi ReSideRdrLeDetn25RdrDetnChks ReSideRdrLeDetn25RdrDetnCntr ReSideRdrLeDetn25RdrDetnConf ReSideRdrLeDetn25RdrDetnElevn ReSideRdrLeDetn25RdrDetnPwr ReSideRdrLeDetn25RdrDetnRng ReSideRdrLeDetn25RdrDetnRngV ReSideRdrLeDetn25RdrDetnSameRV ReSideRdrLeDetn25RdrDetnSts;
SIG_GROUP_ 85 ReSideRdrLeDetn26 1 : ReSideRdrLeDetn26RdrDetnAmbigState ReSideRdrLeDetn26RdrDetnAssoTrkID ReSideRdrLeDetn26RdrDetnAzi ReSideRdrLeDetn26RdrDetnChks ReSideRdrLeDetn26RdrDetnCntr ReSideRdrLeDetn26RdrDetnConf ReSideRdrLeDetn26RdrDetnElevn ReSideRdrLeDetn26RdrDetnPwr ReSideRdrLeDetn26RdrDetnRng ReSideRdrLeDetn26RdrDetnRngV ReSideRdrLeDetn26RdrDetnSameRV ReSideRdrLeDetn26RdrDetnSts;
SIG_GROUP_ 85 ReSideRdrLeDetn27 1 : ReSideRdrLeDetn27RdrDetnAmbigState ReSideRdrLeDetn27RdrDetnAssoTrkID ReSideRdrLeDetn27RdrDetnAzi ReSideRdrLeDetn27RdrDetnChks ReSideRdrLeDetn27RdrDetnCntr ReSideRdrLeDetn27RdrDetnConf ReSideRdrLeDetn27RdrDetnElevn ReSideRdrLeDetn27RdrDetnPwr ReSideRdrLeDetn27RdrDetnRng ReSideRdrLeDetn27RdrDetnRngV ReSideRdrLeDetn27RdrDetnSameRV ReSideRdrLeDetn27RdrDetnSts;
SIG_GROUP_ 85 ReSideRdrLeDetn28 1 : ReSideRdrLeDetn28RdrDetnAmbigState ReSideRdrLeDetn28RdrDetnAssoTrkID ReSideRdrLeDetn28RdrDetnAzi ReSideRdrLeDetn28RdrDetnChks ReSideRdrLeDetn28RdrDetnCntr ReSideRdrLeDetn28RdrDetnConf ReSideRdrLeDetn28RdrDetnElevn ReSideRdrLeDetn28RdrDetnPwr ReSideRdrLeDetn28RdrDetnRng ReSideRdrLeDetn28RdrDetnRngV ReSideRdrLeDetn28RdrDetnSameRV ReSideRdrLeDetn28RdrDetnSts;
SIG_GROUP_ 85 ReSideRdrLeDetn29 1 : ReSideRdrLeDetn29RdrDetnAmbigState ReSideRdrLeDetn29RdrDetnAssoTrkID ReSideRdrLeDetn29RdrDetnAzi ReSideRdrLeDetn29RdrDetnChks ReSideRdrLeDetn29RdrDetnCntr ReSideRdrLeDetn29RdrDetnConf ReSideRdrLeDetn29RdrDetnElevn ReSideRdrLeDetn29RdrDetnPwr ReSideRdrLeDetn29RdrDetnRng ReSideRdrLeDetn29RdrDetnRngV ReSideRdrLeDetn29RdrDetnSameRV ReSideRdrLeDetn29RdrDetnSts;
SIG_GROUP_ 81 ReSideRdrLeDetn3 1 : ReSideRdrLeDetn3RdrDetnAmbigState ReSideRdrLeDetn3RdrDetnAssoTrkID ReSideRdrLeDetn3RdrDetnAzi ReSideRdrLeDetn3RdrDetnChks ReSideRdrLeDetn3RdrDetnCntr ReSideRdrLeDetn3RdrDetnConf ReSideRdrLeDetn3RdrDetnElevn ReSideRdrLeDetn3RdrDetnPwr ReSideRdrLeDetn3RdrDetnRng ReSideRdrLeDetn3RdrDetnRngV ReSideRdrLeDetn3RdrDetnSameRV ReSideRdrLeDetn3RdrDetnSts;
SIG_GROUP_ 85 ReSideRdrLeDetn30 1 : ReSideRdrLeDetn30RdrDetnAmbigState ReSideRdrLeDetn30RdrDetnAssoTrkID ReSideRdrLeDetn30RdrDetnAzi ReSideRdrLeDetn30RdrDetnChks ReSideRdrLeDetn30RdrDetnCntr ReSideRdrLeDetn30RdrDetnConf ReSideRdrLeDetn30RdrDetnElevn ReSideRdrLeDetn30RdrDetnPwr ReSideRdrLeDetn30RdrDetnRng ReSideRdrLeDetn30RdrDetnRngV ReSideRdrLeDetn30RdrDetnSameRV ReSideRdrLeDetn30RdrDetnSts;
SIG_GROUP_ 86 ReSideRdrLeDetn31 1 : ReSideRdrLeDetn31RdrDetnAmbigState ReSideRdrLeDetn31RdrDetnAssoTrkID ReSideRdrLeDetn31RdrDetnAzi ReSideRdrLeDetn31RdrDetnChks ReSideRdrLeDetn31RdrDetnCntr ReSideRdrLeDetn31RdrDetnConf ReSideRdrLeDetn31RdrDetnElevn ReSideRdrLeDetn31RdrDetnPwr ReSideRdrLeDetn31RdrDetnRng ReSideRdrLeDetn31RdrDetnRngV ReSideRdrLeDetn31RdrDetnSameRV ReSideRdrLeDetn31RdrDetnSts;
SIG_GROUP_ 86 ReSideRdrLeDetn32 1 : ReSideRdrLeDetn32RdrDetnAmbigState ReSideRdrLeDetn32RdrDetnAssoTrkID ReSideRdrLeDetn32RdrDetnAzi ReSideRdrLeDetn32RdrDetnChks ReSideRdrLeDetn32RdrDetnCntr ReSideRdrLeDetn32RdrDetnConf ReSideRdrLeDetn32RdrDetnElevn ReSideRdrLeDetn32RdrDetnPwr ReSideRdrLeDetn32RdrDetnRng ReSideRdrLeDetn32RdrDetnRngV ReSideRdrLeDetn32RdrDetnSameRV ReSideRdrLeDetn32RdrDetnSts;
SIG_GROUP_ 86 ReSideRdrLeDetn33 1 : ReSideRdrLeDetn33RdrDetnAmbigState ReSideRdrLeDetn33RdrDetnAssoTrkID ReSideRdrLeDetn33RdrDetnAzi ReSideRdrLeDetn33RdrDetnChks ReSideRdrLeDetn33RdrDetnCntr ReSideRdrLeDetn33RdrDetnConf ReSideRdrLeDetn33RdrDetnElevn ReSideRdrLeDetn33RdrDetnPwr ReSideRdrLeDetn33RdrDetnRng ReSideRdrLeDetn33RdrDetnRngV ReSideRdrLeDetn33RdrDetnSameRV ReSideRdrLeDetn33RdrDetnSts;
SIG_GROUP_ 86 ReSideRdrLeDetn34 1 : ReSideRdrLeDetn34RdrDetnAmbigState ReSideRdrLeDetn34RdrDetnAssoTrkID ReSideRdrLeDetn34RdrDetnAzi ReSideRdrLeDetn34RdrDetnChks ReSideRdrLeDetn34RdrDetnCntr ReSideRdrLeDetn34RdrDetnConf ReSideRdrLeDetn34RdrDetnElevn ReSideRdrLeDetn34RdrDetnPwr ReSideRdrLeDetn34RdrDetnRng ReSideRdrLeDetn34RdrDetnRngV ReSideRdrLeDetn34RdrDetnSameRV ReSideRdrLeDetn34RdrDetnSts;
SIG_GROUP_ 86 ReSideRdrLeDetn35 1 : ReSideRdrLeDetn35RdrDetnAmbigState ReSideRdrLeDetn35RdrDetnAssoTrkID ReSideRdrLeDetn35RdrDetnAzi ReSideRdrLeDetn35RdrDetnChks ReSideRdrLeDetn35RdrDetnCntr ReSideRdrLeDetn35RdrDetnConf ReSideRdrLeDetn35RdrDetnElevn ReSideRdrLeDetn35RdrDetnPwr ReSideRdrLeDetn35RdrDetnRng ReSideRdrLeDetn35RdrDetnRngV ReSideRdrLeDetn35RdrDetnSameRV ReSideRdrLeDetn35RdrDetnSts;
SIG_GROUP_ 86 ReSideRdrLeDetn36 1 : ReSideRdrLeDetn36RdrDetnAmbigState ReSideRdrLeDetn36RdrDetnAssoTrkID ReSideRdrLeDetn36RdrDetnAzi ReSideRdrLeDetn36RdrDetnChks ReSideRdrLeDetn36RdrDetnCntr ReSideRdrLeDetn36RdrDetnConf ReSideRdrLeDetn36RdrDetnElevn ReSideRdrLeDetn36RdrDetnPwr ReSideRdrLeDetn36RdrDetnRng ReSideRdrLeDetn36RdrDetnRngV ReSideRdrLeDetn36RdrDetnSameRV ReSideRdrLeDetn36RdrDetnSts;
SIG_GROUP_ 81 ReSideRdrLeDetn4 1 : ReSideRdrLeDetn4RdrDetnAmbigState ReSideRdrLeDetn4RdrDetnAssoTrkID ReSideRdrLeDetn4RdrDetnAzi ReSideRdrLeDetn4RdrDetnChks ReSideRdrLeDetn4RdrDetnCntr ReSideRdrLeDetn4RdrDetnConf ReSideRdrLeDetn4RdrDetnElevn ReSideRdrLeDetn4RdrDetnPwr ReSideRdrLeDetn4RdrDetnRng ReSideRdrLeDetn4RdrDetnRngV ReSideRdrLeDetn4RdrDetnSameRV ReSideRdrLeDetn4RdrDetnSts;
SIG_GROUP_ 81 ReSideRdrLeDetn5 1 : ReSideRdrLeDetn5RdrDetnAmbigState ReSideRdrLeDetn5RdrDetnAssoTrkID ReSideRdrLeDetn5RdrDetnAzi ReSideRdrLeDetn5RdrDetnChks ReSideRdrLeDetn5RdrDetnCntr ReSideRdrLeDetn5RdrDetnConf ReSideRdrLeDetn5RdrDetnElevn ReSideRdrLeDetn5RdrDetnPwr ReSideRdrLeDetn5RdrDetnRng ReSideRdrLeDetn5RdrDetnRngV ReSideRdrLeDetn5RdrDetnSameRV ReSideRdrLeDetn5RdrDetnSts;
SIG_GROUP_ 81 ReSideRdrLeDetn6 1 : ReSideRdrLeDetn6RdrDetnAmbigState ReSideRdrLeDetn6RdrDetnAssoTrkID ReSideRdrLeDetn6RdrDetnAzi ReSideRdrLeDetn6RdrDetnChks ReSideRdrLeDetn6RdrDetnCntr ReSideRdrLeDetn6RdrDetnConf ReSideRdrLeDetn6RdrDetnElevn ReSideRdrLeDetn6RdrDetnPwr ReSideRdrLeDetn6RdrDetnRng ReSideRdrLeDetn6RdrDetnRngV ReSideRdrLeDetn6RdrDetnSameRV ReSideRdrLeDetn6RdrDetnSts;
SIG_GROUP_ 82 ReSideRdrLeDetn7 1 : ReSideRdrLeDetn7RdrDetnAmbigState ReSideRdrLeDetn7RdrDetnAssoTrkID ReSideRdrLeDetn7RdrDetnAzi ReSideRdrLeDetn7RdrDetnChks ReSideRdrLeDetn7RdrDetnCntr ReSideRdrLeDetn7RdrDetnConf ReSideRdrLeDetn7RdrDetnElevn ReSideRdrLeDetn7RdrDetnPwr ReSideRdrLeDetn7RdrDetnRng ReSideRdrLeDetn7RdrDetnRngV ReSideRdrLeDetn7RdrDetnSameRV ReSideRdrLeDetn7RdrDetnSts;
SIG_GROUP_ 82 ReSideRdrLeDetn8 1 : ReSideRdrLeDetn8RdrDetnAmbigState ReSideRdrLeDetn8RdrDetnAssoTrkID ReSideRdrLeDetn8RdrDetnAzi ReSideRdrLeDetn8RdrDetnChks ReSideRdrLeDetn8RdrDetnCntr ReSideRdrLeDetn8RdrDetnConf ReSideRdrLeDetn8RdrDetnElevn ReSideRdrLeDetn8RdrDetnPwr ReSideRdrLeDetn8RdrDetnRng ReSideRdrLeDetn8RdrDetnRngV ReSideRdrLeDetn8RdrDetnSameRV ReSideRdrLeDetn8RdrDetnSts;
SIG_GROUP_ 82 ReSideRdrLeDetn9 1 : ReSideRdrLeDetn9RdrDetnAmbigState ReSideRdrLeDetn9RdrDetnAssoTrkID ReSideRdrLeDetn9RdrDetnAzi ReSideRdrLeDetn9RdrDetnChks ReSideRdrLeDetn9RdrDetnCntr ReSideRdrLeDetn9RdrDetnConf ReSideRdrLeDetn9RdrDetnElevn ReSideRdrLeDetn9RdrDetnPwr ReSideRdrLeDetn9RdrDetnRng ReSideRdrLeDetn9RdrDetnRngV ReSideRdrLeDetn9RdrDetnSameRV ReSideRdrLeDetn9RdrDetnSts;
