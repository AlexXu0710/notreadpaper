// *************************************************************************** *
// *                                                                           *
// * Description:         CANDB File                                           *
// * Generated at:        2023-03-30 16:08                                     *
// * System:              ZSDB123101                                           *
// * Variant:             CS1E                                                 *
// * Network:             Private_CANFD5                                       *
// *                                                                           *
// *************************************************************************** *
VERSION "Private_CANFD5"

NS_ :

BS_ :

BU_ :  ASDM SODL

BO_ 131 SODLPrivateCANFD5Fr66 : 64 SODL
 SG_ ReSideRdrLeDetn193_UB : 487|1@0+ (1,0) [0|1] "" ASDM
 SG_ ReSideRdrLeDetn193RdrDetnAmbigState : 72|1@0+ (1,0) [0|1] "" ASDM
 SG_ ReSideRdrLeDetn193RdrDetnAssoTrkID : 79|7@0+ (1.0,0.0) [0.0|127.0] "Unitless" ASDM
 SG_ ReSideRdrLeDetn193RdrDetnAzi : 34|11@0+ (0.1,-90.0) [-90.0|90.0] "Deg" ASDM
 SG_ ReSideRdrLeDetn193RdrDetnChks : 7|8@0+ (1.0,0.0) [0.0|255.0] "Unitless" ASDM
 SG_ ReSideRdrLeDetn193RdrDetnCntr : 15|4@0+ (1.0,0.0) [0.0|15.0] "Unitless" ASDM
 SG_ ReSideRdrLeDetn193RdrDetnConf : 11|7@0+ (1.0,0.0) [0.0|100.0] "%" ASDM
 SG_ ReSideRdrLeDetn193RdrDetnElevn : 20|5@0+ (1.0,-15.0) [-15.0|15.0] "Deg" ASDM
 SG_ ReSideRdrLeDetn193RdrDetnPwr : 71|6@0+ (1.0,0.0) [0.0|63.0] "dB" ASDM
 SG_ ReSideRdrLeDetn193RdrDetnRng : 55|14@0+ (0.02,-1.0) [-1.0|200.0] "m" ASDM
 SG_ ReSideRdrLeDetn193RdrDetnRngV : 31|13@0+ (0.02,-80.0) [-80.0|80.0] "m/s" ASDM
 SG_ ReSideRdrLeDetn193RdrDetnSameRV : 65|2@0+ (1,0) [0|3] "" ASDM
 SG_ ReSideRdrLeDetn193RdrDetnSts : 57|2@0+ (1,0) [0|3] "" ASDM
 SG_ ReSideRdrLeDetn194_UB : 486|1@0+ (1,0) [0|1] "" ASDM
 SG_ ReSideRdrLeDetn194RdrDetnAmbigState : 152|1@0+ (1,0) [0|1] "" ASDM
 SG_ ReSideRdrLeDetn194RdrDetnAssoTrkID : 159|7@0+ (1.0,0.0) [0.0|127.0] "Unitless" ASDM
 SG_ ReSideRdrLeDetn194RdrDetnAzi : 114|11@0+ (0.1,-90.0) [-90.0|90.0] "Deg" ASDM
 SG_ ReSideRdrLeDetn194RdrDetnChks : 87|8@0+ (1.0,0.0) [0.0|255.0] "Unitless" ASDM
 SG_ ReSideRdrLeDetn194RdrDetnCntr : 95|4@0+ (1.0,0.0) [0.0|15.0] "Unitless" ASDM
 SG_ ReSideRdrLeDetn194RdrDetnConf : 91|7@0+ (1.0,0.0) [0.0|100.0] "%" ASDM
 SG_ ReSideRdrLeDetn194RdrDetnElevn : 100|5@0+ (1.0,-15.0) [-15.0|15.0] "Deg" ASDM
 SG_ ReSideRdrLeDetn194RdrDetnPwr : 151|6@0+ (1.0,0.0) [0.0|63.0] "dB" ASDM
 SG_ ReSideRdrLeDetn194RdrDetnRng : 135|14@0+ (0.02,-1.0) [-1.0|200.0] "m" ASDM
 SG_ ReSideRdrLeDetn194RdrDetnRngV : 111|13@0+ (0.02,-80.0) [-80.0|80.0] "m/s" ASDM
 SG_ ReSideRdrLeDetn194RdrDetnSameRV : 145|2@0+ (1,0) [0|3] "" ASDM
 SG_ ReSideRdrLeDetn194RdrDetnSts : 137|2@0+ (1,0) [0|3] "" ASDM
 SG_ ReSideRdrLeDetn195_UB : 485|1@0+ (1,0) [0|1] "" ASDM
 SG_ ReSideRdrLeDetn195RdrDetnAmbigState : 232|1@0+ (1,0) [0|1] "" ASDM
 SG_ ReSideRdrLeDetn195RdrDetnAssoTrkID : 239|7@0+ (1.0,0.0) [0.0|127.0] "Unitless" ASDM
 SG_ ReSideRdrLeDetn195RdrDetnAzi : 194|11@0+ (0.1,-90.0) [-90.0|90.0] "Deg" ASDM
 SG_ ReSideRdrLeDetn195RdrDetnChks : 167|8@0+ (1.0,0.0) [0.0|255.0] "Unitless" ASDM
 SG_ ReSideRdrLeDetn195RdrDetnCntr : 175|4@0+ (1.0,0.0) [0.0|15.0] "Unitless" ASDM
 SG_ ReSideRdrLeDetn195RdrDetnConf : 171|7@0+ (1.0,0.0) [0.0|100.0] "%" ASDM
 SG_ ReSideRdrLeDetn195RdrDetnElevn : 180|5@0+ (1.0,-15.0) [-15.0|15.0] "Deg" ASDM
 SG_ ReSideRdrLeDetn195RdrDetnPwr : 231|6@0+ (1.0,0.0) [0.0|63.0] "dB" ASDM
 SG_ ReSideRdrLeDetn195RdrDetnRng : 215|14@0+ (0.02,-1.0) [-1.0|200.0] "m" ASDM
 SG_ ReSideRdrLeDetn195RdrDetnRngV : 191|13@0+ (0.02,-80.0) [-80.0|80.0] "m/s" ASDM
 SG_ ReSideRdrLeDetn195RdrDetnSameRV : 225|2@0+ (1,0) [0|3] "" ASDM
 SG_ ReSideRdrLeDetn195RdrDetnSts : 217|2@0+ (1,0) [0|3] "" ASDM
 SG_ ReSideRdrLeDetn196_UB : 484|1@0+ (1,0) [0|1] "" ASDM
 SG_ ReSideRdrLeDetn196RdrDetnAmbigState : 312|1@0+ (1,0) [0|1] "" ASDM
 SG_ ReSideRdrLeDetn196RdrDetnAssoTrkID : 319|7@0+ (1.0,0.0) [0.0|127.0] "Unitless" ASDM
 SG_ ReSideRdrLeDetn196RdrDetnAzi : 274|11@0+ (0.1,-90.0) [-90.0|90.0] "Deg" ASDM
 SG_ ReSideRdrLeDetn196RdrDetnChks : 247|8@0+ (1.0,0.0) [0.0|255.0] "Unitless" ASDM
 SG_ ReSideRdrLeDetn196RdrDetnCntr : 255|4@0+ (1.0,0.0) [0.0|15.0] "Unitless" ASDM
 SG_ ReSideRdrLeDetn196RdrDetnConf : 251|7@0+ (1.0,0.0) [0.0|100.0] "%" ASDM
 SG_ ReSideRdrLeDetn196RdrDetnElevn : 260|5@0+ (1.0,-15.0) [-15.0|15.0] "Deg" ASDM
 SG_ ReSideRdrLeDetn196RdrDetnPwr : 311|6@0+ (1.0,0.0) [0.0|63.0] "dB" ASDM
 SG_ ReSideRdrLeDetn196RdrDetnRng : 295|14@0+ (0.02,-1.0) [-1.0|200.0] "m" ASDM
 SG_ ReSideRdrLeDetn196RdrDetnRngV : 271|13@0+ (0.02,-80.0) [-80.0|80.0] "m/s" ASDM
 SG_ ReSideRdrLeDetn196RdrDetnSameRV : 305|2@0+ (1,0) [0|3] "" ASDM
 SG_ ReSideRdrLeDetn196RdrDetnSts : 297|2@0+ (1,0) [0|3] "" ASDM
 SG_ ReSideRdrLeDetn197_UB : 483|1@0+ (1,0) [0|1] "" ASDM
 SG_ ReSideRdrLeDetn197RdrDetnAmbigState : 392|1@0+ (1,0) [0|1] "" ASDM
 SG_ ReSideRdrLeDetn197RdrDetnAssoTrkID : 399|7@0+ (1.0,0.0) [0.0|127.0] "Unitless" ASDM
 SG_ ReSideRdrLeDetn197RdrDetnAzi : 354|11@0+ (0.1,-90.0) [-90.0|90.0] "Deg" ASDM
 SG_ ReSideRdrLeDetn197RdrDetnChks : 327|8@0+ (1.0,0.0) [0.0|255.0] "Unitless" ASDM
 SG_ ReSideRdrLeDetn197RdrDetnCntr : 335|4@0+ (1.0,0.0) [0.0|15.0] "Unitless" ASDM
 SG_ ReSideRdrLeDetn197RdrDetnConf : 331|7@0+ (1.0,0.0) [0.0|100.0] "%" ASDM
 SG_ ReSideRdrLeDetn197RdrDetnElevn : 340|5@0+ (1.0,-15.0) [-15.0|15.0] "Deg" ASDM
 SG_ ReSideRdrLeDetn197RdrDetnPwr : 391|6@0+ (1.0,0.0) [0.0|63.0] "dB" ASDM
 SG_ ReSideRdrLeDetn197RdrDetnRng : 375|14@0+ (0.02,-1.0) [-1.0|200.0] "m" ASDM
 SG_ ReSideRdrLeDetn197RdrDetnRngV : 351|13@0+ (0.02,-80.0) [-80.0|80.0] "m/s" ASDM
 SG_ ReSideRdrLeDetn197RdrDetnSameRV : 385|2@0+ (1,0) [0|3] "" ASDM
 SG_ ReSideRdrLeDetn197RdrDetnSts : 377|2@0+ (1,0) [0|3] "" ASDM
 SG_ ReSideRdrLeDetn198_UB : 482|1@0+ (1,0) [0|1] "" ASDM
 SG_ ReSideRdrLeDetn198RdrDetnAmbigState : 472|1@0+ (1,0) [0|1] "" ASDM
 SG_ ReSideRdrLeDetn198RdrDetnAssoTrkID : 479|7@0+ (1.0,0.0) [0.0|127.0] "Unitless" ASDM
 SG_ ReSideRdrLeDetn198RdrDetnAzi : 434|11@0+ (0.1,-90.0) [-90.0|90.0] "Deg" ASDM
 SG_ ReSideRdrLeDetn198RdrDetnChks : 407|8@0+ (1.0,0.0) [0.0|255.0] "Unitless" ASDM
 SG_ ReSideRdrLeDetn198RdrDetnCntr : 415|4@0+ (1.0,0.0) [0.0|15.0] "Unitless" ASDM
 SG_ ReSideRdrLeDetn198RdrDetnConf : 411|7@0+ (1.0,0.0) [0.0|100.0] "%" ASDM
 SG_ ReSideRdrLeDetn198RdrDetnElevn : 420|5@0+ (1.0,-15.0) [-15.0|15.0] "Deg" ASDM
 SG_ ReSideRdrLeDetn198RdrDetnPwr : 471|6@0+ (1.0,0.0) [0.0|63.0] "dB" ASDM
 SG_ ReSideRdrLeDetn198RdrDetnRng : 455|14@0+ (0.02,-1.0) [-1.0|200.0] "m" ASDM
 SG_ ReSideRdrLeDetn198RdrDetnRngV : 431|13@0+ (0.02,-80.0) [-80.0|80.0] "m/s" ASDM
 SG_ ReSideRdrLeDetn198RdrDetnSameRV : 465|2@0+ (1,0) [0|3] "" ASDM
 SG_ ReSideRdrLeDetn198RdrDetnSts : 457|2@0+ (1,0) [0|3] "" ASDM

BO_ 132 SODLPrivateCANFD5Fr67 : 64 SODL
 SG_ ReSideRdrLeDetn199_UB : 487|1@0+ (1,0) [0|1] "" ASDM
 SG_ ReSideRdrLeDetn199RdrDetnAmbigState : 72|1@0+ (1,0) [0|1] "" ASDM
 SG_ ReSideRdrLeDetn199RdrDetnAssoTrkID : 79|7@0+ (1.0,0.0) [0.0|127.0] "Unitless" ASDM
 SG_ ReSideRdrLeDetn199RdrDetnAzi : 34|11@0+ (0.1,-90.0) [-90.0|90.0] "Deg" ASDM
 SG_ ReSideRdrLeDetn199RdrDetnChks : 7|8@0+ (1.0,0.0) [0.0|255.0] "Unitless" ASDM
 SG_ ReSideRdrLeDetn199RdrDetnCntr : 15|4@0+ (1.0,0.0) [0.0|15.0] "Unitless" ASDM
 SG_ ReSideRdrLeDetn199RdrDetnConf : 11|7@0+ (1.0,0.0) [0.0|100.0] "%" ASDM
 SG_ ReSideRdrLeDetn199RdrDetnElevn : 20|5@0+ (1.0,-15.0) [-15.0|15.0] "Deg" ASDM
 SG_ ReSideRdrLeDetn199RdrDetnPwr : 71|6@0+ (1.0,0.0) [0.0|63.0] "dB" ASDM
 SG_ ReSideRdrLeDetn199RdrDetnRng : 55|14@0+ (0.02,-1.0) [-1.0|200.0] "m" ASDM
 SG_ ReSideRdrLeDetn199RdrDetnRngV : 31|13@0+ (0.02,-80.0) [-80.0|80.0] "m/s" ASDM
 SG_ ReSideRdrLeDetn199RdrDetnSameRV : 65|2@0+ (1,0) [0|3] "" ASDM
 SG_ ReSideRdrLeDetn199RdrDetnSts : 57|2@0+ (1,0) [0|3] "" ASDM
 SG_ ReSideRdrLeDetn200_UB : 486|1@0+ (1,0) [0|1] "" ASDM
 SG_ ReSideRdrLeDetn200RdrDetnAmbigState : 152|1@0+ (1,0) [0|1] "" ASDM
 SG_ ReSideRdrLeDetn200RdrDetnAssoTrkID : 159|7@0+ (1.0,0.0) [0.0|127.0] "Unitless" ASDM
 SG_ ReSideRdrLeDetn200RdrDetnAzi : 114|11@0+ (0.1,-90.0) [-90.0|90.0] "Deg" ASDM
 SG_ ReSideRdrLeDetn200RdrDetnChks : 87|8@0+ (1.0,0.0) [0.0|255.0] "Unitless" ASDM
 SG_ ReSideRdrLeDetn200RdrDetnCntr : 95|4@0+ (1.0,0.0) [0.0|15.0] "Unitless" ASDM
 SG_ ReSideRdrLeDetn200RdrDetnConf : 91|7@0+ (1.0,0.0) [0.0|100.0] "%" ASDM
 SG_ ReSideRdrLeDetn200RdrDetnElevn : 100|5@0+ (1.0,-15.0) [-15.0|15.0] "Deg" ASDM
 SG_ ReSideRdrLeDetn200RdrDetnPwr : 151|6@0+ (1.0,0.0) [0.0|63.0] "dB" ASDM
 SG_ ReSideRdrLeDetn200RdrDetnRng : 135|14@0+ (0.02,-1.0) [-1.0|200.0] "m" ASDM
 SG_ ReSideRdrLeDetn200RdrDetnRngV : 111|13@0+ (0.02,-80.0) [-80.0|80.0] "m/s" ASDM
 SG_ ReSideRdrLeDetn200RdrDetnSameRV : 145|2@0+ (1,0) [0|3] "" ASDM
 SG_ ReSideRdrLeDetn200RdrDetnSts : 137|2@0+ (1,0) [0|3] "" ASDM
 SG_ ReSideRdrLeDetn201_UB : 485|1@0+ (1,0) [0|1] "" ASDM
 SG_ ReSideRdrLeDetn201RdrDetnAmbigState : 232|1@0+ (1,0) [0|1] "" ASDM
 SG_ ReSideRdrLeDetn201RdrDetnAssoTrkID : 239|7@0+ (1.0,0.0) [0.0|127.0] "Unitless" ASDM
 SG_ ReSideRdrLeDetn201RdrDetnAzi : 194|11@0+ (0.1,-90.0) [-90.0|90.0] "Deg" ASDM
 SG_ ReSideRdrLeDetn201RdrDetnChks : 167|8@0+ (1.0,0.0) [0.0|255.0] "Unitless" ASDM
 SG_ ReSideRdrLeDetn201RdrDetnCntr : 175|4@0+ (1.0,0.0) [0.0|15.0] "Unitless" ASDM
 SG_ ReSideRdrLeDetn201RdrDetnConf : 171|7@0+ (1.0,0.0) [0.0|100.0] "%" ASDM
 SG_ ReSideRdrLeDetn201RdrDetnElevn : 180|5@0+ (1.0,-15.0) [-15.0|15.0] "Deg" ASDM
 SG_ ReSideRdrLeDetn201RdrDetnPwr : 231|6@0+ (1.0,0.0) [0.0|63.0] "dB" ASDM
 SG_ ReSideRdrLeDetn201RdrDetnRng : 215|14@0+ (0.02,-1.0) [-1.0|200.0] "m" ASDM
 SG_ ReSideRdrLeDetn201RdrDetnRngV : 191|13@0+ (0.02,-80.0) [-80.0|80.0] "m/s" ASDM
 SG_ ReSideRdrLeDetn201RdrDetnSameRV : 225|2@0+ (1,0) [0|3] "" ASDM
 SG_ ReSideRdrLeDetn201RdrDetnSts : 217|2@0+ (1,0) [0|3] "" ASDM
 SG_ ReSideRdrLeDetn202_UB : 484|1@0+ (1,0) [0|1] "" ASDM
 SG_ ReSideRdrLeDetn202RdrDetnAmbigState : 312|1@0+ (1,0) [0|1] "" ASDM
 SG_ ReSideRdrLeDetn202RdrDetnAssoTrkID : 319|7@0+ (1.0,0.0) [0.0|127.0] "Unitless" ASDM
 SG_ ReSideRdrLeDetn202RdrDetnAzi : 274|11@0+ (0.1,-90.0) [-90.0|90.0] "Deg" ASDM
 SG_ ReSideRdrLeDetn202RdrDetnChks : 247|8@0+ (1.0,0.0) [0.0|255.0] "Unitless" ASDM
 SG_ ReSideRdrLeDetn202RdrDetnCntr : 255|4@0+ (1.0,0.0) [0.0|15.0] "Unitless" ASDM
 SG_ ReSideRdrLeDetn202RdrDetnConf : 251|7@0+ (1.0,0.0) [0.0|100.0] "%" ASDM
 SG_ ReSideRdrLeDetn202RdrDetnElevn : 260|5@0+ (1.0,-15.0) [-15.0|15.0] "Deg" ASDM
 SG_ ReSideRdrLeDetn202RdrDetnPwr : 311|6@0+ (1.0,0.0) [0.0|63.0] "dB" ASDM
 SG_ ReSideRdrLeDetn202RdrDetnRng : 295|14@0+ (0.02,-1.0) [-1.0|200.0] "m" ASDM
 SG_ ReSideRdrLeDetn202RdrDetnRngV : 271|13@0+ (0.02,-80.0) [-80.0|80.0] "m/s" ASDM
 SG_ ReSideRdrLeDetn202RdrDetnSameRV : 305|2@0+ (1,0) [0|3] "" ASDM
 SG_ ReSideRdrLeDetn202RdrDetnSts : 297|2@0+ (1,0) [0|3] "" ASDM
 SG_ ReSideRdrLeDetn203_UB : 483|1@0+ (1,0) [0|1] "" ASDM
 SG_ ReSideRdrLeDetn203RdrDetnAmbigState : 392|1@0+ (1,0) [0|1] "" ASDM
 SG_ ReSideRdrLeDetn203RdrDetnAssoTrkID : 399|7@0+ (1.0,0.0) [0.0|127.0] "Unitless" ASDM
 SG_ ReSideRdrLeDetn203RdrDetnAzi : 354|11@0+ (0.1,-90.0) [-90.0|90.0] "Deg" ASDM
 SG_ ReSideRdrLeDetn203RdrDetnChks : 327|8@0+ (1.0,0.0) [0.0|255.0] "Unitless" ASDM
 SG_ ReSideRdrLeDetn203RdrDetnCntr : 335|4@0+ (1.0,0.0) [0.0|15.0] "Unitless" ASDM
 SG_ ReSideRdrLeDetn203RdrDetnConf : 331|7@0+ (1.0,0.0) [0.0|100.0] "%" ASDM
 SG_ ReSideRdrLeDetn203RdrDetnElevn : 340|5@0+ (1.0,-15.0) [-15.0|15.0] "Deg" ASDM
 SG_ ReSideRdrLeDetn203RdrDetnPwr : 391|6@0+ (1.0,0.0) [0.0|63.0] "dB" ASDM
 SG_ ReSideRdrLeDetn203RdrDetnRng : 375|14@0+ (0.02,-1.0) [-1.0|200.0] "m" ASDM
 SG_ ReSideRdrLeDetn203RdrDetnRngV : 351|13@0+ (0.02,-80.0) [-80.0|80.0] "m/s" ASDM
 SG_ ReSideRdrLeDetn203RdrDetnSameRV : 385|2@0+ (1,0) [0|3] "" ASDM
 SG_ ReSideRdrLeDetn203RdrDetnSts : 377|2@0+ (1,0) [0|3] "" ASDM
 SG_ ReSideRdrLeDetn204_UB : 482|1@0+ (1,0) [0|1] "" ASDM
 SG_ ReSideRdrLeDetn204RdrDetnAmbigState : 472|1@0+ (1,0) [0|1] "" ASDM
 SG_ ReSideRdrLeDetn204RdrDetnAssoTrkID : 479|7@0+ (1.0,0.0) [0.0|127.0] "Unitless" ASDM
 SG_ ReSideRdrLeDetn204RdrDetnAzi : 434|11@0+ (0.1,-90.0) [-90.0|90.0] "Deg" ASDM
 SG_ ReSideRdrLeDetn204RdrDetnChks : 407|8@0+ (1.0,0.0) [0.0|255.0] "Unitless" ASDM
 SG_ ReSideRdrLeDetn204RdrDetnCntr : 415|4@0+ (1.0,0.0) [0.0|15.0] "Unitless" ASDM
 SG_ ReSideRdrLeDetn204RdrDetnConf : 411|7@0+ (1.0,0.0) [0.0|100.0] "%" ASDM
 SG_ ReSideRdrLeDetn204RdrDetnElevn : 420|5@0+ (1.0,-15.0) [-15.0|15.0] "Deg" ASDM
 SG_ ReSideRdrLeDetn204RdrDetnPwr : 471|6@0+ (1.0,0.0) [0.0|63.0] "dB" ASDM
 SG_ ReSideRdrLeDetn204RdrDetnRng : 455|14@0+ (0.02,-1.0) [-1.0|200.0] "m" ASDM
 SG_ ReSideRdrLeDetn204RdrDetnRngV : 431|13@0+ (0.02,-80.0) [-80.0|80.0] "m/s" ASDM
 SG_ ReSideRdrLeDetn204RdrDetnSameRV : 465|2@0+ (1,0) [0|3] "" ASDM
 SG_ ReSideRdrLeDetn204RdrDetnSts : 457|2@0+ (1,0) [0|3] "" ASDM

BO_ 133 SODLPrivateCANFD5Fr68 : 64 SODL
 SG_ ReSideRdrLeDetn205_UB : 487|1@0+ (1,0) [0|1] "" ASDM
 SG_ ReSideRdrLeDetn205RdrDetnAmbigState : 72|1@0+ (1,0) [0|1] "" ASDM
 SG_ ReSideRdrLeDetn205RdrDetnAssoTrkID : 79|7@0+ (1.0,0.0) [0.0|127.0] "Unitless" ASDM
 SG_ ReSideRdrLeDetn205RdrDetnAzi : 34|11@0+ (0.1,-90.0) [-90.0|90.0] "Deg" ASDM
 SG_ ReSideRdrLeDetn205RdrDetnChks : 7|8@0+ (1.0,0.0) [0.0|255.0] "Unitless" ASDM
 SG_ ReSideRdrLeDetn205RdrDetnCntr : 15|4@0+ (1.0,0.0) [0.0|15.0] "Unitless" ASDM
 SG_ ReSideRdrLeDetn205RdrDetnConf : 11|7@0+ (1.0,0.0) [0.0|100.0] "%" ASDM
 SG_ ReSideRdrLeDetn205RdrDetnElevn : 20|5@0+ (1.0,-15.0) [-15.0|15.0] "Deg" ASDM
 SG_ ReSideRdrLeDetn205RdrDetnPwr : 71|6@0+ (1.0,0.0) [0.0|63.0] "dB" ASDM
 SG_ ReSideRdrLeDetn205RdrDetnRng : 55|14@0+ (0.02,-1.0) [-1.0|200.0] "m" ASDM
 SG_ ReSideRdrLeDetn205RdrDetnRngV : 31|13@0+ (0.02,-80.0) [-80.0|80.0] "m/s" ASDM
 SG_ ReSideRdrLeDetn205RdrDetnSameRV : 65|2@0+ (1,0) [0|3] "" ASDM
 SG_ ReSideRdrLeDetn205RdrDetnSts : 57|2@0+ (1,0) [0|3] "" ASDM
 SG_ ReSideRdrLeDetn206_UB : 486|1@0+ (1,0) [0|1] "" ASDM
 SG_ ReSideRdrLeDetn206RdrDetnAmbigState : 152|1@0+ (1,0) [0|1] "" ASDM
 SG_ ReSideRdrLeDetn206RdrDetnAssoTrkID : 159|7@0+ (1.0,0.0) [0.0|127.0] "Unitless" ASDM
 SG_ ReSideRdrLeDetn206RdrDetnAzi : 114|11@0+ (0.1,-90.0) [-90.0|90.0] "Deg" ASDM
 SG_ ReSideRdrLeDetn206RdrDetnChks : 87|8@0+ (1.0,0.0) [0.0|255.0] "Unitless" ASDM
 SG_ ReSideRdrLeDetn206RdrDetnCntr : 95|4@0+ (1.0,0.0) [0.0|15.0] "Unitless" ASDM
 SG_ ReSideRdrLeDetn206RdrDetnConf : 91|7@0+ (1.0,0.0) [0.0|100.0] "%" ASDM
 SG_ ReSideRdrLeDetn206RdrDetnElevn : 100|5@0+ (1.0,-15.0) [-15.0|15.0] "Deg" ASDM
 SG_ ReSideRdrLeDetn206RdrDetnPwr : 151|6@0+ (1.0,0.0) [0.0|63.0] "dB" ASDM
 SG_ ReSideRdrLeDetn206RdrDetnRng : 135|14@0+ (0.02,-1.0) [-1.0|200.0] "m" ASDM
 SG_ ReSideRdrLeDetn206RdrDetnRngV : 111|13@0+ (0.02,-80.0) [-80.0|80.0] "m/s" ASDM
 SG_ ReSideRdrLeDetn206RdrDetnSameRV : 145|2@0+ (1,0) [0|3] "" ASDM
 SG_ ReSideRdrLeDetn206RdrDetnSts : 137|2@0+ (1,0) [0|3] "" ASDM
 SG_ ReSideRdrLeDetn207_UB : 485|1@0+ (1,0) [0|1] "" ASDM
 SG_ ReSideRdrLeDetn207RdrDetnAmbigState : 232|1@0+ (1,0) [0|1] "" ASDM
 SG_ ReSideRdrLeDetn207RdrDetnAssoTrkID : 239|7@0+ (1.0,0.0) [0.0|127.0] "Unitless" ASDM
 SG_ ReSideRdrLeDetn207RdrDetnAzi : 194|11@0+ (0.1,-90.0) [-90.0|90.0] "Deg" ASDM
 SG_ ReSideRdrLeDetn207RdrDetnChks : 167|8@0+ (1.0,0.0) [0.0|255.0] "Unitless" ASDM
 SG_ ReSideRdrLeDetn207RdrDetnCntr : 175|4@0+ (1.0,0.0) [0.0|15.0] "Unitless" ASDM
 SG_ ReSideRdrLeDetn207RdrDetnConf : 171|7@0+ (1.0,0.0) [0.0|100.0] "%" ASDM
 SG_ ReSideRdrLeDetn207RdrDetnElevn : 180|5@0+ (1.0,-15.0) [-15.0|15.0] "Deg" ASDM
 SG_ ReSideRdrLeDetn207RdrDetnPwr : 231|6@0+ (1.0,0.0) [0.0|63.0] "dB" ASDM
 SG_ ReSideRdrLeDetn207RdrDetnRng : 215|14@0+ (0.02,-1.0) [-1.0|200.0] "m" ASDM
 SG_ ReSideRdrLeDetn207RdrDetnRngV : 191|13@0+ (0.02,-80.0) [-80.0|80.0] "m/s" ASDM
 SG_ ReSideRdrLeDetn207RdrDetnSameRV : 225|2@0+ (1,0) [0|3] "" ASDM
 SG_ ReSideRdrLeDetn207RdrDetnSts : 217|2@0+ (1,0) [0|3] "" ASDM
 SG_ ReSideRdrLeDetn208_UB : 484|1@0+ (1,0) [0|1] "" ASDM
 SG_ ReSideRdrLeDetn208RdrDetnAmbigState : 312|1@0+ (1,0) [0|1] "" ASDM
 SG_ ReSideRdrLeDetn208RdrDetnAssoTrkID : 319|7@0+ (1.0,0.0) [0.0|127.0] "Unitless" ASDM
 SG_ ReSideRdrLeDetn208RdrDetnAzi : 274|11@0+ (0.1,-90.0) [-90.0|90.0] "Deg" ASDM
 SG_ ReSideRdrLeDetn208RdrDetnChks : 247|8@0+ (1.0,0.0) [0.0|255.0] "Unitless" ASDM
 SG_ ReSideRdrLeDetn208RdrDetnCntr : 255|4@0+ (1.0,0.0) [0.0|15.0] "Unitless" ASDM
 SG_ ReSideRdrLeDetn208RdrDetnConf : 251|7@0+ (1.0,0.0) [0.0|100.0] "%" ASDM
 SG_ ReSideRdrLeDetn208RdrDetnElevn : 260|5@0+ (1.0,-15.0) [-15.0|15.0] "Deg" ASDM
 SG_ ReSideRdrLeDetn208RdrDetnPwr : 311|6@0+ (1.0,0.0) [0.0|63.0] "dB" ASDM
 SG_ ReSideRdrLeDetn208RdrDetnRng : 295|14@0+ (0.02,-1.0) [-1.0|200.0] "m" ASDM
 SG_ ReSideRdrLeDetn208RdrDetnRngV : 271|13@0+ (0.02,-80.0) [-80.0|80.0] "m/s" ASDM
 SG_ ReSideRdrLeDetn208RdrDetnSameRV : 305|2@0+ (1,0) [0|3] "" ASDM
 SG_ ReSideRdrLeDetn208RdrDetnSts : 297|2@0+ (1,0) [0|3] "" ASDM
 SG_ ReSideRdrLeDetn209_UB : 483|1@0+ (1,0) [0|1] "" ASDM
 SG_ ReSideRdrLeDetn209RdrDetnAmbigState : 392|1@0+ (1,0) [0|1] "" ASDM
 SG_ ReSideRdrLeDetn209RdrDetnAssoTrkID : 399|7@0+ (1.0,0.0) [0.0|127.0] "Unitless" ASDM
 SG_ ReSideRdrLeDetn209RdrDetnAzi : 354|11@0+ (0.1,-90.0) [-90.0|90.0] "Deg" ASDM
 SG_ ReSideRdrLeDetn209RdrDetnChks : 327|8@0+ (1.0,0.0) [0.0|255.0] "Unitless" ASDM
 SG_ ReSideRdrLeDetn209RdrDetnCntr : 335|4@0+ (1.0,0.0) [0.0|15.0] "Unitless" ASDM
 SG_ ReSideRdrLeDetn209RdrDetnConf : 331|7@0+ (1.0,0.0) [0.0|100.0] "%" ASDM
 SG_ ReSideRdrLeDetn209RdrDetnElevn : 340|5@0+ (1.0,-15.0) [-15.0|15.0] "Deg" ASDM
 SG_ ReSideRdrLeDetn209RdrDetnPwr : 391|6@0+ (1.0,0.0) [0.0|63.0] "dB" ASDM
 SG_ ReSideRdrLeDetn209RdrDetnRng : 375|14@0+ (0.02,-1.0) [-1.0|200.0] "m" ASDM
 SG_ ReSideRdrLeDetn209RdrDetnRngV : 351|13@0+ (0.02,-80.0) [-80.0|80.0] "m/s" ASDM
 SG_ ReSideRdrLeDetn209RdrDetnSameRV : 385|2@0+ (1,0) [0|3] "" ASDM
 SG_ ReSideRdrLeDetn209RdrDetnSts : 377|2@0+ (1,0) [0|3] "" ASDM
 SG_ ReSideRdrLeDetn210_UB : 482|1@0+ (1,0) [0|1] "" ASDM
 SG_ ReSideRdrLeDetn210RdrDetnAmbigState : 472|1@0+ (1,0) [0|1] "" ASDM
 SG_ ReSideRdrLeDetn210RdrDetnAssoTrkID : 479|7@0+ (1.0,0.0) [0.0|127.0] "Unitless" ASDM
 SG_ ReSideRdrLeDetn210RdrDetnAzi : 434|11@0+ (0.1,-90.0) [-90.0|90.0] "Deg" ASDM
 SG_ ReSideRdrLeDetn210RdrDetnChks : 407|8@0+ (1.0,0.0) [0.0|255.0] "Unitless" ASDM
 SG_ ReSideRdrLeDetn210RdrDetnCntr : 415|4@0+ (1.0,0.0) [0.0|15.0] "Unitless" ASDM
 SG_ ReSideRdrLeDetn210RdrDetnConf : 411|7@0+ (1.0,0.0) [0.0|100.0] "%" ASDM
 SG_ ReSideRdrLeDetn210RdrDetnElevn : 420|5@0+ (1.0,-15.0) [-15.0|15.0] "Deg" ASDM
 SG_ ReSideRdrLeDetn210RdrDetnPwr : 471|6@0+ (1.0,0.0) [0.0|63.0] "dB" ASDM
 SG_ ReSideRdrLeDetn210RdrDetnRng : 455|14@0+ (0.02,-1.0) [-1.0|200.0] "m" ASDM
 SG_ ReSideRdrLeDetn210RdrDetnRngV : 431|13@0+ (0.02,-80.0) [-80.0|80.0] "m/s" ASDM
 SG_ ReSideRdrLeDetn210RdrDetnSameRV : 465|2@0+ (1,0) [0|3] "" ASDM
 SG_ ReSideRdrLeDetn210RdrDetnSts : 457|2@0+ (1,0) [0|3] "" ASDM

BO_ 134 SODLPrivateCANFD5Fr69 : 64 SODL
 SG_ ReSideRdrLeDetn211_UB : 487|1@0+ (1,0) [0|1] "" ASDM
 SG_ ReSideRdrLeDetn211RdrDetnAmbigState : 72|1@0+ (1,0) [0|1] "" ASDM
 SG_ ReSideRdrLeDetn211RdrDetnAssoTrkID : 79|7@0+ (1.0,0.0) [0.0|127.0] "Unitless" ASDM
 SG_ ReSideRdrLeDetn211RdrDetnAzi : 34|11@0+ (0.1,-90.0) [-90.0|90.0] "Deg" ASDM
 SG_ ReSideRdrLeDetn211RdrDetnChks : 7|8@0+ (1.0,0.0) [0.0|255.0] "Unitless" ASDM
 SG_ ReSideRdrLeDetn211RdrDetnCntr : 15|4@0+ (1.0,0.0) [0.0|15.0] "Unitless" ASDM
 SG_ ReSideRdrLeDetn211RdrDetnConf : 11|7@0+ (1.0,0.0) [0.0|100.0] "%" ASDM
 SG_ ReSideRdrLeDetn211RdrDetnElevn : 20|5@0+ (1.0,-15.0) [-15.0|15.0] "Deg" ASDM
 SG_ ReSideRdrLeDetn211RdrDetnPwr : 71|6@0+ (1.0,0.0) [0.0|63.0] "dB" ASDM
 SG_ ReSideRdrLeDetn211RdrDetnRng : 55|14@0+ (0.02,-1.0) [-1.0|200.0] "m" ASDM
 SG_ ReSideRdrLeDetn211RdrDetnRngV : 31|13@0+ (0.02,-80.0) [-80.0|80.0] "m/s" ASDM
 SG_ ReSideRdrLeDetn211RdrDetnSameRV : 65|2@0+ (1,0) [0|3] "" ASDM
 SG_ ReSideRdrLeDetn211RdrDetnSts : 57|2@0+ (1,0) [0|3] "" ASDM
 SG_ ReSideRdrLeDetn212_UB : 486|1@0+ (1,0) [0|1] "" ASDM
 SG_ ReSideRdrLeDetn212RdrDetnAmbigState : 152|1@0+ (1,0) [0|1] "" ASDM
 SG_ ReSideRdrLeDetn212RdrDetnAssoTrkID : 159|7@0+ (1.0,0.0) [0.0|127.0] "Unitless" ASDM
 SG_ ReSideRdrLeDetn212RdrDetnAzi : 114|11@0+ (0.1,-90.0) [-90.0|90.0] "Deg" ASDM
 SG_ ReSideRdrLeDetn212RdrDetnChks : 87|8@0+ (1.0,0.0) [0.0|255.0] "Unitless" ASDM
 SG_ ReSideRdrLeDetn212RdrDetnCntr : 95|4@0+ (1.0,0.0) [0.0|15.0] "Unitless" ASDM
 SG_ ReSideRdrLeDetn212RdrDetnConf : 91|7@0+ (1.0,0.0) [0.0|100.0] "%" ASDM
 SG_ ReSideRdrLeDetn212RdrDetnElevn : 100|5@0+ (1.0,-15.0) [-15.0|15.0] "Deg" ASDM
 SG_ ReSideRdrLeDetn212RdrDetnPwr : 151|6@0+ (1.0,0.0) [0.0|63.0] "dB" ASDM
 SG_ ReSideRdrLeDetn212RdrDetnRng : 135|14@0+ (0.02,-1.0) [-1.0|200.0] "m" ASDM
 SG_ ReSideRdrLeDetn212RdrDetnRngV : 111|13@0+ (0.02,-80.0) [-80.0|80.0] "m/s" ASDM
 SG_ ReSideRdrLeDetn212RdrDetnSameRV : 145|2@0+ (1,0) [0|3] "" ASDM
 SG_ ReSideRdrLeDetn212RdrDetnSts : 137|2@0+ (1,0) [0|3] "" ASDM
 SG_ ReSideRdrLeDetn213_UB : 485|1@0+ (1,0) [0|1] "" ASDM
 SG_ ReSideRdrLeDetn213RdrDetnAmbigState : 232|1@0+ (1,0) [0|1] "" ASDM
 SG_ ReSideRdrLeDetn213RdrDetnAssoTrkID : 239|7@0+ (1.0,0.0) [0.0|127.0] "Unitless" ASDM
 SG_ ReSideRdrLeDetn213RdrDetnAzi : 194|11@0+ (0.1,-90.0) [-90.0|90.0] "Deg" ASDM
 SG_ ReSideRdrLeDetn213RdrDetnChks : 167|8@0+ (1.0,0.0) [0.0|255.0] "Unitless" ASDM
 SG_ ReSideRdrLeDetn213RdrDetnCntr : 175|4@0+ (1.0,0.0) [0.0|15.0] "Unitless" ASDM
 SG_ ReSideRdrLeDetn213RdrDetnConf : 171|7@0+ (1.0,0.0) [0.0|100.0] "%" ASDM
 SG_ ReSideRdrLeDetn213RdrDetnElevn : 180|5@0+ (1.0,-15.0) [-15.0|15.0] "Deg" ASDM
 SG_ ReSideRdrLeDetn213RdrDetnPwr : 231|6@0+ (1.0,0.0) [0.0|63.0] "dB" ASDM
 SG_ ReSideRdrLeDetn213RdrDetnRng : 215|14@0+ (0.02,-1.0) [-1.0|200.0] "m" ASDM
 SG_ ReSideRdrLeDetn213RdrDetnRngV : 191|13@0+ (0.02,-80.0) [-80.0|80.0] "m/s" ASDM
 SG_ ReSideRdrLeDetn213RdrDetnSameRV : 225|2@0+ (1,0) [0|3] "" ASDM
 SG_ ReSideRdrLeDetn213RdrDetnSts : 217|2@0+ (1,0) [0|3] "" ASDM
 SG_ ReSideRdrLeDetn214_UB : 484|1@0+ (1,0) [0|1] "" ASDM
 SG_ ReSideRdrLeDetn214RdrDetnAmbigState : 312|1@0+ (1,0) [0|1] "" ASDM
 SG_ ReSideRdrLeDetn214RdrDetnAssoTrkID : 319|7@0+ (1.0,0.0) [0.0|127.0] "Unitless" ASDM
 SG_ ReSideRdrLeDetn214RdrDetnAzi : 274|11@0+ (0.1,-90.0) [-90.0|90.0] "Deg" ASDM
 SG_ ReSideRdrLeDetn214RdrDetnChks : 247|8@0+ (1.0,0.0) [0.0|255.0] "Unitless" ASDM
 SG_ ReSideRdrLeDetn214RdrDetnCntr : 255|4@0+ (1.0,0.0) [0.0|15.0] "Unitless" ASDM
 SG_ ReSideRdrLeDetn214RdrDetnConf : 251|7@0+ (1.0,0.0) [0.0|100.0] "%" ASDM
 SG_ ReSideRdrLeDetn214RdrDetnElevn : 260|5@0+ (1.0,-15.0) [-15.0|15.0] "Deg" ASDM
 SG_ ReSideRdrLeDetn214RdrDetnPwr : 311|6@0+ (1.0,0.0) [0.0|63.0] "dB" ASDM
 SG_ ReSideRdrLeDetn214RdrDetnRng : 295|14@0+ (0.02,-1.0) [-1.0|200.0] "m" ASDM
 SG_ ReSideRdrLeDetn214RdrDetnRngV : 271|13@0+ (0.02,-80.0) [-80.0|80.0] "m/s" ASDM
 SG_ ReSideRdrLeDetn214RdrDetnSameRV : 305|2@0+ (1,0) [0|3] "" ASDM
 SG_ ReSideRdrLeDetn214RdrDetnSts : 297|2@0+ (1,0) [0|3] "" ASDM
 SG_ ReSideRdrLeDetn215_UB : 483|1@0+ (1,0) [0|1] "" ASDM
 SG_ ReSideRdrLeDetn215RdrDetnAmbigState : 392|1@0+ (1,0) [0|1] "" ASDM
 SG_ ReSideRdrLeDetn215RdrDetnAssoTrkID : 399|7@0+ (1.0,0.0) [0.0|127.0] "Unitless" ASDM
 SG_ ReSideRdrLeDetn215RdrDetnAzi : 354|11@0+ (0.1,-90.0) [-90.0|90.0] "Deg" ASDM
 SG_ ReSideRdrLeDetn215RdrDetnChks : 327|8@0+ (1.0,0.0) [0.0|255.0] "Unitless" ASDM
 SG_ ReSideRdrLeDetn215RdrDetnCntr : 335|4@0+ (1.0,0.0) [0.0|15.0] "Unitless" ASDM
 SG_ ReSideRdrLeDetn215RdrDetnConf : 331|7@0+ (1.0,0.0) [0.0|100.0] "%" ASDM
 SG_ ReSideRdrLeDetn215RdrDetnElevn : 340|5@0+ (1.0,-15.0) [-15.0|15.0] "Deg" ASDM
 SG_ ReSideRdrLeDetn215RdrDetnPwr : 391|6@0+ (1.0,0.0) [0.0|63.0] "dB" ASDM
 SG_ ReSideRdrLeDetn215RdrDetnRng : 375|14@0+ (0.02,-1.0) [-1.0|200.0] "m" ASDM
 SG_ ReSideRdrLeDetn215RdrDetnRngV : 351|13@0+ (0.02,-80.0) [-80.0|80.0] "m/s" ASDM
 SG_ ReSideRdrLeDetn215RdrDetnSameRV : 385|2@0+ (1,0) [0|3] "" ASDM
 SG_ ReSideRdrLeDetn215RdrDetnSts : 377|2@0+ (1,0) [0|3] "" ASDM
 SG_ ReSideRdrLeDetn216_UB : 482|1@0+ (1,0) [0|1] "" ASDM
 SG_ ReSideRdrLeDetn216RdrDetnAmbigState : 472|1@0+ (1,0) [0|1] "" ASDM
 SG_ ReSideRdrLeDetn216RdrDetnAssoTrkID : 479|7@0+ (1.0,0.0) [0.0|127.0] "Unitless" ASDM
 SG_ ReSideRdrLeDetn216RdrDetnAzi : 434|11@0+ (0.1,-90.0) [-90.0|90.0] "Deg" ASDM
 SG_ ReSideRdrLeDetn216RdrDetnChks : 407|8@0+ (1.0,0.0) [0.0|255.0] "Unitless" ASDM
 SG_ ReSideRdrLeDetn216RdrDetnCntr : 415|4@0+ (1.0,0.0) [0.0|15.0] "Unitless" ASDM
 SG_ ReSideRdrLeDetn216RdrDetnConf : 411|7@0+ (1.0,0.0) [0.0|100.0] "%" ASDM
 SG_ ReSideRdrLeDetn216RdrDetnElevn : 420|5@0+ (1.0,-15.0) [-15.0|15.0] "Deg" ASDM
 SG_ ReSideRdrLeDetn216RdrDetnPwr : 471|6@0+ (1.0,0.0) [0.0|63.0] "dB" ASDM
 SG_ ReSideRdrLeDetn216RdrDetnRng : 455|14@0+ (0.02,-1.0) [-1.0|200.0] "m" ASDM
 SG_ ReSideRdrLeDetn216RdrDetnRngV : 431|13@0+ (0.02,-80.0) [-80.0|80.0] "m/s" ASDM
 SG_ ReSideRdrLeDetn216RdrDetnSameRV : 465|2@0+ (1,0) [0|3] "" ASDM
 SG_ ReSideRdrLeDetn216RdrDetnSts : 457|2@0+ (1,0) [0|3] "" ASDM

BO_ 135 SODLPrivateCANFD5Fr70 : 64 SODL
 SG_ ReSideRdrLeDetn217_UB : 487|1@0+ (1,0) [0|1] "" ASDM
 SG_ ReSideRdrLeDetn217RdrDetnAmbigState : 72|1@0+ (1,0) [0|1] "" ASDM
 SG_ ReSideRdrLeDetn217RdrDetnAssoTrkID : 79|7@0+ (1.0,0.0) [0.0|127.0] "Unitless" ASDM
 SG_ ReSideRdrLeDetn217RdrDetnAzi : 34|11@0+ (0.1,-90.0) [-90.0|90.0] "Deg" ASDM
 SG_ ReSideRdrLeDetn217RdrDetnChks : 7|8@0+ (1.0,0.0) [0.0|255.0] "Unitless" ASDM
 SG_ ReSideRdrLeDetn217RdrDetnCntr : 15|4@0+ (1.0,0.0) [0.0|15.0] "Unitless" ASDM
 SG_ ReSideRdrLeDetn217RdrDetnConf : 11|7@0+ (1.0,0.0) [0.0|100.0] "%" ASDM
 SG_ ReSideRdrLeDetn217RdrDetnElevn : 20|5@0+ (1.0,-15.0) [-15.0|15.0] "Deg" ASDM
 SG_ ReSideRdrLeDetn217RdrDetnPwr : 71|6@0+ (1.0,0.0) [0.0|63.0] "dB" ASDM
 SG_ ReSideRdrLeDetn217RdrDetnRng : 55|14@0+ (0.02,-1.0) [-1.0|200.0] "m" ASDM
 SG_ ReSideRdrLeDetn217RdrDetnRngV : 31|13@0+ (0.02,-80.0) [-80.0|80.0] "m/s" ASDM
 SG_ ReSideRdrLeDetn217RdrDetnSameRV : 65|2@0+ (1,0) [0|3] "" ASDM
 SG_ ReSideRdrLeDetn217RdrDetnSts : 57|2@0+ (1,0) [0|3] "" ASDM
 SG_ ReSideRdrLeDetn218_UB : 486|1@0+ (1,0) [0|1] "" ASDM
 SG_ ReSideRdrLeDetn218RdrDetnAmbigState : 152|1@0+ (1,0) [0|1] "" ASDM
 SG_ ReSideRdrLeDetn218RdrDetnAssoTrkID : 159|7@0+ (1.0,0.0) [0.0|127.0] "Unitless" ASDM
 SG_ ReSideRdrLeDetn218RdrDetnAzi : 114|11@0+ (0.1,-90.0) [-90.0|90.0] "Deg" ASDM
 SG_ ReSideRdrLeDetn218RdrDetnChks : 87|8@0+ (1.0,0.0) [0.0|255.0] "Unitless" ASDM
 SG_ ReSideRdrLeDetn218RdrDetnCntr : 95|4@0+ (1.0,0.0) [0.0|15.0] "Unitless" ASDM
 SG_ ReSideRdrLeDetn218RdrDetnConf : 91|7@0+ (1.0,0.0) [0.0|100.0] "%" ASDM
 SG_ ReSideRdrLeDetn218RdrDetnElevn : 100|5@0+ (1.0,-15.0) [-15.0|15.0] "Deg" ASDM
 SG_ ReSideRdrLeDetn218RdrDetnPwr : 151|6@0+ (1.0,0.0) [0.0|63.0] "dB" ASDM
 SG_ ReSideRdrLeDetn218RdrDetnRng : 135|14@0+ (0.02,-1.0) [-1.0|200.0] "m" ASDM
 SG_ ReSideRdrLeDetn218RdrDetnRngV : 111|13@0+ (0.02,-80.0) [-80.0|80.0] "m/s" ASDM
 SG_ ReSideRdrLeDetn218RdrDetnSameRV : 145|2@0+ (1,0) [0|3] "" ASDM
 SG_ ReSideRdrLeDetn218RdrDetnSts : 137|2@0+ (1,0) [0|3] "" ASDM
 SG_ ReSideRdrLeDetn219_UB : 485|1@0+ (1,0) [0|1] "" ASDM
 SG_ ReSideRdrLeDetn219RdrDetnAmbigState : 232|1@0+ (1,0) [0|1] "" ASDM
 SG_ ReSideRdrLeDetn219RdrDetnAssoTrkID : 239|7@0+ (1.0,0.0) [0.0|127.0] "Unitless" ASDM
 SG_ ReSideRdrLeDetn219RdrDetnAzi : 194|11@0+ (0.1,-90.0) [-90.0|90.0] "Deg" ASDM
 SG_ ReSideRdrLeDetn219RdrDetnChks : 167|8@0+ (1.0,0.0) [0.0|255.0] "Unitless" ASDM
 SG_ ReSideRdrLeDetn219RdrDetnCntr : 175|4@0+ (1.0,0.0) [0.0|15.0] "Unitless" ASDM
 SG_ ReSideRdrLeDetn219RdrDetnConf : 171|7@0+ (1.0,0.0) [0.0|100.0] "%" ASDM
 SG_ ReSideRdrLeDetn219RdrDetnElevn : 180|5@0+ (1.0,-15.0) [-15.0|15.0] "Deg" ASDM
 SG_ ReSideRdrLeDetn219RdrDetnPwr : 231|6@0+ (1.0,0.0) [0.0|63.0] "dB" ASDM
 SG_ ReSideRdrLeDetn219RdrDetnRng : 215|14@0+ (0.02,-1.0) [-1.0|200.0] "m" ASDM
 SG_ ReSideRdrLeDetn219RdrDetnRngV : 191|13@0+ (0.02,-80.0) [-80.0|80.0] "m/s" ASDM
 SG_ ReSideRdrLeDetn219RdrDetnSameRV : 225|2@0+ (1,0) [0|3] "" ASDM
 SG_ ReSideRdrLeDetn219RdrDetnSts : 217|2@0+ (1,0) [0|3] "" ASDM
 SG_ ReSideRdrLeDetn220_UB : 484|1@0+ (1,0) [0|1] "" ASDM
 SG_ ReSideRdrLeDetn220RdrDetnAmbigState : 312|1@0+ (1,0) [0|1] "" ASDM
 SG_ ReSideRdrLeDetn220RdrDetnAssoTrkID : 319|7@0+ (1.0,0.0) [0.0|127.0] "Unitless" ASDM
 SG_ ReSideRdrLeDetn220RdrDetnAzi : 274|11@0+ (0.1,-90.0) [-90.0|90.0] "Deg" ASDM
 SG_ ReSideRdrLeDetn220RdrDetnChks : 247|8@0+ (1.0,0.0) [0.0|255.0] "Unitless" ASDM
 SG_ ReSideRdrLeDetn220RdrDetnCntr : 255|4@0+ (1.0,0.0) [0.0|15.0] "Unitless" ASDM
 SG_ ReSideRdrLeDetn220RdrDetnConf : 251|7@0+ (1.0,0.0) [0.0|100.0] "%" ASDM
 SG_ ReSideRdrLeDetn220RdrDetnElevn : 260|5@0+ (1.0,-15.0) [-15.0|15.0] "Deg" ASDM
 SG_ ReSideRdrLeDetn220RdrDetnPwr : 311|6@0+ (1.0,0.0) [0.0|63.0] "dB" ASDM
 SG_ ReSideRdrLeDetn220RdrDetnRng : 295|14@0+ (0.02,-1.0) [-1.0|200.0] "m" ASDM
 SG_ ReSideRdrLeDetn220RdrDetnRngV : 271|13@0+ (0.02,-80.0) [-80.0|80.0] "m/s" ASDM
 SG_ ReSideRdrLeDetn220RdrDetnSameRV : 305|2@0+ (1,0) [0|3] "" ASDM
 SG_ ReSideRdrLeDetn220RdrDetnSts : 297|2@0+ (1,0) [0|3] "" ASDM
 SG_ ReSideRdrLeDetn221_UB : 483|1@0+ (1,0) [0|1] "" ASDM
 SG_ ReSideRdrLeDetn221RdrDetnAmbigState : 392|1@0+ (1,0) [0|1] "" ASDM
 SG_ ReSideRdrLeDetn221RdrDetnAssoTrkID : 399|7@0+ (1.0,0.0) [0.0|127.0] "Unitless" ASDM
 SG_ ReSideRdrLeDetn221RdrDetnAzi : 354|11@0+ (0.1,-90.0) [-90.0|90.0] "Deg" ASDM
 SG_ ReSideRdrLeDetn221RdrDetnChks : 327|8@0+ (1.0,0.0) [0.0|255.0] "Unitless" ASDM
 SG_ ReSideRdrLeDetn221RdrDetnCntr : 335|4@0+ (1.0,0.0) [0.0|15.0] "Unitless" ASDM
 SG_ ReSideRdrLeDetn221RdrDetnConf : 331|7@0+ (1.0,0.0) [0.0|100.0] "%" ASDM
 SG_ ReSideRdrLeDetn221RdrDetnElevn : 340|5@0+ (1.0,-15.0) [-15.0|15.0] "Deg" ASDM
 SG_ ReSideRdrLeDetn221RdrDetnPwr : 391|6@0+ (1.0,0.0) [0.0|63.0] "dB" ASDM
 SG_ ReSideRdrLeDetn221RdrDetnRng : 375|14@0+ (0.02,-1.0) [-1.0|200.0] "m" ASDM
 SG_ ReSideRdrLeDetn221RdrDetnRngV : 351|13@0+ (0.02,-80.0) [-80.0|80.0] "m/s" ASDM
 SG_ ReSideRdrLeDetn221RdrDetnSameRV : 385|2@0+ (1,0) [0|3] "" ASDM
 SG_ ReSideRdrLeDetn221RdrDetnSts : 377|2@0+ (1,0) [0|3] "" ASDM
 SG_ ReSideRdrLeDetn222_UB : 482|1@0+ (1,0) [0|1] "" ASDM
 SG_ ReSideRdrLeDetn222RdrDetnAmbigState : 472|1@0+ (1,0) [0|1] "" ASDM
 SG_ ReSideRdrLeDetn222RdrDetnAssoTrkID : 479|7@0+ (1.0,0.0) [0.0|127.0] "Unitless" ASDM
 SG_ ReSideRdrLeDetn222RdrDetnAzi : 434|11@0+ (0.1,-90.0) [-90.0|90.0] "Deg" ASDM
 SG_ ReSideRdrLeDetn222RdrDetnChks : 407|8@0+ (1.0,0.0) [0.0|255.0] "Unitless" ASDM
 SG_ ReSideRdrLeDetn222RdrDetnCntr : 415|4@0+ (1.0,0.0) [0.0|15.0] "Unitless" ASDM
 SG_ ReSideRdrLeDetn222RdrDetnConf : 411|7@0+ (1.0,0.0) [0.0|100.0] "%" ASDM
 SG_ ReSideRdrLeDetn222RdrDetnElevn : 420|5@0+ (1.0,-15.0) [-15.0|15.0] "Deg" ASDM
 SG_ ReSideRdrLeDetn222RdrDetnPwr : 471|6@0+ (1.0,0.0) [0.0|63.0] "dB" ASDM
 SG_ ReSideRdrLeDetn222RdrDetnRng : 455|14@0+ (0.02,-1.0) [-1.0|200.0] "m" ASDM
 SG_ ReSideRdrLeDetn222RdrDetnRngV : 431|13@0+ (0.02,-80.0) [-80.0|80.0] "m/s" ASDM
 SG_ ReSideRdrLeDetn222RdrDetnSameRV : 465|2@0+ (1,0) [0|3] "" ASDM
 SG_ ReSideRdrLeDetn222RdrDetnSts : 457|2@0+ (1,0) [0|3] "" ASDM

BO_ 136 SODLPrivateCANFD5Fr71 : 64 SODL
 SG_ ReSideRdrLeDetn223_UB : 487|1@0+ (1,0) [0|1] "" ASDM
 SG_ ReSideRdrLeDetn223RdrDetnAmbigState : 72|1@0+ (1,0) [0|1] "" ASDM
 SG_ ReSideRdrLeDetn223RdrDetnAssoTrkID : 79|7@0+ (1.0,0.0) [0.0|127.0] "Unitless" ASDM
 SG_ ReSideRdrLeDetn223RdrDetnAzi : 34|11@0+ (0.1,-90.0) [-90.0|90.0] "Deg" ASDM
 SG_ ReSideRdrLeDetn223RdrDetnChks : 7|8@0+ (1.0,0.0) [0.0|255.0] "Unitless" ASDM
 SG_ ReSideRdrLeDetn223RdrDetnCntr : 15|4@0+ (1.0,0.0) [0.0|15.0] "Unitless" ASDM
 SG_ ReSideRdrLeDetn223RdrDetnConf : 11|7@0+ (1.0,0.0) [0.0|100.0] "%" ASDM
 SG_ ReSideRdrLeDetn223RdrDetnElevn : 20|5@0+ (1.0,-15.0) [-15.0|15.0] "Deg" ASDM
 SG_ ReSideRdrLeDetn223RdrDetnPwr : 71|6@0+ (1.0,0.0) [0.0|63.0] "dB" ASDM
 SG_ ReSideRdrLeDetn223RdrDetnRng : 55|14@0+ (0.02,-1.0) [-1.0|200.0] "m" ASDM
 SG_ ReSideRdrLeDetn223RdrDetnRngV : 31|13@0+ (0.02,-80.0) [-80.0|80.0] "m/s" ASDM
 SG_ ReSideRdrLeDetn223RdrDetnSameRV : 65|2@0+ (1,0) [0|3] "" ASDM
 SG_ ReSideRdrLeDetn223RdrDetnSts : 57|2@0+ (1,0) [0|3] "" ASDM
 SG_ ReSideRdrLeDetn224_UB : 486|1@0+ (1,0) [0|1] "" ASDM
 SG_ ReSideRdrLeDetn224RdrDetnAmbigState : 152|1@0+ (1,0) [0|1] "" ASDM
 SG_ ReSideRdrLeDetn224RdrDetnAssoTrkID : 159|7@0+ (1.0,0.0) [0.0|127.0] "Unitless" ASDM
 SG_ ReSideRdrLeDetn224RdrDetnAzi : 114|11@0+ (0.1,-90.0) [-90.0|90.0] "Deg" ASDM
 SG_ ReSideRdrLeDetn224RdrDetnChks : 87|8@0+ (1.0,0.0) [0.0|255.0] "Unitless" ASDM
 SG_ ReSideRdrLeDetn224RdrDetnCntr : 95|4@0+ (1.0,0.0) [0.0|15.0] "Unitless" ASDM
 SG_ ReSideRdrLeDetn224RdrDetnConf : 91|7@0+ (1.0,0.0) [0.0|100.0] "%" ASDM
 SG_ ReSideRdrLeDetn224RdrDetnElevn : 100|5@0+ (1.0,-15.0) [-15.0|15.0] "Deg" ASDM
 SG_ ReSideRdrLeDetn224RdrDetnPwr : 151|6@0+ (1.0,0.0) [0.0|63.0] "dB" ASDM
 SG_ ReSideRdrLeDetn224RdrDetnRng : 135|14@0+ (0.02,-1.0) [-1.0|200.0] "m" ASDM
 SG_ ReSideRdrLeDetn224RdrDetnRngV : 111|13@0+ (0.02,-80.0) [-80.0|80.0] "m/s" ASDM
 SG_ ReSideRdrLeDetn224RdrDetnSameRV : 145|2@0+ (1,0) [0|3] "" ASDM
 SG_ ReSideRdrLeDetn224RdrDetnSts : 137|2@0+ (1,0) [0|3] "" ASDM
 SG_ ReSideRdrLeDetn225_UB : 485|1@0+ (1,0) [0|1] "" ASDM
 SG_ ReSideRdrLeDetn225RdrDetnAmbigState : 232|1@0+ (1,0) [0|1] "" ASDM
 SG_ ReSideRdrLeDetn225RdrDetnAssoTrkID : 239|7@0+ (1.0,0.0) [0.0|127.0] "Unitless" ASDM
 SG_ ReSideRdrLeDetn225RdrDetnAzi : 194|11@0+ (0.1,-90.0) [-90.0|90.0] "Deg" ASDM
 SG_ ReSideRdrLeDetn225RdrDetnChks : 167|8@0+ (1.0,0.0) [0.0|255.0] "Unitless" ASDM
 SG_ ReSideRdrLeDetn225RdrDetnCntr : 175|4@0+ (1.0,0.0) [0.0|15.0] "Unitless" ASDM
 SG_ ReSideRdrLeDetn225RdrDetnConf : 171|7@0+ (1.0,0.0) [0.0|100.0] "%" ASDM
 SG_ ReSideRdrLeDetn225RdrDetnElevn : 180|5@0+ (1.0,-15.0) [-15.0|15.0] "Deg" ASDM
 SG_ ReSideRdrLeDetn225RdrDetnPwr : 231|6@0+ (1.0,0.0) [0.0|63.0] "dB" ASDM
 SG_ ReSideRdrLeDetn225RdrDetnRng : 215|14@0+ (0.02,-1.0) [-1.0|200.0] "m" ASDM
 SG_ ReSideRdrLeDetn225RdrDetnRngV : 191|13@0+ (0.02,-80.0) [-80.0|80.0] "m/s" ASDM
 SG_ ReSideRdrLeDetn225RdrDetnSameRV : 225|2@0+ (1,0) [0|3] "" ASDM
 SG_ ReSideRdrLeDetn225RdrDetnSts : 217|2@0+ (1,0) [0|3] "" ASDM
 SG_ ReSideRdrLeDetn226_UB : 484|1@0+ (1,0) [0|1] "" ASDM
 SG_ ReSideRdrLeDetn226RdrDetnAmbigState : 312|1@0+ (1,0) [0|1] "" ASDM
 SG_ ReSideRdrLeDetn226RdrDetnAssoTrkID : 319|7@0+ (1.0,0.0) [0.0|127.0] "Unitless" ASDM
 SG_ ReSideRdrLeDetn226RdrDetnAzi : 274|11@0+ (0.1,-90.0) [-90.0|90.0] "Deg" ASDM
 SG_ ReSideRdrLeDetn226RdrDetnChks : 247|8@0+ (1.0,0.0) [0.0|255.0] "Unitless" ASDM
 SG_ ReSideRdrLeDetn226RdrDetnCntr : 255|4@0+ (1.0,0.0) [0.0|15.0] "Unitless" ASDM
 SG_ ReSideRdrLeDetn226RdrDetnConf : 251|7@0+ (1.0,0.0) [0.0|100.0] "%" ASDM
 SG_ ReSideRdrLeDetn226RdrDetnElevn : 260|5@0+ (1.0,-15.0) [-15.0|15.0] "Deg" ASDM
 SG_ ReSideRdrLeDetn226RdrDetnPwr : 311|6@0+ (1.0,0.0) [0.0|63.0] "dB" ASDM
 SG_ ReSideRdrLeDetn226RdrDetnRng : 295|14@0+ (0.02,-1.0) [-1.0|200.0] "m" ASDM
 SG_ ReSideRdrLeDetn226RdrDetnRngV : 271|13@0+ (0.02,-80.0) [-80.0|80.0] "m/s" ASDM
 SG_ ReSideRdrLeDetn226RdrDetnSameRV : 305|2@0+ (1,0) [0|3] "" ASDM
 SG_ ReSideRdrLeDetn226RdrDetnSts : 297|2@0+ (1,0) [0|3] "" ASDM
 SG_ ReSideRdrLeDetn227_UB : 483|1@0+ (1,0) [0|1] "" ASDM
 SG_ ReSideRdrLeDetn227RdrDetnAmbigState : 392|1@0+ (1,0) [0|1] "" ASDM
 SG_ ReSideRdrLeDetn227RdrDetnAssoTrkID : 399|7@0+ (1.0,0.0) [0.0|127.0] "Unitless" ASDM
 SG_ ReSideRdrLeDetn227RdrDetnAzi : 354|11@0+ (0.1,-90.0) [-90.0|90.0] "Deg" ASDM
 SG_ ReSideRdrLeDetn227RdrDetnChks : 327|8@0+ (1.0,0.0) [0.0|255.0] "Unitless" ASDM
 SG_ ReSideRdrLeDetn227RdrDetnCntr : 335|4@0+ (1.0,0.0) [0.0|15.0] "Unitless" ASDM
 SG_ ReSideRdrLeDetn227RdrDetnConf : 331|7@0+ (1.0,0.0) [0.0|100.0] "%" ASDM
 SG_ ReSideRdrLeDetn227RdrDetnElevn : 340|5@0+ (1.0,-15.0) [-15.0|15.0] "Deg" ASDM
 SG_ ReSideRdrLeDetn227RdrDetnPwr : 391|6@0+ (1.0,0.0) [0.0|63.0] "dB" ASDM
 SG_ ReSideRdrLeDetn227RdrDetnRng : 375|14@0+ (0.02,-1.0) [-1.0|200.0] "m" ASDM
 SG_ ReSideRdrLeDetn227RdrDetnRngV : 351|13@0+ (0.02,-80.0) [-80.0|80.0] "m/s" ASDM
 SG_ ReSideRdrLeDetn227RdrDetnSameRV : 385|2@0+ (1,0) [0|3] "" ASDM
 SG_ ReSideRdrLeDetn227RdrDetnSts : 377|2@0+ (1,0) [0|3] "" ASDM
 SG_ ReSideRdrLeDetn228_UB : 482|1@0+ (1,0) [0|1] "" ASDM
 SG_ ReSideRdrLeDetn228RdrDetnAmbigState : 472|1@0+ (1,0) [0|1] "" ASDM
 SG_ ReSideRdrLeDetn228RdrDetnAssoTrkID : 479|7@0+ (1.0,0.0) [0.0|127.0] "Unitless" ASDM
 SG_ ReSideRdrLeDetn228RdrDetnAzi : 434|11@0+ (0.1,-90.0) [-90.0|90.0] "Deg" ASDM
 SG_ ReSideRdrLeDetn228RdrDetnChks : 407|8@0+ (1.0,0.0) [0.0|255.0] "Unitless" ASDM
 SG_ ReSideRdrLeDetn228RdrDetnCntr : 415|4@0+ (1.0,0.0) [0.0|15.0] "Unitless" ASDM
 SG_ ReSideRdrLeDetn228RdrDetnConf : 411|7@0+ (1.0,0.0) [0.0|100.0] "%" ASDM
 SG_ ReSideRdrLeDetn228RdrDetnElevn : 420|5@0+ (1.0,-15.0) [-15.0|15.0] "Deg" ASDM
 SG_ ReSideRdrLeDetn228RdrDetnPwr : 471|6@0+ (1.0,0.0) [0.0|63.0] "dB" ASDM
 SG_ ReSideRdrLeDetn228RdrDetnRng : 455|14@0+ (0.02,-1.0) [-1.0|200.0] "m" ASDM
 SG_ ReSideRdrLeDetn228RdrDetnRngV : 431|13@0+ (0.02,-80.0) [-80.0|80.0] "m/s" ASDM
 SG_ ReSideRdrLeDetn228RdrDetnSameRV : 465|2@0+ (1,0) [0|3] "" ASDM
 SG_ ReSideRdrLeDetn228RdrDetnSts : 457|2@0+ (1,0) [0|3] "" ASDM

CM_ SG_ 131 ReSideRdrLeDetn193RdrDetnAmbigState "Dection ambiguous status";
CM_ SG_ 131 ReSideRdrLeDetn193RdrDetnAssoTrkID "Associated tracker ID
";
CM_ SG_ 131 ReSideRdrLeDetn193RdrDetnAzi "Refer to the data element description in ReSideRdrLeDetn1 with the same data element name";
CM_ SG_ 131 ReSideRdrLeDetn193RdrDetnChks "Refer to the data element description in ReSideRdrLeDetn1 with the same data element name";
CM_ SG_ 131 ReSideRdrLeDetn193RdrDetnCntr "Refer to the data element description in ReSideRdrLeDetn1 with the same data element name";
CM_ SG_ 131 ReSideRdrLeDetn193RdrDetnConf "Refer to the data element description in ReSideRdrLeDetn1 with the same data element name";
CM_ SG_ 131 ReSideRdrLeDetn193RdrDetnElevn "Refer to the data element description in ReSideRdrLeDetn1 with the same data element name";
CM_ SG_ 131 ReSideRdrLeDetn193RdrDetnPwr "Refer to the data element description in ReSideRdrLeDetn1 with the same data element name";
CM_ SG_ 131 ReSideRdrLeDetn193RdrDetnRng "Refer to the data element description in ReSideRdrLeDetn1 with the same data element name";
CM_ SG_ 131 ReSideRdrLeDetn193RdrDetnRngV "Range Velocity";
CM_ SG_ 131 ReSideRdrLeDetn193RdrDetnSameRV "object with same distance and speed";
CM_ SG_ 131 ReSideRdrLeDetn193RdrDetnSts "Refer to the data element description in ReSideRdrLeDetn1 with the same data element name";
CM_ SG_ 131 ReSideRdrLeDetn194RdrDetnAmbigState "Dection ambiguous status";
CM_ SG_ 131 ReSideRdrLeDetn194RdrDetnAssoTrkID "Associated tracker ID
";
CM_ SG_ 131 ReSideRdrLeDetn194RdrDetnAzi "Refer to the data element description in ReSideRdrLeDetn1 with the same data element name";
CM_ SG_ 131 ReSideRdrLeDetn194RdrDetnChks "Refer to the data element description in ReSideRdrLeDetn1 with the same data element name";
CM_ SG_ 131 ReSideRdrLeDetn194RdrDetnCntr "Refer to the data element description in ReSideRdrLeDetn1 with the same data element name";
CM_ SG_ 131 ReSideRdrLeDetn194RdrDetnConf "Refer to the data element description in ReSideRdrLeDetn1 with the same data element name";
CM_ SG_ 131 ReSideRdrLeDetn194RdrDetnElevn "Refer to the data element description in ReSideRdrLeDetn1 with the same data element name";
CM_ SG_ 131 ReSideRdrLeDetn194RdrDetnPwr "Refer to the data element description in ReSideRdrLeDetn1 with the same data element name";
CM_ SG_ 131 ReSideRdrLeDetn194RdrDetnRng "Refer to the data element description in ReSideRdrLeDetn1 with the same data element name";
CM_ SG_ 131 ReSideRdrLeDetn194RdrDetnRngV "Range Velocity";
CM_ SG_ 131 ReSideRdrLeDetn194RdrDetnSameRV "object with same distance and speed";
CM_ SG_ 131 ReSideRdrLeDetn194RdrDetnSts "Refer to the data element description in ReSideRdrLeDetn1 with the same data element name";
CM_ SG_ 131 ReSideRdrLeDetn195RdrDetnAmbigState "Dection ambiguous status";
CM_ SG_ 131 ReSideRdrLeDetn195RdrDetnAssoTrkID "Associated tracker ID
";
CM_ SG_ 131 ReSideRdrLeDetn195RdrDetnAzi "Refer to the data element description in ReSideRdrLeDetn1 with the same data element name";
CM_ SG_ 131 ReSideRdrLeDetn195RdrDetnChks "Refer to the data element description in ReSideRdrLeDetn1 with the same data element name";
CM_ SG_ 131 ReSideRdrLeDetn195RdrDetnCntr "Refer to the data element description in ReSideRdrLeDetn1 with the same data element name";
CM_ SG_ 131 ReSideRdrLeDetn195RdrDetnConf "Refer to the data element description in ReSideRdrLeDetn1 with the same data element name";
CM_ SG_ 131 ReSideRdrLeDetn195RdrDetnElevn "Refer to the data element description in ReSideRdrLeDetn1 with the same data element name";
CM_ SG_ 131 ReSideRdrLeDetn195RdrDetnPwr "Refer to the data element description in ReSideRdrLeDetn1 with the same data element name";
CM_ SG_ 131 ReSideRdrLeDetn195RdrDetnRng "Refer to the data element description in ReSideRdrLeDetn1 with the same data element name";
CM_ SG_ 131 ReSideRdrLeDetn195RdrDetnRngV "Range Velocity";
CM_ SG_ 131 ReSideRdrLeDetn195RdrDetnSameRV "object with same distance and speed";
CM_ SG_ 131 ReSideRdrLeDetn195RdrDetnSts "Refer to the data element description in ReSideRdrLeDetn1 with the same data element name";
CM_ SG_ 131 ReSideRdrLeDetn196RdrDetnAmbigState "Dection ambiguous status";
CM_ SG_ 131 ReSideRdrLeDetn196RdrDetnAssoTrkID "Associated tracker ID
";
CM_ SG_ 131 ReSideRdrLeDetn196RdrDetnAzi "Refer to the data element description in ReSideRdrLeDetn1 with the same data element name";
CM_ SG_ 131 ReSideRdrLeDetn196RdrDetnChks "Refer to the data element description in ReSideRdrLeDetn1 with the same data element name";
CM_ SG_ 131 ReSideRdrLeDetn196RdrDetnCntr "Refer to the data element description in ReSideRdrLeDetn1 with the same data element name";
CM_ SG_ 131 ReSideRdrLeDetn196RdrDetnConf "Refer to the data element description in ReSideRdrLeDetn1 with the same data element name";
CM_ SG_ 131 ReSideRdrLeDetn196RdrDetnElevn "Refer to the data element description in ReSideRdrLeDetn1 with the same data element name";
CM_ SG_ 131 ReSideRdrLeDetn196RdrDetnPwr "Refer to the data element description in ReSideRdrLeDetn1 with the same data element name";
CM_ SG_ 131 ReSideRdrLeDetn196RdrDetnRng "Refer to the data element description in ReSideRdrLeDetn1 with the same data element name";
CM_ SG_ 131 ReSideRdrLeDetn196RdrDetnRngV "Range Velocity";
CM_ SG_ 131 ReSideRdrLeDetn196RdrDetnSameRV "object with same distance and speed";
CM_ SG_ 131 ReSideRdrLeDetn196RdrDetnSts "Refer to the data element description in ReSideRdrLeDetn1 with the same data element name";
CM_ SG_ 131 ReSideRdrLeDetn197RdrDetnAmbigState "Dection ambiguous status";
CM_ SG_ 131 ReSideRdrLeDetn197RdrDetnAssoTrkID "Associated tracker ID
";
CM_ SG_ 131 ReSideRdrLeDetn197RdrDetnAzi "Refer to the data element description in ReSideRdrLeDetn1 with the same data element name";
CM_ SG_ 131 ReSideRdrLeDetn197RdrDetnChks "Refer to the data element description in ReSideRdrLeDetn1 with the same data element name";
CM_ SG_ 131 ReSideRdrLeDetn197RdrDetnCntr "Refer to the data element description in ReSideRdrLeDetn1 with the same data element name";
CM_ SG_ 131 ReSideRdrLeDetn197RdrDetnConf "Refer to the data element description in ReSideRdrLeDetn1 with the same data element name";
CM_ SG_ 131 ReSideRdrLeDetn197RdrDetnElevn "Refer to the data element description in ReSideRdrLeDetn1 with the same data element name";
CM_ SG_ 131 ReSideRdrLeDetn197RdrDetnPwr "Refer to the data element description in ReSideRdrLeDetn1 with the same data element name";
CM_ SG_ 131 ReSideRdrLeDetn197RdrDetnRng "Refer to the data element description in ReSideRdrLeDetn1 with the same data element name";
CM_ SG_ 131 ReSideRdrLeDetn197RdrDetnRngV "Range Velocity";
CM_ SG_ 131 ReSideRdrLeDetn197RdrDetnSameRV "object with same distance and speed";
CM_ SG_ 131 ReSideRdrLeDetn197RdrDetnSts "Refer to the data element description in ReSideRdrLeDetn1 with the same data element name";
CM_ SG_ 131 ReSideRdrLeDetn198RdrDetnAmbigState "Dection ambiguous status";
CM_ SG_ 131 ReSideRdrLeDetn198RdrDetnAssoTrkID "Associated tracker ID
";
CM_ SG_ 131 ReSideRdrLeDetn198RdrDetnAzi "Refer to the data element description in ReSideRdrLeDetn1 with the same data element name";
CM_ SG_ 131 ReSideRdrLeDetn198RdrDetnChks "Refer to the data element description in ReSideRdrLeDetn1 with the same data element name";
CM_ SG_ 131 ReSideRdrLeDetn198RdrDetnCntr "Refer to the data element description in ReSideRdrLeDetn1 with the same data element name";
CM_ SG_ 131 ReSideRdrLeDetn198RdrDetnConf "Refer to the data element description in ReSideRdrLeDetn1 with the same data element name";
CM_ SG_ 131 ReSideRdrLeDetn198RdrDetnElevn "Refer to the data element description in ReSideRdrLeDetn1 with the same data element name";
CM_ SG_ 131 ReSideRdrLeDetn198RdrDetnPwr "Refer to the data element description in ReSideRdrLeDetn1 with the same data element name";
CM_ SG_ 131 ReSideRdrLeDetn198RdrDetnRng "Refer to the data element description in ReSideRdrLeDetn1 with the same data element name";
CM_ SG_ 131 ReSideRdrLeDetn198RdrDetnRngV "Range Velocity";
CM_ SG_ 131 ReSideRdrLeDetn198RdrDetnSameRV "object with same distance and speed";
CM_ SG_ 131 ReSideRdrLeDetn198RdrDetnSts "Refer to the data element description in ReSideRdrLeDetn1 with the same data element name";
CM_ SG_ 132 ReSideRdrLeDetn199RdrDetnAmbigState "Dection ambiguous status";
CM_ SG_ 132 ReSideRdrLeDetn199RdrDetnAssoTrkID "Associated tracker ID
";
CM_ SG_ 132 ReSideRdrLeDetn199RdrDetnAzi "Refer to the data element description in ReSideRdrLeDetn1 with the same data element name";
CM_ SG_ 132 ReSideRdrLeDetn199RdrDetnChks "Refer to the data element description in ReSideRdrLeDetn1 with the same data element name";
CM_ SG_ 132 ReSideRdrLeDetn199RdrDetnCntr "Refer to the data element description in ReSideRdrLeDetn1 with the same data element name";
CM_ SG_ 132 ReSideRdrLeDetn199RdrDetnConf "Refer to the data element description in ReSideRdrLeDetn1 with the same data element name";
CM_ SG_ 132 ReSideRdrLeDetn199RdrDetnElevn "Refer to the data element description in ReSideRdrLeDetn1 with the same data element name";
CM_ SG_ 132 ReSideRdrLeDetn199RdrDetnPwr "Refer to the data element description in ReSideRdrLeDetn1 with the same data element name";
CM_ SG_ 132 ReSideRdrLeDetn199RdrDetnRng "Refer to the data element description in ReSideRdrLeDetn1 with the same data element name";
CM_ SG_ 132 ReSideRdrLeDetn199RdrDetnRngV "Range Velocity";
CM_ SG_ 132 ReSideRdrLeDetn199RdrDetnSameRV "object with same distance and speed";
CM_ SG_ 132 ReSideRdrLeDetn199RdrDetnSts "Refer to the data element description in ReSideRdrLeDetn1 with the same data element name";
CM_ SG_ 132 ReSideRdrLeDetn200RdrDetnAmbigState "Dection ambiguous status";
CM_ SG_ 132 ReSideRdrLeDetn200RdrDetnAssoTrkID "Associated tracker ID
";
CM_ SG_ 132 ReSideRdrLeDetn200RdrDetnAzi "Refer to the data element description in ReSideRdrLeDetn1 with the same data element name";
CM_ SG_ 132 ReSideRdrLeDetn200RdrDetnChks "Refer to the data element description in ReSideRdrLeDetn1 with the same data element name";
CM_ SG_ 132 ReSideRdrLeDetn200RdrDetnCntr "Refer to the data element description in ReSideRdrLeDetn1 with the same data element name";
CM_ SG_ 132 ReSideRdrLeDetn200RdrDetnConf "Refer to the data element description in ReSideRdrLeDetn1 with the same data element name";
CM_ SG_ 132 ReSideRdrLeDetn200RdrDetnElevn "Refer to the data element description in ReSideRdrLeDetn1 with the same data element name";
CM_ SG_ 132 ReSideRdrLeDetn200RdrDetnPwr "Refer to the data element description in ReSideRdrLeDetn1 with the same data element name";
CM_ SG_ 132 ReSideRdrLeDetn200RdrDetnRng "Refer to the data element description in ReSideRdrLeDetn1 with the same data element name";
CM_ SG_ 132 ReSideRdrLeDetn200RdrDetnRngV "Range Velocity";
CM_ SG_ 132 ReSideRdrLeDetn200RdrDetnSameRV "object with same distance and speed";
CM_ SG_ 132 ReSideRdrLeDetn200RdrDetnSts "Refer to the data element description in ReSideRdrLeDetn1 with the same data element name";
CM_ SG_ 132 ReSideRdrLeDetn201RdrDetnAmbigState "Dection ambiguous status";
CM_ SG_ 132 ReSideRdrLeDetn201RdrDetnAssoTrkID "Associated tracker ID
";
CM_ SG_ 132 ReSideRdrLeDetn201RdrDetnAzi "Refer to the data element description in ReSideRdrLeDetn1 with the same data element name";
CM_ SG_ 132 ReSideRdrLeDetn201RdrDetnChks "Refer to the data element description in ReSideRdrLeDetn1 with the same data element name";
CM_ SG_ 132 ReSideRdrLeDetn201RdrDetnCntr "Refer to the data element description in ReSideRdrLeDetn1 with the same data element name";
CM_ SG_ 132 ReSideRdrLeDetn201RdrDetnConf "Refer to the data element description in ReSideRdrLeDetn1 with the same data element name";
CM_ SG_ 132 ReSideRdrLeDetn201RdrDetnElevn "Refer to the data element description in ReSideRdrLeDetn1 with the same data element name";
CM_ SG_ 132 ReSideRdrLeDetn201RdrDetnPwr "Refer to the data element description in ReSideRdrLeDetn1 with the same data element name";
CM_ SG_ 132 ReSideRdrLeDetn201RdrDetnRng "Refer to the data element description in ReSideRdrLeDetn1 with the same data element name";
CM_ SG_ 132 ReSideRdrLeDetn201RdrDetnRngV "Range Velocity";
CM_ SG_ 132 ReSideRdrLeDetn201RdrDetnSameRV "object with same distance and speed";
CM_ SG_ 132 ReSideRdrLeDetn201RdrDetnSts "Refer to the data element description in ReSideRdrLeDetn1 with the same data element name";
CM_ SG_ 132 ReSideRdrLeDetn202RdrDetnAmbigState "Dection ambiguous status";
CM_ SG_ 132 ReSideRdrLeDetn202RdrDetnAssoTrkID "Associated tracker ID
";
CM_ SG_ 132 ReSideRdrLeDetn202RdrDetnAzi "Refer to the data element description in ReSideRdrLeDetn1 with the same data element name";
CM_ SG_ 132 ReSideRdrLeDetn202RdrDetnChks "Refer to the data element description in ReSideRdrLeDetn1 with the same data element name";
CM_ SG_ 132 ReSideRdrLeDetn202RdrDetnCntr "Refer to the data element description in ReSideRdrLeDetn1 with the same data element name";
CM_ SG_ 132 ReSideRdrLeDetn202RdrDetnConf "Refer to the data element description in ReSideRdrLeDetn1 with the same data element name";
CM_ SG_ 132 ReSideRdrLeDetn202RdrDetnElevn "Refer to the data element description in ReSideRdrLeDetn1 with the same data element name";
CM_ SG_ 132 ReSideRdrLeDetn202RdrDetnPwr "Refer to the data element description in ReSideRdrLeDetn1 with the same data element name";
CM_ SG_ 132 ReSideRdrLeDetn202RdrDetnRng "Refer to the data element description in ReSideRdrLeDetn1 with the same data element name";
CM_ SG_ 132 ReSideRdrLeDetn202RdrDetnRngV "Range Velocity";
CM_ SG_ 132 ReSideRdrLeDetn202RdrDetnSameRV "object with same distance and speed";
CM_ SG_ 132 ReSideRdrLeDetn202RdrDetnSts "Refer to the data element description in ReSideRdrLeDetn1 with the same data element name";
CM_ SG_ 132 ReSideRdrLeDetn203RdrDetnAmbigState "Dection ambiguous status";
CM_ SG_ 132 ReSideRdrLeDetn203RdrDetnAssoTrkID "Associated tracker ID
";
CM_ SG_ 132 ReSideRdrLeDetn203RdrDetnAzi "Refer to the data element description in ReSideRdrLeDetn1 with the same data element name";
CM_ SG_ 132 ReSideRdrLeDetn203RdrDetnChks "Refer to the data element description in ReSideRdrLeDetn1 with the same data element name";
CM_ SG_ 132 ReSideRdrLeDetn203RdrDetnCntr "Refer to the data element description in ReSideRdrLeDetn1 with the same data element name";
CM_ SG_ 132 ReSideRdrLeDetn203RdrDetnConf "Refer to the data element description in ReSideRdrLeDetn1 with the same data element name";
CM_ SG_ 132 ReSideRdrLeDetn203RdrDetnElevn "Refer to the data element description in ReSideRdrLeDetn1 with the same data element name";
CM_ SG_ 132 ReSideRdrLeDetn203RdrDetnPwr "Refer to the data element description in ReSideRdrLeDetn1 with the same data element name";
CM_ SG_ 132 ReSideRdrLeDetn203RdrDetnRng "Refer to the data element description in ReSideRdrLeDetn1 with the same data element name";
CM_ SG_ 132 ReSideRdrLeDetn203RdrDetnRngV "Range Velocity";
CM_ SG_ 132 ReSideRdrLeDetn203RdrDetnSameRV "object with same distance and speed";
CM_ SG_ 132 ReSideRdrLeDetn203RdrDetnSts "Refer to the data element description in ReSideRdrLeDetn1 with the same data element name";
CM_ SG_ 132 ReSideRdrLeDetn204RdrDetnAmbigState "Dection ambiguous status";
CM_ SG_ 132 ReSideRdrLeDetn204RdrDetnAssoTrkID "Associated tracker ID
";
CM_ SG_ 132 ReSideRdrLeDetn204RdrDetnAzi "Refer to the data element description in ReSideRdrLeDetn1 with the same data element name";
CM_ SG_ 132 ReSideRdrLeDetn204RdrDetnChks "Refer to the data element description in ReSideRdrLeDetn1 with the same data element name";
CM_ SG_ 132 ReSideRdrLeDetn204RdrDetnCntr "Refer to the data element description in ReSideRdrLeDetn1 with the same data element name";
CM_ SG_ 132 ReSideRdrLeDetn204RdrDetnConf "Refer to the data element description in ReSideRdrLeDetn1 with the same data element name";
CM_ SG_ 132 ReSideRdrLeDetn204RdrDetnElevn "Refer to the data element description in ReSideRdrLeDetn1 with the same data element name";
CM_ SG_ 132 ReSideRdrLeDetn204RdrDetnPwr "Refer to the data element description in ReSideRdrLeDetn1 with the same data element name";
CM_ SG_ 132 ReSideRdrLeDetn204RdrDetnRng "Refer to the data element description in ReSideRdrLeDetn1 with the same data element name";
CM_ SG_ 132 ReSideRdrLeDetn204RdrDetnRngV "Range Velocity";
CM_ SG_ 132 ReSideRdrLeDetn204RdrDetnSameRV "object with same distance and speed";
CM_ SG_ 132 ReSideRdrLeDetn204RdrDetnSts "Refer to the data element description in ReSideRdrLeDetn1 with the same data element name";
CM_ SG_ 133 ReSideRdrLeDetn205RdrDetnAmbigState "Dection ambiguous status";
CM_ SG_ 133 ReSideRdrLeDetn205RdrDetnAssoTrkID "Associated tracker ID
";
CM_ SG_ 133 ReSideRdrLeDetn205RdrDetnAzi "Refer to the data element description in ReSideRdrLeDetn1 with the same data element name";
CM_ SG_ 133 ReSideRdrLeDetn205RdrDetnChks "Refer to the data element description in ReSideRdrLeDetn1 with the same data element name";
CM_ SG_ 133 ReSideRdrLeDetn205RdrDetnCntr "Refer to the data element description in ReSideRdrLeDetn1 with the same data element name";
CM_ SG_ 133 ReSideRdrLeDetn205RdrDetnConf "Refer to the data element description in ReSideRdrLeDetn1 with the same data element name";
CM_ SG_ 133 ReSideRdrLeDetn205RdrDetnElevn "Refer to the data element description in ReSideRdrLeDetn1 with the same data element name";
CM_ SG_ 133 ReSideRdrLeDetn205RdrDetnPwr "Refer to the data element description in ReSideRdrLeDetn1 with the same data element name";
CM_ SG_ 133 ReSideRdrLeDetn205RdrDetnRng "Refer to the data element description in ReSideRdrLeDetn1 with the same data element name";
CM_ SG_ 133 ReSideRdrLeDetn205RdrDetnRngV "Range Velocity";
CM_ SG_ 133 ReSideRdrLeDetn205RdrDetnSameRV "object with same distance and speed";
CM_ SG_ 133 ReSideRdrLeDetn205RdrDetnSts "Refer to the data element description in ReSideRdrLeDetn1 with the same data element name";
CM_ SG_ 133 ReSideRdrLeDetn206RdrDetnAmbigState "Dection ambiguous status";
CM_ SG_ 133 ReSideRdrLeDetn206RdrDetnAssoTrkID "Associated tracker ID
";
CM_ SG_ 133 ReSideRdrLeDetn206RdrDetnAzi "Refer to the data element description in ReSideRdrLeDetn1 with the same data element name";
CM_ SG_ 133 ReSideRdrLeDetn206RdrDetnChks "Refer to the data element description in ReSideRdrLeDetn1 with the same data element name";
CM_ SG_ 133 ReSideRdrLeDetn206RdrDetnCntr "Refer to the data element description in ReSideRdrLeDetn1 with the same data element name";
CM_ SG_ 133 ReSideRdrLeDetn206RdrDetnConf "Refer to the data element description in ReSideRdrLeDetn1 with the same data element name";
CM_ SG_ 133 ReSideRdrLeDetn206RdrDetnElevn "Refer to the data element description in ReSideRdrLeDetn1 with the same data element name";
CM_ SG_ 133 ReSideRdrLeDetn206RdrDetnPwr "Refer to the data element description in ReSideRdrLeDetn1 with the same data element name";
CM_ SG_ 133 ReSideRdrLeDetn206RdrDetnRng "Refer to the data element description in ReSideRdrLeDetn1 with the same data element name";
CM_ SG_ 133 ReSideRdrLeDetn206RdrDetnRngV "Range Velocity";
CM_ SG_ 133 ReSideRdrLeDetn206RdrDetnSameRV "object with same distance and speed";
CM_ SG_ 133 ReSideRdrLeDetn206RdrDetnSts "Refer to the data element description in ReSideRdrLeDetn1 with the same data element name";
CM_ SG_ 133 ReSideRdrLeDetn207RdrDetnAmbigState "Dection ambiguous status";
CM_ SG_ 133 ReSideRdrLeDetn207RdrDetnAssoTrkID "Associated tracker ID
";
CM_ SG_ 133 ReSideRdrLeDetn207RdrDetnAzi "Refer to the data element description in ReSideRdrLeDetn1 with the same data element name";
CM_ SG_ 133 ReSideRdrLeDetn207RdrDetnChks "Refer to the data element description in ReSideRdrLeDetn1 with the same data element name";
CM_ SG_ 133 ReSideRdrLeDetn207RdrDetnCntr "Refer to the data element description in ReSideRdrLeDetn1 with the same data element name";
CM_ SG_ 133 ReSideRdrLeDetn207RdrDetnConf "Refer to the data element description in ReSideRdrLeDetn1 with the same data element name";
CM_ SG_ 133 ReSideRdrLeDetn207RdrDetnElevn "Refer to the data element description in ReSideRdrLeDetn1 with the same data element name";
CM_ SG_ 133 ReSideRdrLeDetn207RdrDetnPwr "Refer to the data element description in ReSideRdrLeDetn1 with the same data element name";
CM_ SG_ 133 ReSideRdrLeDetn207RdrDetnRng "Refer to the data element description in ReSideRdrLeDetn1 with the same data element name";
CM_ SG_ 133 ReSideRdrLeDetn207RdrDetnRngV "Range Velocity";
CM_ SG_ 133 ReSideRdrLeDetn207RdrDetnSameRV "object with same distance and speed";
CM_ SG_ 133 ReSideRdrLeDetn207RdrDetnSts "Refer to the data element description in ReSideRdrLeDetn1 with the same data element name";
CM_ SG_ 133 ReSideRdrLeDetn208RdrDetnAmbigState "Dection ambiguous status";
CM_ SG_ 133 ReSideRdrLeDetn208RdrDetnAssoTrkID "Associated tracker ID
";
CM_ SG_ 133 ReSideRdrLeDetn208RdrDetnAzi "Refer to the data element description in ReSideRdrLeDetn1 with the same data element name";
CM_ SG_ 133 ReSideRdrLeDetn208RdrDetnChks "Refer to the data element description in ReSideRdrLeDetn1 with the same data element name";
CM_ SG_ 133 ReSideRdrLeDetn208RdrDetnCntr "Refer to the data element description in ReSideRdrLeDetn1 with the same data element name";
CM_ SG_ 133 ReSideRdrLeDetn208RdrDetnConf "Refer to the data element description in ReSideRdrLeDetn1 with the same data element name";
CM_ SG_ 133 ReSideRdrLeDetn208RdrDetnElevn "Refer to the data element description in ReSideRdrLeDetn1 with the same data element name";
CM_ SG_ 133 ReSideRdrLeDetn208RdrDetnPwr "Refer to the data element description in ReSideRdrLeDetn1 with the same data element name";
CM_ SG_ 133 ReSideRdrLeDetn208RdrDetnRng "Refer to the data element description in ReSideRdrLeDetn1 with the same data element name";
CM_ SG_ 133 ReSideRdrLeDetn208RdrDetnRngV "Range Velocity";
CM_ SG_ 133 ReSideRdrLeDetn208RdrDetnSameRV "object with same distance and speed";
CM_ SG_ 133 ReSideRdrLeDetn208RdrDetnSts "Refer to the data element description in ReSideRdrLeDetn1 with the same data element name";
CM_ SG_ 133 ReSideRdrLeDetn209RdrDetnAmbigState "Dection ambiguous status";
CM_ SG_ 133 ReSideRdrLeDetn209RdrDetnAssoTrkID "Associated tracker ID
";
CM_ SG_ 133 ReSideRdrLeDetn209RdrDetnAzi "Refer to the data element description in ReSideRdrLeDetn1 with the same data element name";
CM_ SG_ 133 ReSideRdrLeDetn209RdrDetnChks "Refer to the data element description in ReSideRdrLeDetn1 with the same data element name";
CM_ SG_ 133 ReSideRdrLeDetn209RdrDetnCntr "Refer to the data element description in ReSideRdrLeDetn1 with the same data element name";
CM_ SG_ 133 ReSideRdrLeDetn209RdrDetnConf "Refer to the data element description in ReSideRdrLeDetn1 with the same data element name";
CM_ SG_ 133 ReSideRdrLeDetn209RdrDetnElevn "Refer to the data element description in ReSideRdrLeDetn1 with the same data element name";
CM_ SG_ 133 ReSideRdrLeDetn209RdrDetnPwr "Refer to the data element description in ReSideRdrLeDetn1 with the same data element name";
CM_ SG_ 133 ReSideRdrLeDetn209RdrDetnRng "Refer to the data element description in ReSideRdrLeDetn1 with the same data element name";
CM_ SG_ 133 ReSideRdrLeDetn209RdrDetnRngV "Range Velocity";
CM_ SG_ 133 ReSideRdrLeDetn209RdrDetnSameRV "object with same distance and speed";
CM_ SG_ 133 ReSideRdrLeDetn209RdrDetnSts "Refer to the data element description in ReSideRdrLeDetn1 with the same data element name";
CM_ SG_ 133 ReSideRdrLeDetn210RdrDetnAmbigState "Dection ambiguous status";
CM_ SG_ 133 ReSideRdrLeDetn210RdrDetnAssoTrkID "Associated tracker ID
";
CM_ SG_ 133 ReSideRdrLeDetn210RdrDetnAzi "Refer to the data element description in ReSideRdrLeDetn1 with the same data element name";
CM_ SG_ 133 ReSideRdrLeDetn210RdrDetnChks "Refer to the data element description in ReSideRdrLeDetn1 with the same data element name";
CM_ SG_ 133 ReSideRdrLeDetn210RdrDetnCntr "Refer to the data element description in ReSideRdrLeDetn1 with the same data element name";
CM_ SG_ 133 ReSideRdrLeDetn210RdrDetnConf "Refer to the data element description in ReSideRdrLeDetn1 with the same data element name";
CM_ SG_ 133 ReSideRdrLeDetn210RdrDetnElevn "Refer to the data element description in ReSideRdrLeDetn1 with the same data element name";
CM_ SG_ 133 ReSideRdrLeDetn210RdrDetnPwr "Refer to the data element description in ReSideRdrLeDetn1 with the same data element name";
CM_ SG_ 133 ReSideRdrLeDetn210RdrDetnRng "Refer to the data element description in ReSideRdrLeDetn1 with the same data element name";
CM_ SG_ 133 ReSideRdrLeDetn210RdrDetnRngV "Range Velocity";
CM_ SG_ 133 ReSideRdrLeDetn210RdrDetnSameRV "object with same distance and speed";
CM_ SG_ 133 ReSideRdrLeDetn210RdrDetnSts "Refer to the data element description in ReSideRdrLeDetn1 with the same data element name";
CM_ SG_ 134 ReSideRdrLeDetn211RdrDetnAmbigState "Dection ambiguous status";
CM_ SG_ 134 ReSideRdrLeDetn211RdrDetnAssoTrkID "Associated tracker ID
";
CM_ SG_ 134 ReSideRdrLeDetn211RdrDetnAzi "Refer to the data element description in ReSideRdrLeDetn1 with the same data element name";
CM_ SG_ 134 ReSideRdrLeDetn211RdrDetnChks "Refer to the data element description in ReSideRdrLeDetn1 with the same data element name";
CM_ SG_ 134 ReSideRdrLeDetn211RdrDetnCntr "Refer to the data element description in ReSideRdrLeDetn1 with the same data element name";
CM_ SG_ 134 ReSideRdrLeDetn211RdrDetnConf "Refer to the data element description in ReSideRdrLeDetn1 with the same data element name";
CM_ SG_ 134 ReSideRdrLeDetn211RdrDetnElevn "Refer to the data element description in ReSideRdrLeDetn1 with the same data element name";
CM_ SG_ 134 ReSideRdrLeDetn211RdrDetnPwr "Refer to the data element description in ReSideRdrLeDetn1 with the same data element name";
CM_ SG_ 134 ReSideRdrLeDetn211RdrDetnRng "Refer to the data element description in ReSideRdrLeDetn1 with the same data element name";
CM_ SG_ 134 ReSideRdrLeDetn211RdrDetnRngV "Range Velocity";
CM_ SG_ 134 ReSideRdrLeDetn211RdrDetnSameRV "object with same distance and speed";
CM_ SG_ 134 ReSideRdrLeDetn211RdrDetnSts "Refer to the data element description in ReSideRdrLeDetn1 with the same data element name";
CM_ SG_ 134 ReSideRdrLeDetn212RdrDetnAmbigState "Dection ambiguous status";
CM_ SG_ 134 ReSideRdrLeDetn212RdrDetnAssoTrkID "Associated tracker ID
";
CM_ SG_ 134 ReSideRdrLeDetn212RdrDetnAzi "Refer to the data element description in ReSideRdrLeDetn1 with the same data element name";
CM_ SG_ 134 ReSideRdrLeDetn212RdrDetnChks "Refer to the data element description in ReSideRdrLeDetn1 with the same data element name";
CM_ SG_ 134 ReSideRdrLeDetn212RdrDetnCntr "Refer to the data element description in ReSideRdrLeDetn1 with the same data element name";
CM_ SG_ 134 ReSideRdrLeDetn212RdrDetnConf "Refer to the data element description in ReSideRdrLeDetn1 with the same data element name";
CM_ SG_ 134 ReSideRdrLeDetn212RdrDetnElevn "Refer to the data element description in ReSideRdrLeDetn1 with the same data element name";
CM_ SG_ 134 ReSideRdrLeDetn212RdrDetnPwr "Refer to the data element description in ReSideRdrLeDetn1 with the same data element name";
CM_ SG_ 134 ReSideRdrLeDetn212RdrDetnRng "Refer to the data element description in ReSideRdrLeDetn1 with the same data element name";
CM_ SG_ 134 ReSideRdrLeDetn212RdrDetnRngV "Range Velocity";
CM_ SG_ 134 ReSideRdrLeDetn212RdrDetnSameRV "object with same distance and speed";
CM_ SG_ 134 ReSideRdrLeDetn212RdrDetnSts "Refer to the data element description in ReSideRdrLeDetn1 with the same data element name";
CM_ SG_ 134 ReSideRdrLeDetn213RdrDetnAmbigState "Dection ambiguous status";
CM_ SG_ 134 ReSideRdrLeDetn213RdrDetnAssoTrkID "Associated tracker ID
";
CM_ SG_ 134 ReSideRdrLeDetn213RdrDetnAzi "Refer to the data element description in ReSideRdrLeDetn1 with the same data element name";
CM_ SG_ 134 ReSideRdrLeDetn213RdrDetnChks "Refer to the data element description in ReSideRdrLeDetn1 with the same data element name";
CM_ SG_ 134 ReSideRdrLeDetn213RdrDetnCntr "Refer to the data element description in ReSideRdrLeDetn1 with the same data element name";
CM_ SG_ 134 ReSideRdrLeDetn213RdrDetnConf "Refer to the data element description in ReSideRdrLeDetn1 with the same data element name";
CM_ SG_ 134 ReSideRdrLeDetn213RdrDetnElevn "Refer to the data element description in ReSideRdrLeDetn1 with the same data element name";
CM_ SG_ 134 ReSideRdrLeDetn213RdrDetnPwr "Refer to the data element description in ReSideRdrLeDetn1 with the same data element name";
CM_ SG_ 134 ReSideRdrLeDetn213RdrDetnRng "Refer to the data element description in ReSideRdrLeDetn1 with the same data element name";
CM_ SG_ 134 ReSideRdrLeDetn213RdrDetnRngV "Range Velocity";
CM_ SG_ 134 ReSideRdrLeDetn213RdrDetnSameRV "object with same distance and speed";
CM_ SG_ 134 ReSideRdrLeDetn213RdrDetnSts "Refer to the data element description in ReSideRdrLeDetn1 with the same data element name";
CM_ SG_ 134 ReSideRdrLeDetn214RdrDetnAmbigState "Dection ambiguous status";
CM_ SG_ 134 ReSideRdrLeDetn214RdrDetnAssoTrkID "Associated tracker ID
";
CM_ SG_ 134 ReSideRdrLeDetn214RdrDetnAzi "Refer to the data element description in ReSideRdrLeDetn1 with the same data element name";
CM_ SG_ 134 ReSideRdrLeDetn214RdrDetnChks "Refer to the data element description in ReSideRdrLeDetn1 with the same data element name";
CM_ SG_ 134 ReSideRdrLeDetn214RdrDetnCntr "Refer to the data element description in ReSideRdrLeDetn1 with the same data element name";
CM_ SG_ 134 ReSideRdrLeDetn214RdrDetnConf "Refer to the data element description in ReSideRdrLeDetn1 with the same data element name";
CM_ SG_ 134 ReSideRdrLeDetn214RdrDetnElevn "Refer to the data element description in ReSideRdrLeDetn1 with the same data element name";
CM_ SG_ 134 ReSideRdrLeDetn214RdrDetnPwr "Refer to the data element description in ReSideRdrLeDetn1 with the same data element name";
CM_ SG_ 134 ReSideRdrLeDetn214RdrDetnRng "Refer to the data element description in ReSideRdrLeDetn1 with the same data element name";
CM_ SG_ 134 ReSideRdrLeDetn214RdrDetnRngV "Range Velocity";
CM_ SG_ 134 ReSideRdrLeDetn214RdrDetnSameRV "object with same distance and speed";
CM_ SG_ 134 ReSideRdrLeDetn214RdrDetnSts "Refer to the data element description in ReSideRdrLeDetn1 with the same data element name";
CM_ SG_ 134 ReSideRdrLeDetn215RdrDetnAmbigState "Dection ambiguous status";
CM_ SG_ 134 ReSideRdrLeDetn215RdrDetnAssoTrkID "Associated tracker ID
";
CM_ SG_ 134 ReSideRdrLeDetn215RdrDetnAzi "Refer to the data element description in ReSideRdrLeDetn1 with the same data element name";
CM_ SG_ 134 ReSideRdrLeDetn215RdrDetnChks "Refer to the data element description in ReSideRdrLeDetn1 with the same data element name";
CM_ SG_ 134 ReSideRdrLeDetn215RdrDetnCntr "Refer to the data element description in ReSideRdrLeDetn1 with the same data element name";
CM_ SG_ 134 ReSideRdrLeDetn215RdrDetnConf "Refer to the data element description in ReSideRdrLeDetn1 with the same data element name";
CM_ SG_ 134 ReSideRdrLeDetn215RdrDetnElevn "Refer to the data element description in ReSideRdrLeDetn1 with the same data element name";
CM_ SG_ 134 ReSideRdrLeDetn215RdrDetnPwr "Refer to the data element description in ReSideRdrLeDetn1 with the same data element name";
CM_ SG_ 134 ReSideRdrLeDetn215RdrDetnRng "Refer to the data element description in ReSideRdrLeDetn1 with the same data element name";
CM_ SG_ 134 ReSideRdrLeDetn215RdrDetnRngV "Range Velocity";
CM_ SG_ 134 ReSideRdrLeDetn215RdrDetnSameRV "object with same distance and speed";
CM_ SG_ 134 ReSideRdrLeDetn215RdrDetnSts "Refer to the data element description in ReSideRdrLeDetn1 with the same data element name";
CM_ SG_ 134 ReSideRdrLeDetn216RdrDetnAmbigState "Dection ambiguous status";
CM_ SG_ 134 ReSideRdrLeDetn216RdrDetnAssoTrkID "Associated tracker ID
";
CM_ SG_ 134 ReSideRdrLeDetn216RdrDetnAzi "Refer to the data element description in ReSideRdrLeDetn1 with the same data element name";
CM_ SG_ 134 ReSideRdrLeDetn216RdrDetnChks "Refer to the data element description in ReSideRdrLeDetn1 with the same data element name";
CM_ SG_ 134 ReSideRdrLeDetn216RdrDetnCntr "Refer to the data element description in ReSideRdrLeDetn1 with the same data element name";
CM_ SG_ 134 ReSideRdrLeDetn216RdrDetnConf "Refer to the data element description in ReSideRdrLeDetn1 with the same data element name";
CM_ SG_ 134 ReSideRdrLeDetn216RdrDetnElevn "Refer to the data element description in ReSideRdrLeDetn1 with the same data element name";
CM_ SG_ 134 ReSideRdrLeDetn216RdrDetnPwr "Refer to the data element description in ReSideRdrLeDetn1 with the same data element name";
CM_ SG_ 134 ReSideRdrLeDetn216RdrDetnRng "Refer to the data element description in ReSideRdrLeDetn1 with the same data element name";
CM_ SG_ 134 ReSideRdrLeDetn216RdrDetnRngV "Range Velocity";
CM_ SG_ 134 ReSideRdrLeDetn216RdrDetnSameRV "object with same distance and speed";
CM_ SG_ 134 ReSideRdrLeDetn216RdrDetnSts "Refer to the data element description in ReSideRdrLeDetn1 with the same data element name";
CM_ SG_ 135 ReSideRdrLeDetn217RdrDetnAmbigState "Dection ambiguous status";
CM_ SG_ 135 ReSideRdrLeDetn217RdrDetnAssoTrkID "Associated tracker ID
";
CM_ SG_ 135 ReSideRdrLeDetn217RdrDetnAzi "Refer to the data element description in ReSideRdrLeDetn1 with the same data element name";
CM_ SG_ 135 ReSideRdrLeDetn217RdrDetnChks "Refer to the data element description in ReSideRdrLeDetn1 with the same data element name";
CM_ SG_ 135 ReSideRdrLeDetn217RdrDetnCntr "Refer to the data element description in ReSideRdrLeDetn1 with the same data element name";
CM_ SG_ 135 ReSideRdrLeDetn217RdrDetnConf "Refer to the data element description in ReSideRdrLeDetn1 with the same data element name";
CM_ SG_ 135 ReSideRdrLeDetn217RdrDetnElevn "Refer to the data element description in ReSideRdrLeDetn1 with the same data element name";
CM_ SG_ 135 ReSideRdrLeDetn217RdrDetnPwr "Refer to the data element description in ReSideRdrLeDetn1 with the same data element name";
CM_ SG_ 135 ReSideRdrLeDetn217RdrDetnRng "Refer to the data element description in ReSideRdrLeDetn1 with the same data element name";
CM_ SG_ 135 ReSideRdrLeDetn217RdrDetnRngV "Range Velocity";
CM_ SG_ 135 ReSideRdrLeDetn217RdrDetnSameRV "object with same distance and speed";
CM_ SG_ 135 ReSideRdrLeDetn217RdrDetnSts "Refer to the data element description in ReSideRdrLeDetn1 with the same data element name";
CM_ SG_ 135 ReSideRdrLeDetn218RdrDetnAmbigState "Dection ambiguous status";
CM_ SG_ 135 ReSideRdrLeDetn218RdrDetnAssoTrkID "Associated tracker ID
";
CM_ SG_ 135 ReSideRdrLeDetn218RdrDetnAzi "Refer to the data element description in ReSideRdrLeDetn1 with the same data element name";
CM_ SG_ 135 ReSideRdrLeDetn218RdrDetnChks "Refer to the data element description in ReSideRdrLeDetn1 with the same data element name";
CM_ SG_ 135 ReSideRdrLeDetn218RdrDetnCntr "Refer to the data element description in ReSideRdrLeDetn1 with the same data element name";
CM_ SG_ 135 ReSideRdrLeDetn218RdrDetnConf "Refer to the data element description in ReSideRdrLeDetn1 with the same data element name";
CM_ SG_ 135 ReSideRdrLeDetn218RdrDetnElevn "Refer to the data element description in ReSideRdrLeDetn1 with the same data element name";
CM_ SG_ 135 ReSideRdrLeDetn218RdrDetnPwr "Refer to the data element description in ReSideRdrLeDetn1 with the same data element name";
CM_ SG_ 135 ReSideRdrLeDetn218RdrDetnRng "Refer to the data element description in ReSideRdrLeDetn1 with the same data element name";
CM_ SG_ 135 ReSideRdrLeDetn218RdrDetnRngV "Range Velocity";
CM_ SG_ 135 ReSideRdrLeDetn218RdrDetnSameRV "object with same distance and speed";
CM_ SG_ 135 ReSideRdrLeDetn218RdrDetnSts "Refer to the data element description in ReSideRdrLeDetn1 with the same data element name";
CM_ SG_ 135 ReSideRdrLeDetn219RdrDetnAmbigState "Dection ambiguous status";
CM_ SG_ 135 ReSideRdrLeDetn219RdrDetnAssoTrkID "Associated tracker ID
";
CM_ SG_ 135 ReSideRdrLeDetn219RdrDetnAzi "Refer to the data element description in ReSideRdrLeDetn1 with the same data element name";
CM_ SG_ 135 ReSideRdrLeDetn219RdrDetnChks "Refer to the data element description in ReSideRdrLeDetn1 with the same data element name";
CM_ SG_ 135 ReSideRdrLeDetn219RdrDetnCntr "Refer to the data element description in ReSideRdrLeDetn1 with the same data element name";
CM_ SG_ 135 ReSideRdrLeDetn219RdrDetnConf "Refer to the data element description in ReSideRdrLeDetn1 with the same data element name";
CM_ SG_ 135 ReSideRdrLeDetn219RdrDetnElevn "Refer to the data element description in ReSideRdrLeDetn1 with the same data element name";
CM_ SG_ 135 ReSideRdrLeDetn219RdrDetnPwr "Refer to the data element description in ReSideRdrLeDetn1 with the same data element name";
CM_ SG_ 135 ReSideRdrLeDetn219RdrDetnRng "Refer to the data element description in ReSideRdrLeDetn1 with the same data element name";
CM_ SG_ 135 ReSideRdrLeDetn219RdrDetnRngV "Range Velocity";
CM_ SG_ 135 ReSideRdrLeDetn219RdrDetnSameRV "object with same distance and speed";
CM_ SG_ 135 ReSideRdrLeDetn219RdrDetnSts "Refer to the data element description in ReSideRdrLeDetn1 with the same data element name";
CM_ SG_ 135 ReSideRdrLeDetn220RdrDetnAmbigState "Dection ambiguous status";
CM_ SG_ 135 ReSideRdrLeDetn220RdrDetnAssoTrkID "Associated tracker ID
";
CM_ SG_ 135 ReSideRdrLeDetn220RdrDetnAzi "Refer to the data element description in ReSideRdrLeDetn1 with the same data element name";
CM_ SG_ 135 ReSideRdrLeDetn220RdrDetnChks "Refer to the data element description in ReSideRdrLeDetn1 with the same data element name";
CM_ SG_ 135 ReSideRdrLeDetn220RdrDetnCntr "Refer to the data element description in ReSideRdrLeDetn1 with the same data element name";
CM_ SG_ 135 ReSideRdrLeDetn220RdrDetnConf "Refer to the data element description in ReSideRdrLeDetn1 with the same data element name";
CM_ SG_ 135 ReSideRdrLeDetn220RdrDetnElevn "Refer to the data element description in ReSideRdrLeDetn1 with the same data element name";
CM_ SG_ 135 ReSideRdrLeDetn220RdrDetnPwr "Refer to the data element description in ReSideRdrLeDetn1 with the same data element name";
CM_ SG_ 135 ReSideRdrLeDetn220RdrDetnRng "Refer to the data element description in ReSideRdrLeDetn1 with the same data element name";
CM_ SG_ 135 ReSideRdrLeDetn220RdrDetnRngV "Range Velocity";
CM_ SG_ 135 ReSideRdrLeDetn220RdrDetnSameRV "object with same distance and speed";
CM_ SG_ 135 ReSideRdrLeDetn220RdrDetnSts "Refer to the data element description in ReSideRdrLeDetn1 with the same data element name";
CM_ SG_ 135 ReSideRdrLeDetn221RdrDetnAmbigState "Dection ambiguous status";
CM_ SG_ 135 ReSideRdrLeDetn221RdrDetnAssoTrkID "Associated tracker ID
";
CM_ SG_ 135 ReSideRdrLeDetn221RdrDetnAzi "Refer to the data element description in ReSideRdrLeDetn1 with the same data element name";
CM_ SG_ 135 ReSideRdrLeDetn221RdrDetnChks "Refer to the data element description in ReSideRdrLeDetn1 with the same data element name";
CM_ SG_ 135 ReSideRdrLeDetn221RdrDetnCntr "Refer to the data element description in ReSideRdrLeDetn1 with the same data element name";
CM_ SG_ 135 ReSideRdrLeDetn221RdrDetnConf "Refer to the data element description in ReSideRdrLeDetn1 with the same data element name";
CM_ SG_ 135 ReSideRdrLeDetn221RdrDetnElevn "Refer to the data element description in ReSideRdrLeDetn1 with the same data element name";
CM_ SG_ 135 ReSideRdrLeDetn221RdrDetnPwr "Refer to the data element description in ReSideRdrLeDetn1 with the same data element name";
CM_ SG_ 135 ReSideRdrLeDetn221RdrDetnRng "Refer to the data element description in ReSideRdrLeDetn1 with the same data element name";
CM_ SG_ 135 ReSideRdrLeDetn221RdrDetnRngV "Range Velocity";
CM_ SG_ 135 ReSideRdrLeDetn221RdrDetnSameRV "object with same distance and speed";
CM_ SG_ 135 ReSideRdrLeDetn221RdrDetnSts "Refer to the data element description in ReSideRdrLeDetn1 with the same data element name";
CM_ SG_ 135 ReSideRdrLeDetn222RdrDetnAmbigState "Dection ambiguous status";
CM_ SG_ 135 ReSideRdrLeDetn222RdrDetnAssoTrkID "Associated tracker ID
";
CM_ SG_ 135 ReSideRdrLeDetn222RdrDetnAzi "Refer to the data element description in ReSideRdrLeDetn1 with the same data element name";
CM_ SG_ 135 ReSideRdrLeDetn222RdrDetnChks "Refer to the data element description in ReSideRdrLeDetn1 with the same data element name";
CM_ SG_ 135 ReSideRdrLeDetn222RdrDetnCntr "Refer to the data element description in ReSideRdrLeDetn1 with the same data element name";
CM_ SG_ 135 ReSideRdrLeDetn222RdrDetnConf "Refer to the data element description in ReSideRdrLeDetn1 with the same data element name";
CM_ SG_ 135 ReSideRdrLeDetn222RdrDetnElevn "Refer to the data element description in ReSideRdrLeDetn1 with the same data element name";
CM_ SG_ 135 ReSideRdrLeDetn222RdrDetnPwr "Refer to the data element description in ReSideRdrLeDetn1 with the same data element name";
CM_ SG_ 135 ReSideRdrLeDetn222RdrDetnRng "Refer to the data element description in ReSideRdrLeDetn1 with the same data element name";
CM_ SG_ 135 ReSideRdrLeDetn222RdrDetnRngV "Range Velocity";
CM_ SG_ 135 ReSideRdrLeDetn222RdrDetnSameRV "object with same distance and speed";
CM_ SG_ 135 ReSideRdrLeDetn222RdrDetnSts "Refer to the data element description in ReSideRdrLeDetn1 with the same data element name";
CM_ SG_ 136 ReSideRdrLeDetn223RdrDetnAmbigState "Dection ambiguous status";
CM_ SG_ 136 ReSideRdrLeDetn223RdrDetnAssoTrkID "Associated tracker ID
";
CM_ SG_ 136 ReSideRdrLeDetn223RdrDetnAzi "Refer to the data element description in ReSideRdrLeDetn1 with the same data element name";
CM_ SG_ 136 ReSideRdrLeDetn223RdrDetnChks "Refer to the data element description in ReSideRdrLeDetn1 with the same data element name";
CM_ SG_ 136 ReSideRdrLeDetn223RdrDetnCntr "Refer to the data element description in ReSideRdrLeDetn1 with the same data element name";
CM_ SG_ 136 ReSideRdrLeDetn223RdrDetnConf "Refer to the data element description in ReSideRdrLeDetn1 with the same data element name";
CM_ SG_ 136 ReSideRdrLeDetn223RdrDetnElevn "Refer to the data element description in ReSideRdrLeDetn1 with the same data element name";
CM_ SG_ 136 ReSideRdrLeDetn223RdrDetnPwr "Refer to the data element description in ReSideRdrLeDetn1 with the same data element name";
CM_ SG_ 136 ReSideRdrLeDetn223RdrDetnRng "Refer to the data element description in ReSideRdrLeDetn1 with the same data element name";
CM_ SG_ 136 ReSideRdrLeDetn223RdrDetnRngV "Range Velocity";
CM_ SG_ 136 ReSideRdrLeDetn223RdrDetnSameRV "object with same distance and speed";
CM_ SG_ 136 ReSideRdrLeDetn223RdrDetnSts "Refer to the data element description in ReSideRdrLeDetn1 with the same data element name";
CM_ SG_ 136 ReSideRdrLeDetn224RdrDetnAmbigState "Dection ambiguous status";
CM_ SG_ 136 ReSideRdrLeDetn224RdrDetnAssoTrkID "Associated tracker ID
";
CM_ SG_ 136 ReSideRdrLeDetn224RdrDetnAzi "Refer to the data element description in ReSideRdrLeDetn1 with the same data element name";
CM_ SG_ 136 ReSideRdrLeDetn224RdrDetnChks "Refer to the data element description in ReSideRdrLeDetn1 with the same data element name";
CM_ SG_ 136 ReSideRdrLeDetn224RdrDetnCntr "Refer to the data element description in ReSideRdrLeDetn1 with the same data element name";
CM_ SG_ 136 ReSideRdrLeDetn224RdrDetnConf "Refer to the data element description in ReSideRdrLeDetn1 with the same data element name";
CM_ SG_ 136 ReSideRdrLeDetn224RdrDetnElevn "Refer to the data element description in ReSideRdrLeDetn1 with the same data element name";
CM_ SG_ 136 ReSideRdrLeDetn224RdrDetnPwr "Refer to the data element description in ReSideRdrLeDetn1 with the same data element name";
CM_ SG_ 136 ReSideRdrLeDetn224RdrDetnRng "Refer to the data element description in ReSideRdrLeDetn1 with the same data element name";
CM_ SG_ 136 ReSideRdrLeDetn224RdrDetnRngV "Range Velocity";
CM_ SG_ 136 ReSideRdrLeDetn224RdrDetnSameRV "object with same distance and speed";
CM_ SG_ 136 ReSideRdrLeDetn224RdrDetnSts "Refer to the data element description in ReSideRdrLeDetn1 with the same data element name";
CM_ SG_ 136 ReSideRdrLeDetn225RdrDetnAmbigState "Dection ambiguous status";
CM_ SG_ 136 ReSideRdrLeDetn225RdrDetnAssoTrkID "Associated tracker ID
";
CM_ SG_ 136 ReSideRdrLeDetn225RdrDetnAzi "Refer to the data element description in ReSideRdrLeDetn1 with the same data element name";
CM_ SG_ 136 ReSideRdrLeDetn225RdrDetnChks "Refer to the data element description in ReSideRdrLeDetn1 with the same data element name";
CM_ SG_ 136 ReSideRdrLeDetn225RdrDetnCntr "Refer to the data element description in ReSideRdrLeDetn1 with the same data element name";
CM_ SG_ 136 ReSideRdrLeDetn225RdrDetnConf "Refer to the data element description in ReSideRdrLeDetn1 with the same data element name";
CM_ SG_ 136 ReSideRdrLeDetn225RdrDetnElevn "Refer to the data element description in ReSideRdrLeDetn1 with the same data element name";
CM_ SG_ 136 ReSideRdrLeDetn225RdrDetnPwr "Refer to the data element description in ReSideRdrLeDetn1 with the same data element name";
CM_ SG_ 136 ReSideRdrLeDetn225RdrDetnRng "Refer to the data element description in ReSideRdrLeDetn1 with the same data element name";
CM_ SG_ 136 ReSideRdrLeDetn225RdrDetnRngV "Range Velocity";
CM_ SG_ 136 ReSideRdrLeDetn225RdrDetnSameRV "object with same distance and speed";
CM_ SG_ 136 ReSideRdrLeDetn225RdrDetnSts "Refer to the data element description in ReSideRdrLeDetn1 with the same data element name";
CM_ SG_ 136 ReSideRdrLeDetn226RdrDetnAmbigState "Dection ambiguous status";
CM_ SG_ 136 ReSideRdrLeDetn226RdrDetnAssoTrkID "Associated tracker ID
";
CM_ SG_ 136 ReSideRdrLeDetn226RdrDetnAzi "Refer to the data element description in ReSideRdrLeDetn1 with the same data element name";
CM_ SG_ 136 ReSideRdrLeDetn226RdrDetnChks "Refer to the data element description in ReSideRdrLeDetn1 with the same data element name";
CM_ SG_ 136 ReSideRdrLeDetn226RdrDetnCntr "Refer to the data element description in ReSideRdrLeDetn1 with the same data element name";
CM_ SG_ 136 ReSideRdrLeDetn226RdrDetnConf "Refer to the data element description in ReSideRdrLeDetn1 with the same data element name";
CM_ SG_ 136 ReSideRdrLeDetn226RdrDetnElevn "Refer to the data element description in ReSideRdrLeDetn1 with the same data element name";
CM_ SG_ 136 ReSideRdrLeDetn226RdrDetnPwr "Refer to the data element description in ReSideRdrLeDetn1 with the same data element name";
CM_ SG_ 136 ReSideRdrLeDetn226RdrDetnRng "Refer to the data element description in ReSideRdrLeDetn1 with the same data element name";
CM_ SG_ 136 ReSideRdrLeDetn226RdrDetnRngV "Range Velocity";
CM_ SG_ 136 ReSideRdrLeDetn226RdrDetnSameRV "object with same distance and speed";
CM_ SG_ 136 ReSideRdrLeDetn226RdrDetnSts "Refer to the data element description in ReSideRdrLeDetn1 with the same data element name";
CM_ SG_ 136 ReSideRdrLeDetn227RdrDetnAmbigState "Dection ambiguous status";
CM_ SG_ 136 ReSideRdrLeDetn227RdrDetnAssoTrkID "Associated tracker ID
";
CM_ SG_ 136 ReSideRdrLeDetn227RdrDetnAzi "Refer to the data element description in ReSideRdrLeDetn1 with the same data element name";
CM_ SG_ 136 ReSideRdrLeDetn227RdrDetnChks "Refer to the data element description in ReSideRdrLeDetn1 with the same data element name";
CM_ SG_ 136 ReSideRdrLeDetn227RdrDetnCntr "Refer to the data element description in ReSideRdrLeDetn1 with the same data element name";
CM_ SG_ 136 ReSideRdrLeDetn227RdrDetnConf "Refer to the data element description in ReSideRdrLeDetn1 with the same data element name";
CM_ SG_ 136 ReSideRdrLeDetn227RdrDetnElevn "Refer to the data element description in ReSideRdrLeDetn1 with the same data element name";
CM_ SG_ 136 ReSideRdrLeDetn227RdrDetnPwr "Refer to the data element description in ReSideRdrLeDetn1 with the same data element name";
CM_ SG_ 136 ReSideRdrLeDetn227RdrDetnRng "Refer to the data element description in ReSideRdrLeDetn1 with the same data element name";
CM_ SG_ 136 ReSideRdrLeDetn227RdrDetnRngV "Range Velocity";
CM_ SG_ 136 ReSideRdrLeDetn227RdrDetnSameRV "object with same distance and speed";
CM_ SG_ 136 ReSideRdrLeDetn227RdrDetnSts "Refer to the data element description in ReSideRdrLeDetn1 with the same data element name";
CM_ SG_ 136 ReSideRdrLeDetn228RdrDetnAmbigState "Dection ambiguous status";
CM_ SG_ 136 ReSideRdrLeDetn228RdrDetnAssoTrkID "Associated tracker ID
";
CM_ SG_ 136 ReSideRdrLeDetn228RdrDetnAzi "Refer to the data element description in ReSideRdrLeDetn1 with the same data element name";
CM_ SG_ 136 ReSideRdrLeDetn228RdrDetnChks "Refer to the data element description in ReSideRdrLeDetn1 with the same data element name";
CM_ SG_ 136 ReSideRdrLeDetn228RdrDetnCntr "Refer to the data element description in ReSideRdrLeDetn1 with the same data element name";
CM_ SG_ 136 ReSideRdrLeDetn228RdrDetnConf "Refer to the data element description in ReSideRdrLeDetn1 with the same data element name";
CM_ SG_ 136 ReSideRdrLeDetn228RdrDetnElevn "Refer to the data element description in ReSideRdrLeDetn1 with the same data element name";
CM_ SG_ 136 ReSideRdrLeDetn228RdrDetnPwr "Refer to the data element description in ReSideRdrLeDetn1 with the same data element name";
CM_ SG_ 136 ReSideRdrLeDetn228RdrDetnRng "Refer to the data element description in ReSideRdrLeDetn1 with the same data element name";
CM_ SG_ 136 ReSideRdrLeDetn228RdrDetnRngV "Range Velocity";
CM_ SG_ 136 ReSideRdrLeDetn228RdrDetnSameRV "object with same distance and speed";
CM_ SG_ 136 ReSideRdrLeDetn228RdrDetnSts "Refer to the data element description in ReSideRdrLeDetn1 with the same data element name";
BA_DEF_ BO_ "CANFD_BRS" ENUM "0","1";
BA_DEF_ BO_ "GenMsgCycleTime" INT 0 65536; // [ms]
BA_DEF_ BO_ "GenMsgDelayTime" INT 0 65536; // [ms]
BA_DEF_ BO_ "GenMsgSendType" ENUM "cyclic", "spontaneous", "not-used", "not-used", "not-used", "cyclicAndSpontaneous", "not-used", "cyclicIfActive", "NoMsgSendType"; // [us]
BA_DEF_ BO_ "GenMsgStartDelayTime" INT 0 65536; // [ms]
BA_DEF_ BO_ "VFrameFormat" ENUM "StandardCAN","ExtendedCAN","reserved","J1939PG","reserved","reserved","reserved","reserved","reserved","reserved","reserved","reserved","reserved","reserved","StandardCAN_FD","ExtendedCAN_FD";
BA_DEF_ SG_ "GenSigSendType" ENUM "Cyclic","OnWrite","OnWriteWithRepetition","OnChange","OnChangeWithRepetition","IfActive","IfActiveWithRepetition","NoSigSendType";
BA_DEF_ SG_ "GenSigStartValue" HEX 0 80000000;
BA_DEF_ BO_ "GenMsgILSupport" ENUM "No","Yes";
BA_DEF_ BO_ "NmAsrMessage" ENUM "No","Yes";
BA_DEF_ SG_ "GenSigFuncType" ENUM "NoFunction","n/a","n/a","n/a","n/a","n/a","n/a","n/a","n/a","n/a","n/a","n/a","n/a","n/a","n/a","CHK","CNTR","n/a","n/a","n/a","CNTR_AR_01","CRC_AR_01_BOTH","CRC_AR_01_ALT","CRC_AR_01_LOW","CRC_AR_01_NIBBLE","CNTR_AR_04","CRC_AR_04A","CNTR_AR_05","CRC_AR_05";
BA_DEF_ SG_ "GenSigDataID" STRING;
BA_DEF_DEF_ "CANFD_BRS" "1";
BA_DEF_DEF_ "GenSigStartValue" 0;
BA_DEF_DEF_ "VFrameFormat" "J1939PG";
BA_DEF_DEF_ "GenSigSendType" "NoSigSendType";
BA_DEF_DEF_ "GenMsgCycleTime" 0;
BA_DEF_DEF_ "GenMsgDelayTime" 0;
BA_DEF_DEF_ "GenMsgStartDelayTime" 0;
BA_DEF_DEF_ "GenMsgSendType" "NoMsgSendType";
BA_DEF_DEF_ "GenMsgILSupport" "Yes";
BA_DEF_DEF_ "NmAsrMessage" "No";
BA_DEF_DEF_ "GenSigFuncType" "NoFunction";
BA_DEF_DEF_ "GenSigDataID" "";
// Frame: SODLPrivateCANFD5Fr66
BA_ "GenMsgCycleTime" BO_ 131 50 ;
BA_ "GenMsgSendType" BO_ 131 0;
BA_ "VFrameFormat" BO_ 131 14;
// Frame: SODLPrivateCANFD5Fr67
BA_ "GenMsgCycleTime" BO_ 132 50 ;
BA_ "GenMsgSendType" BO_ 132 0;
BA_ "VFrameFormat" BO_ 132 14;
// Frame: SODLPrivateCANFD5Fr68
BA_ "GenMsgCycleTime" BO_ 133 50 ;
BA_ "GenMsgSendType" BO_ 133 0;
BA_ "VFrameFormat" BO_ 133 14;
// Frame: SODLPrivateCANFD5Fr69
BA_ "GenMsgCycleTime" BO_ 134 50 ;
BA_ "GenMsgSendType" BO_ 134 0;
BA_ "VFrameFormat" BO_ 134 14;
// Frame: SODLPrivateCANFD5Fr70
BA_ "GenMsgCycleTime" BO_ 135 50 ;
BA_ "GenMsgSendType" BO_ 135 0;
BA_ "VFrameFormat" BO_ 135 14;
// Frame: SODLPrivateCANFD5Fr71
BA_ "GenMsgCycleTime" BO_ 136 50 ;
BA_ "GenMsgSendType" BO_ 136 0;
BA_ "VFrameFormat" BO_ 136 14;
BA_ "GenSigSendType" SG_ 131 ReSideRdrLeDetn193RdrDetnAmbigState 0;
BA_ "GenSigSendType" SG_ 131 ReSideRdrLeDetn193RdrDetnAssoTrkID 0;
BA_ "GenSigSendType" SG_ 131 ReSideRdrLeDetn193RdrDetnAzi 0;
BA_ "GenSigStartValue" SG_ 131 ReSideRdrLeDetn193RdrDetnAzi 900;
BA_ "GenSigDataID" SG_ 131 ReSideRdrLeDetn193RdrDetnChks "0x111D";
BA_ "GenSigFuncType" SG_ 131 ReSideRdrLeDetn193RdrDetnChks 15;
BA_ "GenSigSendType" SG_ 131 ReSideRdrLeDetn193RdrDetnChks 0;
BA_ "GenSigFuncType" SG_ 131 ReSideRdrLeDetn193RdrDetnCntr 16;
BA_ "GenSigSendType" SG_ 131 ReSideRdrLeDetn193RdrDetnCntr 0;
BA_ "GenSigSendType" SG_ 131 ReSideRdrLeDetn193RdrDetnConf 0;
BA_ "GenSigSendType" SG_ 131 ReSideRdrLeDetn193RdrDetnElevn 0;
BA_ "GenSigStartValue" SG_ 131 ReSideRdrLeDetn193RdrDetnElevn 15;
BA_ "GenSigSendType" SG_ 131 ReSideRdrLeDetn193RdrDetnPwr 0;
BA_ "GenSigSendType" SG_ 131 ReSideRdrLeDetn193RdrDetnRng 0;
BA_ "GenSigStartValue" SG_ 131 ReSideRdrLeDetn193RdrDetnRng 10050;
BA_ "GenSigSendType" SG_ 131 ReSideRdrLeDetn193RdrDetnRngV 0;
BA_ "GenSigStartValue" SG_ 131 ReSideRdrLeDetn193RdrDetnRngV 4000;
BA_ "GenSigSendType" SG_ 131 ReSideRdrLeDetn193RdrDetnSameRV 0;
BA_ "GenSigSendType" SG_ 131 ReSideRdrLeDetn193RdrDetnSts 0;
BA_ "GenSigStartValue" SG_ 131 ReSideRdrLeDetn193RdrDetnSts 3;
BA_ "GenSigSendType" SG_ 131 ReSideRdrLeDetn194RdrDetnAmbigState 0;
BA_ "GenSigSendType" SG_ 131 ReSideRdrLeDetn194RdrDetnAssoTrkID 0;
BA_ "GenSigSendType" SG_ 131 ReSideRdrLeDetn194RdrDetnAzi 0;
BA_ "GenSigStartValue" SG_ 131 ReSideRdrLeDetn194RdrDetnAzi 900;
BA_ "GenSigDataID" SG_ 131 ReSideRdrLeDetn194RdrDetnChks "0x111E";
BA_ "GenSigFuncType" SG_ 131 ReSideRdrLeDetn194RdrDetnChks 15;
BA_ "GenSigSendType" SG_ 131 ReSideRdrLeDetn194RdrDetnChks 0;
BA_ "GenSigFuncType" SG_ 131 ReSideRdrLeDetn194RdrDetnCntr 16;
BA_ "GenSigSendType" SG_ 131 ReSideRdrLeDetn194RdrDetnCntr 0;
BA_ "GenSigSendType" SG_ 131 ReSideRdrLeDetn194RdrDetnConf 0;
BA_ "GenSigSendType" SG_ 131 ReSideRdrLeDetn194RdrDetnElevn 0;
BA_ "GenSigStartValue" SG_ 131 ReSideRdrLeDetn194RdrDetnElevn 15;
BA_ "GenSigSendType" SG_ 131 ReSideRdrLeDetn194RdrDetnPwr 0;
BA_ "GenSigSendType" SG_ 131 ReSideRdrLeDetn194RdrDetnRng 0;
BA_ "GenSigStartValue" SG_ 131 ReSideRdrLeDetn194RdrDetnRng 10050;
BA_ "GenSigSendType" SG_ 131 ReSideRdrLeDetn194RdrDetnRngV 0;
BA_ "GenSigStartValue" SG_ 131 ReSideRdrLeDetn194RdrDetnRngV 4000;
BA_ "GenSigSendType" SG_ 131 ReSideRdrLeDetn194RdrDetnSameRV 0;
BA_ "GenSigSendType" SG_ 131 ReSideRdrLeDetn194RdrDetnSts 0;
BA_ "GenSigStartValue" SG_ 131 ReSideRdrLeDetn194RdrDetnSts 3;
BA_ "GenSigSendType" SG_ 131 ReSideRdrLeDetn195RdrDetnAmbigState 0;
BA_ "GenSigSendType" SG_ 131 ReSideRdrLeDetn195RdrDetnAssoTrkID 0;
BA_ "GenSigSendType" SG_ 131 ReSideRdrLeDetn195RdrDetnAzi 0;
BA_ "GenSigStartValue" SG_ 131 ReSideRdrLeDetn195RdrDetnAzi 900;
BA_ "GenSigDataID" SG_ 131 ReSideRdrLeDetn195RdrDetnChks "0x111F";
BA_ "GenSigFuncType" SG_ 131 ReSideRdrLeDetn195RdrDetnChks 15;
BA_ "GenSigSendType" SG_ 131 ReSideRdrLeDetn195RdrDetnChks 0;
BA_ "GenSigFuncType" SG_ 131 ReSideRdrLeDetn195RdrDetnCntr 16;
BA_ "GenSigSendType" SG_ 131 ReSideRdrLeDetn195RdrDetnCntr 0;
BA_ "GenSigSendType" SG_ 131 ReSideRdrLeDetn195RdrDetnConf 0;
BA_ "GenSigSendType" SG_ 131 ReSideRdrLeDetn195RdrDetnElevn 0;
BA_ "GenSigStartValue" SG_ 131 ReSideRdrLeDetn195RdrDetnElevn 15;
BA_ "GenSigSendType" SG_ 131 ReSideRdrLeDetn195RdrDetnPwr 0;
BA_ "GenSigSendType" SG_ 131 ReSideRdrLeDetn195RdrDetnRng 0;
BA_ "GenSigStartValue" SG_ 131 ReSideRdrLeDetn195RdrDetnRng 10050;
BA_ "GenSigSendType" SG_ 131 ReSideRdrLeDetn195RdrDetnRngV 0;
BA_ "GenSigStartValue" SG_ 131 ReSideRdrLeDetn195RdrDetnRngV 4000;
BA_ "GenSigSendType" SG_ 131 ReSideRdrLeDetn195RdrDetnSameRV 0;
BA_ "GenSigSendType" SG_ 131 ReSideRdrLeDetn195RdrDetnSts 0;
BA_ "GenSigStartValue" SG_ 131 ReSideRdrLeDetn195RdrDetnSts 3;
BA_ "GenSigSendType" SG_ 131 ReSideRdrLeDetn196RdrDetnAmbigState 0;
BA_ "GenSigSendType" SG_ 131 ReSideRdrLeDetn196RdrDetnAssoTrkID 0;
BA_ "GenSigSendType" SG_ 131 ReSideRdrLeDetn196RdrDetnAzi 0;
BA_ "GenSigStartValue" SG_ 131 ReSideRdrLeDetn196RdrDetnAzi 900;
BA_ "GenSigDataID" SG_ 131 ReSideRdrLeDetn196RdrDetnChks "0x1120";
BA_ "GenSigFuncType" SG_ 131 ReSideRdrLeDetn196RdrDetnChks 15;
BA_ "GenSigSendType" SG_ 131 ReSideRdrLeDetn196RdrDetnChks 0;
BA_ "GenSigFuncType" SG_ 131 ReSideRdrLeDetn196RdrDetnCntr 16;
BA_ "GenSigSendType" SG_ 131 ReSideRdrLeDetn196RdrDetnCntr 0;
BA_ "GenSigSendType" SG_ 131 ReSideRdrLeDetn196RdrDetnConf 0;
BA_ "GenSigSendType" SG_ 131 ReSideRdrLeDetn196RdrDetnElevn 0;
BA_ "GenSigStartValue" SG_ 131 ReSideRdrLeDetn196RdrDetnElevn 15;
BA_ "GenSigSendType" SG_ 131 ReSideRdrLeDetn196RdrDetnPwr 0;
BA_ "GenSigSendType" SG_ 131 ReSideRdrLeDetn196RdrDetnRng 0;
BA_ "GenSigStartValue" SG_ 131 ReSideRdrLeDetn196RdrDetnRng 10050;
BA_ "GenSigSendType" SG_ 131 ReSideRdrLeDetn196RdrDetnRngV 0;
BA_ "GenSigStartValue" SG_ 131 ReSideRdrLeDetn196RdrDetnRngV 4000;
BA_ "GenSigSendType" SG_ 131 ReSideRdrLeDetn196RdrDetnSameRV 0;
BA_ "GenSigSendType" SG_ 131 ReSideRdrLeDetn196RdrDetnSts 0;
BA_ "GenSigStartValue" SG_ 131 ReSideRdrLeDetn196RdrDetnSts 3;
BA_ "GenSigSendType" SG_ 131 ReSideRdrLeDetn197RdrDetnAmbigState 0;
BA_ "GenSigSendType" SG_ 131 ReSideRdrLeDetn197RdrDetnAssoTrkID 0;
BA_ "GenSigSendType" SG_ 131 ReSideRdrLeDetn197RdrDetnAzi 0;
BA_ "GenSigStartValue" SG_ 131 ReSideRdrLeDetn197RdrDetnAzi 900;
BA_ "GenSigDataID" SG_ 131 ReSideRdrLeDetn197RdrDetnChks "0x1121";
BA_ "GenSigFuncType" SG_ 131 ReSideRdrLeDetn197RdrDetnChks 15;
BA_ "GenSigSendType" SG_ 131 ReSideRdrLeDetn197RdrDetnChks 0;
BA_ "GenSigFuncType" SG_ 131 ReSideRdrLeDetn197RdrDetnCntr 16;
BA_ "GenSigSendType" SG_ 131 ReSideRdrLeDetn197RdrDetnCntr 0;
BA_ "GenSigSendType" SG_ 131 ReSideRdrLeDetn197RdrDetnConf 0;
BA_ "GenSigSendType" SG_ 131 ReSideRdrLeDetn197RdrDetnElevn 0;
BA_ "GenSigStartValue" SG_ 131 ReSideRdrLeDetn197RdrDetnElevn 15;
BA_ "GenSigSendType" SG_ 131 ReSideRdrLeDetn197RdrDetnPwr 0;
BA_ "GenSigSendType" SG_ 131 ReSideRdrLeDetn197RdrDetnRng 0;
BA_ "GenSigStartValue" SG_ 131 ReSideRdrLeDetn197RdrDetnRng 10050;
BA_ "GenSigSendType" SG_ 131 ReSideRdrLeDetn197RdrDetnRngV 0;
BA_ "GenSigStartValue" SG_ 131 ReSideRdrLeDetn197RdrDetnRngV 4000;
BA_ "GenSigSendType" SG_ 131 ReSideRdrLeDetn197RdrDetnSameRV 0;
BA_ "GenSigSendType" SG_ 131 ReSideRdrLeDetn197RdrDetnSts 0;
BA_ "GenSigStartValue" SG_ 131 ReSideRdrLeDetn197RdrDetnSts 3;
BA_ "GenSigSendType" SG_ 131 ReSideRdrLeDetn198RdrDetnAmbigState 0;
BA_ "GenSigSendType" SG_ 131 ReSideRdrLeDetn198RdrDetnAssoTrkID 0;
BA_ "GenSigSendType" SG_ 131 ReSideRdrLeDetn198RdrDetnAzi 0;
BA_ "GenSigStartValue" SG_ 131 ReSideRdrLeDetn198RdrDetnAzi 900;
BA_ "GenSigDataID" SG_ 131 ReSideRdrLeDetn198RdrDetnChks "0x1122";
BA_ "GenSigFuncType" SG_ 131 ReSideRdrLeDetn198RdrDetnChks 15;
BA_ "GenSigSendType" SG_ 131 ReSideRdrLeDetn198RdrDetnChks 0;
BA_ "GenSigFuncType" SG_ 131 ReSideRdrLeDetn198RdrDetnCntr 16;
BA_ "GenSigSendType" SG_ 131 ReSideRdrLeDetn198RdrDetnCntr 0;
BA_ "GenSigSendType" SG_ 131 ReSideRdrLeDetn198RdrDetnConf 0;
BA_ "GenSigSendType" SG_ 131 ReSideRdrLeDetn198RdrDetnElevn 0;
BA_ "GenSigStartValue" SG_ 131 ReSideRdrLeDetn198RdrDetnElevn 15;
BA_ "GenSigSendType" SG_ 131 ReSideRdrLeDetn198RdrDetnPwr 0;
BA_ "GenSigSendType" SG_ 131 ReSideRdrLeDetn198RdrDetnRng 0;
BA_ "GenSigStartValue" SG_ 131 ReSideRdrLeDetn198RdrDetnRng 10050;
BA_ "GenSigSendType" SG_ 131 ReSideRdrLeDetn198RdrDetnRngV 0;
BA_ "GenSigStartValue" SG_ 131 ReSideRdrLeDetn198RdrDetnRngV 4000;
BA_ "GenSigSendType" SG_ 131 ReSideRdrLeDetn198RdrDetnSameRV 0;
BA_ "GenSigSendType" SG_ 131 ReSideRdrLeDetn198RdrDetnSts 0;
BA_ "GenSigStartValue" SG_ 131 ReSideRdrLeDetn198RdrDetnSts 3;
BA_ "GenSigSendType" SG_ 132 ReSideRdrLeDetn199RdrDetnAmbigState 0;
BA_ "GenSigSendType" SG_ 132 ReSideRdrLeDetn199RdrDetnAssoTrkID 0;
BA_ "GenSigSendType" SG_ 132 ReSideRdrLeDetn199RdrDetnAzi 0;
BA_ "GenSigStartValue" SG_ 132 ReSideRdrLeDetn199RdrDetnAzi 900;
BA_ "GenSigDataID" SG_ 132 ReSideRdrLeDetn199RdrDetnChks "0x1123";
BA_ "GenSigFuncType" SG_ 132 ReSideRdrLeDetn199RdrDetnChks 15;
BA_ "GenSigSendType" SG_ 132 ReSideRdrLeDetn199RdrDetnChks 0;
BA_ "GenSigFuncType" SG_ 132 ReSideRdrLeDetn199RdrDetnCntr 16;
BA_ "GenSigSendType" SG_ 132 ReSideRdrLeDetn199RdrDetnCntr 0;
BA_ "GenSigSendType" SG_ 132 ReSideRdrLeDetn199RdrDetnConf 0;
BA_ "GenSigSendType" SG_ 132 ReSideRdrLeDetn199RdrDetnElevn 0;
BA_ "GenSigStartValue" SG_ 132 ReSideRdrLeDetn199RdrDetnElevn 15;
BA_ "GenSigSendType" SG_ 132 ReSideRdrLeDetn199RdrDetnPwr 0;
BA_ "GenSigSendType" SG_ 132 ReSideRdrLeDetn199RdrDetnRng 0;
BA_ "GenSigStartValue" SG_ 132 ReSideRdrLeDetn199RdrDetnRng 10050;
BA_ "GenSigSendType" SG_ 132 ReSideRdrLeDetn199RdrDetnRngV 0;
BA_ "GenSigStartValue" SG_ 132 ReSideRdrLeDetn199RdrDetnRngV 4000;
BA_ "GenSigSendType" SG_ 132 ReSideRdrLeDetn199RdrDetnSameRV 0;
BA_ "GenSigSendType" SG_ 132 ReSideRdrLeDetn199RdrDetnSts 0;
BA_ "GenSigStartValue" SG_ 132 ReSideRdrLeDetn199RdrDetnSts 3;
BA_ "GenSigSendType" SG_ 132 ReSideRdrLeDetn200RdrDetnAmbigState 0;
BA_ "GenSigSendType" SG_ 132 ReSideRdrLeDetn200RdrDetnAssoTrkID 0;
BA_ "GenSigSendType" SG_ 132 ReSideRdrLeDetn200RdrDetnAzi 0;
BA_ "GenSigStartValue" SG_ 132 ReSideRdrLeDetn200RdrDetnAzi 900;
BA_ "GenSigDataID" SG_ 132 ReSideRdrLeDetn200RdrDetnChks "0x1124";
BA_ "GenSigFuncType" SG_ 132 ReSideRdrLeDetn200RdrDetnChks 15;
BA_ "GenSigSendType" SG_ 132 ReSideRdrLeDetn200RdrDetnChks 0;
BA_ "GenSigFuncType" SG_ 132 ReSideRdrLeDetn200RdrDetnCntr 16;
BA_ "GenSigSendType" SG_ 132 ReSideRdrLeDetn200RdrDetnCntr 0;
BA_ "GenSigSendType" SG_ 132 ReSideRdrLeDetn200RdrDetnConf 0;
BA_ "GenSigSendType" SG_ 132 ReSideRdrLeDetn200RdrDetnElevn 0;
BA_ "GenSigStartValue" SG_ 132 ReSideRdrLeDetn200RdrDetnElevn 15;
BA_ "GenSigSendType" SG_ 132 ReSideRdrLeDetn200RdrDetnPwr 0;
BA_ "GenSigSendType" SG_ 132 ReSideRdrLeDetn200RdrDetnRng 0;
BA_ "GenSigStartValue" SG_ 132 ReSideRdrLeDetn200RdrDetnRng 10050;
BA_ "GenSigSendType" SG_ 132 ReSideRdrLeDetn200RdrDetnRngV 0;
BA_ "GenSigStartValue" SG_ 132 ReSideRdrLeDetn200RdrDetnRngV 4000;
BA_ "GenSigSendType" SG_ 132 ReSideRdrLeDetn200RdrDetnSameRV 0;
BA_ "GenSigSendType" SG_ 132 ReSideRdrLeDetn200RdrDetnSts 0;
BA_ "GenSigStartValue" SG_ 132 ReSideRdrLeDetn200RdrDetnSts 3;
BA_ "GenSigSendType" SG_ 132 ReSideRdrLeDetn201RdrDetnAmbigState 0;
BA_ "GenSigSendType" SG_ 132 ReSideRdrLeDetn201RdrDetnAssoTrkID 0;
BA_ "GenSigSendType" SG_ 132 ReSideRdrLeDetn201RdrDetnAzi 0;
BA_ "GenSigStartValue" SG_ 132 ReSideRdrLeDetn201RdrDetnAzi 900;
BA_ "GenSigDataID" SG_ 132 ReSideRdrLeDetn201RdrDetnChks "0x1125";
BA_ "GenSigFuncType" SG_ 132 ReSideRdrLeDetn201RdrDetnChks 15;
BA_ "GenSigSendType" SG_ 132 ReSideRdrLeDetn201RdrDetnChks 0;
BA_ "GenSigFuncType" SG_ 132 ReSideRdrLeDetn201RdrDetnCntr 16;
BA_ "GenSigSendType" SG_ 132 ReSideRdrLeDetn201RdrDetnCntr 0;
BA_ "GenSigSendType" SG_ 132 ReSideRdrLeDetn201RdrDetnConf 0;
BA_ "GenSigSendType" SG_ 132 ReSideRdrLeDetn201RdrDetnElevn 0;
BA_ "GenSigStartValue" SG_ 132 ReSideRdrLeDetn201RdrDetnElevn 15;
BA_ "GenSigSendType" SG_ 132 ReSideRdrLeDetn201RdrDetnPwr 0;
BA_ "GenSigSendType" SG_ 132 ReSideRdrLeDetn201RdrDetnRng 0;
BA_ "GenSigStartValue" SG_ 132 ReSideRdrLeDetn201RdrDetnRng 10050;
BA_ "GenSigSendType" SG_ 132 ReSideRdrLeDetn201RdrDetnRngV 0;
BA_ "GenSigStartValue" SG_ 132 ReSideRdrLeDetn201RdrDetnRngV 4000;
BA_ "GenSigSendType" SG_ 132 ReSideRdrLeDetn201RdrDetnSameRV 0;
BA_ "GenSigSendType" SG_ 132 ReSideRdrLeDetn201RdrDetnSts 0;
BA_ "GenSigStartValue" SG_ 132 ReSideRdrLeDetn201RdrDetnSts 3;
BA_ "GenSigSendType" SG_ 132 ReSideRdrLeDetn202RdrDetnAmbigState 0;
BA_ "GenSigSendType" SG_ 132 ReSideRdrLeDetn202RdrDetnAssoTrkID 0;
BA_ "GenSigSendType" SG_ 132 ReSideRdrLeDetn202RdrDetnAzi 0;
BA_ "GenSigStartValue" SG_ 132 ReSideRdrLeDetn202RdrDetnAzi 900;
BA_ "GenSigDataID" SG_ 132 ReSideRdrLeDetn202RdrDetnChks "0x1126";
BA_ "GenSigFuncType" SG_ 132 ReSideRdrLeDetn202RdrDetnChks 15;
BA_ "GenSigSendType" SG_ 132 ReSideRdrLeDetn202RdrDetnChks 0;
BA_ "GenSigFuncType" SG_ 132 ReSideRdrLeDetn202RdrDetnCntr 16;
BA_ "GenSigSendType" SG_ 132 ReSideRdrLeDetn202RdrDetnCntr 0;
BA_ "GenSigSendType" SG_ 132 ReSideRdrLeDetn202RdrDetnConf 0;
BA_ "GenSigSendType" SG_ 132 ReSideRdrLeDetn202RdrDetnElevn 0;
BA_ "GenSigStartValue" SG_ 132 ReSideRdrLeDetn202RdrDetnElevn 15;
BA_ "GenSigSendType" SG_ 132 ReSideRdrLeDetn202RdrDetnPwr 0;
BA_ "GenSigSendType" SG_ 132 ReSideRdrLeDetn202RdrDetnRng 0;
BA_ "GenSigStartValue" SG_ 132 ReSideRdrLeDetn202RdrDetnRng 10050;
BA_ "GenSigSendType" SG_ 132 ReSideRdrLeDetn202RdrDetnRngV 0;
BA_ "GenSigStartValue" SG_ 132 ReSideRdrLeDetn202RdrDetnRngV 4000;
BA_ "GenSigSendType" SG_ 132 ReSideRdrLeDetn202RdrDetnSameRV 0;
BA_ "GenSigSendType" SG_ 132 ReSideRdrLeDetn202RdrDetnSts 0;
BA_ "GenSigStartValue" SG_ 132 ReSideRdrLeDetn202RdrDetnSts 3;
BA_ "GenSigSendType" SG_ 132 ReSideRdrLeDetn203RdrDetnAmbigState 0;
BA_ "GenSigSendType" SG_ 132 ReSideRdrLeDetn203RdrDetnAssoTrkID 0;
BA_ "GenSigSendType" SG_ 132 ReSideRdrLeDetn203RdrDetnAzi 0;
BA_ "GenSigStartValue" SG_ 132 ReSideRdrLeDetn203RdrDetnAzi 900;
BA_ "GenSigDataID" SG_ 132 ReSideRdrLeDetn203RdrDetnChks "0x1127";
BA_ "GenSigFuncType" SG_ 132 ReSideRdrLeDetn203RdrDetnChks 15;
BA_ "GenSigSendType" SG_ 132 ReSideRdrLeDetn203RdrDetnChks 0;
BA_ "GenSigFuncType" SG_ 132 ReSideRdrLeDetn203RdrDetnCntr 16;
BA_ "GenSigSendType" SG_ 132 ReSideRdrLeDetn203RdrDetnCntr 0;
BA_ "GenSigSendType" SG_ 132 ReSideRdrLeDetn203RdrDetnConf 0;
BA_ "GenSigSendType" SG_ 132 ReSideRdrLeDetn203RdrDetnElevn 0;
BA_ "GenSigStartValue" SG_ 132 ReSideRdrLeDetn203RdrDetnElevn 15;
BA_ "GenSigSendType" SG_ 132 ReSideRdrLeDetn203RdrDetnPwr 0;
BA_ "GenSigSendType" SG_ 132 ReSideRdrLeDetn203RdrDetnRng 0;
BA_ "GenSigStartValue" SG_ 132 ReSideRdrLeDetn203RdrDetnRng 10050;
BA_ "GenSigSendType" SG_ 132 ReSideRdrLeDetn203RdrDetnRngV 0;
BA_ "GenSigStartValue" SG_ 132 ReSideRdrLeDetn203RdrDetnRngV 4000;
BA_ "GenSigSendType" SG_ 132 ReSideRdrLeDetn203RdrDetnSameRV 0;
BA_ "GenSigSendType" SG_ 132 ReSideRdrLeDetn203RdrDetnSts 0;
BA_ "GenSigStartValue" SG_ 132 ReSideRdrLeDetn203RdrDetnSts 3;
BA_ "GenSigSendType" SG_ 132 ReSideRdrLeDetn204RdrDetnAmbigState 0;
BA_ "GenSigSendType" SG_ 132 ReSideRdrLeDetn204RdrDetnAssoTrkID 0;
BA_ "GenSigSendType" SG_ 132 ReSideRdrLeDetn204RdrDetnAzi 0;
BA_ "GenSigStartValue" SG_ 132 ReSideRdrLeDetn204RdrDetnAzi 900;
BA_ "GenSigDataID" SG_ 132 ReSideRdrLeDetn204RdrDetnChks "0x1128";
BA_ "GenSigFuncType" SG_ 132 ReSideRdrLeDetn204RdrDetnChks 15;
BA_ "GenSigSendType" SG_ 132 ReSideRdrLeDetn204RdrDetnChks 0;
BA_ "GenSigFuncType" SG_ 132 ReSideRdrLeDetn204RdrDetnCntr 16;
BA_ "GenSigSendType" SG_ 132 ReSideRdrLeDetn204RdrDetnCntr 0;
BA_ "GenSigSendType" SG_ 132 ReSideRdrLeDetn204RdrDetnConf 0;
BA_ "GenSigSendType" SG_ 132 ReSideRdrLeDetn204RdrDetnElevn 0;
BA_ "GenSigStartValue" SG_ 132 ReSideRdrLeDetn204RdrDetnElevn 15;
BA_ "GenSigSendType" SG_ 132 ReSideRdrLeDetn204RdrDetnPwr 0;
BA_ "GenSigSendType" SG_ 132 ReSideRdrLeDetn204RdrDetnRng 0;
BA_ "GenSigStartValue" SG_ 132 ReSideRdrLeDetn204RdrDetnRng 10050;
BA_ "GenSigSendType" SG_ 132 ReSideRdrLeDetn204RdrDetnRngV 0;
BA_ "GenSigStartValue" SG_ 132 ReSideRdrLeDetn204RdrDetnRngV 4000;
BA_ "GenSigSendType" SG_ 132 ReSideRdrLeDetn204RdrDetnSameRV 0;
BA_ "GenSigSendType" SG_ 132 ReSideRdrLeDetn204RdrDetnSts 0;
BA_ "GenSigStartValue" SG_ 132 ReSideRdrLeDetn204RdrDetnSts 3;
BA_ "GenSigSendType" SG_ 133 ReSideRdrLeDetn205RdrDetnAmbigState 0;
BA_ "GenSigSendType" SG_ 133 ReSideRdrLeDetn205RdrDetnAssoTrkID 0;
BA_ "GenSigSendType" SG_ 133 ReSideRdrLeDetn205RdrDetnAzi 0;
BA_ "GenSigStartValue" SG_ 133 ReSideRdrLeDetn205RdrDetnAzi 900;
BA_ "GenSigDataID" SG_ 133 ReSideRdrLeDetn205RdrDetnChks "0x1129";
BA_ "GenSigFuncType" SG_ 133 ReSideRdrLeDetn205RdrDetnChks 15;
BA_ "GenSigSendType" SG_ 133 ReSideRdrLeDetn205RdrDetnChks 0;
BA_ "GenSigFuncType" SG_ 133 ReSideRdrLeDetn205RdrDetnCntr 16;
BA_ "GenSigSendType" SG_ 133 ReSideRdrLeDetn205RdrDetnCntr 0;
BA_ "GenSigSendType" SG_ 133 ReSideRdrLeDetn205RdrDetnConf 0;
BA_ "GenSigSendType" SG_ 133 ReSideRdrLeDetn205RdrDetnElevn 0;
BA_ "GenSigStartValue" SG_ 133 ReSideRdrLeDetn205RdrDetnElevn 15;
BA_ "GenSigSendType" SG_ 133 ReSideRdrLeDetn205RdrDetnPwr 0;
BA_ "GenSigSendType" SG_ 133 ReSideRdrLeDetn205RdrDetnRng 0;
BA_ "GenSigStartValue" SG_ 133 ReSideRdrLeDetn205RdrDetnRng 10050;
BA_ "GenSigSendType" SG_ 133 ReSideRdrLeDetn205RdrDetnRngV 0;
BA_ "GenSigStartValue" SG_ 133 ReSideRdrLeDetn205RdrDetnRngV 4000;
BA_ "GenSigSendType" SG_ 133 ReSideRdrLeDetn205RdrDetnSameRV 0;
BA_ "GenSigSendType" SG_ 133 ReSideRdrLeDetn205RdrDetnSts 0;
BA_ "GenSigStartValue" SG_ 133 ReSideRdrLeDetn205RdrDetnSts 3;
BA_ "GenSigSendType" SG_ 133 ReSideRdrLeDetn206RdrDetnAmbigState 0;
BA_ "GenSigSendType" SG_ 133 ReSideRdrLeDetn206RdrDetnAssoTrkID 0;
BA_ "GenSigSendType" SG_ 133 ReSideRdrLeDetn206RdrDetnAzi 0;
BA_ "GenSigStartValue" SG_ 133 ReSideRdrLeDetn206RdrDetnAzi 900;
BA_ "GenSigDataID" SG_ 133 ReSideRdrLeDetn206RdrDetnChks "0x112A";
BA_ "GenSigFuncType" SG_ 133 ReSideRdrLeDetn206RdrDetnChks 15;
BA_ "GenSigSendType" SG_ 133 ReSideRdrLeDetn206RdrDetnChks 0;
BA_ "GenSigFuncType" SG_ 133 ReSideRdrLeDetn206RdrDetnCntr 16;
BA_ "GenSigSendType" SG_ 133 ReSideRdrLeDetn206RdrDetnCntr 0;
BA_ "GenSigSendType" SG_ 133 ReSideRdrLeDetn206RdrDetnConf 0;
BA_ "GenSigSendType" SG_ 133 ReSideRdrLeDetn206RdrDetnElevn 0;
BA_ "GenSigStartValue" SG_ 133 ReSideRdrLeDetn206RdrDetnElevn 15;
BA_ "GenSigSendType" SG_ 133 ReSideRdrLeDetn206RdrDetnPwr 0;
BA_ "GenSigSendType" SG_ 133 ReSideRdrLeDetn206RdrDetnRng 0;
BA_ "GenSigStartValue" SG_ 133 ReSideRdrLeDetn206RdrDetnRng 10050;
BA_ "GenSigSendType" SG_ 133 ReSideRdrLeDetn206RdrDetnRngV 0;
BA_ "GenSigStartValue" SG_ 133 ReSideRdrLeDetn206RdrDetnRngV 4000;
BA_ "GenSigSendType" SG_ 133 ReSideRdrLeDetn206RdrDetnSameRV 0;
BA_ "GenSigSendType" SG_ 133 ReSideRdrLeDetn206RdrDetnSts 0;
BA_ "GenSigStartValue" SG_ 133 ReSideRdrLeDetn206RdrDetnSts 3;
BA_ "GenSigSendType" SG_ 133 ReSideRdrLeDetn207RdrDetnAmbigState 0;
BA_ "GenSigSendType" SG_ 133 ReSideRdrLeDetn207RdrDetnAssoTrkID 0;
BA_ "GenSigSendType" SG_ 133 ReSideRdrLeDetn207RdrDetnAzi 0;
BA_ "GenSigStartValue" SG_ 133 ReSideRdrLeDetn207RdrDetnAzi 900;
BA_ "GenSigDataID" SG_ 133 ReSideRdrLeDetn207RdrDetnChks "0x112B";
BA_ "GenSigFuncType" SG_ 133 ReSideRdrLeDetn207RdrDetnChks 15;
BA_ "GenSigSendType" SG_ 133 ReSideRdrLeDetn207RdrDetnChks 0;
BA_ "GenSigFuncType" SG_ 133 ReSideRdrLeDetn207RdrDetnCntr 16;
BA_ "GenSigSendType" SG_ 133 ReSideRdrLeDetn207RdrDetnCntr 0;
BA_ "GenSigSendType" SG_ 133 ReSideRdrLeDetn207RdrDetnConf 0;
BA_ "GenSigSendType" SG_ 133 ReSideRdrLeDetn207RdrDetnElevn 0;
BA_ "GenSigStartValue" SG_ 133 ReSideRdrLeDetn207RdrDetnElevn 15;
BA_ "GenSigSendType" SG_ 133 ReSideRdrLeDetn207RdrDetnPwr 0;
BA_ "GenSigSendType" SG_ 133 ReSideRdrLeDetn207RdrDetnRng 0;
BA_ "GenSigStartValue" SG_ 133 ReSideRdrLeDetn207RdrDetnRng 10050;
BA_ "GenSigSendType" SG_ 133 ReSideRdrLeDetn207RdrDetnRngV 0;
BA_ "GenSigStartValue" SG_ 133 ReSideRdrLeDetn207RdrDetnRngV 4000;
BA_ "GenSigSendType" SG_ 133 ReSideRdrLeDetn207RdrDetnSameRV 0;
BA_ "GenSigSendType" SG_ 133 ReSideRdrLeDetn207RdrDetnSts 0;
BA_ "GenSigStartValue" SG_ 133 ReSideRdrLeDetn207RdrDetnSts 3;
BA_ "GenSigSendType" SG_ 133 ReSideRdrLeDetn208RdrDetnAmbigState 0;
BA_ "GenSigSendType" SG_ 133 ReSideRdrLeDetn208RdrDetnAssoTrkID 0;
BA_ "GenSigSendType" SG_ 133 ReSideRdrLeDetn208RdrDetnAzi 0;
BA_ "GenSigStartValue" SG_ 133 ReSideRdrLeDetn208RdrDetnAzi 900;
BA_ "GenSigDataID" SG_ 133 ReSideRdrLeDetn208RdrDetnChks "0x112C";
BA_ "GenSigFuncType" SG_ 133 ReSideRdrLeDetn208RdrDetnChks 15;
BA_ "GenSigSendType" SG_ 133 ReSideRdrLeDetn208RdrDetnChks 0;
BA_ "GenSigFuncType" SG_ 133 ReSideRdrLeDetn208RdrDetnCntr 16;
BA_ "GenSigSendType" SG_ 133 ReSideRdrLeDetn208RdrDetnCntr 0;
BA_ "GenSigSendType" SG_ 133 ReSideRdrLeDetn208RdrDetnConf 0;
BA_ "GenSigSendType" SG_ 133 ReSideRdrLeDetn208RdrDetnElevn 0;
BA_ "GenSigStartValue" SG_ 133 ReSideRdrLeDetn208RdrDetnElevn 15;
BA_ "GenSigSendType" SG_ 133 ReSideRdrLeDetn208RdrDetnPwr 0;
BA_ "GenSigSendType" SG_ 133 ReSideRdrLeDetn208RdrDetnRng 0;
BA_ "GenSigStartValue" SG_ 133 ReSideRdrLeDetn208RdrDetnRng 10050;
BA_ "GenSigSendType" SG_ 133 ReSideRdrLeDetn208RdrDetnRngV 0;
BA_ "GenSigStartValue" SG_ 133 ReSideRdrLeDetn208RdrDetnRngV 4000;
BA_ "GenSigSendType" SG_ 133 ReSideRdrLeDetn208RdrDetnSameRV 0;
BA_ "GenSigSendType" SG_ 133 ReSideRdrLeDetn208RdrDetnSts 0;
BA_ "GenSigStartValue" SG_ 133 ReSideRdrLeDetn208RdrDetnSts 3;
BA_ "GenSigSendType" SG_ 133 ReSideRdrLeDetn209RdrDetnAmbigState 0;
BA_ "GenSigSendType" SG_ 133 ReSideRdrLeDetn209RdrDetnAssoTrkID 0;
BA_ "GenSigSendType" SG_ 133 ReSideRdrLeDetn209RdrDetnAzi 0;
BA_ "GenSigStartValue" SG_ 133 ReSideRdrLeDetn209RdrDetnAzi 900;
BA_ "GenSigDataID" SG_ 133 ReSideRdrLeDetn209RdrDetnChks "0x112D";
BA_ "GenSigFuncType" SG_ 133 ReSideRdrLeDetn209RdrDetnChks 15;
BA_ "GenSigSendType" SG_ 133 ReSideRdrLeDetn209RdrDetnChks 0;
BA_ "GenSigFuncType" SG_ 133 ReSideRdrLeDetn209RdrDetnCntr 16;
BA_ "GenSigSendType" SG_ 133 ReSideRdrLeDetn209RdrDetnCntr 0;
BA_ "GenSigSendType" SG_ 133 ReSideRdrLeDetn209RdrDetnConf 0;
BA_ "GenSigSendType" SG_ 133 ReSideRdrLeDetn209RdrDetnElevn 0;
BA_ "GenSigStartValue" SG_ 133 ReSideRdrLeDetn209RdrDetnElevn 15;
BA_ "GenSigSendType" SG_ 133 ReSideRdrLeDetn209RdrDetnPwr 0;
BA_ "GenSigSendType" SG_ 133 ReSideRdrLeDetn209RdrDetnRng 0;
BA_ "GenSigStartValue" SG_ 133 ReSideRdrLeDetn209RdrDetnRng 10050;
BA_ "GenSigSendType" SG_ 133 ReSideRdrLeDetn209RdrDetnRngV 0;
BA_ "GenSigStartValue" SG_ 133 ReSideRdrLeDetn209RdrDetnRngV 4000;
BA_ "GenSigSendType" SG_ 133 ReSideRdrLeDetn209RdrDetnSameRV 0;
BA_ "GenSigSendType" SG_ 133 ReSideRdrLeDetn209RdrDetnSts 0;
BA_ "GenSigStartValue" SG_ 133 ReSideRdrLeDetn209RdrDetnSts 3;
BA_ "GenSigSendType" SG_ 133 ReSideRdrLeDetn210RdrDetnAmbigState 0;
BA_ "GenSigSendType" SG_ 133 ReSideRdrLeDetn210RdrDetnAssoTrkID 0;
BA_ "GenSigSendType" SG_ 133 ReSideRdrLeDetn210RdrDetnAzi 0;
BA_ "GenSigStartValue" SG_ 133 ReSideRdrLeDetn210RdrDetnAzi 900;
BA_ "GenSigDataID" SG_ 133 ReSideRdrLeDetn210RdrDetnChks "0x112E";
BA_ "GenSigFuncType" SG_ 133 ReSideRdrLeDetn210RdrDetnChks 15;
BA_ "GenSigSendType" SG_ 133 ReSideRdrLeDetn210RdrDetnChks 0;
BA_ "GenSigFuncType" SG_ 133 ReSideRdrLeDetn210RdrDetnCntr 16;
BA_ "GenSigSendType" SG_ 133 ReSideRdrLeDetn210RdrDetnCntr 0;
BA_ "GenSigSendType" SG_ 133 ReSideRdrLeDetn210RdrDetnConf 0;
BA_ "GenSigSendType" SG_ 133 ReSideRdrLeDetn210RdrDetnElevn 0;
BA_ "GenSigStartValue" SG_ 133 ReSideRdrLeDetn210RdrDetnElevn 15;
BA_ "GenSigSendType" SG_ 133 ReSideRdrLeDetn210RdrDetnPwr 0;
BA_ "GenSigSendType" SG_ 133 ReSideRdrLeDetn210RdrDetnRng 0;
BA_ "GenSigStartValue" SG_ 133 ReSideRdrLeDetn210RdrDetnRng 10050;
BA_ "GenSigSendType" SG_ 133 ReSideRdrLeDetn210RdrDetnRngV 0;
BA_ "GenSigStartValue" SG_ 133 ReSideRdrLeDetn210RdrDetnRngV 4000;
BA_ "GenSigSendType" SG_ 133 ReSideRdrLeDetn210RdrDetnSameRV 0;
BA_ "GenSigSendType" SG_ 133 ReSideRdrLeDetn210RdrDetnSts 0;
BA_ "GenSigStartValue" SG_ 133 ReSideRdrLeDetn210RdrDetnSts 3;
BA_ "GenSigSendType" SG_ 134 ReSideRdrLeDetn211RdrDetnAmbigState 0;
BA_ "GenSigSendType" SG_ 134 ReSideRdrLeDetn211RdrDetnAssoTrkID 0;
BA_ "GenSigSendType" SG_ 134 ReSideRdrLeDetn211RdrDetnAzi 0;
BA_ "GenSigStartValue" SG_ 134 ReSideRdrLeDetn211RdrDetnAzi 900;
BA_ "GenSigDataID" SG_ 134 ReSideRdrLeDetn211RdrDetnChks "0x112F";
BA_ "GenSigFuncType" SG_ 134 ReSideRdrLeDetn211RdrDetnChks 15;
BA_ "GenSigSendType" SG_ 134 ReSideRdrLeDetn211RdrDetnChks 0;
BA_ "GenSigFuncType" SG_ 134 ReSideRdrLeDetn211RdrDetnCntr 16;
BA_ "GenSigSendType" SG_ 134 ReSideRdrLeDetn211RdrDetnCntr 0;
BA_ "GenSigSendType" SG_ 134 ReSideRdrLeDetn211RdrDetnConf 0;
BA_ "GenSigSendType" SG_ 134 ReSideRdrLeDetn211RdrDetnElevn 0;
BA_ "GenSigStartValue" SG_ 134 ReSideRdrLeDetn211RdrDetnElevn 15;
BA_ "GenSigSendType" SG_ 134 ReSideRdrLeDetn211RdrDetnPwr 0;
BA_ "GenSigSendType" SG_ 134 ReSideRdrLeDetn211RdrDetnRng 0;
BA_ "GenSigStartValue" SG_ 134 ReSideRdrLeDetn211RdrDetnRng 10050;
BA_ "GenSigSendType" SG_ 134 ReSideRdrLeDetn211RdrDetnRngV 0;
BA_ "GenSigStartValue" SG_ 134 ReSideRdrLeDetn211RdrDetnRngV 4000;
BA_ "GenSigSendType" SG_ 134 ReSideRdrLeDetn211RdrDetnSameRV 0;
BA_ "GenSigSendType" SG_ 134 ReSideRdrLeDetn211RdrDetnSts 0;
BA_ "GenSigStartValue" SG_ 134 ReSideRdrLeDetn211RdrDetnSts 3;
BA_ "GenSigSendType" SG_ 134 ReSideRdrLeDetn212RdrDetnAmbigState 0;
BA_ "GenSigSendType" SG_ 134 ReSideRdrLeDetn212RdrDetnAssoTrkID 0;
BA_ "GenSigSendType" SG_ 134 ReSideRdrLeDetn212RdrDetnAzi 0;
BA_ "GenSigStartValue" SG_ 134 ReSideRdrLeDetn212RdrDetnAzi 900;
BA_ "GenSigDataID" SG_ 134 ReSideRdrLeDetn212RdrDetnChks "0x1130";
BA_ "GenSigFuncType" SG_ 134 ReSideRdrLeDetn212RdrDetnChks 15;
BA_ "GenSigSendType" SG_ 134 ReSideRdrLeDetn212RdrDetnChks 0;
BA_ "GenSigFuncType" SG_ 134 ReSideRdrLeDetn212RdrDetnCntr 16;
BA_ "GenSigSendType" SG_ 134 ReSideRdrLeDetn212RdrDetnCntr 0;
BA_ "GenSigSendType" SG_ 134 ReSideRdrLeDetn212RdrDetnConf 0;
BA_ "GenSigSendType" SG_ 134 ReSideRdrLeDetn212RdrDetnElevn 0;
BA_ "GenSigStartValue" SG_ 134 ReSideRdrLeDetn212RdrDetnElevn 15;
BA_ "GenSigSendType" SG_ 134 ReSideRdrLeDetn212RdrDetnPwr 0;
BA_ "GenSigSendType" SG_ 134 ReSideRdrLeDetn212RdrDetnRng 0;
BA_ "GenSigStartValue" SG_ 134 ReSideRdrLeDetn212RdrDetnRng 10050;
BA_ "GenSigSendType" SG_ 134 ReSideRdrLeDetn212RdrDetnRngV 0;
BA_ "GenSigStartValue" SG_ 134 ReSideRdrLeDetn212RdrDetnRngV 4000;
BA_ "GenSigSendType" SG_ 134 ReSideRdrLeDetn212RdrDetnSameRV 0;
BA_ "GenSigSendType" SG_ 134 ReSideRdrLeDetn212RdrDetnSts 0;
BA_ "GenSigStartValue" SG_ 134 ReSideRdrLeDetn212RdrDetnSts 3;
BA_ "GenSigSendType" SG_ 134 ReSideRdrLeDetn213RdrDetnAmbigState 0;
BA_ "GenSigSendType" SG_ 134 ReSideRdrLeDetn213RdrDetnAssoTrkID 0;
BA_ "GenSigSendType" SG_ 134 ReSideRdrLeDetn213RdrDetnAzi 0;
BA_ "GenSigStartValue" SG_ 134 ReSideRdrLeDetn213RdrDetnAzi 900;
BA_ "GenSigDataID" SG_ 134 ReSideRdrLeDetn213RdrDetnChks "0x1131";
BA_ "GenSigFuncType" SG_ 134 ReSideRdrLeDetn213RdrDetnChks 15;
BA_ "GenSigSendType" SG_ 134 ReSideRdrLeDetn213RdrDetnChks 0;
BA_ "GenSigFuncType" SG_ 134 ReSideRdrLeDetn213RdrDetnCntr 16;
BA_ "GenSigSendType" SG_ 134 ReSideRdrLeDetn213RdrDetnCntr 0;
BA_ "GenSigSendType" SG_ 134 ReSideRdrLeDetn213RdrDetnConf 0;
BA_ "GenSigSendType" SG_ 134 ReSideRdrLeDetn213RdrDetnElevn 0;
BA_ "GenSigStartValue" SG_ 134 ReSideRdrLeDetn213RdrDetnElevn 15;
BA_ "GenSigSendType" SG_ 134 ReSideRdrLeDetn213RdrDetnPwr 0;
BA_ "GenSigSendType" SG_ 134 ReSideRdrLeDetn213RdrDetnRng 0;
BA_ "GenSigStartValue" SG_ 134 ReSideRdrLeDetn213RdrDetnRng 10050;
BA_ "GenSigSendType" SG_ 134 ReSideRdrLeDetn213RdrDetnRngV 0;
BA_ "GenSigStartValue" SG_ 134 ReSideRdrLeDetn213RdrDetnRngV 4000;
BA_ "GenSigSendType" SG_ 134 ReSideRdrLeDetn213RdrDetnSameRV 0;
BA_ "GenSigSendType" SG_ 134 ReSideRdrLeDetn213RdrDetnSts 0;
BA_ "GenSigStartValue" SG_ 134 ReSideRdrLeDetn213RdrDetnSts 3;
BA_ "GenSigSendType" SG_ 134 ReSideRdrLeDetn214RdrDetnAmbigState 0;
BA_ "GenSigSendType" SG_ 134 ReSideRdrLeDetn214RdrDetnAssoTrkID 0;
BA_ "GenSigSendType" SG_ 134 ReSideRdrLeDetn214RdrDetnAzi 0;
BA_ "GenSigStartValue" SG_ 134 ReSideRdrLeDetn214RdrDetnAzi 900;
BA_ "GenSigDataID" SG_ 134 ReSideRdrLeDetn214RdrDetnChks "0x1132";
BA_ "GenSigFuncType" SG_ 134 ReSideRdrLeDetn214RdrDetnChks 15;
BA_ "GenSigSendType" SG_ 134 ReSideRdrLeDetn214RdrDetnChks 0;
BA_ "GenSigFuncType" SG_ 134 ReSideRdrLeDetn214RdrDetnCntr 16;
BA_ "GenSigSendType" SG_ 134 ReSideRdrLeDetn214RdrDetnCntr 0;
BA_ "GenSigSendType" SG_ 134 ReSideRdrLeDetn214RdrDetnConf 0;
BA_ "GenSigSendType" SG_ 134 ReSideRdrLeDetn214RdrDetnElevn 0;
BA_ "GenSigStartValue" SG_ 134 ReSideRdrLeDetn214RdrDetnElevn 15;
BA_ "GenSigSendType" SG_ 134 ReSideRdrLeDetn214RdrDetnPwr 0;
BA_ "GenSigSendType" SG_ 134 ReSideRdrLeDetn214RdrDetnRng 0;
BA_ "GenSigStartValue" SG_ 134 ReSideRdrLeDetn214RdrDetnRng 10050;
BA_ "GenSigSendType" SG_ 134 ReSideRdrLeDetn214RdrDetnRngV 0;
BA_ "GenSigStartValue" SG_ 134 ReSideRdrLeDetn214RdrDetnRngV 4000;
BA_ "GenSigSendType" SG_ 134 ReSideRdrLeDetn214RdrDetnSameRV 0;
BA_ "GenSigSendType" SG_ 134 ReSideRdrLeDetn214RdrDetnSts 0;
BA_ "GenSigStartValue" SG_ 134 ReSideRdrLeDetn214RdrDetnSts 3;
BA_ "GenSigSendType" SG_ 134 ReSideRdrLeDetn215RdrDetnAmbigState 0;
BA_ "GenSigSendType" SG_ 134 ReSideRdrLeDetn215RdrDetnAssoTrkID 0;
BA_ "GenSigSendType" SG_ 134 ReSideRdrLeDetn215RdrDetnAzi 0;
BA_ "GenSigStartValue" SG_ 134 ReSideRdrLeDetn215RdrDetnAzi 900;
BA_ "GenSigDataID" SG_ 134 ReSideRdrLeDetn215RdrDetnChks "0x1133";
BA_ "GenSigFuncType" SG_ 134 ReSideRdrLeDetn215RdrDetnChks 15;
BA_ "GenSigSendType" SG_ 134 ReSideRdrLeDetn215RdrDetnChks 0;
BA_ "GenSigFuncType" SG_ 134 ReSideRdrLeDetn215RdrDetnCntr 16;
BA_ "GenSigSendType" SG_ 134 ReSideRdrLeDetn215RdrDetnCntr 0;
BA_ "GenSigSendType" SG_ 134 ReSideRdrLeDetn215RdrDetnConf 0;
BA_ "GenSigSendType" SG_ 134 ReSideRdrLeDetn215RdrDetnElevn 0;
BA_ "GenSigStartValue" SG_ 134 ReSideRdrLeDetn215RdrDetnElevn 15;
BA_ "GenSigSendType" SG_ 134 ReSideRdrLeDetn215RdrDetnPwr 0;
BA_ "GenSigSendType" SG_ 134 ReSideRdrLeDetn215RdrDetnRng 0;
BA_ "GenSigStartValue" SG_ 134 ReSideRdrLeDetn215RdrDetnRng 10050;
BA_ "GenSigSendType" SG_ 134 ReSideRdrLeDetn215RdrDetnRngV 0;
BA_ "GenSigStartValue" SG_ 134 ReSideRdrLeDetn215RdrDetnRngV 4000;
BA_ "GenSigSendType" SG_ 134 ReSideRdrLeDetn215RdrDetnSameRV 0;
BA_ "GenSigSendType" SG_ 134 ReSideRdrLeDetn215RdrDetnSts 0;
BA_ "GenSigStartValue" SG_ 134 ReSideRdrLeDetn215RdrDetnSts 3;
BA_ "GenSigSendType" SG_ 134 ReSideRdrLeDetn216RdrDetnAmbigState 0;
BA_ "GenSigSendType" SG_ 134 ReSideRdrLeDetn216RdrDetnAssoTrkID 0;
BA_ "GenSigSendType" SG_ 134 ReSideRdrLeDetn216RdrDetnAzi 0;
BA_ "GenSigStartValue" SG_ 134 ReSideRdrLeDetn216RdrDetnAzi 900;
BA_ "GenSigDataID" SG_ 134 ReSideRdrLeDetn216RdrDetnChks "0x1134";
BA_ "GenSigFuncType" SG_ 134 ReSideRdrLeDetn216RdrDetnChks 15;
BA_ "GenSigSendType" SG_ 134 ReSideRdrLeDetn216RdrDetnChks 0;
BA_ "GenSigFuncType" SG_ 134 ReSideRdrLeDetn216RdrDetnCntr 16;
BA_ "GenSigSendType" SG_ 134 ReSideRdrLeDetn216RdrDetnCntr 0;
BA_ "GenSigSendType" SG_ 134 ReSideRdrLeDetn216RdrDetnConf 0;
BA_ "GenSigSendType" SG_ 134 ReSideRdrLeDetn216RdrDetnElevn 0;
BA_ "GenSigStartValue" SG_ 134 ReSideRdrLeDetn216RdrDetnElevn 15;
BA_ "GenSigSendType" SG_ 134 ReSideRdrLeDetn216RdrDetnPwr 0;
BA_ "GenSigSendType" SG_ 134 ReSideRdrLeDetn216RdrDetnRng 0;
BA_ "GenSigStartValue" SG_ 134 ReSideRdrLeDetn216RdrDetnRng 10050;
BA_ "GenSigSendType" SG_ 134 ReSideRdrLeDetn216RdrDetnRngV 0;
BA_ "GenSigStartValue" SG_ 134 ReSideRdrLeDetn216RdrDetnRngV 4000;
BA_ "GenSigSendType" SG_ 134 ReSideRdrLeDetn216RdrDetnSameRV 0;
BA_ "GenSigSendType" SG_ 134 ReSideRdrLeDetn216RdrDetnSts 0;
BA_ "GenSigStartValue" SG_ 134 ReSideRdrLeDetn216RdrDetnSts 3;
BA_ "GenSigSendType" SG_ 135 ReSideRdrLeDetn217RdrDetnAmbigState 0;
BA_ "GenSigSendType" SG_ 135 ReSideRdrLeDetn217RdrDetnAssoTrkID 0;
BA_ "GenSigSendType" SG_ 135 ReSideRdrLeDetn217RdrDetnAzi 0;
BA_ "GenSigStartValue" SG_ 135 ReSideRdrLeDetn217RdrDetnAzi 900;
BA_ "GenSigDataID" SG_ 135 ReSideRdrLeDetn217RdrDetnChks "0x1135";
BA_ "GenSigFuncType" SG_ 135 ReSideRdrLeDetn217RdrDetnChks 15;
BA_ "GenSigSendType" SG_ 135 ReSideRdrLeDetn217RdrDetnChks 0;
BA_ "GenSigFuncType" SG_ 135 ReSideRdrLeDetn217RdrDetnCntr 16;
BA_ "GenSigSendType" SG_ 135 ReSideRdrLeDetn217RdrDetnCntr 0;
BA_ "GenSigSendType" SG_ 135 ReSideRdrLeDetn217RdrDetnConf 0;
BA_ "GenSigSendType" SG_ 135 ReSideRdrLeDetn217RdrDetnElevn 0;
BA_ "GenSigStartValue" SG_ 135 ReSideRdrLeDetn217RdrDetnElevn 15;
BA_ "GenSigSendType" SG_ 135 ReSideRdrLeDetn217RdrDetnPwr 0;
BA_ "GenSigSendType" SG_ 135 ReSideRdrLeDetn217RdrDetnRng 0;
BA_ "GenSigStartValue" SG_ 135 ReSideRdrLeDetn217RdrDetnRng 10050;
BA_ "GenSigSendType" SG_ 135 ReSideRdrLeDetn217RdrDetnRngV 0;
BA_ "GenSigStartValue" SG_ 135 ReSideRdrLeDetn217RdrDetnRngV 4000;
BA_ "GenSigSendType" SG_ 135 ReSideRdrLeDetn217RdrDetnSameRV 0;
BA_ "GenSigSendType" SG_ 135 ReSideRdrLeDetn217RdrDetnSts 0;
BA_ "GenSigStartValue" SG_ 135 ReSideRdrLeDetn217RdrDetnSts 3;
BA_ "GenSigSendType" SG_ 135 ReSideRdrLeDetn218RdrDetnAmbigState 0;
BA_ "GenSigSendType" SG_ 135 ReSideRdrLeDetn218RdrDetnAssoTrkID 0;
BA_ "GenSigSendType" SG_ 135 ReSideRdrLeDetn218RdrDetnAzi 0;
BA_ "GenSigStartValue" SG_ 135 ReSideRdrLeDetn218RdrDetnAzi 900;
BA_ "GenSigDataID" SG_ 135 ReSideRdrLeDetn218RdrDetnChks "0x1136";
BA_ "GenSigFuncType" SG_ 135 ReSideRdrLeDetn218RdrDetnChks 15;
BA_ "GenSigSendType" SG_ 135 ReSideRdrLeDetn218RdrDetnChks 0;
BA_ "GenSigFuncType" SG_ 135 ReSideRdrLeDetn218RdrDetnCntr 16;
BA_ "GenSigSendType" SG_ 135 ReSideRdrLeDetn218RdrDetnCntr 0;
BA_ "GenSigSendType" SG_ 135 ReSideRdrLeDetn218RdrDetnConf 0;
BA_ "GenSigSendType" SG_ 135 ReSideRdrLeDetn218RdrDetnElevn 0;
BA_ "GenSigStartValue" SG_ 135 ReSideRdrLeDetn218RdrDetnElevn 15;
BA_ "GenSigSendType" SG_ 135 ReSideRdrLeDetn218RdrDetnPwr 0;
BA_ "GenSigSendType" SG_ 135 ReSideRdrLeDetn218RdrDetnRng 0;
BA_ "GenSigStartValue" SG_ 135 ReSideRdrLeDetn218RdrDetnRng 10050;
BA_ "GenSigSendType" SG_ 135 ReSideRdrLeDetn218RdrDetnRngV 0;
BA_ "GenSigStartValue" SG_ 135 ReSideRdrLeDetn218RdrDetnRngV 4000;
BA_ "GenSigSendType" SG_ 135 ReSideRdrLeDetn218RdrDetnSameRV 0;
BA_ "GenSigSendType" SG_ 135 ReSideRdrLeDetn218RdrDetnSts 0;
BA_ "GenSigStartValue" SG_ 135 ReSideRdrLeDetn218RdrDetnSts 3;
BA_ "GenSigSendType" SG_ 135 ReSideRdrLeDetn219RdrDetnAmbigState 0;
BA_ "GenSigSendType" SG_ 135 ReSideRdrLeDetn219RdrDetnAssoTrkID 0;
BA_ "GenSigSendType" SG_ 135 ReSideRdrLeDetn219RdrDetnAzi 0;
BA_ "GenSigStartValue" SG_ 135 ReSideRdrLeDetn219RdrDetnAzi 900;
BA_ "GenSigDataID" SG_ 135 ReSideRdrLeDetn219RdrDetnChks "0x1137";
BA_ "GenSigFuncType" SG_ 135 ReSideRdrLeDetn219RdrDetnChks 15;
BA_ "GenSigSendType" SG_ 135 ReSideRdrLeDetn219RdrDetnChks 0;
BA_ "GenSigFuncType" SG_ 135 ReSideRdrLeDetn219RdrDetnCntr 16;
BA_ "GenSigSendType" SG_ 135 ReSideRdrLeDetn219RdrDetnCntr 0;
BA_ "GenSigSendType" SG_ 135 ReSideRdrLeDetn219RdrDetnConf 0;
BA_ "GenSigSendType" SG_ 135 ReSideRdrLeDetn219RdrDetnElevn 0;
BA_ "GenSigStartValue" SG_ 135 ReSideRdrLeDetn219RdrDetnElevn 15;
BA_ "GenSigSendType" SG_ 135 ReSideRdrLeDetn219RdrDetnPwr 0;
BA_ "GenSigSendType" SG_ 135 ReSideRdrLeDetn219RdrDetnRng 0;
BA_ "GenSigStartValue" SG_ 135 ReSideRdrLeDetn219RdrDetnRng 10050;
BA_ "GenSigSendType" SG_ 135 ReSideRdrLeDetn219RdrDetnRngV 0;
BA_ "GenSigStartValue" SG_ 135 ReSideRdrLeDetn219RdrDetnRngV 4000;
BA_ "GenSigSendType" SG_ 135 ReSideRdrLeDetn219RdrDetnSameRV 0;
BA_ "GenSigSendType" SG_ 135 ReSideRdrLeDetn219RdrDetnSts 0;
BA_ "GenSigStartValue" SG_ 135 ReSideRdrLeDetn219RdrDetnSts 3;
BA_ "GenSigSendType" SG_ 135 ReSideRdrLeDetn220RdrDetnAmbigState 0;
BA_ "GenSigSendType" SG_ 135 ReSideRdrLeDetn220RdrDetnAssoTrkID 0;
BA_ "GenSigSendType" SG_ 135 ReSideRdrLeDetn220RdrDetnAzi 0;
BA_ "GenSigStartValue" SG_ 135 ReSideRdrLeDetn220RdrDetnAzi 900;
BA_ "GenSigDataID" SG_ 135 ReSideRdrLeDetn220RdrDetnChks "0x1138";
BA_ "GenSigFuncType" SG_ 135 ReSideRdrLeDetn220RdrDetnChks 15;
BA_ "GenSigSendType" SG_ 135 ReSideRdrLeDetn220RdrDetnChks 0;
BA_ "GenSigFuncType" SG_ 135 ReSideRdrLeDetn220RdrDetnCntr 16;
BA_ "GenSigSendType" SG_ 135 ReSideRdrLeDetn220RdrDetnCntr 0;
BA_ "GenSigSendType" SG_ 135 ReSideRdrLeDetn220RdrDetnConf 0;
BA_ "GenSigSendType" SG_ 135 ReSideRdrLeDetn220RdrDetnElevn 0;
BA_ "GenSigStartValue" SG_ 135 ReSideRdrLeDetn220RdrDetnElevn 15;
BA_ "GenSigSendType" SG_ 135 ReSideRdrLeDetn220RdrDetnPwr 0;
BA_ "GenSigSendType" SG_ 135 ReSideRdrLeDetn220RdrDetnRng 0;
BA_ "GenSigStartValue" SG_ 135 ReSideRdrLeDetn220RdrDetnRng 10050;
BA_ "GenSigSendType" SG_ 135 ReSideRdrLeDetn220RdrDetnRngV 0;
BA_ "GenSigStartValue" SG_ 135 ReSideRdrLeDetn220RdrDetnRngV 4000;
BA_ "GenSigSendType" SG_ 135 ReSideRdrLeDetn220RdrDetnSameRV 0;
BA_ "GenSigSendType" SG_ 135 ReSideRdrLeDetn220RdrDetnSts 0;
BA_ "GenSigStartValue" SG_ 135 ReSideRdrLeDetn220RdrDetnSts 3;
BA_ "GenSigSendType" SG_ 135 ReSideRdrLeDetn221RdrDetnAmbigState 0;
BA_ "GenSigSendType" SG_ 135 ReSideRdrLeDetn221RdrDetnAssoTrkID 0;
BA_ "GenSigSendType" SG_ 135 ReSideRdrLeDetn221RdrDetnAzi 0;
BA_ "GenSigStartValue" SG_ 135 ReSideRdrLeDetn221RdrDetnAzi 900;
BA_ "GenSigDataID" SG_ 135 ReSideRdrLeDetn221RdrDetnChks "0x1139";
BA_ "GenSigFuncType" SG_ 135 ReSideRdrLeDetn221RdrDetnChks 15;
BA_ "GenSigSendType" SG_ 135 ReSideRdrLeDetn221RdrDetnChks 0;
BA_ "GenSigFuncType" SG_ 135 ReSideRdrLeDetn221RdrDetnCntr 16;
BA_ "GenSigSendType" SG_ 135 ReSideRdrLeDetn221RdrDetnCntr 0;
BA_ "GenSigSendType" SG_ 135 ReSideRdrLeDetn221RdrDetnConf 0;
BA_ "GenSigSendType" SG_ 135 ReSideRdrLeDetn221RdrDetnElevn 0;
BA_ "GenSigStartValue" SG_ 135 ReSideRdrLeDetn221RdrDetnElevn 15;
BA_ "GenSigSendType" SG_ 135 ReSideRdrLeDetn221RdrDetnPwr 0;
BA_ "GenSigSendType" SG_ 135 ReSideRdrLeDetn221RdrDetnRng 0;
BA_ "GenSigStartValue" SG_ 135 ReSideRdrLeDetn221RdrDetnRng 10050;
BA_ "GenSigSendType" SG_ 135 ReSideRdrLeDetn221RdrDetnRngV 0;
BA_ "GenSigStartValue" SG_ 135 ReSideRdrLeDetn221RdrDetnRngV 4000;
BA_ "GenSigSendType" SG_ 135 ReSideRdrLeDetn221RdrDetnSameRV 0;
BA_ "GenSigSendType" SG_ 135 ReSideRdrLeDetn221RdrDetnSts 0;
BA_ "GenSigStartValue" SG_ 135 ReSideRdrLeDetn221RdrDetnSts 3;
BA_ "GenSigSendType" SG_ 135 ReSideRdrLeDetn222RdrDetnAmbigState 0;
BA_ "GenSigSendType" SG_ 135 ReSideRdrLeDetn222RdrDetnAssoTrkID 0;
BA_ "GenSigSendType" SG_ 135 ReSideRdrLeDetn222RdrDetnAzi 0;
BA_ "GenSigStartValue" SG_ 135 ReSideRdrLeDetn222RdrDetnAzi 900;
BA_ "GenSigDataID" SG_ 135 ReSideRdrLeDetn222RdrDetnChks "0x113A";
BA_ "GenSigFuncType" SG_ 135 ReSideRdrLeDetn222RdrDetnChks 15;
BA_ "GenSigSendType" SG_ 135 ReSideRdrLeDetn222RdrDetnChks 0;
BA_ "GenSigFuncType" SG_ 135 ReSideRdrLeDetn222RdrDetnCntr 16;
BA_ "GenSigSendType" SG_ 135 ReSideRdrLeDetn222RdrDetnCntr 0;
BA_ "GenSigSendType" SG_ 135 ReSideRdrLeDetn222RdrDetnConf 0;
BA_ "GenSigSendType" SG_ 135 ReSideRdrLeDetn222RdrDetnElevn 0;
BA_ "GenSigStartValue" SG_ 135 ReSideRdrLeDetn222RdrDetnElevn 15;
BA_ "GenSigSendType" SG_ 135 ReSideRdrLeDetn222RdrDetnPwr 0;
BA_ "GenSigSendType" SG_ 135 ReSideRdrLeDetn222RdrDetnRng 0;
BA_ "GenSigStartValue" SG_ 135 ReSideRdrLeDetn222RdrDetnRng 10050;
BA_ "GenSigSendType" SG_ 135 ReSideRdrLeDetn222RdrDetnRngV 0;
BA_ "GenSigStartValue" SG_ 135 ReSideRdrLeDetn222RdrDetnRngV 4000;
BA_ "GenSigSendType" SG_ 135 ReSideRdrLeDetn222RdrDetnSameRV 0;
BA_ "GenSigSendType" SG_ 135 ReSideRdrLeDetn222RdrDetnSts 0;
BA_ "GenSigStartValue" SG_ 135 ReSideRdrLeDetn222RdrDetnSts 3;
BA_ "GenSigSendType" SG_ 136 ReSideRdrLeDetn223RdrDetnAmbigState 0;
BA_ "GenSigSendType" SG_ 136 ReSideRdrLeDetn223RdrDetnAssoTrkID 0;
BA_ "GenSigSendType" SG_ 136 ReSideRdrLeDetn223RdrDetnAzi 0;
BA_ "GenSigStartValue" SG_ 136 ReSideRdrLeDetn223RdrDetnAzi 900;
BA_ "GenSigDataID" SG_ 136 ReSideRdrLeDetn223RdrDetnChks "0x113B";
BA_ "GenSigFuncType" SG_ 136 ReSideRdrLeDetn223RdrDetnChks 15;
BA_ "GenSigSendType" SG_ 136 ReSideRdrLeDetn223RdrDetnChks 0;
BA_ "GenSigFuncType" SG_ 136 ReSideRdrLeDetn223RdrDetnCntr 16;
BA_ "GenSigSendType" SG_ 136 ReSideRdrLeDetn223RdrDetnCntr 0;
BA_ "GenSigSendType" SG_ 136 ReSideRdrLeDetn223RdrDetnConf 0;
BA_ "GenSigSendType" SG_ 136 ReSideRdrLeDetn223RdrDetnElevn 0;
BA_ "GenSigStartValue" SG_ 136 ReSideRdrLeDetn223RdrDetnElevn 15;
BA_ "GenSigSendType" SG_ 136 ReSideRdrLeDetn223RdrDetnPwr 0;
BA_ "GenSigSendType" SG_ 136 ReSideRdrLeDetn223RdrDetnRng 0;
BA_ "GenSigStartValue" SG_ 136 ReSideRdrLeDetn223RdrDetnRng 10050;
BA_ "GenSigSendType" SG_ 136 ReSideRdrLeDetn223RdrDetnRngV 0;
BA_ "GenSigStartValue" SG_ 136 ReSideRdrLeDetn223RdrDetnRngV 4000;
BA_ "GenSigSendType" SG_ 136 ReSideRdrLeDetn223RdrDetnSameRV 0;
BA_ "GenSigSendType" SG_ 136 ReSideRdrLeDetn223RdrDetnSts 0;
BA_ "GenSigStartValue" SG_ 136 ReSideRdrLeDetn223RdrDetnSts 3;
BA_ "GenSigSendType" SG_ 136 ReSideRdrLeDetn224RdrDetnAmbigState 0;
BA_ "GenSigSendType" SG_ 136 ReSideRdrLeDetn224RdrDetnAssoTrkID 0;
BA_ "GenSigSendType" SG_ 136 ReSideRdrLeDetn224RdrDetnAzi 0;
BA_ "GenSigStartValue" SG_ 136 ReSideRdrLeDetn224RdrDetnAzi 900;
BA_ "GenSigDataID" SG_ 136 ReSideRdrLeDetn224RdrDetnChks "0x113C";
BA_ "GenSigFuncType" SG_ 136 ReSideRdrLeDetn224RdrDetnChks 15;
BA_ "GenSigSendType" SG_ 136 ReSideRdrLeDetn224RdrDetnChks 0;
BA_ "GenSigFuncType" SG_ 136 ReSideRdrLeDetn224RdrDetnCntr 16;
BA_ "GenSigSendType" SG_ 136 ReSideRdrLeDetn224RdrDetnCntr 0;
BA_ "GenSigSendType" SG_ 136 ReSideRdrLeDetn224RdrDetnConf 0;
BA_ "GenSigSendType" SG_ 136 ReSideRdrLeDetn224RdrDetnElevn 0;
BA_ "GenSigStartValue" SG_ 136 ReSideRdrLeDetn224RdrDetnElevn 15;
BA_ "GenSigSendType" SG_ 136 ReSideRdrLeDetn224RdrDetnPwr 0;
BA_ "GenSigSendType" SG_ 136 ReSideRdrLeDetn224RdrDetnRng 0;
BA_ "GenSigStartValue" SG_ 136 ReSideRdrLeDetn224RdrDetnRng 10050;
BA_ "GenSigSendType" SG_ 136 ReSideRdrLeDetn224RdrDetnRngV 0;
BA_ "GenSigStartValue" SG_ 136 ReSideRdrLeDetn224RdrDetnRngV 4000;
BA_ "GenSigSendType" SG_ 136 ReSideRdrLeDetn224RdrDetnSameRV 0;
BA_ "GenSigSendType" SG_ 136 ReSideRdrLeDetn224RdrDetnSts 0;
BA_ "GenSigStartValue" SG_ 136 ReSideRdrLeDetn224RdrDetnSts 3;
BA_ "GenSigSendType" SG_ 136 ReSideRdrLeDetn225RdrDetnAmbigState 0;
BA_ "GenSigSendType" SG_ 136 ReSideRdrLeDetn225RdrDetnAssoTrkID 0;
BA_ "GenSigSendType" SG_ 136 ReSideRdrLeDetn225RdrDetnAzi 0;
BA_ "GenSigStartValue" SG_ 136 ReSideRdrLeDetn225RdrDetnAzi 900;
BA_ "GenSigDataID" SG_ 136 ReSideRdrLeDetn225RdrDetnChks "0x113D";
BA_ "GenSigFuncType" SG_ 136 ReSideRdrLeDetn225RdrDetnChks 15;
BA_ "GenSigSendType" SG_ 136 ReSideRdrLeDetn225RdrDetnChks 0;
BA_ "GenSigFuncType" SG_ 136 ReSideRdrLeDetn225RdrDetnCntr 16;
BA_ "GenSigSendType" SG_ 136 ReSideRdrLeDetn225RdrDetnCntr 0;
BA_ "GenSigSendType" SG_ 136 ReSideRdrLeDetn225RdrDetnConf 0;
BA_ "GenSigSendType" SG_ 136 ReSideRdrLeDetn225RdrDetnElevn 0;
BA_ "GenSigStartValue" SG_ 136 ReSideRdrLeDetn225RdrDetnElevn 15;
BA_ "GenSigSendType" SG_ 136 ReSideRdrLeDetn225RdrDetnPwr 0;
BA_ "GenSigSendType" SG_ 136 ReSideRdrLeDetn225RdrDetnRng 0;
BA_ "GenSigStartValue" SG_ 136 ReSideRdrLeDetn225RdrDetnRng 10050;
BA_ "GenSigSendType" SG_ 136 ReSideRdrLeDetn225RdrDetnRngV 0;
BA_ "GenSigStartValue" SG_ 136 ReSideRdrLeDetn225RdrDetnRngV 4000;
BA_ "GenSigSendType" SG_ 136 ReSideRdrLeDetn225RdrDetnSameRV 0;
BA_ "GenSigSendType" SG_ 136 ReSideRdrLeDetn225RdrDetnSts 0;
BA_ "GenSigStartValue" SG_ 136 ReSideRdrLeDetn225RdrDetnSts 3;
BA_ "GenSigSendType" SG_ 136 ReSideRdrLeDetn226RdrDetnAmbigState 0;
BA_ "GenSigSendType" SG_ 136 ReSideRdrLeDetn226RdrDetnAssoTrkID 0;
BA_ "GenSigSendType" SG_ 136 ReSideRdrLeDetn226RdrDetnAzi 0;
BA_ "GenSigStartValue" SG_ 136 ReSideRdrLeDetn226RdrDetnAzi 900;
BA_ "GenSigDataID" SG_ 136 ReSideRdrLeDetn226RdrDetnChks "0x113E";
BA_ "GenSigFuncType" SG_ 136 ReSideRdrLeDetn226RdrDetnChks 15;
BA_ "GenSigSendType" SG_ 136 ReSideRdrLeDetn226RdrDetnChks 0;
BA_ "GenSigFuncType" SG_ 136 ReSideRdrLeDetn226RdrDetnCntr 16;
BA_ "GenSigSendType" SG_ 136 ReSideRdrLeDetn226RdrDetnCntr 0;
BA_ "GenSigSendType" SG_ 136 ReSideRdrLeDetn226RdrDetnConf 0;
BA_ "GenSigSendType" SG_ 136 ReSideRdrLeDetn226RdrDetnElevn 0;
BA_ "GenSigStartValue" SG_ 136 ReSideRdrLeDetn226RdrDetnElevn 15;
BA_ "GenSigSendType" SG_ 136 ReSideRdrLeDetn226RdrDetnPwr 0;
BA_ "GenSigSendType" SG_ 136 ReSideRdrLeDetn226RdrDetnRng 0;
BA_ "GenSigStartValue" SG_ 136 ReSideRdrLeDetn226RdrDetnRng 10050;
BA_ "GenSigSendType" SG_ 136 ReSideRdrLeDetn226RdrDetnRngV 0;
BA_ "GenSigStartValue" SG_ 136 ReSideRdrLeDetn226RdrDetnRngV 4000;
BA_ "GenSigSendType" SG_ 136 ReSideRdrLeDetn226RdrDetnSameRV 0;
BA_ "GenSigSendType" SG_ 136 ReSideRdrLeDetn226RdrDetnSts 0;
BA_ "GenSigStartValue" SG_ 136 ReSideRdrLeDetn226RdrDetnSts 3;
BA_ "GenSigSendType" SG_ 136 ReSideRdrLeDetn227RdrDetnAmbigState 0;
BA_ "GenSigSendType" SG_ 136 ReSideRdrLeDetn227RdrDetnAssoTrkID 0;
BA_ "GenSigSendType" SG_ 136 ReSideRdrLeDetn227RdrDetnAzi 0;
BA_ "GenSigStartValue" SG_ 136 ReSideRdrLeDetn227RdrDetnAzi 900;
BA_ "GenSigDataID" SG_ 136 ReSideRdrLeDetn227RdrDetnChks "0x113F";
BA_ "GenSigFuncType" SG_ 136 ReSideRdrLeDetn227RdrDetnChks 15;
BA_ "GenSigSendType" SG_ 136 ReSideRdrLeDetn227RdrDetnChks 0;
BA_ "GenSigFuncType" SG_ 136 ReSideRdrLeDetn227RdrDetnCntr 16;
BA_ "GenSigSendType" SG_ 136 ReSideRdrLeDetn227RdrDetnCntr 0;
BA_ "GenSigSendType" SG_ 136 ReSideRdrLeDetn227RdrDetnConf 0;
BA_ "GenSigSendType" SG_ 136 ReSideRdrLeDetn227RdrDetnElevn 0;
BA_ "GenSigStartValue" SG_ 136 ReSideRdrLeDetn227RdrDetnElevn 15;
BA_ "GenSigSendType" SG_ 136 ReSideRdrLeDetn227RdrDetnPwr 0;
BA_ "GenSigSendType" SG_ 136 ReSideRdrLeDetn227RdrDetnRng 0;
BA_ "GenSigStartValue" SG_ 136 ReSideRdrLeDetn227RdrDetnRng 10050;
BA_ "GenSigSendType" SG_ 136 ReSideRdrLeDetn227RdrDetnRngV 0;
BA_ "GenSigStartValue" SG_ 136 ReSideRdrLeDetn227RdrDetnRngV 4000;
BA_ "GenSigSendType" SG_ 136 ReSideRdrLeDetn227RdrDetnSameRV 0;
BA_ "GenSigSendType" SG_ 136 ReSideRdrLeDetn227RdrDetnSts 0;
BA_ "GenSigStartValue" SG_ 136 ReSideRdrLeDetn227RdrDetnSts 3;
BA_ "GenSigSendType" SG_ 136 ReSideRdrLeDetn228RdrDetnAmbigState 0;
BA_ "GenSigSendType" SG_ 136 ReSideRdrLeDetn228RdrDetnAssoTrkID 0;
BA_ "GenSigSendType" SG_ 136 ReSideRdrLeDetn228RdrDetnAzi 0;
BA_ "GenSigStartValue" SG_ 136 ReSideRdrLeDetn228RdrDetnAzi 900;
BA_ "GenSigDataID" SG_ 136 ReSideRdrLeDetn228RdrDetnChks "0x1140";
BA_ "GenSigFuncType" SG_ 136 ReSideRdrLeDetn228RdrDetnChks 15;
BA_ "GenSigSendType" SG_ 136 ReSideRdrLeDetn228RdrDetnChks 0;
BA_ "GenSigFuncType" SG_ 136 ReSideRdrLeDetn228RdrDetnCntr 16;
BA_ "GenSigSendType" SG_ 136 ReSideRdrLeDetn228RdrDetnCntr 0;
BA_ "GenSigSendType" SG_ 136 ReSideRdrLeDetn228RdrDetnConf 0;
BA_ "GenSigSendType" SG_ 136 ReSideRdrLeDetn228RdrDetnElevn 0;
BA_ "GenSigStartValue" SG_ 136 ReSideRdrLeDetn228RdrDetnElevn 15;
BA_ "GenSigSendType" SG_ 136 ReSideRdrLeDetn228RdrDetnPwr 0;
BA_ "GenSigSendType" SG_ 136 ReSideRdrLeDetn228RdrDetnRng 0;
BA_ "GenSigStartValue" SG_ 136 ReSideRdrLeDetn228RdrDetnRng 10050;
BA_ "GenSigSendType" SG_ 136 ReSideRdrLeDetn228RdrDetnRngV 0;
BA_ "GenSigStartValue" SG_ 136 ReSideRdrLeDetn228RdrDetnRngV 4000;
BA_ "GenSigSendType" SG_ 136 ReSideRdrLeDetn228RdrDetnSameRV 0;
BA_ "GenSigSendType" SG_ 136 ReSideRdrLeDetn228RdrDetnSts 0;
BA_ "GenSigStartValue" SG_ 136 ReSideRdrLeDetn228RdrDetnSts 3;
VAL_ 131 ReSideRdrLeDetn193RdrDetnAmbigState 0 "YesNo1_Yes" 1 "YesNo1_No";
VAL_ 131 ReSideRdrLeDetn193RdrDetnSameRV 0 "Mode6_0" 1 "Mode6_1" 2 "Mode6_2";
VAL_ 131 ReSideRdrLeDetn193RdrDetnSts 0 "RdrDetnSts_Ukwn" 1 "RdrDetnSts_Movg" 2 "RdrDetnSts_Staty" 3 "RdrDetnSts_Invalid";
VAL_ 131 ReSideRdrLeDetn194RdrDetnAmbigState 0 "YesNo1_Yes" 1 "YesNo1_No";
VAL_ 131 ReSideRdrLeDetn194RdrDetnSameRV 0 "Mode6_0" 1 "Mode6_1" 2 "Mode6_2";
VAL_ 131 ReSideRdrLeDetn194RdrDetnSts 0 "RdrDetnSts_Ukwn" 1 "RdrDetnSts_Movg" 2 "RdrDetnSts_Staty" 3 "RdrDetnSts_Invalid";
VAL_ 131 ReSideRdrLeDetn195RdrDetnAmbigState 0 "YesNo1_Yes" 1 "YesNo1_No";
VAL_ 131 ReSideRdrLeDetn195RdrDetnSameRV 0 "Mode6_0" 1 "Mode6_1" 2 "Mode6_2";
VAL_ 131 ReSideRdrLeDetn195RdrDetnSts 0 "RdrDetnSts_Ukwn" 1 "RdrDetnSts_Movg" 2 "RdrDetnSts_Staty" 3 "RdrDetnSts_Invalid";
VAL_ 131 ReSideRdrLeDetn196RdrDetnAmbigState 0 "YesNo1_Yes" 1 "YesNo1_No";
VAL_ 131 ReSideRdrLeDetn196RdrDetnSameRV 0 "Mode6_0" 1 "Mode6_1" 2 "Mode6_2";
VAL_ 131 ReSideRdrLeDetn196RdrDetnSts 0 "RdrDetnSts_Ukwn" 1 "RdrDetnSts_Movg" 2 "RdrDetnSts_Staty" 3 "RdrDetnSts_Invalid";
VAL_ 131 ReSideRdrLeDetn197RdrDetnAmbigState 0 "YesNo1_Yes" 1 "YesNo1_No";
VAL_ 131 ReSideRdrLeDetn197RdrDetnSameRV 0 "Mode6_0" 1 "Mode6_1" 2 "Mode6_2";
VAL_ 131 ReSideRdrLeDetn197RdrDetnSts 0 "RdrDetnSts_Ukwn" 1 "RdrDetnSts_Movg" 2 "RdrDetnSts_Staty" 3 "RdrDetnSts_Invalid";
VAL_ 131 ReSideRdrLeDetn198RdrDetnAmbigState 0 "YesNo1_Yes" 1 "YesNo1_No";
VAL_ 131 ReSideRdrLeDetn198RdrDetnSameRV 0 "Mode6_0" 1 "Mode6_1" 2 "Mode6_2";
VAL_ 131 ReSideRdrLeDetn198RdrDetnSts 0 "RdrDetnSts_Ukwn" 1 "RdrDetnSts_Movg" 2 "RdrDetnSts_Staty" 3 "RdrDetnSts_Invalid";
VAL_ 132 ReSideRdrLeDetn199RdrDetnAmbigState 0 "YesNo1_Yes" 1 "YesNo1_No";
VAL_ 132 ReSideRdrLeDetn199RdrDetnSameRV 0 "Mode6_0" 1 "Mode6_1" 2 "Mode6_2";
VAL_ 132 ReSideRdrLeDetn199RdrDetnSts 0 "RdrDetnSts_Ukwn" 1 "RdrDetnSts_Movg" 2 "RdrDetnSts_Staty" 3 "RdrDetnSts_Invalid";
VAL_ 132 ReSideRdrLeDetn200RdrDetnAmbigState 0 "YesNo1_Yes" 1 "YesNo1_No";
VAL_ 132 ReSideRdrLeDetn200RdrDetnSameRV 0 "Mode6_0" 1 "Mode6_1" 2 "Mode6_2";
VAL_ 132 ReSideRdrLeDetn200RdrDetnSts 0 "RdrDetnSts_Ukwn" 1 "RdrDetnSts_Movg" 2 "RdrDetnSts_Staty" 3 "RdrDetnSts_Invalid";
VAL_ 132 ReSideRdrLeDetn201RdrDetnAmbigState 0 "YesNo1_Yes" 1 "YesNo1_No";
VAL_ 132 ReSideRdrLeDetn201RdrDetnSameRV 0 "Mode6_0" 1 "Mode6_1" 2 "Mode6_2";
VAL_ 132 ReSideRdrLeDetn201RdrDetnSts 0 "RdrDetnSts_Ukwn" 1 "RdrDetnSts_Movg" 2 "RdrDetnSts_Staty" 3 "RdrDetnSts_Invalid";
VAL_ 132 ReSideRdrLeDetn202RdrDetnAmbigState 0 "YesNo1_Yes" 1 "YesNo1_No";
VAL_ 132 ReSideRdrLeDetn202RdrDetnSameRV 0 "Mode6_0" 1 "Mode6_1" 2 "Mode6_2";
VAL_ 132 ReSideRdrLeDetn202RdrDetnSts 0 "RdrDetnSts_Ukwn" 1 "RdrDetnSts_Movg" 2 "RdrDetnSts_Staty" 3 "RdrDetnSts_Invalid";
VAL_ 132 ReSideRdrLeDetn203RdrDetnAmbigState 0 "YesNo1_Yes" 1 "YesNo1_No";
VAL_ 132 ReSideRdrLeDetn203RdrDetnSameRV 0 "Mode6_0" 1 "Mode6_1" 2 "Mode6_2";
VAL_ 132 ReSideRdrLeDetn203RdrDetnSts 0 "RdrDetnSts_Ukwn" 1 "RdrDetnSts_Movg" 2 "RdrDetnSts_Staty" 3 "RdrDetnSts_Invalid";
VAL_ 132 ReSideRdrLeDetn204RdrDetnAmbigState 0 "YesNo1_Yes" 1 "YesNo1_No";
VAL_ 132 ReSideRdrLeDetn204RdrDetnSameRV 0 "Mode6_0" 1 "Mode6_1" 2 "Mode6_2";
VAL_ 132 ReSideRdrLeDetn204RdrDetnSts 0 "RdrDetnSts_Ukwn" 1 "RdrDetnSts_Movg" 2 "RdrDetnSts_Staty" 3 "RdrDetnSts_Invalid";
VAL_ 133 ReSideRdrLeDetn205RdrDetnAmbigState 0 "YesNo1_Yes" 1 "YesNo1_No";
VAL_ 133 ReSideRdrLeDetn205RdrDetnSameRV 0 "Mode6_0" 1 "Mode6_1" 2 "Mode6_2";
VAL_ 133 ReSideRdrLeDetn205RdrDetnSts 0 "RdrDetnSts_Ukwn" 1 "RdrDetnSts_Movg" 2 "RdrDetnSts_Staty" 3 "RdrDetnSts_Invalid";
VAL_ 133 ReSideRdrLeDetn206RdrDetnAmbigState 0 "YesNo1_Yes" 1 "YesNo1_No";
VAL_ 133 ReSideRdrLeDetn206RdrDetnSameRV 0 "Mode6_0" 1 "Mode6_1" 2 "Mode6_2";
VAL_ 133 ReSideRdrLeDetn206RdrDetnSts 0 "RdrDetnSts_Ukwn" 1 "RdrDetnSts_Movg" 2 "RdrDetnSts_Staty" 3 "RdrDetnSts_Invalid";
VAL_ 133 ReSideRdrLeDetn207RdrDetnAmbigState 0 "YesNo1_Yes" 1 "YesNo1_No";
VAL_ 133 ReSideRdrLeDetn207RdrDetnSameRV 0 "Mode6_0" 1 "Mode6_1" 2 "Mode6_2";
VAL_ 133 ReSideRdrLeDetn207RdrDetnSts 0 "RdrDetnSts_Ukwn" 1 "RdrDetnSts_Movg" 2 "RdrDetnSts_Staty" 3 "RdrDetnSts_Invalid";
VAL_ 133 ReSideRdrLeDetn208RdrDetnAmbigState 0 "YesNo1_Yes" 1 "YesNo1_No";
VAL_ 133 ReSideRdrLeDetn208RdrDetnSameRV 0 "Mode6_0" 1 "Mode6_1" 2 "Mode6_2";
VAL_ 133 ReSideRdrLeDetn208RdrDetnSts 0 "RdrDetnSts_Ukwn" 1 "RdrDetnSts_Movg" 2 "RdrDetnSts_Staty" 3 "RdrDetnSts_Invalid";
VAL_ 133 ReSideRdrLeDetn209RdrDetnAmbigState 0 "YesNo1_Yes" 1 "YesNo1_No";
VAL_ 133 ReSideRdrLeDetn209RdrDetnSameRV 0 "Mode6_0" 1 "Mode6_1" 2 "Mode6_2";
VAL_ 133 ReSideRdrLeDetn209RdrDetnSts 0 "RdrDetnSts_Ukwn" 1 "RdrDetnSts_Movg" 2 "RdrDetnSts_Staty" 3 "RdrDetnSts_Invalid";
VAL_ 133 ReSideRdrLeDetn210RdrDetnAmbigState 0 "YesNo1_Yes" 1 "YesNo1_No";
VAL_ 133 ReSideRdrLeDetn210RdrDetnSameRV 0 "Mode6_0" 1 "Mode6_1" 2 "Mode6_2";
VAL_ 133 ReSideRdrLeDetn210RdrDetnSts 0 "RdrDetnSts_Ukwn" 1 "RdrDetnSts_Movg" 2 "RdrDetnSts_Staty" 3 "RdrDetnSts_Invalid";
VAL_ 134 ReSideRdrLeDetn211RdrDetnAmbigState 0 "YesNo1_Yes" 1 "YesNo1_No";
VAL_ 134 ReSideRdrLeDetn211RdrDetnSameRV 0 "Mode6_0" 1 "Mode6_1" 2 "Mode6_2";
VAL_ 134 ReSideRdrLeDetn211RdrDetnSts 0 "RdrDetnSts_Ukwn" 1 "RdrDetnSts_Movg" 2 "RdrDetnSts_Staty" 3 "RdrDetnSts_Invalid";
VAL_ 134 ReSideRdrLeDetn212RdrDetnAmbigState 0 "YesNo1_Yes" 1 "YesNo1_No";
VAL_ 134 ReSideRdrLeDetn212RdrDetnSameRV 0 "Mode6_0" 1 "Mode6_1" 2 "Mode6_2";
VAL_ 134 ReSideRdrLeDetn212RdrDetnSts 0 "RdrDetnSts_Ukwn" 1 "RdrDetnSts_Movg" 2 "RdrDetnSts_Staty" 3 "RdrDetnSts_Invalid";
VAL_ 134 ReSideRdrLeDetn213RdrDetnAmbigState 0 "YesNo1_Yes" 1 "YesNo1_No";
VAL_ 134 ReSideRdrLeDetn213RdrDetnSameRV 0 "Mode6_0" 1 "Mode6_1" 2 "Mode6_2";
VAL_ 134 ReSideRdrLeDetn213RdrDetnSts 0 "RdrDetnSts_Ukwn" 1 "RdrDetnSts_Movg" 2 "RdrDetnSts_Staty" 3 "RdrDetnSts_Invalid";
VAL_ 134 ReSideRdrLeDetn214RdrDetnAmbigState 0 "YesNo1_Yes" 1 "YesNo1_No";
VAL_ 134 ReSideRdrLeDetn214RdrDetnSameRV 0 "Mode6_0" 1 "Mode6_1" 2 "Mode6_2";
VAL_ 134 ReSideRdrLeDetn214RdrDetnSts 0 "RdrDetnSts_Ukwn" 1 "RdrDetnSts_Movg" 2 "RdrDetnSts_Staty" 3 "RdrDetnSts_Invalid";
VAL_ 134 ReSideRdrLeDetn215RdrDetnAmbigState 0 "YesNo1_Yes" 1 "YesNo1_No";
VAL_ 134 ReSideRdrLeDetn215RdrDetnSameRV 0 "Mode6_0" 1 "Mode6_1" 2 "Mode6_2";
VAL_ 134 ReSideRdrLeDetn215RdrDetnSts 0 "RdrDetnSts_Ukwn" 1 "RdrDetnSts_Movg" 2 "RdrDetnSts_Staty" 3 "RdrDetnSts_Invalid";
VAL_ 134 ReSideRdrLeDetn216RdrDetnAmbigState 0 "YesNo1_Yes" 1 "YesNo1_No";
VAL_ 134 ReSideRdrLeDetn216RdrDetnSameRV 0 "Mode6_0" 1 "Mode6_1" 2 "Mode6_2";
VAL_ 134 ReSideRdrLeDetn216RdrDetnSts 0 "RdrDetnSts_Ukwn" 1 "RdrDetnSts_Movg" 2 "RdrDetnSts_Staty" 3 "RdrDetnSts_Invalid";
VAL_ 135 ReSideRdrLeDetn217RdrDetnAmbigState 0 "YesNo1_Yes" 1 "YesNo1_No";
VAL_ 135 ReSideRdrLeDetn217RdrDetnSameRV 0 "Mode6_0" 1 "Mode6_1" 2 "Mode6_2";
VAL_ 135 ReSideRdrLeDetn217RdrDetnSts 0 "RdrDetnSts_Ukwn" 1 "RdrDetnSts_Movg" 2 "RdrDetnSts_Staty" 3 "RdrDetnSts_Invalid";
VAL_ 135 ReSideRdrLeDetn218RdrDetnAmbigState 0 "YesNo1_Yes" 1 "YesNo1_No";
VAL_ 135 ReSideRdrLeDetn218RdrDetnSameRV 0 "Mode6_0" 1 "Mode6_1" 2 "Mode6_2";
VAL_ 135 ReSideRdrLeDetn218RdrDetnSts 0 "RdrDetnSts_Ukwn" 1 "RdrDetnSts_Movg" 2 "RdrDetnSts_Staty" 3 "RdrDetnSts_Invalid";
VAL_ 135 ReSideRdrLeDetn219RdrDetnAmbigState 0 "YesNo1_Yes" 1 "YesNo1_No";
VAL_ 135 ReSideRdrLeDetn219RdrDetnSameRV 0 "Mode6_0" 1 "Mode6_1" 2 "Mode6_2";
VAL_ 135 ReSideRdrLeDetn219RdrDetnSts 0 "RdrDetnSts_Ukwn" 1 "RdrDetnSts_Movg" 2 "RdrDetnSts_Staty" 3 "RdrDetnSts_Invalid";
VAL_ 135 ReSideRdrLeDetn220RdrDetnAmbigState 0 "YesNo1_Yes" 1 "YesNo1_No";
VAL_ 135 ReSideRdrLeDetn220RdrDetnSameRV 0 "Mode6_0" 1 "Mode6_1" 2 "Mode6_2";
VAL_ 135 ReSideRdrLeDetn220RdrDetnSts 0 "RdrDetnSts_Ukwn" 1 "RdrDetnSts_Movg" 2 "RdrDetnSts_Staty" 3 "RdrDetnSts_Invalid";
VAL_ 135 ReSideRdrLeDetn221RdrDetnAmbigState 0 "YesNo1_Yes" 1 "YesNo1_No";
VAL_ 135 ReSideRdrLeDetn221RdrDetnSameRV 0 "Mode6_0" 1 "Mode6_1" 2 "Mode6_2";
VAL_ 135 ReSideRdrLeDetn221RdrDetnSts 0 "RdrDetnSts_Ukwn" 1 "RdrDetnSts_Movg" 2 "RdrDetnSts_Staty" 3 "RdrDetnSts_Invalid";
VAL_ 135 ReSideRdrLeDetn222RdrDetnAmbigState 0 "YesNo1_Yes" 1 "YesNo1_No";
VAL_ 135 ReSideRdrLeDetn222RdrDetnSameRV 0 "Mode6_0" 1 "Mode6_1" 2 "Mode6_2";
VAL_ 135 ReSideRdrLeDetn222RdrDetnSts 0 "RdrDetnSts_Ukwn" 1 "RdrDetnSts_Movg" 2 "RdrDetnSts_Staty" 3 "RdrDetnSts_Invalid";
VAL_ 136 ReSideRdrLeDetn223RdrDetnAmbigState 0 "YesNo1_Yes" 1 "YesNo1_No";
VAL_ 136 ReSideRdrLeDetn223RdrDetnSameRV 0 "Mode6_0" 1 "Mode6_1" 2 "Mode6_2";
VAL_ 136 ReSideRdrLeDetn223RdrDetnSts 0 "RdrDetnSts_Ukwn" 1 "RdrDetnSts_Movg" 2 "RdrDetnSts_Staty" 3 "RdrDetnSts_Invalid";
VAL_ 136 ReSideRdrLeDetn224RdrDetnAmbigState 0 "YesNo1_Yes" 1 "YesNo1_No";
VAL_ 136 ReSideRdrLeDetn224RdrDetnSameRV 0 "Mode6_0" 1 "Mode6_1" 2 "Mode6_2";
VAL_ 136 ReSideRdrLeDetn224RdrDetnSts 0 "RdrDetnSts_Ukwn" 1 "RdrDetnSts_Movg" 2 "RdrDetnSts_Staty" 3 "RdrDetnSts_Invalid";
VAL_ 136 ReSideRdrLeDetn225RdrDetnAmbigState 0 "YesNo1_Yes" 1 "YesNo1_No";
VAL_ 136 ReSideRdrLeDetn225RdrDetnSameRV 0 "Mode6_0" 1 "Mode6_1" 2 "Mode6_2";
VAL_ 136 ReSideRdrLeDetn225RdrDetnSts 0 "RdrDetnSts_Ukwn" 1 "RdrDetnSts_Movg" 2 "RdrDetnSts_Staty" 3 "RdrDetnSts_Invalid";
VAL_ 136 ReSideRdrLeDetn226RdrDetnAmbigState 0 "YesNo1_Yes" 1 "YesNo1_No";
VAL_ 136 ReSideRdrLeDetn226RdrDetnSameRV 0 "Mode6_0" 1 "Mode6_1" 2 "Mode6_2";
VAL_ 136 ReSideRdrLeDetn226RdrDetnSts 0 "RdrDetnSts_Ukwn" 1 "RdrDetnSts_Movg" 2 "RdrDetnSts_Staty" 3 "RdrDetnSts_Invalid";
VAL_ 136 ReSideRdrLeDetn227RdrDetnAmbigState 0 "YesNo1_Yes" 1 "YesNo1_No";
VAL_ 136 ReSideRdrLeDetn227RdrDetnSameRV 0 "Mode6_0" 1 "Mode6_1" 2 "Mode6_2";
VAL_ 136 ReSideRdrLeDetn227RdrDetnSts 0 "RdrDetnSts_Ukwn" 1 "RdrDetnSts_Movg" 2 "RdrDetnSts_Staty" 3 "RdrDetnSts_Invalid";
VAL_ 136 ReSideRdrLeDetn228RdrDetnAmbigState 0 "YesNo1_Yes" 1 "YesNo1_No";
VAL_ 136 ReSideRdrLeDetn228RdrDetnSameRV 0 "Mode6_0" 1 "Mode6_1" 2 "Mode6_2";
VAL_ 136 ReSideRdrLeDetn228RdrDetnSts 0 "RdrDetnSts_Ukwn" 1 "RdrDetnSts_Movg" 2 "RdrDetnSts_Staty" 3 "RdrDetnSts_Invalid";
SIG_GROUP_ 131 ReSideRdrLeDetn193 1 : ReSideRdrLeDetn193RdrDetnAmbigState ReSideRdrLeDetn193RdrDetnAssoTrkID ReSideRdrLeDetn193RdrDetnAzi ReSideRdrLeDetn193RdrDetnChks ReSideRdrLeDetn193RdrDetnCntr ReSideRdrLeDetn193RdrDetnConf ReSideRdrLeDetn193RdrDetnElevn ReSideRdrLeDetn193RdrDetnPwr ReSideRdrLeDetn193RdrDetnRng ReSideRdrLeDetn193RdrDetnRngV ReSideRdrLeDetn193RdrDetnSameRV ReSideRdrLeDetn193RdrDetnSts;
SIG_GROUP_ 131 ReSideRdrLeDetn194 1 : ReSideRdrLeDetn194RdrDetnAmbigState ReSideRdrLeDetn194RdrDetnAssoTrkID ReSideRdrLeDetn194RdrDetnAzi ReSideRdrLeDetn194RdrDetnChks ReSideRdrLeDetn194RdrDetnCntr ReSideRdrLeDetn194RdrDetnConf ReSideRdrLeDetn194RdrDetnElevn ReSideRdrLeDetn194RdrDetnPwr ReSideRdrLeDetn194RdrDetnRng ReSideRdrLeDetn194RdrDetnRngV ReSideRdrLeDetn194RdrDetnSameRV ReSideRdrLeDetn194RdrDetnSts;
SIG_GROUP_ 131 ReSideRdrLeDetn195 1 : ReSideRdrLeDetn195RdrDetnAmbigState ReSideRdrLeDetn195RdrDetnAssoTrkID ReSideRdrLeDetn195RdrDetnAzi ReSideRdrLeDetn195RdrDetnChks ReSideRdrLeDetn195RdrDetnCntr ReSideRdrLeDetn195RdrDetnConf ReSideRdrLeDetn195RdrDetnElevn ReSideRdrLeDetn195RdrDetnPwr ReSideRdrLeDetn195RdrDetnRng ReSideRdrLeDetn195RdrDetnRngV ReSideRdrLeDetn195RdrDetnSameRV ReSideRdrLeDetn195RdrDetnSts;
SIG_GROUP_ 131 ReSideRdrLeDetn196 1 : ReSideRdrLeDetn196RdrDetnAmbigState ReSideRdrLeDetn196RdrDetnAssoTrkID ReSideRdrLeDetn196RdrDetnAzi ReSideRdrLeDetn196RdrDetnChks ReSideRdrLeDetn196RdrDetnCntr ReSideRdrLeDetn196RdrDetnConf ReSideRdrLeDetn196RdrDetnElevn ReSideRdrLeDetn196RdrDetnPwr ReSideRdrLeDetn196RdrDetnRng ReSideRdrLeDetn196RdrDetnRngV ReSideRdrLeDetn196RdrDetnSameRV ReSideRdrLeDetn196RdrDetnSts;
SIG_GROUP_ 131 ReSideRdrLeDetn197 1 : ReSideRdrLeDetn197RdrDetnAmbigState ReSideRdrLeDetn197RdrDetnAssoTrkID ReSideRdrLeDetn197RdrDetnAzi ReSideRdrLeDetn197RdrDetnChks ReSideRdrLeDetn197RdrDetnCntr ReSideRdrLeDetn197RdrDetnConf ReSideRdrLeDetn197RdrDetnElevn ReSideRdrLeDetn197RdrDetnPwr ReSideRdrLeDetn197RdrDetnRng ReSideRdrLeDetn197RdrDetnRngV ReSideRdrLeDetn197RdrDetnSameRV ReSideRdrLeDetn197RdrDetnSts;
SIG_GROUP_ 131 ReSideRdrLeDetn198 1 : ReSideRdrLeDetn198RdrDetnAmbigState ReSideRdrLeDetn198RdrDetnAssoTrkID ReSideRdrLeDetn198RdrDetnAzi ReSideRdrLeDetn198RdrDetnChks ReSideRdrLeDetn198RdrDetnCntr ReSideRdrLeDetn198RdrDetnConf ReSideRdrLeDetn198RdrDetnElevn ReSideRdrLeDetn198RdrDetnPwr ReSideRdrLeDetn198RdrDetnRng ReSideRdrLeDetn198RdrDetnRngV ReSideRdrLeDetn198RdrDetnSameRV ReSideRdrLeDetn198RdrDetnSts;
SIG_GROUP_ 132 ReSideRdrLeDetn199 1 : ReSideRdrLeDetn199RdrDetnAmbigState ReSideRdrLeDetn199RdrDetnAssoTrkID ReSideRdrLeDetn199RdrDetnAzi ReSideRdrLeDetn199RdrDetnChks ReSideRdrLeDetn199RdrDetnCntr ReSideRdrLeDetn199RdrDetnConf ReSideRdrLeDetn199RdrDetnElevn ReSideRdrLeDetn199RdrDetnPwr ReSideRdrLeDetn199RdrDetnRng ReSideRdrLeDetn199RdrDetnRngV ReSideRdrLeDetn199RdrDetnSameRV ReSideRdrLeDetn199RdrDetnSts;
SIG_GROUP_ 132 ReSideRdrLeDetn200 1 : ReSideRdrLeDetn200RdrDetnAmbigState ReSideRdrLeDetn200RdrDetnAssoTrkID ReSideRdrLeDetn200RdrDetnAzi ReSideRdrLeDetn200RdrDetnChks ReSideRdrLeDetn200RdrDetnCntr ReSideRdrLeDetn200RdrDetnConf ReSideRdrLeDetn200RdrDetnElevn ReSideRdrLeDetn200RdrDetnPwr ReSideRdrLeDetn200RdrDetnRng ReSideRdrLeDetn200RdrDetnRngV ReSideRdrLeDetn200RdrDetnSameRV ReSideRdrLeDetn200RdrDetnSts;
SIG_GROUP_ 132 ReSideRdrLeDetn201 1 : ReSideRdrLeDetn201RdrDetnAmbigState ReSideRdrLeDetn201RdrDetnAssoTrkID ReSideRdrLeDetn201RdrDetnAzi ReSideRdrLeDetn201RdrDetnChks ReSideRdrLeDetn201RdrDetnCntr ReSideRdrLeDetn201RdrDetnConf ReSideRdrLeDetn201RdrDetnElevn ReSideRdrLeDetn201RdrDetnPwr ReSideRdrLeDetn201RdrDetnRng ReSideRdrLeDetn201RdrDetnRngV ReSideRdrLeDetn201RdrDetnSameRV ReSideRdrLeDetn201RdrDetnSts;
SIG_GROUP_ 132 ReSideRdrLeDetn202 1 : ReSideRdrLeDetn202RdrDetnAmbigState ReSideRdrLeDetn202RdrDetnAssoTrkID ReSideRdrLeDetn202RdrDetnAzi ReSideRdrLeDetn202RdrDetnChks ReSideRdrLeDetn202RdrDetnCntr ReSideRdrLeDetn202RdrDetnConf ReSideRdrLeDetn202RdrDetnElevn ReSideRdrLeDetn202RdrDetnPwr ReSideRdrLeDetn202RdrDetnRng ReSideRdrLeDetn202RdrDetnRngV ReSideRdrLeDetn202RdrDetnSameRV ReSideRdrLeDetn202RdrDetnSts;
SIG_GROUP_ 132 ReSideRdrLeDetn203 1 : ReSideRdrLeDetn203RdrDetnAmbigState ReSideRdrLeDetn203RdrDetnAssoTrkID ReSideRdrLeDetn203RdrDetnAzi ReSideRdrLeDetn203RdrDetnChks ReSideRdrLeDetn203RdrDetnCntr ReSideRdrLeDetn203RdrDetnConf ReSideRdrLeDetn203RdrDetnElevn ReSideRdrLeDetn203RdrDetnPwr ReSideRdrLeDetn203RdrDetnRng ReSideRdrLeDetn203RdrDetnRngV ReSideRdrLeDetn203RdrDetnSameRV ReSideRdrLeDetn203RdrDetnSts;
SIG_GROUP_ 132 ReSideRdrLeDetn204 1 : ReSideRdrLeDetn204RdrDetnAmbigState ReSideRdrLeDetn204RdrDetnAssoTrkID ReSideRdrLeDetn204RdrDetnAzi ReSideRdrLeDetn204RdrDetnChks ReSideRdrLeDetn204RdrDetnCntr ReSideRdrLeDetn204RdrDetnConf ReSideRdrLeDetn204RdrDetnElevn ReSideRdrLeDetn204RdrDetnPwr ReSideRdrLeDetn204RdrDetnRng ReSideRdrLeDetn204RdrDetnRngV ReSideRdrLeDetn204RdrDetnSameRV ReSideRdrLeDetn204RdrDetnSts;
SIG_GROUP_ 133 ReSideRdrLeDetn205 1 : ReSideRdrLeDetn205RdrDetnAmbigState ReSideRdrLeDetn205RdrDetnAssoTrkID ReSideRdrLeDetn205RdrDetnAzi ReSideRdrLeDetn205RdrDetnChks ReSideRdrLeDetn205RdrDetnCntr ReSideRdrLeDetn205RdrDetnConf ReSideRdrLeDetn205RdrDetnElevn ReSideRdrLeDetn205RdrDetnPwr ReSideRdrLeDetn205RdrDetnRng ReSideRdrLeDetn205RdrDetnRngV ReSideRdrLeDetn205RdrDetnSameRV ReSideRdrLeDetn205RdrDetnSts;
SIG_GROUP_ 133 ReSideRdrLeDetn206 1 : ReSideRdrLeDetn206RdrDetnAmbigState ReSideRdrLeDetn206RdrDetnAssoTrkID ReSideRdrLeDetn206RdrDetnAzi ReSideRdrLeDetn206RdrDetnChks ReSideRdrLeDetn206RdrDetnCntr ReSideRdrLeDetn206RdrDetnConf ReSideRdrLeDetn206RdrDetnElevn ReSideRdrLeDetn206RdrDetnPwr ReSideRdrLeDetn206RdrDetnRng ReSideRdrLeDetn206RdrDetnRngV ReSideRdrLeDetn206RdrDetnSameRV ReSideRdrLeDetn206RdrDetnSts;
SIG_GROUP_ 133 ReSideRdrLeDetn207 1 : ReSideRdrLeDetn207RdrDetnAmbigState ReSideRdrLeDetn207RdrDetnAssoTrkID ReSideRdrLeDetn207RdrDetnAzi ReSideRdrLeDetn207RdrDetnChks ReSideRdrLeDetn207RdrDetnCntr ReSideRdrLeDetn207RdrDetnConf ReSideRdrLeDetn207RdrDetnElevn ReSideRdrLeDetn207RdrDetnPwr ReSideRdrLeDetn207RdrDetnRng ReSideRdrLeDetn207RdrDetnRngV ReSideRdrLeDetn207RdrDetnSameRV ReSideRdrLeDetn207RdrDetnSts;
SIG_GROUP_ 133 ReSideRdrLeDetn208 1 : ReSideRdrLeDetn208RdrDetnAmbigState ReSideRdrLeDetn208RdrDetnAssoTrkID ReSideRdrLeDetn208RdrDetnAzi ReSideRdrLeDetn208RdrDetnChks ReSideRdrLeDetn208RdrDetnCntr ReSideRdrLeDetn208RdrDetnConf ReSideRdrLeDetn208RdrDetnElevn ReSideRdrLeDetn208RdrDetnPwr ReSideRdrLeDetn208RdrDetnRng ReSideRdrLeDetn208RdrDetnRngV ReSideRdrLeDetn208RdrDetnSameRV ReSideRdrLeDetn208RdrDetnSts;
SIG_GROUP_ 133 ReSideRdrLeDetn209 1 : ReSideRdrLeDetn209RdrDetnAmbigState ReSideRdrLeDetn209RdrDetnAssoTrkID ReSideRdrLeDetn209RdrDetnAzi ReSideRdrLeDetn209RdrDetnChks ReSideRdrLeDetn209RdrDetnCntr ReSideRdrLeDetn209RdrDetnConf ReSideRdrLeDetn209RdrDetnElevn ReSideRdrLeDetn209RdrDetnPwr ReSideRdrLeDetn209RdrDetnRng ReSideRdrLeDetn209RdrDetnRngV ReSideRdrLeDetn209RdrDetnSameRV ReSideRdrLeDetn209RdrDetnSts;
SIG_GROUP_ 133 ReSideRdrLeDetn210 1 : ReSideRdrLeDetn210RdrDetnAmbigState ReSideRdrLeDetn210RdrDetnAssoTrkID ReSideRdrLeDetn210RdrDetnAzi ReSideRdrLeDetn210RdrDetnChks ReSideRdrLeDetn210RdrDetnCntr ReSideRdrLeDetn210RdrDetnConf ReSideRdrLeDetn210RdrDetnElevn ReSideRdrLeDetn210RdrDetnPwr ReSideRdrLeDetn210RdrDetnRng ReSideRdrLeDetn210RdrDetnRngV ReSideRdrLeDetn210RdrDetnSameRV ReSideRdrLeDetn210RdrDetnSts;
SIG_GROUP_ 134 ReSideRdrLeDetn211 1 : ReSideRdrLeDetn211RdrDetnAmbigState ReSideRdrLeDetn211RdrDetnAssoTrkID ReSideRdrLeDetn211RdrDetnAzi ReSideRdrLeDetn211RdrDetnChks ReSideRdrLeDetn211RdrDetnCntr ReSideRdrLeDetn211RdrDetnConf ReSideRdrLeDetn211RdrDetnElevn ReSideRdrLeDetn211RdrDetnPwr ReSideRdrLeDetn211RdrDetnRng ReSideRdrLeDetn211RdrDetnRngV ReSideRdrLeDetn211RdrDetnSameRV ReSideRdrLeDetn211RdrDetnSts;
SIG_GROUP_ 134 ReSideRdrLeDetn212 1 : ReSideRdrLeDetn212RdrDetnAmbigState ReSideRdrLeDetn212RdrDetnAssoTrkID ReSideRdrLeDetn212RdrDetnAzi ReSideRdrLeDetn212RdrDetnChks ReSideRdrLeDetn212RdrDetnCntr ReSideRdrLeDetn212RdrDetnConf ReSideRdrLeDetn212RdrDetnElevn ReSideRdrLeDetn212RdrDetnPwr ReSideRdrLeDetn212RdrDetnRng ReSideRdrLeDetn212RdrDetnRngV ReSideRdrLeDetn212RdrDetnSameRV ReSideRdrLeDetn212RdrDetnSts;
SIG_GROUP_ 134 ReSideRdrLeDetn213 1 : ReSideRdrLeDetn213RdrDetnAmbigState ReSideRdrLeDetn213RdrDetnAssoTrkID ReSideRdrLeDetn213RdrDetnAzi ReSideRdrLeDetn213RdrDetnChks ReSideRdrLeDetn213RdrDetnCntr ReSideRdrLeDetn213RdrDetnConf ReSideRdrLeDetn213RdrDetnElevn ReSideRdrLeDetn213RdrDetnPwr ReSideRdrLeDetn213RdrDetnRng ReSideRdrLeDetn213RdrDetnRngV ReSideRdrLeDetn213RdrDetnSameRV ReSideRdrLeDetn213RdrDetnSts;
SIG_GROUP_ 134 ReSideRdrLeDetn214 1 : ReSideRdrLeDetn214RdrDetnAmbigState ReSideRdrLeDetn214RdrDetnAssoTrkID ReSideRdrLeDetn214RdrDetnAzi ReSideRdrLeDetn214RdrDetnChks ReSideRdrLeDetn214RdrDetnCntr ReSideRdrLeDetn214RdrDetnConf ReSideRdrLeDetn214RdrDetnElevn ReSideRdrLeDetn214RdrDetnPwr ReSideRdrLeDetn214RdrDetnRng ReSideRdrLeDetn214RdrDetnRngV ReSideRdrLeDetn214RdrDetnSameRV ReSideRdrLeDetn214RdrDetnSts;
SIG_GROUP_ 134 ReSideRdrLeDetn215 1 : ReSideRdrLeDetn215RdrDetnAmbigState ReSideRdrLeDetn215RdrDetnAssoTrkID ReSideRdrLeDetn215RdrDetnAzi ReSideRdrLeDetn215RdrDetnChks ReSideRdrLeDetn215RdrDetnCntr ReSideRdrLeDetn215RdrDetnConf ReSideRdrLeDetn215RdrDetnElevn ReSideRdrLeDetn215RdrDetnPwr ReSideRdrLeDetn215RdrDetnRng ReSideRdrLeDetn215RdrDetnRngV ReSideRdrLeDetn215RdrDetnSameRV ReSideRdrLeDetn215RdrDetnSts;
SIG_GROUP_ 134 ReSideRdrLeDetn216 1 : ReSideRdrLeDetn216RdrDetnAmbigState ReSideRdrLeDetn216RdrDetnAssoTrkID ReSideRdrLeDetn216RdrDetnAzi ReSideRdrLeDetn216RdrDetnChks ReSideRdrLeDetn216RdrDetnCntr ReSideRdrLeDetn216RdrDetnConf ReSideRdrLeDetn216RdrDetnElevn ReSideRdrLeDetn216RdrDetnPwr ReSideRdrLeDetn216RdrDetnRng ReSideRdrLeDetn216RdrDetnRngV ReSideRdrLeDetn216RdrDetnSameRV ReSideRdrLeDetn216RdrDetnSts;
SIG_GROUP_ 135 ReSideRdrLeDetn217 1 : ReSideRdrLeDetn217RdrDetnAmbigState ReSideRdrLeDetn217RdrDetnAssoTrkID ReSideRdrLeDetn217RdrDetnAzi ReSideRdrLeDetn217RdrDetnChks ReSideRdrLeDetn217RdrDetnCntr ReSideRdrLeDetn217RdrDetnConf ReSideRdrLeDetn217RdrDetnElevn ReSideRdrLeDetn217RdrDetnPwr ReSideRdrLeDetn217RdrDetnRng ReSideRdrLeDetn217RdrDetnRngV ReSideRdrLeDetn217RdrDetnSameRV ReSideRdrLeDetn217RdrDetnSts;
SIG_GROUP_ 135 ReSideRdrLeDetn218 1 : ReSideRdrLeDetn218RdrDetnAmbigState ReSideRdrLeDetn218RdrDetnAssoTrkID ReSideRdrLeDetn218RdrDetnAzi ReSideRdrLeDetn218RdrDetnChks ReSideRdrLeDetn218RdrDetnCntr ReSideRdrLeDetn218RdrDetnConf ReSideRdrLeDetn218RdrDetnElevn ReSideRdrLeDetn218RdrDetnPwr ReSideRdrLeDetn218RdrDetnRng ReSideRdrLeDetn218RdrDetnRngV ReSideRdrLeDetn218RdrDetnSameRV ReSideRdrLeDetn218RdrDetnSts;
SIG_GROUP_ 135 ReSideRdrLeDetn219 1 : ReSideRdrLeDetn219RdrDetnAmbigState ReSideRdrLeDetn219RdrDetnAssoTrkID ReSideRdrLeDetn219RdrDetnAzi ReSideRdrLeDetn219RdrDetnChks ReSideRdrLeDetn219RdrDetnCntr ReSideRdrLeDetn219RdrDetnConf ReSideRdrLeDetn219RdrDetnElevn ReSideRdrLeDetn219RdrDetnPwr ReSideRdrLeDetn219RdrDetnRng ReSideRdrLeDetn219RdrDetnRngV ReSideRdrLeDetn219RdrDetnSameRV ReSideRdrLeDetn219RdrDetnSts;
SIG_GROUP_ 135 ReSideRdrLeDetn220 1 : ReSideRdrLeDetn220RdrDetnAmbigState ReSideRdrLeDetn220RdrDetnAssoTrkID ReSideRdrLeDetn220RdrDetnAzi ReSideRdrLeDetn220RdrDetnChks ReSideRdrLeDetn220RdrDetnCntr ReSideRdrLeDetn220RdrDetnConf ReSideRdrLeDetn220RdrDetnElevn ReSideRdrLeDetn220RdrDetnPwr ReSideRdrLeDetn220RdrDetnRng ReSideRdrLeDetn220RdrDetnRngV ReSideRdrLeDetn220RdrDetnSameRV ReSideRdrLeDetn220RdrDetnSts;
SIG_GROUP_ 135 ReSideRdrLeDetn221 1 : ReSideRdrLeDetn221RdrDetnAmbigState ReSideRdrLeDetn221RdrDetnAssoTrkID ReSideRdrLeDetn221RdrDetnAzi ReSideRdrLeDetn221RdrDetnChks ReSideRdrLeDetn221RdrDetnCntr ReSideRdrLeDetn221RdrDetnConf ReSideRdrLeDetn221RdrDetnElevn ReSideRdrLeDetn221RdrDetnPwr ReSideRdrLeDetn221RdrDetnRng ReSideRdrLeDetn221RdrDetnRngV ReSideRdrLeDetn221RdrDetnSameRV ReSideRdrLeDetn221RdrDetnSts;
SIG_GROUP_ 135 ReSideRdrLeDetn222 1 : ReSideRdrLeDetn222RdrDetnAmbigState ReSideRdrLeDetn222RdrDetnAssoTrkID ReSideRdrLeDetn222RdrDetnAzi ReSideRdrLeDetn222RdrDetnChks ReSideRdrLeDetn222RdrDetnCntr ReSideRdrLeDetn222RdrDetnConf ReSideRdrLeDetn222RdrDetnElevn ReSideRdrLeDetn222RdrDetnPwr ReSideRdrLeDetn222RdrDetnRng ReSideRdrLeDetn222RdrDetnRngV ReSideRdrLeDetn222RdrDetnSameRV ReSideRdrLeDetn222RdrDetnSts;
SIG_GROUP_ 136 ReSideRdrLeDetn223 1 : ReSideRdrLeDetn223RdrDetnAmbigState ReSideRdrLeDetn223RdrDetnAssoTrkID ReSideRdrLeDetn223RdrDetnAzi ReSideRdrLeDetn223RdrDetnChks ReSideRdrLeDetn223RdrDetnCntr ReSideRdrLeDetn223RdrDetnConf ReSideRdrLeDetn223RdrDetnElevn ReSideRdrLeDetn223RdrDetnPwr ReSideRdrLeDetn223RdrDetnRng ReSideRdrLeDetn223RdrDetnRngV ReSideRdrLeDetn223RdrDetnSameRV ReSideRdrLeDetn223RdrDetnSts;
SIG_GROUP_ 136 ReSideRdrLeDetn224 1 : ReSideRdrLeDetn224RdrDetnAmbigState ReSideRdrLeDetn224RdrDetnAssoTrkID ReSideRdrLeDetn224RdrDetnAzi ReSideRdrLeDetn224RdrDetnChks ReSideRdrLeDetn224RdrDetnCntr ReSideRdrLeDetn224RdrDetnConf ReSideRdrLeDetn224RdrDetnElevn ReSideRdrLeDetn224RdrDetnPwr ReSideRdrLeDetn224RdrDetnRng ReSideRdrLeDetn224RdrDetnRngV ReSideRdrLeDetn224RdrDetnSameRV ReSideRdrLeDetn224RdrDetnSts;
SIG_GROUP_ 136 ReSideRdrLeDetn225 1 : ReSideRdrLeDetn225RdrDetnAmbigState ReSideRdrLeDetn225RdrDetnAssoTrkID ReSideRdrLeDetn225RdrDetnAzi ReSideRdrLeDetn225RdrDetnChks ReSideRdrLeDetn225RdrDetnCntr ReSideRdrLeDetn225RdrDetnConf ReSideRdrLeDetn225RdrDetnElevn ReSideRdrLeDetn225RdrDetnPwr ReSideRdrLeDetn225RdrDetnRng ReSideRdrLeDetn225RdrDetnRngV ReSideRdrLeDetn225RdrDetnSameRV ReSideRdrLeDetn225RdrDetnSts;
SIG_GROUP_ 136 ReSideRdrLeDetn226 1 : ReSideRdrLeDetn226RdrDetnAmbigState ReSideRdrLeDetn226RdrDetnAssoTrkID ReSideRdrLeDetn226RdrDetnAzi ReSideRdrLeDetn226RdrDetnChks ReSideRdrLeDetn226RdrDetnCntr ReSideRdrLeDetn226RdrDetnConf ReSideRdrLeDetn226RdrDetnElevn ReSideRdrLeDetn226RdrDetnPwr ReSideRdrLeDetn226RdrDetnRng ReSideRdrLeDetn226RdrDetnRngV ReSideRdrLeDetn226RdrDetnSameRV ReSideRdrLeDetn226RdrDetnSts;
SIG_GROUP_ 136 ReSideRdrLeDetn227 1 : ReSideRdrLeDetn227RdrDetnAmbigState ReSideRdrLeDetn227RdrDetnAssoTrkID ReSideRdrLeDetn227RdrDetnAzi ReSideRdrLeDetn227RdrDetnChks ReSideRdrLeDetn227RdrDetnCntr ReSideRdrLeDetn227RdrDetnConf ReSideRdrLeDetn227RdrDetnElevn ReSideRdrLeDetn227RdrDetnPwr ReSideRdrLeDetn227RdrDetnRng ReSideRdrLeDetn227RdrDetnRngV ReSideRdrLeDetn227RdrDetnSameRV ReSideRdrLeDetn227RdrDetnSts;
SIG_GROUP_ 136 ReSideRdrLeDetn228 1 : ReSideRdrLeDetn228RdrDetnAmbigState ReSideRdrLeDetn228RdrDetnAssoTrkID ReSideRdrLeDetn228RdrDetnAzi ReSideRdrLeDetn228RdrDetnChks ReSideRdrLeDetn228RdrDetnCntr ReSideRdrLeDetn228RdrDetnConf ReSideRdrLeDetn228RdrDetnElevn ReSideRdrLeDetn228RdrDetnPwr ReSideRdrLeDetn228RdrDetnRng ReSideRdrLeDetn228RdrDetnRngV ReSideRdrLeDetn228RdrDetnSameRV ReSideRdrLeDetn228RdrDetnSts;
