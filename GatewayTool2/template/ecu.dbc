// *************************************************************************** *
// *                                                                           *
// * Description:         CANDB File                                           *
// * Generated at:        2023-03-30 16:08                                     *
// * System:              ZSDB123101                                           *
// * Variant:             CS1E                                                 *
// * Network:             Private_CANFD5                                       *
// *                                                                           *
// *************************************************************************** *
VERSION "Private_CANFD5"

NS_ :

BS_ :

BU_ :  ASDM SODL

BO_ 100 SODLPrivateCANFD5Fr47 : 64 SODL
 SG_ ReSideRdrLeDetn79_UB : 487|1@0+ (1,0) [0|1] "" ASDM
 SG_ ReSideRdrLeDetn79RdrDetnAmbigState : 72|1@0+ (1,0) [0|1] "" ASDM
 SG_ ReSideRdrLeDetn79RdrDetnAssoTrkID : 79|7@0+ (1.0,0.0) [0.0|127.0] "Unitless" ASDM
 SG_ ReSideRdrLeDetn79RdrDetnAzi : 34|11@0+ (0.1,-90.0) [-90.0|90.0] "Deg" ASDM
 SG_ ReSideRdrLeDetn79RdrDetnChks : 7|8@0+ (1.0,0.0) [0.0|255.0] "Unitless" ASDM
 SG_ ReSideRdrLeDetn79RdrDetnCntr : 15|4@0+ (1.0,0.0) [0.0|15.0] "Unitless" ASDM
 SG_ ReSideRdrLeDetn79RdrDetnConf : 11|7@0+ (1.0,0.0) [0.0|100.0] "%" ASDM
 SG_ ReSideRdrLeDetn79RdrDetnElevn : 20|5@0+ (1.0,-15.0) [-15.0|15.0] "Deg" ASDM
 SG_ ReSideRdrLeDetn79RdrDetnPwr : 71|6@0+ (1.0,0.0) [0.0|63.0] "dB" ASDM
 SG_ ReSideRdrLeDetn79RdrDetnRng : 55|14@0+ (0.02,-1.0) [-1.0|200.0] "m" ASDM
 SG_ ReSideRdrLeDetn79RdrDetnRngV : 31|13@0+ (0.02,-80.0) [-80.0|80.0] "m/s" ASDM
 SG_ ReSideRdrLeDetn79RdrDetnSameRV : 65|2@0+ (1,0) [0|3] "" ASDM
 SG_ ReSideRdrLeDetn79RdrDetnSts : 57|2@0+ (1,0) [0|3] "" ASDM
 SG_ ReSideRdrLeDetn80_UB : 486|1@0+ (1,0) [0|1] "" ASDM
 SG_ ReSideRdrLeDetn80RdrDetnAmbigState : 152|1@0+ (1,0) [0|1] "" ASDM
 SG_ ReSideRdrLeDetn80RdrDetnAssoTrkID : 159|7@0+ (1.0,0.0) [0.0|127.0] "Unitless" ASDM
 SG_ ReSideRdrLeDetn80RdrDetnAzi : 114|11@0+ (0.1,-90.0) [-90.0|90.0] "Deg" ASDM
 SG_ ReSideRdrLeDetn80RdrDetnChks : 87|8@0+ (1.0,0.0) [0.0|255.0] "Unitless" ASDM
 SG_ ReSideRdrLeDetn80RdrDetnCntr : 95|4@0+ (1.0,0.0) [0.0|15.0] "Unitless" ASDM
 SG_ ReSideRdrLeDetn80RdrDetnConf : 91|7@0+ (1.0,0.0) [0.0|100.0] "%" ASDM
 SG_ ReSideRdrLeDetn80RdrDetnElevn : 100|5@0+ (1.0,-15.0) [-15.0|15.0] "Deg" ASDM
 SG_ ReSideRdrLeDetn80RdrDetnPwr : 151|6@0+ (1.0,0.0) [0.0|63.0] "dB" ASDM
 SG_ ReSideRdrLeDetn80RdrDetnRng : 135|14@0+ (0.02,-1.0) [-1.0|200.0] "m" ASDM
 SG_ ReSideRdrLeDetn80RdrDetnRngV : 111|13@0+ (0.02,-80.0) [-80.0|80.0] "m/s" ASDM
 SG_ ReSideRdrLeDetn80RdrDetnSameRV : 145|2@0+ (1,0) [0|3] "" ASDM
 SG_ ReSideRdrLeDetn80RdrDetnSts : 137|2@0+ (1,0) [0|3] "" ASDM
 SG_ ReSideRdrLeDetn81_UB : 485|1@0+ (1,0) [0|1] "" ASDM
 SG_ ReSideRdrLeDetn81RdrDetnAmbigState : 232|1@0+ (1,0) [0|1] "" ASDM
 SG_ ReSideRdrLeDetn81RdrDetnAssoTrkID : 239|7@0+ (1.0,0.0) [0.0|127.0] "Unitless" ASDM
 SG_ ReSideRdrLeDetn81RdrDetnAzi : 194|11@0+ (0.1,-90.0) [-90.0|90.0] "Deg" ASDM
 SG_ ReSideRdrLeDetn81RdrDetnChks : 167|8@0+ (1.0,0.0) [0.0|255.0] "Unitless" ASDM
 SG_ ReSideRdrLeDetn81RdrDetnCntr : 175|4@0+ (1.0,0.0) [0.0|15.0] "Unitless" ASDM
 SG_ ReSideRdrLeDetn81RdrDetnConf : 171|7@0+ (1.0,0.0) [0.0|100.0] "%" ASDM
 SG_ ReSideRdrLeDetn81RdrDetnElevn : 180|5@0+ (1.0,-15.0) [-15.0|15.0] "Deg" ASDM
 SG_ ReSideRdrLeDetn81RdrDetnPwr : 231|6@0+ (1.0,0.0) [0.0|63.0] "dB" ASDM
 SG_ ReSideRdrLeDetn81RdrDetnRng : 215|14@0+ (0.02,-1.0) [-1.0|200.0] "m" ASDM
 SG_ ReSideRdrLeDetn81RdrDetnRngV : 191|13@0+ (0.02,-80.0) [-80.0|80.0] "m/s" ASDM
 SG_ ReSideRdrLeDetn81RdrDetnSameRV : 225|2@0+ (1,0) [0|3] "" ASDM
 SG_ ReSideRdrLeDetn81RdrDetnSts : 217|2@0+ (1,0) [0|3] "" ASDM
 SG_ ReSideRdrLeDetn82_UB : 484|1@0+ (1,0) [0|1] "" ASDM
 SG_ ReSideRdrLeDetn82RdrDetnAmbigState : 312|1@0+ (1,0) [0|1] "" ASDM
 SG_ ReSideRdrLeDetn82RdrDetnAssoTrkID : 319|7@0+ (1.0,0.0) [0.0|127.0] "Unitless" ASDM
 SG_ ReSideRdrLeDetn82RdrDetnAzi : 274|11@0+ (0.1,-90.0) [-90.0|90.0] "Deg" ASDM
 SG_ ReSideRdrLeDetn82RdrDetnChks : 247|8@0+ (1.0,0.0) [0.0|255.0] "Unitless" ASDM
 SG_ ReSideRdrLeDetn82RdrDetnCntr : 255|4@0+ (1.0,0.0) [0.0|15.0] "Unitless" ASDM
 SG_ ReSideRdrLeDetn82RdrDetnConf : 251|7@0+ (1.0,0.0) [0.0|100.0] "%" ASDM
 SG_ ReSideRdrLeDetn82RdrDetnElevn : 260|5@0+ (1.0,-15.0) [-15.0|15.0] "Deg" ASDM
 SG_ ReSideRdrLeDetn82RdrDetnPwr : 311|6@0+ (1.0,0.0) [0.0|63.0] "dB" ASDM
 SG_ ReSideRdrLeDetn82RdrDetnRng : 295|14@0+ (0.02,-1.0) [-1.0|200.0] "m" ASDM
 SG_ ReSideRdrLeDetn82RdrDetnRngV : 271|13@0+ (0.02,-80.0) [-80.0|80.0] "m/s" ASDM
 SG_ ReSideRdrLeDetn82RdrDetnSameRV : 305|2@0+ (1,0) [0|3] "" ASDM
 SG_ ReSideRdrLeDetn82RdrDetnSts : 297|2@0+ (1,0) [0|3] "" ASDM
 SG_ ReSideRdrLeDetn83_UB : 483|1@0+ (1,0) [0|1] "" ASDM
 SG_ ReSideRdrLeDetn83RdrDetnAmbigState : 392|1@0+ (1,0) [0|1] "" ASDM
 SG_ ReSideRdrLeDetn83RdrDetnAssoTrkID : 399|7@0+ (1.0,0.0) [0.0|127.0] "Unitless" ASDM
 SG_ ReSideRdrLeDetn83RdrDetnAzi : 354|11@0+ (0.1,-90.0) [-90.0|90.0] "Deg" ASDM
 SG_ ReSideRdrLeDetn83RdrDetnChks : 327|8@0+ (1.0,0.0) [0.0|255.0] "Unitless" ASDM
 SG_ ReSideRdrLeDetn83RdrDetnCntr : 335|4@0+ (1.0,0.0) [0.0|15.0] "Unitless" ASDM
 SG_ ReSideRdrLeDetn83RdrDetnConf : 331|7@0+ (1.0,0.0) [0.0|100.0] "%" ASDM
 SG_ ReSideRdrLeDetn83RdrDetnElevn : 340|5@0+ (1.0,-15.0) [-15.0|15.0] "Deg" ASDM
 SG_ ReSideRdrLeDetn83RdrDetnPwr : 391|6@0+ (1.0,0.0) [0.0|63.0] "dB" ASDM
 SG_ ReSideRdrLeDetn83RdrDetnRng : 375|14@0+ (0.02,-1.0) [-1.0|200.0] "m" ASDM
 SG_ ReSideRdrLeDetn83RdrDetnRngV : 351|13@0+ (0.02,-80.0) [-80.0|80.0] "m/s" ASDM
 SG_ ReSideRdrLeDetn83RdrDetnSameRV : 385|2@0+ (1,0) [0|3] "" ASDM
 SG_ ReSideRdrLeDetn83RdrDetnSts : 377|2@0+ (1,0) [0|3] "" ASDM
 SG_ ReSideRdrLeDetn84_UB : 482|1@0+ (1,0) [0|1] "" ASDM
 SG_ ReSideRdrLeDetn84RdrDetnAmbigState : 472|1@0+ (1,0) [0|1] "" ASDM
 SG_ ReSideRdrLeDetn84RdrDetnAssoTrkID : 479|7@0+ (1.0,0.0) [0.0|127.0] "Unitless" ASDM
 SG_ ReSideRdrLeDetn84RdrDetnAzi : 434|11@0+ (0.1,-90.0) [-90.0|90.0] "Deg" ASDM
 SG_ ReSideRdrLeDetn84RdrDetnChks : 407|8@0+ (1.0,0.0) [0.0|255.0] "Unitless" ASDM
 SG_ ReSideRdrLeDetn84RdrDetnCntr : 415|4@0+ (1.0,0.0) [0.0|15.0] "Unitless" ASDM
 SG_ ReSideRdrLeDetn84RdrDetnConf : 411|7@0+ (1.0,0.0) [0.0|100.0] "%" ASDM
 SG_ ReSideRdrLeDetn84RdrDetnElevn : 420|5@0+ (1.0,-15.0) [-15.0|15.0] "Deg" ASDM
 SG_ ReSideRdrLeDetn84RdrDetnPwr : 471|6@0+ (1.0,0.0) [0.0|63.0] "dB" ASDM
 SG_ ReSideRdrLeDetn84RdrDetnRng : 455|14@0+ (0.02,-1.0) [-1.0|200.0] "m" ASDM
 SG_ ReSideRdrLeDetn84RdrDetnRngV : 431|13@0+ (0.02,-80.0) [-80.0|80.0] "m/s" ASDM
 SG_ ReSideRdrLeDetn84RdrDetnSameRV : 465|2@0+ (1,0) [0|3] "" ASDM
 SG_ ReSideRdrLeDetn84RdrDetnSts : 457|2@0+ (1,0) [0|3] "" ASDM

BO_ 101 SODLPrivateCANFD5Fr48 : 64 SODL
 SG_ ReSideRdrLeDetn85_UB : 487|1@0+ (1,0) [0|1] "" ASDM
 SG_ ReSideRdrLeDetn85RdrDetnAmbigState : 72|1@0+ (1,0) [0|1] "" ASDM
 SG_ ReSideRdrLeDetn85RdrDetnAssoTrkID : 79|7@0+ (1.0,0.0) [0.0|127.0] "Unitless" ASDM
 SG_ ReSideRdrLeDetn85RdrDetnAzi : 34|11@0+ (0.1,-90.0) [-90.0|90.0] "Deg" ASDM
 SG_ ReSideRdrLeDetn85RdrDetnChks : 7|8@0+ (1.0,0.0) [0.0|255.0] "Unitless" ASDM
 SG_ ReSideRdrLeDetn85RdrDetnCntr : 15|4@0+ (1.0,0.0) [0.0|15.0] "Unitless" ASDM
 SG_ ReSideRdrLeDetn85RdrDetnConf : 11|7@0+ (1.0,0.0) [0.0|100.0] "%" ASDM
 SG_ ReSideRdrLeDetn85RdrDetnElevn : 20|5@0+ (1.0,-15.0) [-15.0|15.0] "Deg" ASDM
 SG_ ReSideRdrLeDetn85RdrDetnPwr : 71|6@0+ (1.0,0.0) [0.0|63.0] "dB" ASDM
 SG_ ReSideRdrLeDetn85RdrDetnRng : 55|14@0+ (0.02,-1.0) [-1.0|200.0] "m" ASDM
 SG_ ReSideRdrLeDetn85RdrDetnRngV : 31|13@0+ (0.02,-80.0) [-80.0|80.0] "m/s" ASDM
 SG_ ReSideRdrLeDetn85RdrDetnSameRV : 65|2@0+ (1,0) [0|3] "" ASDM
 SG_ ReSideRdrLeDetn85RdrDetnSts : 57|2@0+ (1,0) [0|3] "" ASDM
 SG_ ReSideRdrLeDetn86_UB : 486|1@0+ (1,0) [0|1] "" ASDM
 SG_ ReSideRdrLeDetn86RdrDetnAmbigState : 152|1@0+ (1,0) [0|1] "" ASDM
 SG_ ReSideRdrLeDetn86RdrDetnAssoTrkID : 159|7@0+ (1.0,0.0) [0.0|127.0] "Unitless" ASDM
 SG_ ReSideRdrLeDetn86RdrDetnAzi : 114|11@0+ (0.1,-90.0) [-90.0|90.0] "Deg" ASDM
 SG_ ReSideRdrLeDetn86RdrDetnChks : 87|8@0+ (1.0,0.0) [0.0|255.0] "Unitless" ASDM
 SG_ ReSideRdrLeDetn86RdrDetnCntr : 95|4@0+ (1.0,0.0) [0.0|15.0] "Unitless" ASDM
 SG_ ReSideRdrLeDetn86RdrDetnConf : 91|7@0+ (1.0,0.0) [0.0|100.0] "%" ASDM
 SG_ ReSideRdrLeDetn86RdrDetnElevn : 100|5@0+ (1.0,-15.0) [-15.0|15.0] "Deg" ASDM
 SG_ ReSideRdrLeDetn86RdrDetnPwr : 151|6@0+ (1.0,0.0) [0.0|63.0] "dB" ASDM
 SG_ ReSideRdrLeDetn86RdrDetnRng : 135|14@0+ (0.02,-1.0) [-1.0|200.0] "m" ASDM
 SG_ ReSideRdrLeDetn86RdrDetnRngV : 111|13@0+ (0.02,-80.0) [-80.0|80.0] "m/s" ASDM
 SG_ ReSideRdrLeDetn86RdrDetnSameRV : 145|2@0+ (1,0) [0|3] "" ASDM
 SG_ ReSideRdrLeDetn86RdrDetnSts : 137|2@0+ (1,0) [0|3] "" ASDM
 SG_ ReSideRdrLeDetn87_UB : 485|1@0+ (1,0) [0|1] "" ASDM
 SG_ ReSideRdrLeDetn87RdrDetnAmbigState : 232|1@0+ (1,0) [0|1] "" ASDM
 SG_ ReSideRdrLeDetn87RdrDetnAssoTrkID : 239|7@0+ (1.0,0.0) [0.0|127.0] "Unitless" ASDM
 SG_ ReSideRdrLeDetn87RdrDetnAzi : 194|11@0+ (0.1,-90.0) [-90.0|90.0] "Deg" ASDM
 SG_ ReSideRdrLeDetn87RdrDetnChks : 167|8@0+ (1.0,0.0) [0.0|255.0] "Unitless" ASDM
 SG_ ReSideRdrLeDetn87RdrDetnCntr : 175|4@0+ (1.0,0.0) [0.0|15.0] "Unitless" ASDM
 SG_ ReSideRdrLeDetn87RdrDetnConf : 171|7@0+ (1.0,0.0) [0.0|100.0] "%" ASDM
 SG_ ReSideRdrLeDetn87RdrDetnElevn : 180|5@0+ (1.0,-15.0) [-15.0|15.0] "Deg" ASDM
 SG_ ReSideRdrLeDetn87RdrDetnPwr : 231|6@0+ (1.0,0.0) [0.0|63.0] "dB" ASDM
 SG_ ReSideRdrLeDetn87RdrDetnRng : 215|14@0+ (0.02,-1.0) [-1.0|200.0] "m" ASDM
 SG_ ReSideRdrLeDetn87RdrDetnRngV : 191|13@0+ (0.02,-80.0) [-80.0|80.0] "m/s" ASDM
 SG_ ReSideRdrLeDetn87RdrDetnSameRV : 225|2@0+ (1,0) [0|3] "" ASDM
 SG_ ReSideRdrLeDetn87RdrDetnSts : 217|2@0+ (1,0) [0|3] "" ASDM
 SG_ ReSideRdrLeDetn88_UB : 484|1@0+ (1,0) [0|1] "" ASDM
 SG_ ReSideRdrLeDetn88RdrDetnAmbigState : 312|1@0+ (1,0) [0|1] "" ASDM
 SG_ ReSideRdrLeDetn88RdrDetnAssoTrkID : 319|7@0+ (1.0,0.0) [0.0|127.0] "Unitless" ASDM
 SG_ ReSideRdrLeDetn88RdrDetnAzi : 274|11@0+ (0.1,-90.0) [-90.0|90.0] "Deg" ASDM
 SG_ ReSideRdrLeDetn88RdrDetnChks : 247|8@0+ (1.0,0.0) [0.0|255.0] "Unitless" ASDM
 SG_ ReSideRdrLeDetn88RdrDetnCntr : 255|4@0+ (1.0,0.0) [0.0|15.0] "Unitless" ASDM
 SG_ ReSideRdrLeDetn88RdrDetnConf : 251|7@0+ (1.0,0.0) [0.0|100.0] "%" ASDM
 SG_ ReSideRdrLeDetn88RdrDetnElevn : 260|5@0+ (1.0,-15.0) [-15.0|15.0] "Deg" ASDM
 SG_ ReSideRdrLeDetn88RdrDetnPwr : 311|6@0+ (1.0,0.0) [0.0|63.0] "dB" ASDM
 SG_ ReSideRdrLeDetn88RdrDetnRng : 295|14@0+ (0.02,-1.0) [-1.0|200.0] "m" ASDM
 SG_ ReSideRdrLeDetn88RdrDetnRngV : 271|13@0+ (0.02,-80.0) [-80.0|80.0] "m/s" ASDM
 SG_ ReSideRdrLeDetn88RdrDetnSameRV : 305|2@0+ (1,0) [0|3] "" ASDM
 SG_ ReSideRdrLeDetn88RdrDetnSts : 297|2@0+ (1,0) [0|3] "" ASDM
 SG_ ReSideRdrLeDetn89_UB : 483|1@0+ (1,0) [0|1] "" ASDM
 SG_ ReSideRdrLeDetn89RdrDetnAmbigState : 392|1@0+ (1,0) [0|1] "" ASDM
 SG_ ReSideRdrLeDetn89RdrDetnAssoTrkID : 399|7@0+ (1.0,0.0) [0.0|127.0] "Unitless" ASDM
 SG_ ReSideRdrLeDetn89RdrDetnAzi : 354|11@0+ (0.1,-90.0) [-90.0|90.0] "Deg" ASDM
 SG_ ReSideRdrLeDetn89RdrDetnChks : 327|8@0+ (1.0,0.0) [0.0|255.0] "Unitless" ASDM
 SG_ ReSideRdrLeDetn89RdrDetnCntr : 335|4@0+ (1.0,0.0) [0.0|15.0] "Unitless" ASDM
 SG_ ReSideRdrLeDetn89RdrDetnConf : 331|7@0+ (1.0,0.0) [0.0|100.0] "%" ASDM
 SG_ ReSideRdrLeDetn89RdrDetnElevn : 340|5@0+ (1.0,-15.0) [-15.0|15.0] "Deg" ASDM
 SG_ ReSideRdrLeDetn89RdrDetnPwr : 391|6@0+ (1.0,0.0) [0.0|63.0] "dB" ASDM
 SG_ ReSideRdrLeDetn89RdrDetnRng : 375|14@0+ (0.02,-1.0) [-1.0|200.0] "m" ASDM
 SG_ ReSideRdrLeDetn89RdrDetnRngV : 351|13@0+ (0.02,-80.0) [-80.0|80.0] "m/s" ASDM
 SG_ ReSideRdrLeDetn89RdrDetnSameRV : 385|2@0+ (1,0) [0|3] "" ASDM
 SG_ ReSideRdrLeDetn89RdrDetnSts : 377|2@0+ (1,0) [0|3] "" ASDM
 SG_ ReSideRdrLeDetn90_UB : 482|1@0+ (1,0) [0|1] "" ASDM
 SG_ ReSideRdrLeDetn90RdrDetnAmbigState : 472|1@0+ (1,0) [0|1] "" ASDM
 SG_ ReSideRdrLeDetn90RdrDetnAssoTrkID : 479|7@0+ (1.0,0.0) [0.0|127.0] "Unitless" ASDM
 SG_ ReSideRdrLeDetn90RdrDetnAzi : 434|11@0+ (0.1,-90.0) [-90.0|90.0] "Deg" ASDM
 SG_ ReSideRdrLeDetn90RdrDetnChks : 407|8@0+ (1.0,0.0) [0.0|255.0] "Unitless" ASDM
 SG_ ReSideRdrLeDetn90RdrDetnCntr : 415|4@0+ (1.0,0.0) [0.0|15.0] "Unitless" ASDM
 SG_ ReSideRdrLeDetn90RdrDetnConf : 411|7@0+ (1.0,0.0) [0.0|100.0] "%" ASDM
 SG_ ReSideRdrLeDetn90RdrDetnElevn : 420|5@0+ (1.0,-15.0) [-15.0|15.0] "Deg" ASDM
 SG_ ReSideRdrLeDetn90RdrDetnPwr : 471|6@0+ (1.0,0.0) [0.0|63.0] "dB" ASDM
 SG_ ReSideRdrLeDetn90RdrDetnRng : 455|14@0+ (0.02,-1.0) [-1.0|200.0] "m" ASDM
 SG_ ReSideRdrLeDetn90RdrDetnRngV : 431|13@0+ (0.02,-80.0) [-80.0|80.0] "m/s" ASDM
 SG_ ReSideRdrLeDetn90RdrDetnSameRV : 465|2@0+ (1,0) [0|3] "" ASDM
 SG_ ReSideRdrLeDetn90RdrDetnSts : 457|2@0+ (1,0) [0|3] "" ASDM

BO_ 102 SODLPrivateCANFD5Fr49 : 64 SODL
 SG_ ReSideRdrLeDetn91_UB : 487|1@0+ (1,0) [0|1] "" ASDM
 SG_ ReSideRdrLeDetn91RdrDetnAmbigState : 72|1@0+ (1,0) [0|1] "" ASDM
 SG_ ReSideRdrLeDetn91RdrDetnAssoTrkID : 79|7@0+ (1.0,0.0) [0.0|127.0] "Unitless" ASDM
 SG_ ReSideRdrLeDetn91RdrDetnAzi : 34|11@0+ (0.1,-90.0) [-90.0|90.0] "Deg" ASDM
 SG_ ReSideRdrLeDetn91RdrDetnChks : 7|8@0+ (1.0,0.0) [0.0|255.0] "Unitless" ASDM
 SG_ ReSideRdrLeDetn91RdrDetnCntr : 15|4@0+ (1.0,0.0) [0.0|15.0] "Unitless" ASDM
 SG_ ReSideRdrLeDetn91RdrDetnConf : 11|7@0+ (1.0,0.0) [0.0|100.0] "%" ASDM
 SG_ ReSideRdrLeDetn91RdrDetnElevn : 20|5@0+ (1.0,-15.0) [-15.0|15.0] "Deg" ASDM
 SG_ ReSideRdrLeDetn91RdrDetnPwr : 71|6@0+ (1.0,0.0) [0.0|63.0] "dB" ASDM
 SG_ ReSideRdrLeDetn91RdrDetnRng : 55|14@0+ (0.02,-1.0) [-1.0|200.0] "m" ASDM
 SG_ ReSideRdrLeDetn91RdrDetnRngV : 31|13@0+ (0.02,-80.0) [-80.0|80.0] "m/s" ASDM
 SG_ ReSideRdrLeDetn91RdrDetnSameRV : 65|2@0+ (1,0) [0|3] "" ASDM
 SG_ ReSideRdrLeDetn91RdrDetnSts : 57|2@0+ (1,0) [0|3] "" ASDM
 SG_ ReSideRdrLeDetn92_UB : 486|1@0+ (1,0) [0|1] "" ASDM
 SG_ ReSideRdrLeDetn92RdrDetnAmbigState : 152|1@0+ (1,0) [0|1] "" ASDM
 SG_ ReSideRdrLeDetn92RdrDetnAssoTrkID : 159|7@0+ (1.0,0.0) [0.0|127.0] "Unitless" ASDM
 SG_ ReSideRdrLeDetn92RdrDetnAzi : 114|11@0+ (0.1,-90.0) [-90.0|90.0] "Deg" ASDM
 SG_ ReSideRdrLeDetn92RdrDetnChks : 87|8@0+ (1.0,0.0) [0.0|255.0] "Unitless" ASDM
 SG_ ReSideRdrLeDetn92RdrDetnCntr : 95|4@0+ (1.0,0.0) [0.0|15.0] "Unitless" ASDM
 SG_ ReSideRdrLeDetn92RdrDetnConf : 91|7@0+ (1.0,0.0) [0.0|100.0] "%" ASDM
 SG_ ReSideRdrLeDetn92RdrDetnElevn : 100|5@0+ (1.0,-15.0) [-15.0|15.0] "Deg" ASDM
 SG_ ReSideRdrLeDetn92RdrDetnPwr : 151|6@0+ (1.0,0.0) [0.0|63.0] "dB" ASDM
 SG_ ReSideRdrLeDetn92RdrDetnRng : 135|14@0+ (0.02,-1.0) [-1.0|200.0] "m" ASDM
 SG_ ReSideRdrLeDetn92RdrDetnRngV : 111|13@0+ (0.02,-80.0) [-80.0|80.0] "m/s" ASDM
 SG_ ReSideRdrLeDetn92RdrDetnSameRV : 145|2@0+ (1,0) [0|3] "" ASDM
 SG_ ReSideRdrLeDetn92RdrDetnSts : 137|2@0+ (1,0) [0|3] "" ASDM
 SG_ ReSideRdrLeDetn93_UB : 485|1@0+ (1,0) [0|1] "" ASDM
 SG_ ReSideRdrLeDetn93RdrDetnAmbigState : 232|1@0+ (1,0) [0|1] "" ASDM
 SG_ ReSideRdrLeDetn93RdrDetnAssoTrkID : 239|7@0+ (1.0,0.0) [0.0|127.0] "Unitless" ASDM
 SG_ ReSideRdrLeDetn93RdrDetnAzi : 194|11@0+ (0.1,-90.0) [-90.0|90.0] "Deg" ASDM
 SG_ ReSideRdrLeDetn93RdrDetnChks : 167|8@0+ (1.0,0.0) [0.0|255.0] "Unitless" ASDM
 SG_ ReSideRdrLeDetn93RdrDetnCntr : 175|4@0+ (1.0,0.0) [0.0|15.0] "Unitless" ASDM
 SG_ ReSideRdrLeDetn93RdrDetnConf : 171|7@0+ (1.0,0.0) [0.0|100.0] "%" ASDM
 SG_ ReSideRdrLeDetn93RdrDetnElevn : 180|5@0+ (1.0,-15.0) [-15.0|15.0] "Deg" ASDM
 SG_ ReSideRdrLeDetn93RdrDetnPwr : 231|6@0+ (1.0,0.0) [0.0|63.0] "dB" ASDM
 SG_ ReSideRdrLeDetn93RdrDetnRng : 215|14@0+ (0.02,-1.0) [-1.0|200.0] "m" ASDM
 SG_ ReSideRdrLeDetn93RdrDetnRngV : 191|13@0+ (0.02,-80.0) [-80.0|80.0] "m/s" ASDM
 SG_ ReSideRdrLeDetn93RdrDetnSameRV : 225|2@0+ (1,0) [0|3] "" ASDM
 SG_ ReSideRdrLeDetn93RdrDetnSts : 217|2@0+ (1,0) [0|3] "" ASDM
 SG_ ReSideRdrLeDetn94_UB : 484|1@0+ (1,0) [0|1] "" ASDM
 SG_ ReSideRdrLeDetn94RdrDetnAmbigState : 312|1@0+ (1,0) [0|1] "" ASDM
 SG_ ReSideRdrLeDetn94RdrDetnAssoTrkID : 319|7@0+ (1.0,0.0) [0.0|127.0] "Unitless" ASDM
 SG_ ReSideRdrLeDetn94RdrDetnAzi : 274|11@0+ (0.1,-90.0) [-90.0|90.0] "Deg" ASDM
 SG_ ReSideRdrLeDetn94RdrDetnChks : 247|8@0+ (1.0,0.0) [0.0|255.0] "Unitless" ASDM
 SG_ ReSideRdrLeDetn94RdrDetnCntr : 255|4@0+ (1.0,0.0) [0.0|15.0] "Unitless" ASDM
 SG_ ReSideRdrLeDetn94RdrDetnConf : 251|7@0+ (1.0,0.0) [0.0|100.0] "%" ASDM
 SG_ ReSideRdrLeDetn94RdrDetnElevn : 260|5@0+ (1.0,-15.0) [-15.0|15.0] "Deg" ASDM
 SG_ ReSideRdrLeDetn94RdrDetnPwr : 311|6@0+ (1.0,0.0) [0.0|63.0] "dB" ASDM
 SG_ ReSideRdrLeDetn94RdrDetnRng : 295|14@0+ (0.02,-1.0) [-1.0|200.0] "m" ASDM
 SG_ ReSideRdrLeDetn94RdrDetnRngV : 271|13@0+ (0.02,-80.0) [-80.0|80.0] "m/s" ASDM
 SG_ ReSideRdrLeDetn94RdrDetnSameRV : 305|2@0+ (1,0) [0|3] "" ASDM
 SG_ ReSideRdrLeDetn94RdrDetnSts : 297|2@0+ (1,0) [0|3] "" ASDM
 SG_ ReSideRdrLeDetn95_UB : 483|1@0+ (1,0) [0|1] "" ASDM
 SG_ ReSideRdrLeDetn95RdrDetnAmbigState : 392|1@0+ (1,0) [0|1] "" ASDM
 SG_ ReSideRdrLeDetn95RdrDetnAssoTrkID : 399|7@0+ (1.0,0.0) [0.0|127.0] "Unitless" ASDM
 SG_ ReSideRdrLeDetn95RdrDetnAzi : 354|11@0+ (0.1,-90.0) [-90.0|90.0] "Deg" ASDM
 SG_ ReSideRdrLeDetn95RdrDetnChks : 327|8@0+ (1.0,0.0) [0.0|255.0] "Unitless" ASDM
 SG_ ReSideRdrLeDetn95RdrDetnCntr : 335|4@0+ (1.0,0.0) [0.0|15.0] "Unitless" ASDM
 SG_ ReSideRdrLeDetn95RdrDetnConf : 331|7@0+ (1.0,0.0) [0.0|100.0] "%" ASDM
 SG_ ReSideRdrLeDetn95RdrDetnElevn : 340|5@0+ (1.0,-15.0) [-15.0|15.0] "Deg" ASDM
 SG_ ReSideRdrLeDetn95RdrDetnPwr : 391|6@0+ (1.0,0.0) [0.0|63.0] "dB" ASDM
 SG_ ReSideRdrLeDetn95RdrDetnRng : 375|14@0+ (0.02,-1.0) [-1.0|200.0] "m" ASDM
 SG_ ReSideRdrLeDetn95RdrDetnRngV : 351|13@0+ (0.02,-80.0) [-80.0|80.0] "m/s" ASDM
 SG_ ReSideRdrLeDetn95RdrDetnSameRV : 385|2@0+ (1,0) [0|3] "" ASDM
 SG_ ReSideRdrLeDetn95RdrDetnSts : 377|2@0+ (1,0) [0|3] "" ASDM
 SG_ ReSideRdrLeDetn96_UB : 482|1@0+ (1,0) [0|1] "" ASDM
 SG_ ReSideRdrLeDetn96RdrDetnAmbigState : 472|1@0+ (1,0) [0|1] "" ASDM
 SG_ ReSideRdrLeDetn96RdrDetnAssoTrkID : 479|7@0+ (1.0,0.0) [0.0|127.0] "Unitless" ASDM
 SG_ ReSideRdrLeDetn96RdrDetnAzi : 434|11@0+ (0.1,-90.0) [-90.0|90.0] "Deg" ASDM
 SG_ ReSideRdrLeDetn96RdrDetnChks : 407|8@0+ (1.0,0.0) [0.0|255.0] "Unitless" ASDM
 SG_ ReSideRdrLeDetn96RdrDetnCntr : 415|4@0+ (1.0,0.0) [0.0|15.0] "Unitless" ASDM
 SG_ ReSideRdrLeDetn96RdrDetnConf : 411|7@0+ (1.0,0.0) [0.0|100.0] "%" ASDM
 SG_ ReSideRdrLeDetn96RdrDetnElevn : 420|5@0+ (1.0,-15.0) [-15.0|15.0] "Deg" ASDM
 SG_ ReSideRdrLeDetn96RdrDetnPwr : 471|6@0+ (1.0,0.0) [0.0|63.0] "dB" ASDM
 SG_ ReSideRdrLeDetn96RdrDetnRng : 455|14@0+ (0.02,-1.0) [-1.0|200.0] "m" ASDM
 SG_ ReSideRdrLeDetn96RdrDetnRngV : 431|13@0+ (0.02,-80.0) [-80.0|80.0] "m/s" ASDM
 SG_ ReSideRdrLeDetn96RdrDetnSameRV : 465|2@0+ (1,0) [0|3] "" ASDM
 SG_ ReSideRdrLeDetn96RdrDetnSts : 457|2@0+ (1,0) [0|3] "" ASDM

BO_ 103 SODLPrivateCANFD5Fr50 : 64 SODL
 SG_ ReSideRdrLeDetn100_UB : 484|1@0+ (1,0) [0|1] "" ASDM
 SG_ ReSideRdrLeDetn100RdrDetnAmbigState : 312|1@0+ (1,0) [0|1] "" ASDM
 SG_ ReSideRdrLeDetn100RdrDetnAssoTrkID : 319|7@0+ (1.0,0.0) [0.0|127.0] "Unitless" ASDM
 SG_ ReSideRdrLeDetn100RdrDetnAzi : 274|11@0+ (0.1,-90.0) [-90.0|90.0] "Deg" ASDM
 SG_ ReSideRdrLeDetn100RdrDetnChks : 247|8@0+ (1.0,0.0) [0.0|255.0] "Unitless" ASDM
 SG_ ReSideRdrLeDetn100RdrDetnCntr : 255|4@0+ (1.0,0.0) [0.0|15.0] "Unitless" ASDM
 SG_ ReSideRdrLeDetn100RdrDetnConf : 251|7@0+ (1.0,0.0) [0.0|100.0] "%" ASDM
 SG_ ReSideRdrLeDetn100RdrDetnElevn : 260|5@0+ (1.0,-15.0) [-15.0|15.0] "Deg" ASDM
 SG_ ReSideRdrLeDetn100RdrDetnPwr : 311|6@0+ (1.0,0.0) [0.0|63.0] "dB" ASDM
 SG_ ReSideRdrLeDetn100RdrDetnRng : 295|14@0+ (0.02,-1.0) [-1.0|200.0] "m" ASDM
 SG_ ReSideRdrLeDetn100RdrDetnRngV : 271|13@0+ (0.02,-80.0) [-80.0|80.0] "m/s" ASDM
 SG_ ReSideRdrLeDetn100RdrDetnSameRV : 305|2@0+ (1,0) [0|3] "" ASDM
 SG_ ReSideRdrLeDetn100RdrDetnSts : 297|2@0+ (1,0) [0|3] "" ASDM
 SG_ ReSideRdrLeDetn101_UB : 483|1@0+ (1,0) [0|1] "" ASDM
 SG_ ReSideRdrLeDetn101RdrDetnAmbigState : 392|1@0+ (1,0) [0|1] "" ASDM
 SG_ ReSideRdrLeDetn101RdrDetnAssoTrkID : 399|7@0+ (1.0,0.0) [0.0|127.0] "Unitless" ASDM
 SG_ ReSideRdrLeDetn101RdrDetnAzi : 354|11@0+ (0.1,-90.0) [-90.0|90.0] "Deg" ASDM
 SG_ ReSideRdrLeDetn101RdrDetnChks : 327|8@0+ (1.0,0.0) [0.0|255.0] "Unitless" ASDM
 SG_ ReSideRdrLeDetn101RdrDetnCntr : 335|4@0+ (1.0,0.0) [0.0|15.0] "Unitless" ASDM
 SG_ ReSideRdrLeDetn101RdrDetnConf : 331|7@0+ (1.0,0.0) [0.0|100.0] "%" ASDM
 SG_ ReSideRdrLeDetn101RdrDetnElevn : 340|5@0+ (1.0,-15.0) [-15.0|15.0] "Deg" ASDM
 SG_ ReSideRdrLeDetn101RdrDetnPwr : 391|6@0+ (1.0,0.0) [0.0|63.0] "dB" ASDM
 SG_ ReSideRdrLeDetn101RdrDetnRng : 375|14@0+ (0.02,-1.0) [-1.0|200.0] "m" ASDM
 SG_ ReSideRdrLeDetn101RdrDetnRngV : 351|13@0+ (0.02,-80.0) [-80.0|80.0] "m/s" ASDM
 SG_ ReSideRdrLeDetn101RdrDetnSameRV : 385|2@0+ (1,0) [0|3] "" ASDM
 SG_ ReSideRdrLeDetn101RdrDetnSts : 377|2@0+ (1,0) [0|3] "" ASDM
 SG_ ReSideRdrLeDetn102_UB : 482|1@0+ (1,0) [0|1] "" ASDM
 SG_ ReSideRdrLeDetn102RdrDetnAmbigState : 472|1@0+ (1,0) [0|1] "" ASDM
 SG_ ReSideRdrLeDetn102RdrDetnAssoTrkID : 479|7@0+ (1.0,0.0) [0.0|127.0] "Unitless" ASDM
 SG_ ReSideRdrLeDetn102RdrDetnAzi : 434|11@0+ (0.1,-90.0) [-90.0|90.0] "Deg" ASDM
 SG_ ReSideRdrLeDetn102RdrDetnChks : 407|8@0+ (1.0,0.0) [0.0|255.0] "Unitless" ASDM
 SG_ ReSideRdrLeDetn102RdrDetnCntr : 415|4@0+ (1.0,0.0) [0.0|15.0] "Unitless" ASDM
 SG_ ReSideRdrLeDetn102RdrDetnConf : 411|7@0+ (1.0,0.0) [0.0|100.0] "%" ASDM
 SG_ ReSideRdrLeDetn102RdrDetnElevn : 420|5@0+ (1.0,-15.0) [-15.0|15.0] "Deg" ASDM
 SG_ ReSideRdrLeDetn102RdrDetnPwr : 471|6@0+ (1.0,0.0) [0.0|63.0] "dB" ASDM
 SG_ ReSideRdrLeDetn102RdrDetnRng : 455|14@0+ (0.02,-1.0) [-1.0|200.0] "m" ASDM
 SG_ ReSideRdrLeDetn102RdrDetnRngV : 431|13@0+ (0.02,-80.0) [-80.0|80.0] "m/s" ASDM
 SG_ ReSideRdrLeDetn102RdrDetnSameRV : 465|2@0+ (1,0) [0|3] "" ASDM
 SG_ ReSideRdrLeDetn102RdrDetnSts : 457|2@0+ (1,0) [0|3] "" ASDM
 SG_ ReSideRdrLeDetn97_UB : 487|1@0+ (1,0) [0|1] "" ASDM
 SG_ ReSideRdrLeDetn97RdrDetnAmbigState : 72|1@0+ (1,0) [0|1] "" ASDM
 SG_ ReSideRdrLeDetn97RdrDetnAssoTrkID : 79|7@0+ (1.0,0.0) [0.0|127.0] "Unitless" ASDM
 SG_ ReSideRdrLeDetn97RdrDetnAzi : 34|11@0+ (0.1,-90.0) [-90.0|90.0] "Deg" ASDM
 SG_ ReSideRdrLeDetn97RdrDetnChks : 7|8@0+ (1.0,0.0) [0.0|255.0] "Unitless" ASDM
 SG_ ReSideRdrLeDetn97RdrDetnCntr : 15|4@0+ (1.0,0.0) [0.0|15.0] "Unitless" ASDM
 SG_ ReSideRdrLeDetn97RdrDetnConf : 11|7@0+ (1.0,0.0) [0.0|100.0] "%" ASDM
 SG_ ReSideRdrLeDetn97RdrDetnElevn : 20|5@0+ (1.0,-15.0) [-15.0|15.0] "Deg" ASDM
 SG_ ReSideRdrLeDetn97RdrDetnPwr : 71|6@0+ (1.0,0.0) [0.0|63.0] "dB" ASDM
 SG_ ReSideRdrLeDetn97RdrDetnRng : 55|14@0+ (0.02,-1.0) [-1.0|200.0] "m" ASDM
 SG_ ReSideRdrLeDetn97RdrDetnRngV : 31|13@0+ (0.02,-80.0) [-80.0|80.0] "m/s" ASDM
 SG_ ReSideRdrLeDetn97RdrDetnSameRV : 65|2@0+ (1,0) [0|3] "" ASDM
 SG_ ReSideRdrLeDetn97RdrDetnSts : 57|2@0+ (1,0) [0|3] "" ASDM
 SG_ ReSideRdrLeDetn98_UB : 486|1@0+ (1,0) [0|1] "" ASDM
 SG_ ReSideRdrLeDetn98RdrDetnAmbigState : 152|1@0+ (1,0) [0|1] "" ASDM
 SG_ ReSideRdrLeDetn98RdrDetnAssoTrkID : 159|7@0+ (1.0,0.0) [0.0|127.0] "Unitless" ASDM
 SG_ ReSideRdrLeDetn98RdrDetnAzi : 114|11@0+ (0.1,-90.0) [-90.0|90.0] "Deg" ASDM
 SG_ ReSideRdrLeDetn98RdrDetnChks : 87|8@0+ (1.0,0.0) [0.0|255.0] "Unitless" ASDM
 SG_ ReSideRdrLeDetn98RdrDetnCntr : 95|4@0+ (1.0,0.0) [0.0|15.0] "Unitless" ASDM
 SG_ ReSideRdrLeDetn98RdrDetnConf : 91|7@0+ (1.0,0.0) [0.0|100.0] "%" ASDM
 SG_ ReSideRdrLeDetn98RdrDetnElevn : 100|5@0+ (1.0,-15.0) [-15.0|15.0] "Deg" ASDM
 SG_ ReSideRdrLeDetn98RdrDetnPwr : 151|6@0+ (1.0,0.0) [0.0|63.0] "dB" ASDM
 SG_ ReSideRdrLeDetn98RdrDetnRng : 135|14@0+ (0.02,-1.0) [-1.0|200.0] "m" ASDM
 SG_ ReSideRdrLeDetn98RdrDetnRngV : 111|13@0+ (0.02,-80.0) [-80.0|80.0] "m/s" ASDM
 SG_ ReSideRdrLeDetn98RdrDetnSameRV : 145|2@0+ (1,0) [0|3] "" ASDM
 SG_ ReSideRdrLeDetn98RdrDetnSts : 137|2@0+ (1,0) [0|3] "" ASDM
 SG_ ReSideRdrLeDetn99_UB : 485|1@0+ (1,0) [0|1] "" ASDM
 SG_ ReSideRdrLeDetn99RdrDetnAmbigState : 232|1@0+ (1,0) [0|1] "" ASDM
 SG_ ReSideRdrLeDetn99RdrDetnAssoTrkID : 239|7@0+ (1.0,0.0) [0.0|127.0] "Unitless" ASDM
 SG_ ReSideRdrLeDetn99RdrDetnAzi : 194|11@0+ (0.1,-90.0) [-90.0|90.0] "Deg" ASDM
 SG_ ReSideRdrLeDetn99RdrDetnChks : 167|8@0+ (1.0,0.0) [0.0|255.0] "Unitless" ASDM
 SG_ ReSideRdrLeDetn99RdrDetnCntr : 175|4@0+ (1.0,0.0) [0.0|15.0] "Unitless" ASDM
 SG_ ReSideRdrLeDetn99RdrDetnConf : 171|7@0+ (1.0,0.0) [0.0|100.0] "%" ASDM
 SG_ ReSideRdrLeDetn99RdrDetnElevn : 180|5@0+ (1.0,-15.0) [-15.0|15.0] "Deg" ASDM
 SG_ ReSideRdrLeDetn99RdrDetnPwr : 231|6@0+ (1.0,0.0) [0.0|63.0] "dB" ASDM
 SG_ ReSideRdrLeDetn99RdrDetnRng : 215|14@0+ (0.02,-1.0) [-1.0|200.0] "m" ASDM
 SG_ ReSideRdrLeDetn99RdrDetnRngV : 191|13@0+ (0.02,-80.0) [-80.0|80.0] "m/s" ASDM
 SG_ ReSideRdrLeDetn99RdrDetnSameRV : 225|2@0+ (1,0) [0|3] "" ASDM
 SG_ ReSideRdrLeDetn99RdrDetnSts : 217|2@0+ (1,0) [0|3] "" ASDM

BO_ 104 SODLPrivateCANFD5Fr51 : 64 SODL
 SG_ ReSideRdrLeDetn103_UB : 487|1@0+ (1,0) [0|1] "" ASDM
 SG_ ReSideRdrLeDetn103RdrDetnAmbigState : 72|1@0+ (1,0) [0|1] "" ASDM
 SG_ ReSideRdrLeDetn103RdrDetnAssoTrkID : 79|7@0+ (1.0,0.0) [0.0|127.0] "Unitless" ASDM
 SG_ ReSideRdrLeDetn103RdrDetnAzi : 34|11@0+ (0.1,-90.0) [-90.0|90.0] "Deg" ASDM
 SG_ ReSideRdrLeDetn103RdrDetnChks : 7|8@0+ (1.0,0.0) [0.0|255.0] "Unitless" ASDM
 SG_ ReSideRdrLeDetn103RdrDetnCntr : 15|4@0+ (1.0,0.0) [0.0|15.0] "Unitless" ASDM
 SG_ ReSideRdrLeDetn103RdrDetnConf : 11|7@0+ (1.0,0.0) [0.0|100.0] "%" ASDM
 SG_ ReSideRdrLeDetn103RdrDetnElevn : 20|5@0+ (1.0,-15.0) [-15.0|15.0] "Deg" ASDM
 SG_ ReSideRdrLeDetn103RdrDetnPwr : 71|6@0+ (1.0,0.0) [0.0|63.0] "dB" ASDM
 SG_ ReSideRdrLeDetn103RdrDetnRng : 55|14@0+ (0.02,-1.0) [-1.0|200.0] "m" ASDM
 SG_ ReSideRdrLeDetn103RdrDetnRngV : 31|13@0+ (0.02,-80.0) [-80.0|80.0] "m/s" ASDM
 SG_ ReSideRdrLeDetn103RdrDetnSameRV : 65|2@0+ (1,0) [0|3] "" ASDM
 SG_ ReSideRdrLeDetn103RdrDetnSts : 57|2@0+ (1,0) [0|3] "" ASDM
 SG_ ReSideRdrLeDetn104_UB : 486|1@0+ (1,0) [0|1] "" ASDM
 SG_ ReSideRdrLeDetn104RdrDetnAmbigState : 152|1@0+ (1,0) [0|1] "" ASDM
 SG_ ReSideRdrLeDetn104RdrDetnAssoTrkID : 159|7@0+ (1.0,0.0) [0.0|127.0] "Unitless" ASDM
 SG_ ReSideRdrLeDetn104RdrDetnAzi : 114|11@0+ (0.1,-90.0) [-90.0|90.0] "Deg" ASDM
 SG_ ReSideRdrLeDetn104RdrDetnChks : 87|8@0+ (1.0,0.0) [0.0|255.0] "Unitless" ASDM
 SG_ ReSideRdrLeDetn104RdrDetnCntr : 95|4@0+ (1.0,0.0) [0.0|15.0] "Unitless" ASDM
 SG_ ReSideRdrLeDetn104RdrDetnConf : 91|7@0+ (1.0,0.0) [0.0|100.0] "%" ASDM
 SG_ ReSideRdrLeDetn104RdrDetnElevn : 100|5@0+ (1.0,-15.0) [-15.0|15.0] "Deg" ASDM
 SG_ ReSideRdrLeDetn104RdrDetnPwr : 151|6@0+ (1.0,0.0) [0.0|63.0] "dB" ASDM
 SG_ ReSideRdrLeDetn104RdrDetnRng : 135|14@0+ (0.02,-1.0) [-1.0|200.0] "m" ASDM
 SG_ ReSideRdrLeDetn104RdrDetnRngV : 111|13@0+ (0.02,-80.0) [-80.0|80.0] "m/s" ASDM
 SG_ ReSideRdrLeDetn104RdrDetnSameRV : 145|2@0+ (1,0) [0|3] "" ASDM
 SG_ ReSideRdrLeDetn104RdrDetnSts : 137|2@0+ (1,0) [0|3] "" ASDM
 SG_ ReSideRdrLeDetn105_UB : 485|1@0+ (1,0) [0|1] "" ASDM
 SG_ ReSideRdrLeDetn105RdrDetnAmbigState : 232|1@0+ (1,0) [0|1] "" ASDM
 SG_ ReSideRdrLeDetn105RdrDetnAssoTrkID : 239|7@0+ (1.0,0.0) [0.0|127.0] "Unitless" ASDM
 SG_ ReSideRdrLeDetn105RdrDetnAzi : 194|11@0+ (0.1,-90.0) [-90.0|90.0] "Deg" ASDM
 SG_ ReSideRdrLeDetn105RdrDetnChks : 167|8@0+ (1.0,0.0) [0.0|255.0] "Unitless" ASDM
 SG_ ReSideRdrLeDetn105RdrDetnCntr : 175|4@0+ (1.0,0.0) [0.0|15.0] "Unitless" ASDM
 SG_ ReSideRdrLeDetn105RdrDetnConf : 171|7@0+ (1.0,0.0) [0.0|100.0] "%" ASDM
 SG_ ReSideRdrLeDetn105RdrDetnElevn : 180|5@0+ (1.0,-15.0) [-15.0|15.0] "Deg" ASDM
 SG_ ReSideRdrLeDetn105RdrDetnPwr : 231|6@0+ (1.0,0.0) [0.0|63.0] "dB" ASDM
 SG_ ReSideRdrLeDetn105RdrDetnRng : 215|14@0+ (0.02,-1.0) [-1.0|200.0] "m" ASDM
 SG_ ReSideRdrLeDetn105RdrDetnRngV : 191|13@0+ (0.02,-80.0) [-80.0|80.0] "m/s" ASDM
 SG_ ReSideRdrLeDetn105RdrDetnSameRV : 225|2@0+ (1,0) [0|3] "" ASDM
 SG_ ReSideRdrLeDetn105RdrDetnSts : 217|2@0+ (1,0) [0|3] "" ASDM
 SG_ ReSideRdrLeDetn106_UB : 484|1@0+ (1,0) [0|1] "" ASDM
 SG_ ReSideRdrLeDetn106RdrDetnAmbigState : 312|1@0+ (1,0) [0|1] "" ASDM
 SG_ ReSideRdrLeDetn106RdrDetnAssoTrkID : 319|7@0+ (1.0,0.0) [0.0|127.0] "Unitless" ASDM
 SG_ ReSideRdrLeDetn106RdrDetnAzi : 274|11@0+ (0.1,-90.0) [-90.0|90.0] "Deg" ASDM
 SG_ ReSideRdrLeDetn106RdrDetnChks : 247|8@0+ (1.0,0.0) [0.0|255.0] "Unitless" ASDM
 SG_ ReSideRdrLeDetn106RdrDetnCntr : 255|4@0+ (1.0,0.0) [0.0|15.0] "Unitless" ASDM
 SG_ ReSideRdrLeDetn106RdrDetnConf : 251|7@0+ (1.0,0.0) [0.0|100.0] "%" ASDM
 SG_ ReSideRdrLeDetn106RdrDetnElevn : 260|5@0+ (1.0,-15.0) [-15.0|15.0] "Deg" ASDM
 SG_ ReSideRdrLeDetn106RdrDetnPwr : 311|6@0+ (1.0,0.0) [0.0|63.0] "dB" ASDM
 SG_ ReSideRdrLeDetn106RdrDetnRng : 295|14@0+ (0.02,-1.0) [-1.0|200.0] "m" ASDM
 SG_ ReSideRdrLeDetn106RdrDetnRngV : 271|13@0+ (0.02,-80.0) [-80.0|80.0] "m/s" ASDM
 SG_ ReSideRdrLeDetn106RdrDetnSameRV : 305|2@0+ (1,0) [0|3] "" ASDM
 SG_ ReSideRdrLeDetn106RdrDetnSts : 297|2@0+ (1,0) [0|3] "" ASDM
 SG_ ReSideRdrLeDetn107_UB : 483|1@0+ (1,0) [0|1] "" ASDM
 SG_ ReSideRdrLeDetn107RdrDetnAmbigState : 392|1@0+ (1,0) [0|1] "" ASDM
 SG_ ReSideRdrLeDetn107RdrDetnAssoTrkID : 399|7@0+ (1.0,0.0) [0.0|127.0] "Unitless" ASDM
 SG_ ReSideRdrLeDetn107RdrDetnAzi : 354|11@0+ (0.1,-90.0) [-90.0|90.0] "Deg" ASDM
 SG_ ReSideRdrLeDetn107RdrDetnChks : 327|8@0+ (1.0,0.0) [0.0|255.0] "Unitless" ASDM
 SG_ ReSideRdrLeDetn107RdrDetnCntr : 335|4@0+ (1.0,0.0) [0.0|15.0] "Unitless" ASDM
 SG_ ReSideRdrLeDetn107RdrDetnConf : 331|7@0+ (1.0,0.0) [0.0|100.0] "%" ASDM
 SG_ ReSideRdrLeDetn107RdrDetnElevn : 340|5@0+ (1.0,-15.0) [-15.0|15.0] "Deg" ASDM
 SG_ ReSideRdrLeDetn107RdrDetnPwr : 391|6@0+ (1.0,0.0) [0.0|63.0] "dB" ASDM
 SG_ ReSideRdrLeDetn107RdrDetnRng : 375|14@0+ (0.02,-1.0) [-1.0|200.0] "m" ASDM
 SG_ ReSideRdrLeDetn107RdrDetnRngV : 351|13@0+ (0.02,-80.0) [-80.0|80.0] "m/s" ASDM
 SG_ ReSideRdrLeDetn107RdrDetnSameRV : 385|2@0+ (1,0) [0|3] "" ASDM
 SG_ ReSideRdrLeDetn107RdrDetnSts : 377|2@0+ (1,0) [0|3] "" ASDM
 SG_ ReSideRdrLeDetn108_UB : 482|1@0+ (1,0) [0|1] "" ASDM
 SG_ ReSideRdrLeDetn108RdrDetnAmbigState : 472|1@0+ (1,0) [0|1] "" ASDM
 SG_ ReSideRdrLeDetn108RdrDetnAssoTrkID : 479|7@0+ (1.0,0.0) [0.0|127.0] "Unitless" ASDM
 SG_ ReSideRdrLeDetn108RdrDetnAzi : 434|11@0+ (0.1,-90.0) [-90.0|90.0] "Deg" ASDM
 SG_ ReSideRdrLeDetn108RdrDetnChks : 407|8@0+ (1.0,0.0) [0.0|255.0] "Unitless" ASDM
 SG_ ReSideRdrLeDetn108RdrDetnCntr : 415|4@0+ (1.0,0.0) [0.0|15.0] "Unitless" ASDM
 SG_ ReSideRdrLeDetn108RdrDetnConf : 411|7@0+ (1.0,0.0) [0.0|100.0] "%" ASDM
 SG_ ReSideRdrLeDetn108RdrDetnElevn : 420|5@0+ (1.0,-15.0) [-15.0|15.0] "Deg" ASDM
 SG_ ReSideRdrLeDetn108RdrDetnPwr : 471|6@0+ (1.0,0.0) [0.0|63.0] "dB" ASDM
 SG_ ReSideRdrLeDetn108RdrDetnRng : 455|14@0+ (0.02,-1.0) [-1.0|200.0] "m" ASDM
 SG_ ReSideRdrLeDetn108RdrDetnRngV : 431|13@0+ (0.02,-80.0) [-80.0|80.0] "m/s" ASDM
 SG_ ReSideRdrLeDetn108RdrDetnSameRV : 465|2@0+ (1,0) [0|3] "" ASDM
 SG_ ReSideRdrLeDetn108RdrDetnSts : 457|2@0+ (1,0) [0|3] "" ASDM

BO_ 105 SODLPrivateCANFD5Fr52 : 64 SODL
 SG_ ReSideRdrLeDetn109_UB : 487|1@0+ (1,0) [0|1] "" ASDM
 SG_ ReSideRdrLeDetn109RdrDetnAmbigState : 72|1@0+ (1,0) [0|1] "" ASDM
 SG_ ReSideRdrLeDetn109RdrDetnAssoTrkID : 79|7@0+ (1.0,0.0) [0.0|127.0] "Unitless" ASDM
 SG_ ReSideRdrLeDetn109RdrDetnAzi : 34|11@0+ (0.1,-90.0) [-90.0|90.0] "Deg" ASDM
 SG_ ReSideRdrLeDetn109RdrDetnChks : 7|8@0+ (1.0,0.0) [0.0|255.0] "Unitless" ASDM
 SG_ ReSideRdrLeDetn109RdrDetnCntr : 15|4@0+ (1.0,0.0) [0.0|15.0] "Unitless" ASDM
 SG_ ReSideRdrLeDetn109RdrDetnConf : 11|7@0+ (1.0,0.0) [0.0|100.0] "%" ASDM
 SG_ ReSideRdrLeDetn109RdrDetnElevn : 20|5@0+ (1.0,-15.0) [-15.0|15.0] "Deg" ASDM
 SG_ ReSideRdrLeDetn109RdrDetnPwr : 71|6@0+ (1.0,0.0) [0.0|63.0] "dB" ASDM
 SG_ ReSideRdrLeDetn109RdrDetnRng : 55|14@0+ (0.02,-1.0) [-1.0|200.0] "m" ASDM
 SG_ ReSideRdrLeDetn109RdrDetnRngV : 31|13@0+ (0.02,-80.0) [-80.0|80.0] "m/s" ASDM
 SG_ ReSideRdrLeDetn109RdrDetnSameRV : 65|2@0+ (1,0) [0|3] "" ASDM
 SG_ ReSideRdrLeDetn109RdrDetnSts : 57|2@0+ (1,0) [0|3] "" ASDM
 SG_ ReSideRdrLeDetn110_UB : 486|1@0+ (1,0) [0|1] "" ASDM
 SG_ ReSideRdrLeDetn110RdrDetnAmbigState : 152|1@0+ (1,0) [0|1] "" ASDM
 SG_ ReSideRdrLeDetn110RdrDetnAssoTrkID : 159|7@0+ (1.0,0.0) [0.0|127.0] "Unitless" ASDM
 SG_ ReSideRdrLeDetn110RdrDetnAzi : 114|11@0+ (0.1,-90.0) [-90.0|90.0] "Deg" ASDM
 SG_ ReSideRdrLeDetn110RdrDetnChks : 87|8@0+ (1.0,0.0) [0.0|255.0] "Unitless" ASDM
 SG_ ReSideRdrLeDetn110RdrDetnCntr : 95|4@0+ (1.0,0.0) [0.0|15.0] "Unitless" ASDM
 SG_ ReSideRdrLeDetn110RdrDetnConf : 91|7@0+ (1.0,0.0) [0.0|100.0] "%" ASDM
 SG_ ReSideRdrLeDetn110RdrDetnElevn : 100|5@0+ (1.0,-15.0) [-15.0|15.0] "Deg" ASDM
 SG_ ReSideRdrLeDetn110RdrDetnPwr : 151|6@0+ (1.0,0.0) [0.0|63.0] "dB" ASDM
 SG_ ReSideRdrLeDetn110RdrDetnRng : 135|14@0+ (0.02,-1.0) [-1.0|200.0] "m" ASDM
 SG_ ReSideRdrLeDetn110RdrDetnRngV : 111|13@0+ (0.02,-80.0) [-80.0|80.0] "m/s" ASDM
 SG_ ReSideRdrLeDetn110RdrDetnSameRV : 145|2@0+ (1,0) [0|3] "" ASDM
 SG_ ReSideRdrLeDetn110RdrDetnSts : 137|2@0+ (1,0) [0|3] "" ASDM
 SG_ ReSideRdrLeDetn111_UB : 485|1@0+ (1,0) [0|1] "" ASDM
 SG_ ReSideRdrLeDetn111RdrDetnAmbigState : 232|1@0+ (1,0) [0|1] "" ASDM
 SG_ ReSideRdrLeDetn111RdrDetnAssoTrkID : 239|7@0+ (1.0,0.0) [0.0|127.0] "Unitless" ASDM
 SG_ ReSideRdrLeDetn111RdrDetnAzi : 194|11@0+ (0.1,-90.0) [-90.0|90.0] "Deg" ASDM
 SG_ ReSideRdrLeDetn111RdrDetnChks : 167|8@0+ (1.0,0.0) [0.0|255.0] "Unitless" ASDM
 SG_ ReSideRdrLeDetn111RdrDetnCntr : 175|4@0+ (1.0,0.0) [0.0|15.0] "Unitless" ASDM
 SG_ ReSideRdrLeDetn111RdrDetnConf : 171|7@0+ (1.0,0.0) [0.0|100.0] "%" ASDM
 SG_ ReSideRdrLeDetn111RdrDetnElevn : 180|5@0+ (1.0,-15.0) [-15.0|15.0] "Deg" ASDM
 SG_ ReSideRdrLeDetn111RdrDetnPwr : 231|6@0+ (1.0,0.0) [0.0|63.0] "dB" ASDM
 SG_ ReSideRdrLeDetn111RdrDetnRng : 215|14@0+ (0.02,-1.0) [-1.0|200.0] "m" ASDM
 SG_ ReSideRdrLeDetn111RdrDetnRngV : 191|13@0+ (0.02,-80.0) [-80.0|80.0] "m/s" ASDM
 SG_ ReSideRdrLeDetn111RdrDetnSameRV : 225|2@0+ (1,0) [0|3] "" ASDM
 SG_ ReSideRdrLeDetn111RdrDetnSts : 217|2@0+ (1,0) [0|3] "" ASDM
 SG_ ReSideRdrLeDetn112_UB : 484|1@0+ (1,0) [0|1] "" ASDM
 SG_ ReSideRdrLeDetn112RdrDetnAmbigState : 312|1@0+ (1,0) [0|1] "" ASDM
 SG_ ReSideRdrLeDetn112RdrDetnAssoTrkID : 319|7@0+ (1.0,0.0) [0.0|127.0] "Unitless" ASDM
 SG_ ReSideRdrLeDetn112RdrDetnAzi : 274|11@0+ (0.1,-90.0) [-90.0|90.0] "Deg" ASDM
 SG_ ReSideRdrLeDetn112RdrDetnChks : 247|8@0+ (1.0,0.0) [0.0|255.0] "Unitless" ASDM
 SG_ ReSideRdrLeDetn112RdrDetnCntr : 255|4@0+ (1.0,0.0) [0.0|15.0] "Unitless" ASDM
 SG_ ReSideRdrLeDetn112RdrDetnConf : 251|7@0+ (1.0,0.0) [0.0|100.0] "%" ASDM
 SG_ ReSideRdrLeDetn112RdrDetnElevn : 260|5@0+ (1.0,-15.0) [-15.0|15.0] "Deg" ASDM
 SG_ ReSideRdrLeDetn112RdrDetnPwr : 311|6@0+ (1.0,0.0) [0.0|63.0] "dB" ASDM
 SG_ ReSideRdrLeDetn112RdrDetnRng : 295|14@0+ (0.02,-1.0) [-1.0|200.0] "m" ASDM
 SG_ ReSideRdrLeDetn112RdrDetnRngV : 271|13@0+ (0.02,-80.0) [-80.0|80.0] "m/s" ASDM
 SG_ ReSideRdrLeDetn112RdrDetnSameRV : 305|2@0+ (1,0) [0|3] "" ASDM
 SG_ ReSideRdrLeDetn112RdrDetnSts : 297|2@0+ (1,0) [0|3] "" ASDM
 SG_ ReSideRdrLeDetn113_UB : 483|1@0+ (1,0) [0|1] "" ASDM
 SG_ ReSideRdrLeDetn113RdrDetnAmbigState : 392|1@0+ (1,0) [0|1] "" ASDM
 SG_ ReSideRdrLeDetn113RdrDetnAssoTrkID : 399|7@0+ (1.0,0.0) [0.0|127.0] "Unitless" ASDM
 SG_ ReSideRdrLeDetn113RdrDetnAzi : 354|11@0+ (0.1,-90.0) [-90.0|90.0] "Deg" ASDM
 SG_ ReSideRdrLeDetn113RdrDetnChks : 327|8@0+ (1.0,0.0) [0.0|255.0] "Unitless" ASDM
 SG_ ReSideRdrLeDetn113RdrDetnCntr : 335|4@0+ (1.0,0.0) [0.0|15.0] "Unitless" ASDM
 SG_ ReSideRdrLeDetn113RdrDetnConf : 331|7@0+ (1.0,0.0) [0.0|100.0] "%" ASDM
 SG_ ReSideRdrLeDetn113RdrDetnElevn : 340|5@0+ (1.0,-15.0) [-15.0|15.0] "Deg" ASDM
 SG_ ReSideRdrLeDetn113RdrDetnPwr : 391|6@0+ (1.0,0.0) [0.0|63.0] "dB" ASDM
 SG_ ReSideRdrLeDetn113RdrDetnRng : 375|14@0+ (0.02,-1.0) [-1.0|200.0] "m" ASDM
 SG_ ReSideRdrLeDetn113RdrDetnRngV : 351|13@0+ (0.02,-80.0) [-80.0|80.0] "m/s" ASDM
 SG_ ReSideRdrLeDetn113RdrDetnSameRV : 385|2@0+ (1,0) [0|3] "" ASDM
 SG_ ReSideRdrLeDetn113RdrDetnSts : 377|2@0+ (1,0) [0|3] "" ASDM
 SG_ ReSideRdrLeDetn114_UB : 482|1@0+ (1,0) [0|1] "" ASDM
 SG_ ReSideRdrLeDetn114RdrDetnAmbigState : 472|1@0+ (1,0) [0|1] "" ASDM
 SG_ ReSideRdrLeDetn114RdrDetnAssoTrkID : 479|7@0+ (1.0,0.0) [0.0|127.0] "Unitless" ASDM
 SG_ ReSideRdrLeDetn114RdrDetnAzi : 434|11@0+ (0.1,-90.0) [-90.0|90.0] "Deg" ASDM
 SG_ ReSideRdrLeDetn114RdrDetnChks : 407|8@0+ (1.0,0.0) [0.0|255.0] "Unitless" ASDM
 SG_ ReSideRdrLeDetn114RdrDetnCntr : 415|4@0+ (1.0,0.0) [0.0|15.0] "Unitless" ASDM
 SG_ ReSideRdrLeDetn114RdrDetnConf : 411|7@0+ (1.0,0.0) [0.0|100.0] "%" ASDM
 SG_ ReSideRdrLeDetn114RdrDetnElevn : 420|5@0+ (1.0,-15.0) [-15.0|15.0] "Deg" ASDM
 SG_ ReSideRdrLeDetn114RdrDetnPwr : 471|6@0+ (1.0,0.0) [0.0|63.0] "dB" ASDM
 SG_ ReSideRdrLeDetn114RdrDetnRng : 455|14@0+ (0.02,-1.0) [-1.0|200.0] "m" ASDM
 SG_ ReSideRdrLeDetn114RdrDetnRngV : 431|13@0+ (0.02,-80.0) [-80.0|80.0] "m/s" ASDM
 SG_ ReSideRdrLeDetn114RdrDetnSameRV : 465|2@0+ (1,0) [0|3] "" ASDM
 SG_ ReSideRdrLeDetn114RdrDetnSts : 457|2@0+ (1,0) [0|3] "" ASDM

BO_ 112 SODLPrivateCANFD5Fr53 : 64 SODL
 SG_ ReSideRdrLeDetn115_UB : 487|1@0+ (1,0) [0|1] "" ASDM
 SG_ ReSideRdrLeDetn115RdrDetnAmbigState : 72|1@0+ (1,0) [0|1] "" ASDM
 SG_ ReSideRdrLeDetn115RdrDetnAssoTrkID : 79|7@0+ (1.0,0.0) [0.0|127.0] "Unitless" ASDM
 SG_ ReSideRdrLeDetn115RdrDetnAzi : 34|11@0+ (0.1,-90.0) [-90.0|90.0] "Deg" ASDM
 SG_ ReSideRdrLeDetn115RdrDetnChks : 7|8@0+ (1.0,0.0) [0.0|255.0] "Unitless" ASDM
 SG_ ReSideRdrLeDetn115RdrDetnCntr : 15|4@0+ (1.0,0.0) [0.0|15.0] "Unitless" ASDM
 SG_ ReSideRdrLeDetn115RdrDetnConf : 11|7@0+ (1.0,0.0) [0.0|100.0] "%" ASDM
 SG_ ReSideRdrLeDetn115RdrDetnElevn : 20|5@0+ (1.0,-15.0) [-15.0|15.0] "Deg" ASDM
 SG_ ReSideRdrLeDetn115RdrDetnPwr : 71|6@0+ (1.0,0.0) [0.0|63.0] "dB" ASDM
 SG_ ReSideRdrLeDetn115RdrDetnRng : 55|14@0+ (0.02,-1.0) [-1.0|200.0] "m" ASDM
 SG_ ReSideRdrLeDetn115RdrDetnRngV : 31|13@0+ (0.02,-80.0) [-80.0|80.0] "m/s" ASDM
 SG_ ReSideRdrLeDetn115RdrDetnSameRV : 65|2@0+ (1,0) [0|3] "" ASDM
 SG_ ReSideRdrLeDetn115RdrDetnSts : 57|2@0+ (1,0) [0|3] "" ASDM
 SG_ ReSideRdrLeDetn116_UB : 486|1@0+ (1,0) [0|1] "" ASDM
 SG_ ReSideRdrLeDetn116RdrDetnAmbigState : 152|1@0+ (1,0) [0|1] "" ASDM
 SG_ ReSideRdrLeDetn116RdrDetnAssoTrkID : 159|7@0+ (1.0,0.0) [0.0|127.0] "Unitless" ASDM
 SG_ ReSideRdrLeDetn116RdrDetnAzi : 114|11@0+ (0.1,-90.0) [-90.0|90.0] "Deg" ASDM
 SG_ ReSideRdrLeDetn116RdrDetnChks : 87|8@0+ (1.0,0.0) [0.0|255.0] "Unitless" ASDM
 SG_ ReSideRdrLeDetn116RdrDetnCntr : 95|4@0+ (1.0,0.0) [0.0|15.0] "Unitless" ASDM
 SG_ ReSideRdrLeDetn116RdrDetnConf : 91|7@0+ (1.0,0.0) [0.0|100.0] "%" ASDM
 SG_ ReSideRdrLeDetn116RdrDetnElevn : 100|5@0+ (1.0,-15.0) [-15.0|15.0] "Deg" ASDM
 SG_ ReSideRdrLeDetn116RdrDetnPwr : 151|6@0+ (1.0,0.0) [0.0|63.0] "dB" ASDM
 SG_ ReSideRdrLeDetn116RdrDetnRng : 135|14@0+ (0.02,-1.0) [-1.0|200.0] "m" ASDM
 SG_ ReSideRdrLeDetn116RdrDetnRngV : 111|13@0+ (0.02,-80.0) [-80.0|80.0] "m/s" ASDM
 SG_ ReSideRdrLeDetn116RdrDetnSameRV : 145|2@0+ (1,0) [0|3] "" ASDM
 SG_ ReSideRdrLeDetn116RdrDetnSts : 137|2@0+ (1,0) [0|3] "" ASDM
 SG_ ReSideRdrLeDetn117_UB : 485|1@0+ (1,0) [0|1] "" ASDM
 SG_ ReSideRdrLeDetn117RdrDetnAmbigState : 232|1@0+ (1,0) [0|1] "" ASDM
 SG_ ReSideRdrLeDetn117RdrDetnAssoTrkID : 239|7@0+ (1.0,0.0) [0.0|127.0] "Unitless" ASDM
 SG_ ReSideRdrLeDetn117RdrDetnAzi : 194|11@0+ (0.1,-90.0) [-90.0|90.0] "Deg" ASDM
 SG_ ReSideRdrLeDetn117RdrDetnChks : 167|8@0+ (1.0,0.0) [0.0|255.0] "Unitless" ASDM
 SG_ ReSideRdrLeDetn117RdrDetnCntr : 175|4@0+ (1.0,0.0) [0.0|15.0] "Unitless" ASDM
 SG_ ReSideRdrLeDetn117RdrDetnConf : 171|7@0+ (1.0,0.0) [0.0|100.0] "%" ASDM
 SG_ ReSideRdrLeDetn117RdrDetnElevn : 180|5@0+ (1.0,-15.0) [-15.0|15.0] "Deg" ASDM
 SG_ ReSideRdrLeDetn117RdrDetnPwr : 231|6@0+ (1.0,0.0) [0.0|63.0] "dB" ASDM
 SG_ ReSideRdrLeDetn117RdrDetnRng : 215|14@0+ (0.02,-1.0) [-1.0|200.0] "m" ASDM
 SG_ ReSideRdrLeDetn117RdrDetnRngV : 191|13@0+ (0.02,-80.0) [-80.0|80.0] "m/s" ASDM
 SG_ ReSideRdrLeDetn117RdrDetnSameRV : 225|2@0+ (1,0) [0|3] "" ASDM
 SG_ ReSideRdrLeDetn117RdrDetnSts : 217|2@0+ (1,0) [0|3] "" ASDM
 SG_ ReSideRdrLeDetn118_UB : 484|1@0+ (1,0) [0|1] "" ASDM
 SG_ ReSideRdrLeDetn118RdrDetnAmbigState : 312|1@0+ (1,0) [0|1] "" ASDM
 SG_ ReSideRdrLeDetn118RdrDetnAssoTrkID : 319|7@0+ (1.0,0.0) [0.0|127.0] "Unitless" ASDM
 SG_ ReSideRdrLeDetn118RdrDetnAzi : 274|11@0+ (0.1,-90.0) [-90.0|90.0] "Deg" ASDM
 SG_ ReSideRdrLeDetn118RdrDetnChks : 247|8@0+ (1.0,0.0) [0.0|255.0] "Unitless" ASDM
 SG_ ReSideRdrLeDetn118RdrDetnCntr : 255|4@0+ (1.0,0.0) [0.0|15.0] "Unitless" ASDM
 SG_ ReSideRdrLeDetn118RdrDetnConf : 251|7@0+ (1.0,0.0) [0.0|100.0] "%" ASDM
 SG_ ReSideRdrLeDetn118RdrDetnElevn : 260|5@0+ (1.0,-15.0) [-15.0|15.0] "Deg" ASDM
 SG_ ReSideRdrLeDetn118RdrDetnPwr : 311|6@0+ (1.0,0.0) [0.0|63.0] "dB" ASDM
 SG_ ReSideRdrLeDetn118RdrDetnRng : 295|14@0+ (0.02,-1.0) [-1.0|200.0] "m" ASDM
 SG_ ReSideRdrLeDetn118RdrDetnRngV : 271|13@0+ (0.02,-80.0) [-80.0|80.0] "m/s" ASDM
 SG_ ReSideRdrLeDetn118RdrDetnSameRV : 305|2@0+ (1,0) [0|3] "" ASDM
 SG_ ReSideRdrLeDetn118RdrDetnSts : 297|2@0+ (1,0) [0|3] "" ASDM
 SG_ ReSideRdrLeDetn119_UB : 483|1@0+ (1,0) [0|1] "" ASDM
 SG_ ReSideRdrLeDetn119RdrDetnAmbigState : 392|1@0+ (1,0) [0|1] "" ASDM
 SG_ ReSideRdrLeDetn119RdrDetnAssoTrkID : 399|7@0+ (1.0,0.0) [0.0|127.0] "Unitless" ASDM
 SG_ ReSideRdrLeDetn119RdrDetnAzi : 354|11@0+ (0.1,-90.0) [-90.0|90.0] "Deg" ASDM
 SG_ ReSideRdrLeDetn119RdrDetnChks : 327|8@0+ (1.0,0.0) [0.0|255.0] "Unitless" ASDM
 SG_ ReSideRdrLeDetn119RdrDetnCntr : 335|4@0+ (1.0,0.0) [0.0|15.0] "Unitless" ASDM
 SG_ ReSideRdrLeDetn119RdrDetnConf : 331|7@0+ (1.0,0.0) [0.0|100.0] "%" ASDM
 SG_ ReSideRdrLeDetn119RdrDetnElevn : 340|5@0+ (1.0,-15.0) [-15.0|15.0] "Deg" ASDM
 SG_ ReSideRdrLeDetn119RdrDetnPwr : 391|6@0+ (1.0,0.0) [0.0|63.0] "dB" ASDM
 SG_ ReSideRdrLeDetn119RdrDetnRng : 375|14@0+ (0.02,-1.0) [-1.0|200.0] "m" ASDM
 SG_ ReSideRdrLeDetn119RdrDetnRngV : 351|13@0+ (0.02,-80.0) [-80.0|80.0] "m/s" ASDM
 SG_ ReSideRdrLeDetn119RdrDetnSameRV : 385|2@0+ (1,0) [0|3] "" ASDM
 SG_ ReSideRdrLeDetn119RdrDetnSts : 377|2@0+ (1,0) [0|3] "" ASDM
 SG_ ReSideRdrLeDetn120_UB : 482|1@0+ (1,0) [0|1] "" ASDM
 SG_ ReSideRdrLeDetn120RdrDetnAmbigState : 472|1@0+ (1,0) [0|1] "" ASDM
 SG_ ReSideRdrLeDetn120RdrDetnAssoTrkID : 479|7@0+ (1.0,0.0) [0.0|127.0] "Unitless" ASDM
 SG_ ReSideRdrLeDetn120RdrDetnAzi : 434|11@0+ (0.1,-90.0) [-90.0|90.0] "Deg" ASDM
 SG_ ReSideRdrLeDetn120RdrDetnChks : 407|8@0+ (1.0,0.0) [0.0|255.0] "Unitless" ASDM
 SG_ ReSideRdrLeDetn120RdrDetnCntr : 415|4@0+ (1.0,0.0) [0.0|15.0] "Unitless" ASDM
 SG_ ReSideRdrLeDetn120RdrDetnConf : 411|7@0+ (1.0,0.0) [0.0|100.0] "%" ASDM
 SG_ ReSideRdrLeDetn120RdrDetnElevn : 420|5@0+ (1.0,-15.0) [-15.0|15.0] "Deg" ASDM
 SG_ ReSideRdrLeDetn120RdrDetnPwr : 471|6@0+ (1.0,0.0) [0.0|63.0] "dB" ASDM
 SG_ ReSideRdrLeDetn120RdrDetnRng : 455|14@0+ (0.02,-1.0) [-1.0|200.0] "m" ASDM
 SG_ ReSideRdrLeDetn120RdrDetnRngV : 431|13@0+ (0.02,-80.0) [-80.0|80.0] "m/s" ASDM
 SG_ ReSideRdrLeDetn120RdrDetnSameRV : 465|2@0+ (1,0) [0|3] "" ASDM
 SG_ ReSideRdrLeDetn120RdrDetnSts : 457|2@0+ (1,0) [0|3] "" ASDM

CM_ SG_ 100 ReSideRdrLeDetn79RdrDetnAmbigState "Dection ambiguous status";
CM_ SG_ 100 ReSideRdrLeDetn79RdrDetnAssoTrkID "Associated tracker ID
";
CM_ SG_ 100 ReSideRdrLeDetn79RdrDetnAzi "Refer to the data element description in ReSideRdrLeDetn1 with the same data element name";
CM_ SG_ 100 ReSideRdrLeDetn79RdrDetnChks "Refer to the data element description in ReSideRdrLeDetn1 with the same data element name";
CM_ SG_ 100 ReSideRdrLeDetn79RdrDetnCntr "Refer to the data element description in ReSideRdrLeDetn1 with the same data element name";
CM_ SG_ 100 ReSideRdrLeDetn79RdrDetnConf "Refer to the data element description in ReSideRdrLeDetn1 with the same data element name";
CM_ SG_ 100 ReSideRdrLeDetn79RdrDetnElevn "Refer to the data element description in ReSideRdrLeDetn1 with the same data element name";
CM_ SG_ 100 ReSideRdrLeDetn79RdrDetnPwr "Refer to the data element description in ReSideRdrLeDetn1 with the same data element name";
CM_ SG_ 100 ReSideRdrLeDetn79RdrDetnRng "Refer to the data element description in ReSideRdrLeDetn1 with the same data element name";
CM_ SG_ 100 ReSideRdrLeDetn79RdrDetnRngV "Range Velocity";
CM_ SG_ 100 ReSideRdrLeDetn79RdrDetnSameRV "object with same distance and speed";
CM_ SG_ 100 ReSideRdrLeDetn79RdrDetnSts "Refer to the data element description in ReSideRdrLeDetn1 with the same data element name";
CM_ SG_ 100 ReSideRdrLeDetn80RdrDetnAmbigState "Dection ambiguous status";
CM_ SG_ 100 ReSideRdrLeDetn80RdrDetnAssoTrkID "Associated tracker ID
";
CM_ SG_ 100 ReSideRdrLeDetn80RdrDetnAzi "Refer to the data element description in ReSideRdrLeDetn1 with the same data element name";
CM_ SG_ 100 ReSideRdrLeDetn80RdrDetnChks "Refer to the data element description in ReSideRdrLeDetn1 with the same data element name";
CM_ SG_ 100 ReSideRdrLeDetn80RdrDetnCntr "Refer to the data element description in ReSideRdrLeDetn1 with the same data element name";
CM_ SG_ 100 ReSideRdrLeDetn80RdrDetnConf "Refer to the data element description in ReSideRdrLeDetn1 with the same data element name";
CM_ SG_ 100 ReSideRdrLeDetn80RdrDetnElevn "Refer to the data element description in ReSideRdrLeDetn1 with the same data element name";
CM_ SG_ 100 ReSideRdrLeDetn80RdrDetnPwr "Refer to the data element description in ReSideRdrLeDetn1 with the same data element name";
CM_ SG_ 100 ReSideRdrLeDetn80RdrDetnRng "Refer to the data element description in ReSideRdrLeDetn1 with the same data element name";
CM_ SG_ 100 ReSideRdrLeDetn80RdrDetnRngV "Range Velocity";
CM_ SG_ 100 ReSideRdrLeDetn80RdrDetnSameRV "object with same distance and speed";
CM_ SG_ 100 ReSideRdrLeDetn80RdrDetnSts "Refer to the data element description in ReSideRdrLeDetn1 with the same data element name";
CM_ SG_ 100 ReSideRdrLeDetn81RdrDetnAmbigState "Dection ambiguous status";
CM_ SG_ 100 ReSideRdrLeDetn81RdrDetnAssoTrkID "Associated tracker ID
";
CM_ SG_ 100 ReSideRdrLeDetn81RdrDetnAzi "Refer to the data element description in ReSideRdrLeDetn1 with the same data element name";
CM_ SG_ 100 ReSideRdrLeDetn81RdrDetnChks "Refer to the data element description in ReSideRdrLeDetn1 with the same data element name";
CM_ SG_ 100 ReSideRdrLeDetn81RdrDetnCntr "Refer to the data element description in ReSideRdrLeDetn1 with the same data element name";
CM_ SG_ 100 ReSideRdrLeDetn81RdrDetnConf "Refer to the data element description in ReSideRdrLeDetn1 with the same data element name";
CM_ SG_ 100 ReSideRdrLeDetn81RdrDetnElevn "Refer to the data element description in ReSideRdrLeDetn1 with the same data element name";
CM_ SG_ 100 ReSideRdrLeDetn81RdrDetnPwr "Refer to the data element description in ReSideRdrLeDetn1 with the same data element name";
CM_ SG_ 100 ReSideRdrLeDetn81RdrDetnRng "Refer to the data element description in ReSideRdrLeDetn1 with the same data element name";
CM_ SG_ 100 ReSideRdrLeDetn81RdrDetnRngV "Range Velocity";
CM_ SG_ 100 ReSideRdrLeDetn81RdrDetnSameRV "object with same distance and speed";
CM_ SG_ 100 ReSideRdrLeDetn81RdrDetnSts "Refer to the data element description in ReSideRdrLeDetn1 with the same data element name";
CM_ SG_ 100 ReSideRdrLeDetn82RdrDetnAmbigState "Dection ambiguous status";
CM_ SG_ 100 ReSideRdrLeDetn82RdrDetnAssoTrkID "Associated tracker ID
";
CM_ SG_ 100 ReSideRdrLeDetn82RdrDetnAzi "Refer to the data element description in ReSideRdrLeDetn1 with the same data element name";
CM_ SG_ 100 ReSideRdrLeDetn82RdrDetnChks "Refer to the data element description in ReSideRdrLeDetn1 with the same data element name";
CM_ SG_ 100 ReSideRdrLeDetn82RdrDetnCntr "Refer to the data element description in ReSideRdrLeDetn1 with the same data element name";
CM_ SG_ 100 ReSideRdrLeDetn82RdrDetnConf "Refer to the data element description in ReSideRdrLeDetn1 with the same data element name";
CM_ SG_ 100 ReSideRdrLeDetn82RdrDetnElevn "Refer to the data element description in ReSideRdrLeDetn1 with the same data element name";
CM_ SG_ 100 ReSideRdrLeDetn82RdrDetnPwr "Refer to the data element description in ReSideRdrLeDetn1 with the same data element name";
CM_ SG_ 100 ReSideRdrLeDetn82RdrDetnRng "Refer to the data element description in ReSideRdrLeDetn1 with the same data element name";
CM_ SG_ 100 ReSideRdrLeDetn82RdrDetnRngV "Range Velocity";
CM_ SG_ 100 ReSideRdrLeDetn82RdrDetnSameRV "object with same distance and speed";
CM_ SG_ 100 ReSideRdrLeDetn82RdrDetnSts "Refer to the data element description in ReSideRdrLeDetn1 with the same data element name";
CM_ SG_ 100 ReSideRdrLeDetn83RdrDetnAmbigState "Dection ambiguous status";
CM_ SG_ 100 ReSideRdrLeDetn83RdrDetnAssoTrkID "Associated tracker ID
";
CM_ SG_ 100 ReSideRdrLeDetn83RdrDetnAzi "Refer to the data element description in ReSideRdrLeDetn1 with the same data element name";
CM_ SG_ 100 ReSideRdrLeDetn83RdrDetnChks "Refer to the data element description in ReSideRdrLeDetn1 with the same data element name";
CM_ SG_ 100 ReSideRdrLeDetn83RdrDetnCntr "Refer to the data element description in ReSideRdrLeDetn1 with the same data element name";
CM_ SG_ 100 ReSideRdrLeDetn83RdrDetnConf "Refer to the data element description in ReSideRdrLeDetn1 with the same data element name";
CM_ SG_ 100 ReSideRdrLeDetn83RdrDetnElevn "Refer to the data element description in ReSideRdrLeDetn1 with the same data element name";
CM_ SG_ 100 ReSideRdrLeDetn83RdrDetnPwr "Refer to the data element description in ReSideRdrLeDetn1 with the same data element name";
CM_ SG_ 100 ReSideRdrLeDetn83RdrDetnRng "Refer to the data element description in ReSideRdrLeDetn1 with the same data element name";
CM_ SG_ 100 ReSideRdrLeDetn83RdrDetnRngV "Range Velocity";
CM_ SG_ 100 ReSideRdrLeDetn83RdrDetnSameRV "object with same distance and speed";
CM_ SG_ 100 ReSideRdrLeDetn83RdrDetnSts "Refer to the data element description in ReSideRdrLeDetn1 with the same data element name";
CM_ SG_ 100 ReSideRdrLeDetn84RdrDetnAmbigState "Dection ambiguous status";
CM_ SG_ 100 ReSideRdrLeDetn84RdrDetnAssoTrkID "Associated tracker ID
";
CM_ SG_ 100 ReSideRdrLeDetn84RdrDetnAzi "Refer to the data element description in ReSideRdrLeDetn1 with the same data element name";
CM_ SG_ 100 ReSideRdrLeDetn84RdrDetnChks "Refer to the data element description in ReSideRdrLeDetn1 with the same data element name";
CM_ SG_ 100 ReSideRdrLeDetn84RdrDetnCntr "Refer to the data element description in ReSideRdrLeDetn1 with the same data element name";
CM_ SG_ 100 ReSideRdrLeDetn84RdrDetnConf "Refer to the data element description in ReSideRdrLeDetn1 with the same data element name";
CM_ SG_ 100 ReSideRdrLeDetn84RdrDetnElevn "Refer to the data element description in ReSideRdrLeDetn1 with the same data element name";
CM_ SG_ 100 ReSideRdrLeDetn84RdrDetnPwr "Refer to the data element description in ReSideRdrLeDetn1 with the same data element name";
CM_ SG_ 100 ReSideRdrLeDetn84RdrDetnRng "Refer to the data element description in ReSideRdrLeDetn1 with the same data element name";
CM_ SG_ 100 ReSideRdrLeDetn84RdrDetnRngV "Range Velocity";
CM_ SG_ 100 ReSideRdrLeDetn84RdrDetnSameRV "object with same distance and speed";
CM_ SG_ 100 ReSideRdrLeDetn84RdrDetnSts "Refer to the data element description in ReSideRdrLeDetn1 with the same data element name";
CM_ SG_ 101 ReSideRdrLeDetn85RdrDetnAmbigState "Dection ambiguous status";
CM_ SG_ 101 ReSideRdrLeDetn85RdrDetnAssoTrkID "Associated tracker ID
";
CM_ SG_ 101 ReSideRdrLeDetn85RdrDetnAzi "Refer to the data element description in ReSideRdrLeDetn1 with the same data element name";
CM_ SG_ 101 ReSideRdrLeDetn85RdrDetnChks "Refer to the data element description in ReSideRdrLeDetn1 with the same data element name";
CM_ SG_ 101 ReSideRdrLeDetn85RdrDetnCntr "Refer to the data element description in ReSideRdrLeDetn1 with the same data element name";
CM_ SG_ 101 ReSideRdrLeDetn85RdrDetnConf "Refer to the data element description in ReSideRdrLeDetn1 with the same data element name";
CM_ SG_ 101 ReSideRdrLeDetn85RdrDetnElevn "Refer to the data element description in ReSideRdrLeDetn1 with the same data element name";
CM_ SG_ 101 ReSideRdrLeDetn85RdrDetnPwr "Refer to the data element description in ReSideRdrLeDetn1 with the same data element name";
CM_ SG_ 101 ReSideRdrLeDetn85RdrDetnRng "Refer to the data element description in ReSideRdrLeDetn1 with the same data element name";
CM_ SG_ 101 ReSideRdrLeDetn85RdrDetnRngV "Range Velocity";
CM_ SG_ 101 ReSideRdrLeDetn85RdrDetnSameRV "object with same distance and speed";
CM_ SG_ 101 ReSideRdrLeDetn85RdrDetnSts "Refer to the data element description in ReSideRdrLeDetn1 with the same data element name";
CM_ SG_ 101 ReSideRdrLeDetn86RdrDetnAmbigState "Dection ambiguous status";
CM_ SG_ 101 ReSideRdrLeDetn86RdrDetnAssoTrkID "Associated tracker ID
";
CM_ SG_ 101 ReSideRdrLeDetn86RdrDetnAzi "Refer to the data element description in ReSideRdrLeDetn1 with the same data element name";
CM_ SG_ 101 ReSideRdrLeDetn86RdrDetnChks "Refer to the data element description in ReSideRdrLeDetn1 with the same data element name";
CM_ SG_ 101 ReSideRdrLeDetn86RdrDetnCntr "Refer to the data element description in ReSideRdrLeDetn1 with the same data element name";
CM_ SG_ 101 ReSideRdrLeDetn86RdrDetnConf "Refer to the data element description in ReSideRdrLeDetn1 with the same data element name";
CM_ SG_ 101 ReSideRdrLeDetn86RdrDetnElevn "Refer to the data element description in ReSideRdrLeDetn1 with the same data element name";
CM_ SG_ 101 ReSideRdrLeDetn86RdrDetnPwr "Refer to the data element description in ReSideRdrLeDetn1 with the same data element name";
CM_ SG_ 101 ReSideRdrLeDetn86RdrDetnRng "Refer to the data element description in ReSideRdrLeDetn1 with the same data element name";
CM_ SG_ 101 ReSideRdrLeDetn86RdrDetnRngV "Range Velocity";
CM_ SG_ 101 ReSideRdrLeDetn86RdrDetnSameRV "object with same distance and speed";
CM_ SG_ 101 ReSideRdrLeDetn86RdrDetnSts "Refer to the data element description in ReSideRdrLeDetn1 with the same data element name";
CM_ SG_ 101 ReSideRdrLeDetn87RdrDetnAmbigState "Dection ambiguous status";
CM_ SG_ 101 ReSideRdrLeDetn87RdrDetnAssoTrkID "Associated tracker ID
";
CM_ SG_ 101 ReSideRdrLeDetn87RdrDetnAzi "Refer to the data element description in ReSideRdrLeDetn1 with the same data element name";
CM_ SG_ 101 ReSideRdrLeDetn87RdrDetnChks "Refer to the data element description in ReSideRdrLeDetn1 with the same data element name";
CM_ SG_ 101 ReSideRdrLeDetn87RdrDetnCntr "Refer to the data element description in ReSideRdrLeDetn1 with the same data element name";
CM_ SG_ 101 ReSideRdrLeDetn87RdrDetnConf "Refer to the data element description in ReSideRdrLeDetn1 with the same data element name";
CM_ SG_ 101 ReSideRdrLeDetn87RdrDetnElevn "Refer to the data element description in ReSideRdrLeDetn1 with the same data element name";
CM_ SG_ 101 ReSideRdrLeDetn87RdrDetnPwr "Refer to the data element description in ReSideRdrLeDetn1 with the same data element name";
CM_ SG_ 101 ReSideRdrLeDetn87RdrDetnRng "Refer to the data element description in ReSideRdrLeDetn1 with the same data element name";
CM_ SG_ 101 ReSideRdrLeDetn87RdrDetnRngV "Range Velocity";
CM_ SG_ 101 ReSideRdrLeDetn87RdrDetnSameRV "object with same distance and speed";
CM_ SG_ 101 ReSideRdrLeDetn87RdrDetnSts "Refer to the data element description in ReSideRdrLeDetn1 with the same data element name";
CM_ SG_ 101 ReSideRdrLeDetn88RdrDetnAmbigState "Dection ambiguous status";
CM_ SG_ 101 ReSideRdrLeDetn88RdrDetnAssoTrkID "Associated tracker ID
";
CM_ SG_ 101 ReSideRdrLeDetn88RdrDetnAzi "Refer to the data element description in ReSideRdrLeDetn1 with the same data element name";
CM_ SG_ 101 ReSideRdrLeDetn88RdrDetnChks "Refer to the data element description in ReSideRdrLeDetn1 with the same data element name";
CM_ SG_ 101 ReSideRdrLeDetn88RdrDetnCntr "Refer to the data element description in ReSideRdrLeDetn1 with the same data element name";
CM_ SG_ 101 ReSideRdrLeDetn88RdrDetnConf "Refer to the data element description in ReSideRdrLeDetn1 with the same data element name";
CM_ SG_ 101 ReSideRdrLeDetn88RdrDetnElevn "Refer to the data element description in ReSideRdrLeDetn1 with the same data element name";
CM_ SG_ 101 ReSideRdrLeDetn88RdrDetnPwr "Refer to the data element description in ReSideRdrLeDetn1 with the same data element name";
CM_ SG_ 101 ReSideRdrLeDetn88RdrDetnRng "Refer to the data element description in ReSideRdrLeDetn1 with the same data element name";
CM_ SG_ 101 ReSideRdrLeDetn88RdrDetnRngV "Range Velocity";
CM_ SG_ 101 ReSideRdrLeDetn88RdrDetnSameRV "object with same distance and speed";
CM_ SG_ 101 ReSideRdrLeDetn88RdrDetnSts "Refer to the data element description in ReSideRdrLeDetn1 with the same data element name";
CM_ SG_ 101 ReSideRdrLeDetn89RdrDetnAmbigState "Dection ambiguous status";
CM_ SG_ 101 ReSideRdrLeDetn89RdrDetnAssoTrkID "Associated tracker ID
";
CM_ SG_ 101 ReSideRdrLeDetn89RdrDetnAzi "Refer to the data element description in ReSideRdrLeDetn1 with the same data element name";
CM_ SG_ 101 ReSideRdrLeDetn89RdrDetnChks "Refer to the data element description in ReSideRdrLeDetn1 with the same data element name";
CM_ SG_ 101 ReSideRdrLeDetn89RdrDetnCntr "Refer to the data element description in ReSideRdrLeDetn1 with the same data element name";
CM_ SG_ 101 ReSideRdrLeDetn89RdrDetnConf "Refer to the data element description in ReSideRdrLeDetn1 with the same data element name";
CM_ SG_ 101 ReSideRdrLeDetn89RdrDetnElevn "Refer to the data element description in ReSideRdrLeDetn1 with the same data element name";
CM_ SG_ 101 ReSideRdrLeDetn89RdrDetnPwr "Refer to the data element description in ReSideRdrLeDetn1 with the same data element name";
CM_ SG_ 101 ReSideRdrLeDetn89RdrDetnRng "Refer to the data element description in ReSideRdrLeDetn1 with the same data element name";
CM_ SG_ 101 ReSideRdrLeDetn89RdrDetnRngV "Range Velocity";
CM_ SG_ 101 ReSideRdrLeDetn89RdrDetnSameRV "object with same distance and speed";
CM_ SG_ 101 ReSideRdrLeDetn89RdrDetnSts "Refer to the data element description in ReSideRdrLeDetn1 with the same data element name";
CM_ SG_ 101 ReSideRdrLeDetn90RdrDetnAmbigState "Dection ambiguous status";
CM_ SG_ 101 ReSideRdrLeDetn90RdrDetnAssoTrkID "Associated tracker ID
";
CM_ SG_ 101 ReSideRdrLeDetn90RdrDetnAzi "Refer to the data element description in ReSideRdrLeDetn1 with the same data element name";
CM_ SG_ 101 ReSideRdrLeDetn90RdrDetnChks "Refer to the data element description in ReSideRdrLeDetn1 with the same data element name";
CM_ SG_ 101 ReSideRdrLeDetn90RdrDetnCntr "Refer to the data element description in ReSideRdrLeDetn1 with the same data element name";
CM_ SG_ 101 ReSideRdrLeDetn90RdrDetnConf "Refer to the data element description in ReSideRdrLeDetn1 with the same data element name";
CM_ SG_ 101 ReSideRdrLeDetn90RdrDetnElevn "Refer to the data element description in ReSideRdrLeDetn1 with the same data element name";
CM_ SG_ 101 ReSideRdrLeDetn90RdrDetnPwr "Refer to the data element description in ReSideRdrLeDetn1 with the same data element name";
CM_ SG_ 101 ReSideRdrLeDetn90RdrDetnRng "Refer to the data element description in ReSideRdrLeDetn1 with the same data element name";
CM_ SG_ 101 ReSideRdrLeDetn90RdrDetnRngV "Range Velocity";
CM_ SG_ 101 ReSideRdrLeDetn90RdrDetnSameRV "object with same distance and speed";
CM_ SG_ 101 ReSideRdrLeDetn90RdrDetnSts "Refer to the data element description in ReSideRdrLeDetn1 with the same data element name";
CM_ SG_ 102 ReSideRdrLeDetn91RdrDetnAmbigState "Dection ambiguous status";
CM_ SG_ 102 ReSideRdrLeDetn91RdrDetnAssoTrkID "Associated tracker ID
";
CM_ SG_ 102 ReSideRdrLeDetn91RdrDetnAzi "Refer to the data element description in ReSideRdrLeDetn1 with the same data element name";
CM_ SG_ 102 ReSideRdrLeDetn91RdrDetnChks "Refer to the data element description in ReSideRdrLeDetn1 with the same data element name";
CM_ SG_ 102 ReSideRdrLeDetn91RdrDetnCntr "Refer to the data element description in ReSideRdrLeDetn1 with the same data element name";
CM_ SG_ 102 ReSideRdrLeDetn91RdrDetnConf "Refer to the data element description in ReSideRdrLeDetn1 with the same data element name";
CM_ SG_ 102 ReSideRdrLeDetn91RdrDetnElevn "Refer to the data element description in ReSideRdrLeDetn1 with the same data element name";
CM_ SG_ 102 ReSideRdrLeDetn91RdrDetnPwr "Refer to the data element description in ReSideRdrLeDetn1 with the same data element name";
CM_ SG_ 102 ReSideRdrLeDetn91RdrDetnRng "Refer to the data element description in ReSideRdrLeDetn1 with the same data element name";
CM_ SG_ 102 ReSideRdrLeDetn91RdrDetnRngV "Range Velocity";
CM_ SG_ 102 ReSideRdrLeDetn91RdrDetnSameRV "object with same distance and speed";
CM_ SG_ 102 ReSideRdrLeDetn91RdrDetnSts "Refer to the data element description in ReSideRdrLeDetn1 with the same data element name";
CM_ SG_ 102 ReSideRdrLeDetn92RdrDetnAmbigState "Dection ambiguous status";
CM_ SG_ 102 ReSideRdrLeDetn92RdrDetnAssoTrkID "Associated tracker ID
";
CM_ SG_ 102 ReSideRdrLeDetn92RdrDetnAzi "Refer to the data element description in ReSideRdrLeDetn1 with the same data element name";
CM_ SG_ 102 ReSideRdrLeDetn92RdrDetnChks "Refer to the data element description in ReSideRdrLeDetn1 with the same data element name";
CM_ SG_ 102 ReSideRdrLeDetn92RdrDetnCntr "Refer to the data element description in ReSideRdrLeDetn1 with the same data element name";
CM_ SG_ 102 ReSideRdrLeDetn92RdrDetnConf "Refer to the data element description in ReSideRdrLeDetn1 with the same data element name";
CM_ SG_ 102 ReSideRdrLeDetn92RdrDetnElevn "Refer to the data element description in ReSideRdrLeDetn1 with the same data element name";
CM_ SG_ 102 ReSideRdrLeDetn92RdrDetnPwr "Refer to the data element description in ReSideRdrLeDetn1 with the same data element name";
CM_ SG_ 102 ReSideRdrLeDetn92RdrDetnRng "Refer to the data element description in ReSideRdrLeDetn1 with the same data element name";
CM_ SG_ 102 ReSideRdrLeDetn92RdrDetnRngV "Range Velocity";
CM_ SG_ 102 ReSideRdrLeDetn92RdrDetnSameRV "object with same distance and speed";
CM_ SG_ 102 ReSideRdrLeDetn92RdrDetnSts "Refer to the data element description in ReSideRdrLeDetn1 with the same data element name";
CM_ SG_ 102 ReSideRdrLeDetn93RdrDetnAmbigState "Dection ambiguous status";
CM_ SG_ 102 ReSideRdrLeDetn93RdrDetnAssoTrkID "Associated tracker ID
";
CM_ SG_ 102 ReSideRdrLeDetn93RdrDetnAzi "Refer to the data element description in ReSideRdrLeDetn1 with the same data element name";
CM_ SG_ 102 ReSideRdrLeDetn93RdrDetnChks "Refer to the data element description in ReSideRdrLeDetn1 with the same data element name";
CM_ SG_ 102 ReSideRdrLeDetn93RdrDetnCntr "Refer to the data element description in ReSideRdrLeDetn1 with the same data element name";
CM_ SG_ 102 ReSideRdrLeDetn93RdrDetnConf "Refer to the data element description in ReSideRdrLeDetn1 with the same data element name";
CM_ SG_ 102 ReSideRdrLeDetn93RdrDetnElevn "Refer to the data element description in ReSideRdrLeDetn1 with the same data element name";
CM_ SG_ 102 ReSideRdrLeDetn93RdrDetnPwr "Refer to the data element description in ReSideRdrLeDetn1 with the same data element name";
CM_ SG_ 102 ReSideRdrLeDetn93RdrDetnRng "Refer to the data element description in ReSideRdrLeDetn1 with the same data element name";
CM_ SG_ 102 ReSideRdrLeDetn93RdrDetnRngV "Range Velocity";
CM_ SG_ 102 ReSideRdrLeDetn93RdrDetnSameRV "object with same distance and speed";
CM_ SG_ 102 ReSideRdrLeDetn93RdrDetnSts "Refer to the data element description in ReSideRdrLeDetn1 with the same data element name";
CM_ SG_ 102 ReSideRdrLeDetn94RdrDetnAmbigState "Dection ambiguous status";
CM_ SG_ 102 ReSideRdrLeDetn94RdrDetnAssoTrkID "Associated tracker ID
";
CM_ SG_ 102 ReSideRdrLeDetn94RdrDetnAzi "vRefer to the data element description in ReSideRdrLeDetn1 with the same data element name";
CM_ SG_ 102 ReSideRdrLeDetn94RdrDetnChks "Refer to the data element description in ReSideRdrLeDetn1 with the same data element name";
CM_ SG_ 102 ReSideRdrLeDetn94RdrDetnCntr "Refer to the data element description in ReSideRdrLeDetn1 with the same data element name";
CM_ SG_ 102 ReSideRdrLeDetn94RdrDetnConf "Refer to the data element description in ReSideRdrLeDetn1 with the same data element name";
CM_ SG_ 102 ReSideRdrLeDetn94RdrDetnElevn "Refer to the data element description in ReSideRdrLeDetn1 with the same data element name";
CM_ SG_ 102 ReSideRdrLeDetn94RdrDetnPwr "Refer to the data element description in ReSideRdrLeDetn1 with the same data element name";
CM_ SG_ 102 ReSideRdrLeDetn94RdrDetnRng "Refer to the data element description in ReSideRdrLeDetn1 with the same data element name";
CM_ SG_ 102 ReSideRdrLeDetn94RdrDetnRngV "Range Velocity";
CM_ SG_ 102 ReSideRdrLeDetn94RdrDetnSameRV "object with same distance and speed";
CM_ SG_ 102 ReSideRdrLeDetn94RdrDetnSts "Refer to the data element description in ReSideRdrLeDetn1 with the same data element name";
CM_ SG_ 102 ReSideRdrLeDetn95RdrDetnAmbigState "Dection ambiguous status";
CM_ SG_ 102 ReSideRdrLeDetn95RdrDetnAssoTrkID "Associated tracker ID
";
CM_ SG_ 102 ReSideRdrLeDetn95RdrDetnAzi "Refer to the data element description in ReSideRdrLeDetn1 with the same data element name";
CM_ SG_ 102 ReSideRdrLeDetn95RdrDetnChks "Refer to the data element description in ReSideRdrLeDetn1 with the same data element name";
CM_ SG_ 102 ReSideRdrLeDetn95RdrDetnCntr "Refer to the data element description in ReSideRdrLeDetn1 with the same data element name";
CM_ SG_ 102 ReSideRdrLeDetn95RdrDetnConf "Refer to the data element description in ReSideRdrLeDetn1 with the same data element name";
CM_ SG_ 102 ReSideRdrLeDetn95RdrDetnElevn "Refer to the data element description in ReSideRdrLeDetn1 with the same data element name";
CM_ SG_ 102 ReSideRdrLeDetn95RdrDetnPwr "Refer to the data element description in ReSideRdrLeDetn1 with the same data element name";
CM_ SG_ 102 ReSideRdrLeDetn95RdrDetnRng "Refer to the data element description in ReSideRdrLeDetn1 with the same data element name";
CM_ SG_ 102 ReSideRdrLeDetn95RdrDetnRngV "Range Velocity";
CM_ SG_ 102 ReSideRdrLeDetn95RdrDetnSameRV "object with same distance and speed";
CM_ SG_ 102 ReSideRdrLeDetn95RdrDetnSts "Refer to the data element description in ReSideRdrLeDetn1 with the same data element name";
CM_ SG_ 102 ReSideRdrLeDetn96RdrDetnAmbigState "Dection ambiguous status";
CM_ SG_ 102 ReSideRdrLeDetn96RdrDetnAssoTrkID "Associated tracker ID
";
CM_ SG_ 102 ReSideRdrLeDetn96RdrDetnAzi "Refer to the data element description in ReSideRdrLeDetn1 with the same data element name";
CM_ SG_ 102 ReSideRdrLeDetn96RdrDetnChks "Refer to the data element description in ReSideRdrLeDetn1 with the same data element name";
CM_ SG_ 102 ReSideRdrLeDetn96RdrDetnCntr "Refer to the data element description in ReSideRdrLeDetn1 with the same data element name";
CM_ SG_ 102 ReSideRdrLeDetn96RdrDetnConf "Refer to the data element description in ReSideRdrLeDetn1 with the same data element name";
CM_ SG_ 102 ReSideRdrLeDetn96RdrDetnElevn "Refer to the data element description in ReSideRdrLeDetn1 with the same data element name";
CM_ SG_ 102 ReSideRdrLeDetn96RdrDetnPwr "Refer to the data element description in ReSideRdrLeDetn1 with the same data element name";
CM_ SG_ 102 ReSideRdrLeDetn96RdrDetnRng "Refer to the data element description in ReSideRdrLeDetn1 with the same data element name";
CM_ SG_ 102 ReSideRdrLeDetn96RdrDetnRngV "Range Velocity";
CM_ SG_ 102 ReSideRdrLeDetn96RdrDetnSameRV "object with same distance and speed";
CM_ SG_ 102 ReSideRdrLeDetn96RdrDetnSts "Refer to the data element description in ReSideRdrLeDetn1 with the same data element name";
CM_ SG_ 103 ReSideRdrLeDetn100RdrDetnAmbigState "Dection ambiguous status";
CM_ SG_ 103 ReSideRdrLeDetn100RdrDetnAssoTrkID "Associated tracker ID
";
CM_ SG_ 103 ReSideRdrLeDetn100RdrDetnAzi "Refer to the data element description in ReSideRdrLeDetn1 with the same data element name";
CM_ SG_ 103 ReSideRdrLeDetn100RdrDetnChks "Refer to the data element description in ReSideRdrLeDetn1 with the same data element name";
CM_ SG_ 103 ReSideRdrLeDetn100RdrDetnCntr "Refer to the data element description in ReSideRdrLeDetn1 with the same data element name";
CM_ SG_ 103 ReSideRdrLeDetn100RdrDetnConf "Refer to the data element description in ReSideRdrLeDetn1 with the same data element name";
CM_ SG_ 103 ReSideRdrLeDetn100RdrDetnElevn "Refer to the data element description in ReSideRdrLeDetn1 with the same data element name";
CM_ SG_ 103 ReSideRdrLeDetn100RdrDetnPwr "Refer to the data element description in ReSideRdrLeDetn1 with the same data element name";
CM_ SG_ 103 ReSideRdrLeDetn100RdrDetnRng "Refer to the data element description in ReSideRdrLeDetn1 with the same data element name";
CM_ SG_ 103 ReSideRdrLeDetn100RdrDetnRngV "Range Velocity";
CM_ SG_ 103 ReSideRdrLeDetn100RdrDetnSameRV "object with same distance and speed";
CM_ SG_ 103 ReSideRdrLeDetn100RdrDetnSts "Refer to the data element description in ReSideRdrLeDetn1 with the same data element name";
CM_ SG_ 103 ReSideRdrLeDetn101RdrDetnAmbigState "Dection ambiguous status";
CM_ SG_ 103 ReSideRdrLeDetn101RdrDetnAssoTrkID "Associated tracker ID
";
CM_ SG_ 103 ReSideRdrLeDetn101RdrDetnAzi "Refer to the data element description in ReSideRdrLeDetn1 with the same data element name";
CM_ SG_ 103 ReSideRdrLeDetn101RdrDetnChks "Refer to the data element description in ReSideRdrLeDetn1 with the same data element name";
CM_ SG_ 103 ReSideRdrLeDetn101RdrDetnCntr "Refer to the data element description in ReSideRdrLeDetn1 with the same data element name";
CM_ SG_ 103 ReSideRdrLeDetn101RdrDetnConf "Refer to the data element description in ReSideRdrLeDetn1 with the same data element name";
CM_ SG_ 103 ReSideRdrLeDetn101RdrDetnElevn "Refer to the data element description in ReSideRdrLeDetn1 with the same data element name";
CM_ SG_ 103 ReSideRdrLeDetn101RdrDetnPwr "Refer to the data element description in ReSideRdrLeDetn1 with the same data element name";
CM_ SG_ 103 ReSideRdrLeDetn101RdrDetnRng "Refer to the data element description in ReSideRdrLeDetn1 with the same data element name";
CM_ SG_ 103 ReSideRdrLeDetn101RdrDetnRngV "Range Velocity";
CM_ SG_ 103 ReSideRdrLeDetn101RdrDetnSameRV "object with same distance and speed";
CM_ SG_ 103 ReSideRdrLeDetn101RdrDetnSts "Refer to the data element description in ReSideRdrLeDetn1 with the same data element name";
CM_ SG_ 103 ReSideRdrLeDetn102RdrDetnAmbigState "Dection ambiguous status";
CM_ SG_ 103 ReSideRdrLeDetn102RdrDetnAssoTrkID "Associated tracker ID
";
CM_ SG_ 103 ReSideRdrLeDetn102RdrDetnAzi "Refer to the data element description in ReSideRdrLeDetn1 with the same data element name";
CM_ SG_ 103 ReSideRdrLeDetn102RdrDetnChks "Refer to the data element description in ReSideRdrLeDetn1 with the same data element name";
CM_ SG_ 103 ReSideRdrLeDetn102RdrDetnCntr "Refer to the data element description in ReSideRdrLeDetn1 with the same data element name";
CM_ SG_ 103 ReSideRdrLeDetn102RdrDetnConf "Refer to the data element description in ReSideRdrLeDetn1 with the same data element name";
CM_ SG_ 103 ReSideRdrLeDetn102RdrDetnElevn "Refer to the data element description in ReSideRdrLeDetn1 with the same data element name";
CM_ SG_ 103 ReSideRdrLeDetn102RdrDetnPwr "Refer to the data element description in ReSideRdrLeDetn1 with the same data element name";
CM_ SG_ 103 ReSideRdrLeDetn102RdrDetnRng "Refer to the data element description in ReSideRdrLeDetn1 with the same data element name";
CM_ SG_ 103 ReSideRdrLeDetn102RdrDetnRngV "Range Velocity";
CM_ SG_ 103 ReSideRdrLeDetn102RdrDetnSameRV "object with same distance and speed";
CM_ SG_ 103 ReSideRdrLeDetn102RdrDetnSts "Refer to the data element description in ReSideRdrLeDetn1 with the same data element name";
CM_ SG_ 103 ReSideRdrLeDetn97RdrDetnAmbigState "Dection ambiguous status";
CM_ SG_ 103 ReSideRdrLeDetn97RdrDetnAssoTrkID "Associated tracker ID
";
CM_ SG_ 103 ReSideRdrLeDetn97RdrDetnAzi "Refer to the data element description in ReSideRdrLeDetn1 with the same data element name";
CM_ SG_ 103 ReSideRdrLeDetn97RdrDetnChks "Refer to the data element description in ReSideRdrLeDetn1 with the same data element name";
CM_ SG_ 103 ReSideRdrLeDetn97RdrDetnCntr "Refer to the data element description in ReSideRdrLeDetn1 with the same data element name";
CM_ SG_ 103 ReSideRdrLeDetn97RdrDetnConf "Refer to the data element description in ReSideRdrLeDetn1 with the same data element name";
CM_ SG_ 103 ReSideRdrLeDetn97RdrDetnElevn "Refer to the data element description in ReSideRdrLeDetn1 with the same data element name";
CM_ SG_ 103 ReSideRdrLeDetn97RdrDetnPwr "Refer to the data element description in ReSideRdrLeDetn1 with the same data element name";
CM_ SG_ 103 ReSideRdrLeDetn97RdrDetnRng "Refer to the data element description in ReSideRdrLeDetn1 with the same data element name";
CM_ SG_ 103 ReSideRdrLeDetn97RdrDetnRngV "Range Velocity";
CM_ SG_ 103 ReSideRdrLeDetn97RdrDetnSameRV "object with same distance and speed";
CM_ SG_ 103 ReSideRdrLeDetn97RdrDetnSts "Refer to the data element description in ReSideRdrLeDetn1 with the same data element name";
CM_ SG_ 103 ReSideRdrLeDetn98RdrDetnAmbigState "Dection ambiguous status";
CM_ SG_ 103 ReSideRdrLeDetn98RdrDetnAssoTrkID "Associated tracker ID
";
CM_ SG_ 103 ReSideRdrLeDetn98RdrDetnAzi "Refer to the data element description in ReSideRdrLeDetn1 with the same data element name";
CM_ SG_ 103 ReSideRdrLeDetn98RdrDetnChks "Refer to the data element description in ReSideRdrLeDetn1 with the same data element name";
CM_ SG_ 103 ReSideRdrLeDetn98RdrDetnCntr "Refer to the data element description in ReSideRdrLeDetn1 with the same data element name";
CM_ SG_ 103 ReSideRdrLeDetn98RdrDetnConf "Refer to the data element description in ReSideRdrLeDetn1 with the same data element name";
CM_ SG_ 103 ReSideRdrLeDetn98RdrDetnElevn "Refer to the data element description in ReSideRdrLeDetn1 with the same data element name";
CM_ SG_ 103 ReSideRdrLeDetn98RdrDetnPwr "Refer to the data element description in ReSideRdrLeDetn1 with the same data element name";
CM_ SG_ 103 ReSideRdrLeDetn98RdrDetnRng "Refer to the data element description in ReSideRdrLeDetn1 with the same data element name";
CM_ SG_ 103 ReSideRdrLeDetn98RdrDetnRngV "Range Velocity";
CM_ SG_ 103 ReSideRdrLeDetn98RdrDetnSameRV "object with same distance and speed";
CM_ SG_ 103 ReSideRdrLeDetn98RdrDetnSts "Refer to the data element description in ReSideRdrLeDetn1 with the same data element name";
CM_ SG_ 103 ReSideRdrLeDetn99RdrDetnAmbigState "Dection ambiguous status";
CM_ SG_ 103 ReSideRdrLeDetn99RdrDetnAssoTrkID "Associated tracker ID
";
CM_ SG_ 103 ReSideRdrLeDetn99RdrDetnAzi "Refer to the data element description in ReSideRdrLeDetn1 with the same data element name";
CM_ SG_ 103 ReSideRdrLeDetn99RdrDetnChks "Refer to the data element description in ReSideRdrLeDetn1 with the same data element name";
CM_ SG_ 103 ReSideRdrLeDetn99RdrDetnCntr "Refer to the data element description in ReSideRdrLeDetn1 with the same data element name";
CM_ SG_ 103 ReSideRdrLeDetn99RdrDetnConf "Refer to the data element description in ReSideRdrLeDetn1 with the same data element name";
CM_ SG_ 103 ReSideRdrLeDetn99RdrDetnElevn "Refer to the data element description in ReSideRdrLeDetn1 with the same data element name";
CM_ SG_ 103 ReSideRdrLeDetn99RdrDetnPwr "Refer to the data element description in ReSideRdrLeDetn1 with the same data element name";
CM_ SG_ 103 ReSideRdrLeDetn99RdrDetnRng "Refer to the data element description in ReSideRdrLeDetn1 with the same data element name";
CM_ SG_ 103 ReSideRdrLeDetn99RdrDetnRngV "Range Velocity";
CM_ SG_ 103 ReSideRdrLeDetn99RdrDetnSameRV "object with same distance and speed";
CM_ SG_ 103 ReSideRdrLeDetn99RdrDetnSts "Refer to the data element description in ReSideRdrLeDetn1 with the same data element name";
CM_ SG_ 104 ReSideRdrLeDetn103RdrDetnAmbigState "Dection ambiguous status";
CM_ SG_ 104 ReSideRdrLeDetn103RdrDetnAssoTrkID "Associated tracker ID
";
CM_ SG_ 104 ReSideRdrLeDetn103RdrDetnAzi "Refer to the data element description in ReSideRdrLeDetn1 with the same data element name";
CM_ SG_ 104 ReSideRdrLeDetn103RdrDetnChks "Refer to the data element description in ReSideRdrLeDetn1 with the same data element name";
CM_ SG_ 104 ReSideRdrLeDetn103RdrDetnCntr "Refer to the data element description in ReSideRdrLeDetn1 with the same data element name";
CM_ SG_ 104 ReSideRdrLeDetn103RdrDetnConf "Refer to the data element description in ReSideRdrLeDetn1 with the same data element name";
CM_ SG_ 104 ReSideRdrLeDetn103RdrDetnElevn "Refer to the data element description in ReSideRdrLeDetn1 with the same data element name";
CM_ SG_ 104 ReSideRdrLeDetn103RdrDetnPwr "Refer to the data element description in ReSideRdrLeDetn1 with the same data element name";
CM_ SG_ 104 ReSideRdrLeDetn103RdrDetnRng "Refer to the data element description in ReSideRdrLeDetn1 with the same data element name";
CM_ SG_ 104 ReSideRdrLeDetn103RdrDetnRngV "Range Velocity";
CM_ SG_ 104 ReSideRdrLeDetn103RdrDetnSameRV "object with same distance and speed";
CM_ SG_ 104 ReSideRdrLeDetn103RdrDetnSts "Refer to the data element description in ReSideRdrLeDetn1 with the same data element name";
CM_ SG_ 104 ReSideRdrLeDetn104RdrDetnAmbigState "Dection ambiguous status";
CM_ SG_ 104 ReSideRdrLeDetn104RdrDetnAssoTrkID "Associated tracker ID
";
CM_ SG_ 104 ReSideRdrLeDetn104RdrDetnAzi "Refer to the data element description in ReSideRdrLeDetn1 with the same data element name";
CM_ SG_ 104 ReSideRdrLeDetn104RdrDetnChks "Refer to the data element description in ReSideRdrLeDetn1 with the same data element name";
CM_ SG_ 104 ReSideRdrLeDetn104RdrDetnCntr "Refer to the data element description in ReSideRdrLeDetn1 with the same data element name";
CM_ SG_ 104 ReSideRdrLeDetn104RdrDetnConf "Refer to the data element description in ReSideRdrLeDetn1 with the same data element name";
CM_ SG_ 104 ReSideRdrLeDetn104RdrDetnElevn "Refer to the data element description in ReSideRdrLeDetn1 with the same data element name";
CM_ SG_ 104 ReSideRdrLeDetn104RdrDetnPwr "Refer to the data element description in ReSideRdrLeDetn1 with the same data element name";
CM_ SG_ 104 ReSideRdrLeDetn104RdrDetnRng "Refer to the data element description in ReSideRdrLeDetn1 with the same data element name";
CM_ SG_ 104 ReSideRdrLeDetn104RdrDetnRngV "Range Velocity";
CM_ SG_ 104 ReSideRdrLeDetn104RdrDetnSameRV "object with same distance and speed";
CM_ SG_ 104 ReSideRdrLeDetn104RdrDetnSts "Refer to the data element description in ReSideRdrLeDetn1 with the same data element name";
CM_ SG_ 104 ReSideRdrLeDetn105RdrDetnAmbigState "Dection ambiguous status";
CM_ SG_ 104 ReSideRdrLeDetn105RdrDetnAssoTrkID "Associated tracker ID
";
CM_ SG_ 104 ReSideRdrLeDetn105RdrDetnAzi "Refer to the data element description in ReSideRdrLeDetn1 with the same data element name";
CM_ SG_ 104 ReSideRdrLeDetn105RdrDetnChks "Refer to the data element description in ReSideRdrLeDetn1 with the same data element name";
CM_ SG_ 104 ReSideRdrLeDetn105RdrDetnCntr "Refer to the data element description in ReSideRdrLeDetn1 with the same data element name";
CM_ SG_ 104 ReSideRdrLeDetn105RdrDetnConf "Refer to the data element description in ReSideRdrLeDetn1 with the same data element name";
CM_ SG_ 104 ReSideRdrLeDetn105RdrDetnElevn "Refer to the data element description in ReSideRdrLeDetn1 with the same data element name";
CM_ SG_ 104 ReSideRdrLeDetn105RdrDetnPwr "Refer to the data element description in ReSideRdrLeDetn1 with the same data element name";
CM_ SG_ 104 ReSideRdrLeDetn105RdrDetnRng "Refer to the data element description in ReSideRdrLeDetn1 with the same data element name";
CM_ SG_ 104 ReSideRdrLeDetn105RdrDetnRngV "Range Velocity";
CM_ SG_ 104 ReSideRdrLeDetn105RdrDetnSameRV "object with same distance and speed";
CM_ SG_ 104 ReSideRdrLeDetn105RdrDetnSts "Refer to the data element description in ReSideRdrLeDetn1 with the same data element name";
CM_ SG_ 104 ReSideRdrLeDetn106RdrDetnAmbigState "Dection ambiguous status";
CM_ SG_ 104 ReSideRdrLeDetn106RdrDetnAssoTrkID "Associated tracker ID
";
CM_ SG_ 104 ReSideRdrLeDetn106RdrDetnAzi "Refer to the data element description in ReSideRdrLeDetn1 with the same data element name";
CM_ SG_ 104 ReSideRdrLeDetn106RdrDetnChks "Refer to the data element description in ReSideRdrLeDetn1 with the same data element name";
CM_ SG_ 104 ReSideRdrLeDetn106RdrDetnCntr "Refer to the data element description in ReSideRdrLeDetn1 with the same data element name";
CM_ SG_ 104 ReSideRdrLeDetn106RdrDetnConf "Refer to the data element description in ReSideRdrLeDetn1 with the same data element name";
CM_ SG_ 104 ReSideRdrLeDetn106RdrDetnElevn "Refer to the data element description in ReSideRdrLeDetn1 with the same data element name";
CM_ SG_ 104 ReSideRdrLeDetn106RdrDetnPwr "Refer to the data element description in ReSideRdrLeDetn1 with the same data element name";
CM_ SG_ 104 ReSideRdrLeDetn106RdrDetnRng "Refer to the data element description in ReSideRdrLeDetn1 with the same data element name";
CM_ SG_ 104 ReSideRdrLeDetn106RdrDetnRngV "Range Velocity";
CM_ SG_ 104 ReSideRdrLeDetn106RdrDetnSameRV "object with same distance and speed";
CM_ SG_ 104 ReSideRdrLeDetn106RdrDetnSts "Refer to the data element description in ReSideRdrLeDetn1 with the same data element name";
CM_ SG_ 104 ReSideRdrLeDetn107RdrDetnAmbigState "Dection ambiguous status";
CM_ SG_ 104 ReSideRdrLeDetn107RdrDetnAssoTrkID "Associated tracker ID
";
CM_ SG_ 104 ReSideRdrLeDetn107RdrDetnAzi "Refer to the data element description in ReSideRdrLeDetn1 with the same data element name";
CM_ SG_ 104 ReSideRdrLeDetn107RdrDetnChks "Refer to the data element description in ReSideRdrLeDetn1 with the same data element name";
CM_ SG_ 104 ReSideRdrLeDetn107RdrDetnCntr "Refer to the data element description in ReSideRdrLeDetn1 with the same data element name";
CM_ SG_ 104 ReSideRdrLeDetn107RdrDetnConf "Refer to the data element description in ReSideRdrLeDetn1 with the same data element name";
CM_ SG_ 104 ReSideRdrLeDetn107RdrDetnElevn "Refer to the data element description in ReSideRdrLeDetn1 with the same data element name";
CM_ SG_ 104 ReSideRdrLeDetn107RdrDetnPwr "Refer to the data element description in ReSideRdrLeDetn1 with the same data element name";
CM_ SG_ 104 ReSideRdrLeDetn107RdrDetnRng "Refer to the data element description in ReSideRdrLeDetn1 with the same data element name";
CM_ SG_ 104 ReSideRdrLeDetn107RdrDetnRngV "Range Velocity";
CM_ SG_ 104 ReSideRdrLeDetn107RdrDetnSameRV "object with same distance and speed";
CM_ SG_ 104 ReSideRdrLeDetn107RdrDetnSts "Refer to the data element description in ReSideRdrLeDetn1 with the same data element name";
CM_ SG_ 104 ReSideRdrLeDetn108RdrDetnAmbigState "Dection ambiguous status";
CM_ SG_ 104 ReSideRdrLeDetn108RdrDetnAssoTrkID "Associated tracker ID
";
CM_ SG_ 104 ReSideRdrLeDetn108RdrDetnAzi "Refer to the data element description in ReSideRdrLeDetn1 with the same data element name";
CM_ SG_ 104 ReSideRdrLeDetn108RdrDetnChks "Refer to the data element description in ReSideRdrLeDetn1 with the same data element name";
CM_ SG_ 104 ReSideRdrLeDetn108RdrDetnCntr "Refer to the data element description in ReSideRdrLeDetn1 with the same data element name";
CM_ SG_ 104 ReSideRdrLeDetn108RdrDetnConf "Refer to the data element description in ReSideRdrLeDetn1 with the same data element name";
CM_ SG_ 104 ReSideRdrLeDetn108RdrDetnElevn "Refer to the data element description in ReSideRdrLeDetn1 with the same data element name";
CM_ SG_ 104 ReSideRdrLeDetn108RdrDetnPwr "Refer to the data element description in ReSideRdrLeDetn1 with the same data element name";
CM_ SG_ 104 ReSideRdrLeDetn108RdrDetnRng "Refer to the data element description in ReSideRdrLeDetn1 with the same data element name";
CM_ SG_ 104 ReSideRdrLeDetn108RdrDetnRngV "Range Velocity";
CM_ SG_ 104 ReSideRdrLeDetn108RdrDetnSameRV "object with same distance and speed";
CM_ SG_ 104 ReSideRdrLeDetn108RdrDetnSts "Refer to the data element description in ReSideRdrLeDetn1 with the same data element name";
CM_ SG_ 105 ReSideRdrLeDetn109RdrDetnAmbigState "Dection ambiguous status";
CM_ SG_ 105 ReSideRdrLeDetn109RdrDetnAssoTrkID "Associated tracker ID
";
CM_ SG_ 105 ReSideRdrLeDetn109RdrDetnAzi "Refer to the data element description in ReSideRdrLeDetn1 with the same data element name";
CM_ SG_ 105 ReSideRdrLeDetn109RdrDetnChks "Refer to the data element description in ReSideRdrLeDetn1 with the same data element name";
CM_ SG_ 105 ReSideRdrLeDetn109RdrDetnCntr "Refer to the data element description in ReSideRdrLeDetn1 with the same data element name";
CM_ SG_ 105 ReSideRdrLeDetn109RdrDetnConf "Refer to the data element description in ReSideRdrLeDetn1 with the same data element name";
CM_ SG_ 105 ReSideRdrLeDetn109RdrDetnElevn "Refer to the data element description in ReSideRdrLeDetn1 with the same data element name";
CM_ SG_ 105 ReSideRdrLeDetn109RdrDetnPwr "Refer to the data element description in ReSideRdrLeDetn1 with the same data element name";
CM_ SG_ 105 ReSideRdrLeDetn109RdrDetnRng "Refer to the data element description in ReSideRdrLeDetn1 with the same data element name";
CM_ SG_ 105 ReSideRdrLeDetn109RdrDetnRngV "Range Velocity";
CM_ SG_ 105 ReSideRdrLeDetn109RdrDetnSameRV "object with same distance and speed";
CM_ SG_ 105 ReSideRdrLeDetn109RdrDetnSts "Refer to the data element description in ReSideRdrLeDetn1 with the same data element name";
CM_ SG_ 105 ReSideRdrLeDetn110RdrDetnAmbigState "Dection ambiguous status";
CM_ SG_ 105 ReSideRdrLeDetn110RdrDetnAssoTrkID "Associated tracker ID
";
CM_ SG_ 105 ReSideRdrLeDetn110RdrDetnAzi "Refer to the data element description in ReSideRdrLeDetn1 with the same data element name";
CM_ SG_ 105 ReSideRdrLeDetn110RdrDetnChks "Refer to the data element description in ReSideRdrLeDetn1 with the same data element name";
CM_ SG_ 105 ReSideRdrLeDetn110RdrDetnCntr "Refer to the data element description in ReSideRdrLeDetn1 with the same data element name";
CM_ SG_ 105 ReSideRdrLeDetn110RdrDetnConf "Refer to the data element description in ReSideRdrLeDetn1 with the same data element name";
CM_ SG_ 105 ReSideRdrLeDetn110RdrDetnElevn "Refer to the data element description in ReSideRdrLeDetn1 with the same data element name";
CM_ SG_ 105 ReSideRdrLeDetn110RdrDetnPwr "Refer to the data element description in ReSideRdrLeDetn1 with the same data element name";
CM_ SG_ 105 ReSideRdrLeDetn110RdrDetnRng "Refer to the data element description in ReSideRdrLeDetn1 with the same data element name";
CM_ SG_ 105 ReSideRdrLeDetn110RdrDetnRngV "Range Velocity";
CM_ SG_ 105 ReSideRdrLeDetn110RdrDetnSameRV "object with same distance and speed";
CM_ SG_ 105 ReSideRdrLeDetn110RdrDetnSts "Refer to the data element description in ReSideRdrLeDetn1 with the same data element name";
CM_ SG_ 105 ReSideRdrLeDetn111RdrDetnAmbigState "Dection ambiguous status";
CM_ SG_ 105 ReSideRdrLeDetn111RdrDetnAssoTrkID "Associated tracker ID
";
CM_ SG_ 105 ReSideRdrLeDetn111RdrDetnAzi "Refer to the data element description in ReSideRdrLeDetn1 with the same data element name";
CM_ SG_ 105 ReSideRdrLeDetn111RdrDetnChks "Refer to the data element description in ReSideRdrLeDetn1 with the same data element name";
CM_ SG_ 105 ReSideRdrLeDetn111RdrDetnCntr "Refer to the data element description in ReSideRdrLeDetn1 with the same data element name";
CM_ SG_ 105 ReSideRdrLeDetn111RdrDetnConf "Refer to the data element description in ReSideRdrLeDetn1 with the same data element name";
CM_ SG_ 105 ReSideRdrLeDetn111RdrDetnElevn "Refer to the data element description in ReSideRdrLeDetn1 with the same data element name";
CM_ SG_ 105 ReSideRdrLeDetn111RdrDetnPwr "Refer to the data element description in ReSideRdrLeDetn1 with the same data element name";
CM_ SG_ 105 ReSideRdrLeDetn111RdrDetnRng "Refer to the data element description in ReSideRdrLeDetn1 with the same data element name";
CM_ SG_ 105 ReSideRdrLeDetn111RdrDetnRngV "Range Velocity";
CM_ SG_ 105 ReSideRdrLeDetn111RdrDetnSameRV "object with same distance and speed";
CM_ SG_ 105 ReSideRdrLeDetn111RdrDetnSts "Refer to the data element description in ReSideRdrLeDetn1 with the same data element name";
CM_ SG_ 105 ReSideRdrLeDetn112RdrDetnAmbigState "Dection ambiguous status";
CM_ SG_ 105 ReSideRdrLeDetn112RdrDetnAssoTrkID "Associated tracker ID
";
CM_ SG_ 105 ReSideRdrLeDetn112RdrDetnAzi "Refer to the data element description in ReSideRdrLeDetn1 with the same data element name";
CM_ SG_ 105 ReSideRdrLeDetn112RdrDetnChks "Refer to the data element description in ReSideRdrLeDetn1 with the same data element name";
CM_ SG_ 105 ReSideRdrLeDetn112RdrDetnCntr "Refer to the data element description in ReSideRdrLeDetn1 with the same data element name";
CM_ SG_ 105 ReSideRdrLeDetn112RdrDetnConf "Refer to the data element description in ReSideRdrLeDetn1 with the same data element name";
CM_ SG_ 105 ReSideRdrLeDetn112RdrDetnElevn "Refer to the data element description in ReSideRdrLeDetn1 with the same data element name";
CM_ SG_ 105 ReSideRdrLeDetn112RdrDetnPwr "Refer to the data element description in ReSideRdrLeDetn1 with the same data element name";
CM_ SG_ 105 ReSideRdrLeDetn112RdrDetnRng "Refer to the data element description in ReSideRdrLeDetn1 with the same data element name";
CM_ SG_ 105 ReSideRdrLeDetn112RdrDetnRngV "Range Velocity";
CM_ SG_ 105 ReSideRdrLeDetn112RdrDetnSameRV "object with same distance and speed";
CM_ SG_ 105 ReSideRdrLeDetn112RdrDetnSts "Refer to the data element description in ReSideRdrLeDetn1 with the same data element name";
CM_ SG_ 105 ReSideRdrLeDetn113RdrDetnAmbigState "Dection ambiguous status";
CM_ SG_ 105 ReSideRdrLeDetn113RdrDetnAssoTrkID "Associated tracker ID
";
CM_ SG_ 105 ReSideRdrLeDetn113RdrDetnAzi "Refer to the data element description in ReSideRdrLeDetn1 with the same data element name";
CM_ SG_ 105 ReSideRdrLeDetn113RdrDetnChks "Refer to the data element description in ReSideRdrLeDetn1 with the same data element name";
CM_ SG_ 105 ReSideRdrLeDetn113RdrDetnCntr "Refer to the data element description in ReSideRdrLeDetn1 with the same data element name";
CM_ SG_ 105 ReSideRdrLeDetn113RdrDetnConf "Refer to the data element description in ReSideRdrLeDetn1 with the same data element name";
CM_ SG_ 105 ReSideRdrLeDetn113RdrDetnElevn "Refer to the data element description in ReSideRdrLeDetn1 with the same data element name";
CM_ SG_ 105 ReSideRdrLeDetn113RdrDetnPwr "Refer to the data element description in ReSideRdrLeDetn1 with the same data element name";
CM_ SG_ 105 ReSideRdrLeDetn113RdrDetnRng "Refer to the data element description in ReSideRdrLeDetn1 with the same data element name";
CM_ SG_ 105 ReSideRdrLeDetn113RdrDetnRngV "Range Velocity";
CM_ SG_ 105 ReSideRdrLeDetn113RdrDetnSameRV "object with same distance and speed";
CM_ SG_ 105 ReSideRdrLeDetn113RdrDetnSts "Refer to the data element description in ReSideRdrLeDetn1 with the same data element name";
CM_ SG_ 105 ReSideRdrLeDetn114RdrDetnAmbigState "Dection ambiguous status";
CM_ SG_ 105 ReSideRdrLeDetn114RdrDetnAssoTrkID "Associated tracker ID
";
CM_ SG_ 105 ReSideRdrLeDetn114RdrDetnAzi "Refer to the data element description in ReSideRdrLeDetn1 with the same data element name";
CM_ SG_ 105 ReSideRdrLeDetn114RdrDetnChks "Refer to the data element description in ReSideRdrLeDetn1 with the same data element name";
CM_ SG_ 105 ReSideRdrLeDetn114RdrDetnCntr "Refer to the data element description in ReSideRdrLeDetn1 with the same data element name";
CM_ SG_ 105 ReSideRdrLeDetn114RdrDetnConf "Refer to the data element description in ReSideRdrLeDetn1 with the same data element name";
CM_ SG_ 105 ReSideRdrLeDetn114RdrDetnElevn "Refer to the data element description in ReSideRdrLeDetn1 with the same data element name";
CM_ SG_ 105 ReSideRdrLeDetn114RdrDetnPwr "Refer to the data element description in ReSideRdrLeDetn1 with the same data element name";
CM_ SG_ 105 ReSideRdrLeDetn114RdrDetnRng "Refer to the data element description in ReSideRdrLeDetn1 with the same data element name";
CM_ SG_ 105 ReSideRdrLeDetn114RdrDetnRngV "Range Velocity";
CM_ SG_ 105 ReSideRdrLeDetn114RdrDetnSameRV "object with same distance and speed";
CM_ SG_ 105 ReSideRdrLeDetn114RdrDetnSts "Refer to the data element description in ReSideRdrLeDetn1 with the same data element name";
CM_ SG_ 112 ReSideRdrLeDetn115RdrDetnAmbigState "Dection ambiguous status";
CM_ SG_ 112 ReSideRdrLeDetn115RdrDetnAssoTrkID "Associated tracker ID
";
CM_ SG_ 112 ReSideRdrLeDetn115RdrDetnAzi "Refer to the data element description in ReSideRdrLeDetn1 with the same data element name";
CM_ SG_ 112 ReSideRdrLeDetn115RdrDetnChks "Refer to the data element description in ReSideRdrLeDetn1 with the same data element name";
CM_ SG_ 112 ReSideRdrLeDetn115RdrDetnCntr "Refer to the data element description in ReSideRdrLeDetn1 with the same data element name";
CM_ SG_ 112 ReSideRdrLeDetn115RdrDetnConf "Refer to the data element description in ReSideRdrLeDetn1 with the same data element name";
CM_ SG_ 112 ReSideRdrLeDetn115RdrDetnElevn "Refer to the data element description in ReSideRdrLeDetn1 with the same data element name";
CM_ SG_ 112 ReSideRdrLeDetn115RdrDetnPwr "Refer to the data element description in ReSideRdrLeDetn1 with the same data element name";
CM_ SG_ 112 ReSideRdrLeDetn115RdrDetnRng "Refer to the data element description in ReSideRdrLeDetn1 with the same data element name";
CM_ SG_ 112 ReSideRdrLeDetn115RdrDetnRngV "Range Velocity";
CM_ SG_ 112 ReSideRdrLeDetn115RdrDetnSameRV "object with same distance and speed";
CM_ SG_ 112 ReSideRdrLeDetn115RdrDetnSts "Refer to the data element description in ReSideRdrLeDetn1 with the same data element name";
CM_ SG_ 112 ReSideRdrLeDetn116RdrDetnAmbigState "Dection ambiguous status";
CM_ SG_ 112 ReSideRdrLeDetn116RdrDetnAssoTrkID "Associated tracker ID
";
CM_ SG_ 112 ReSideRdrLeDetn116RdrDetnAzi "Refer to the data element description in ReSideRdrLeDetn1 with the same data element name";
CM_ SG_ 112 ReSideRdrLeDetn116RdrDetnChks "Refer to the data element description in ReSideRdrLeDetn1 with the same data element name";
CM_ SG_ 112 ReSideRdrLeDetn116RdrDetnCntr "Refer to the data element description in ReSideRdrLeDetn1 with the same data element name";
CM_ SG_ 112 ReSideRdrLeDetn116RdrDetnConf "Refer to the data element description in ReSideRdrLeDetn1 with the same data element name";
CM_ SG_ 112 ReSideRdrLeDetn116RdrDetnElevn "Refer to the data element description in ReSideRdrLeDetn1 with the same data element name";
CM_ SG_ 112 ReSideRdrLeDetn116RdrDetnPwr "Refer to the data element description in ReSideRdrLeDetn1 with the same data element name";
CM_ SG_ 112 ReSideRdrLeDetn116RdrDetnRng "Refer to the data element description in ReSideRdrLeDetn1 with the same data element name";
CM_ SG_ 112 ReSideRdrLeDetn116RdrDetnRngV "Range Velocity";
CM_ SG_ 112 ReSideRdrLeDetn116RdrDetnSameRV "object with same distance and speed";
CM_ SG_ 112 ReSideRdrLeDetn116RdrDetnSts "Refer to the data element description in ReSideRdrLeDetn1 with the same data element name";
CM_ SG_ 112 ReSideRdrLeDetn117RdrDetnAmbigState "Dection ambiguous status";
CM_ SG_ 112 ReSideRdrLeDetn117RdrDetnAssoTrkID "Associated tracker ID
";
CM_ SG_ 112 ReSideRdrLeDetn117RdrDetnAzi "Refer to the data element description in ReSideRdrLeDetn1 with the same data element name";
CM_ SG_ 112 ReSideRdrLeDetn117RdrDetnChks "Refer to the data element description in ReSideRdrLeDetn1 with the same data element name";
CM_ SG_ 112 ReSideRdrLeDetn117RdrDetnCntr "Refer to the data element description in ReSideRdrLeDetn1 with the same data element name";
CM_ SG_ 112 ReSideRdrLeDetn117RdrDetnConf "Refer to the data element description in ReSideRdrLeDetn1 with the same data element name";
CM_ SG_ 112 ReSideRdrLeDetn117RdrDetnElevn "Refer to the data element description in ReSideRdrLeDetn1 with the same data element name";
CM_ SG_ 112 ReSideRdrLeDetn117RdrDetnPwr "Refer to the data element description in ReSideRdrLeDetn1 with the same data element name";
CM_ SG_ 112 ReSideRdrLeDetn117RdrDetnRng "Refer to the data element description in ReSideRdrLeDetn1 with the same data element name";
CM_ SG_ 112 ReSideRdrLeDetn117RdrDetnRngV "Range Velocity";
CM_ SG_ 112 ReSideRdrLeDetn117RdrDetnSameRV "object with same distance and speed";
CM_ SG_ 112 ReSideRdrLeDetn117RdrDetnSts "Refer to the data element description in ReSideRdrLeDetn1 with the same data element name";
CM_ SG_ 112 ReSideRdrLeDetn118RdrDetnAmbigState "Dection ambiguous status";
CM_ SG_ 112 ReSideRdrLeDetn118RdrDetnAssoTrkID "Associated tracker ID
";
CM_ SG_ 112 ReSideRdrLeDetn118RdrDetnAzi "Refer to the data element description in ReSideRdrLeDetn1 with the same data element name";
CM_ SG_ 112 ReSideRdrLeDetn118RdrDetnChks "Refer to the data element description in ReSideRdrLeDetn1 with the same data element name";
CM_ SG_ 112 ReSideRdrLeDetn118RdrDetnCntr "Refer to the data element description in ReSideRdrLeDetn1 with the same data element name";
CM_ SG_ 112 ReSideRdrLeDetn118RdrDetnConf "Refer to the data element description in ReSideRdrLeDetn1 with the same data element name";
CM_ SG_ 112 ReSideRdrLeDetn118RdrDetnElevn "Refer to the data element description in ReSideRdrLeDetn1 with the same data element name";
CM_ SG_ 112 ReSideRdrLeDetn118RdrDetnPwr "Refer to the data element description in ReSideRdrLeDetn1 with the same data element name";
CM_ SG_ 112 ReSideRdrLeDetn118RdrDetnRng "Refer to the data element description in ReSideRdrLeDetn1 with the same data element name";
CM_ SG_ 112 ReSideRdrLeDetn118RdrDetnRngV "Range Velocity";
CM_ SG_ 112 ReSideRdrLeDetn118RdrDetnSameRV "object with same distance and speed";
CM_ SG_ 112 ReSideRdrLeDetn118RdrDetnSts "Refer to the data element description in ReSideRdrLeDetn1 with the same data element name";
CM_ SG_ 112 ReSideRdrLeDetn119RdrDetnAmbigState "Dection ambiguous status";
CM_ SG_ 112 ReSideRdrLeDetn119RdrDetnAssoTrkID "Associated tracker ID
";
CM_ SG_ 112 ReSideRdrLeDetn119RdrDetnAzi "Refer to the data element description in ReSideRdrLeDetn1 with the same data element name";
CM_ SG_ 112 ReSideRdrLeDetn119RdrDetnChks "Refer to the data element description in ReSideRdrLeDetn1 with the same data element name";
CM_ SG_ 112 ReSideRdrLeDetn119RdrDetnCntr "Refer to the data element description in ReSideRdrLeDetn1 with the same data element name";
CM_ SG_ 112 ReSideRdrLeDetn119RdrDetnConf "Refer to the data element description in ReSideRdrLeDetn1 with the same data element name";
CM_ SG_ 112 ReSideRdrLeDetn119RdrDetnElevn "Refer to the data element description in ReSideRdrLeDetn1 with the same data element name";
CM_ SG_ 112 ReSideRdrLeDetn119RdrDetnPwr "Refer to the data element description in ReSideRdrLeDetn1 with the same data element name";
CM_ SG_ 112 ReSideRdrLeDetn119RdrDetnRng "Refer to the data element description in ReSideRdrLeDetn1 with the same data element name";
CM_ SG_ 112 ReSideRdrLeDetn119RdrDetnRngV "Range Velocity";
CM_ SG_ 112 ReSideRdrLeDetn119RdrDetnSameRV "object with same distance and speed";
CM_ SG_ 112 ReSideRdrLeDetn119RdrDetnSts "Refer to the data element description in ReSideRdrLeDetn1 with the same data element name";
CM_ SG_ 112 ReSideRdrLeDetn120RdrDetnAmbigState "Dection ambiguous status";
CM_ SG_ 112 ReSideRdrLeDetn120RdrDetnAssoTrkID "Associated tracker ID
";
CM_ SG_ 112 ReSideRdrLeDetn120RdrDetnAzi "Refer to the data element description in ReSideRdrLeDetn1 with the same data element name";
CM_ SG_ 112 ReSideRdrLeDetn120RdrDetnChks "Refer to the data element description in ReSideRdrLeDetn1 with the same data element name";
CM_ SG_ 112 ReSideRdrLeDetn120RdrDetnCntr "Refer to the data element description in ReSideRdrLeDetn1 with the same data element name";
CM_ SG_ 112 ReSideRdrLeDetn120RdrDetnConf "Refer to the data element description in ReSideRdrLeDetn1 with the same data element name";
CM_ SG_ 112 ReSideRdrLeDetn120RdrDetnElevn "Refer to the data element description in ReSideRdrLeDetn1 with the same data element name";
CM_ SG_ 112 ReSideRdrLeDetn120RdrDetnPwr "Refer to the data element description in ReSideRdrLeDetn1 with the same data element name";
CM_ SG_ 112 ReSideRdrLeDetn120RdrDetnRng "Refer to the data element description in ReSideRdrLeDetn1 with the same data element name";
CM_ SG_ 112 ReSideRdrLeDetn120RdrDetnRngV "Range Velocity";
CM_ SG_ 112 ReSideRdrLeDetn120RdrDetnSameRV "object with same distance and speed";
CM_ SG_ 112 ReSideRdrLeDetn120RdrDetnSts "Refer to the data element description in ReSideRdrLeDetn1 with the same data element name";
BA_DEF_ BO_ "CANFD_BRS" ENUM "0","1";
BA_DEF_ BO_ "GenMsgCycleTime" INT 0 65536; // [ms]
BA_DEF_ BO_ "GenMsgDelayTime" INT 0 65536; // [ms]
BA_DEF_ BO_ "GenMsgSendType" ENUM "cyclic", "spontaneous", "not-used", "not-used", "not-used", "cyclicAndSpontaneous", "not-used", "cyclicIfActive", "NoMsgSendType"; // [us]
BA_DEF_ BO_ "GenMsgStartDelayTime" INT 0 65536; // [ms]
BA_DEF_ BO_ "VFrameFormat" ENUM "StandardCAN","ExtendedCAN","reserved","J1939PG","reserved","reserved","reserved","reserved","reserved","reserved","reserved","reserved","reserved","reserved","StandardCAN_FD","ExtendedCAN_FD";
BA_DEF_ SG_ "GenSigSendType" ENUM "Cyclic","OnWrite","OnWriteWithRepetition","OnChange","OnChangeWithRepetition","IfActive","IfActiveWithRepetition","NoSigSendType";
BA_DEF_ SG_ "GenSigStartValue" HEX 0 80000000;
BA_DEF_ BO_ "GenMsgILSupport" ENUM "No","Yes";
BA_DEF_ BO_ "NmAsrMessage" ENUM "No","Yes";
BA_DEF_ SG_ "GenSigFuncType" ENUM "NoFunction","n/a","n/a","n/a","n/a","n/a","n/a","n/a","n/a","n/a","n/a","n/a","n/a","n/a","n/a","CHK","CNTR","n/a","n/a","n/a","CNTR_AR_01","CRC_AR_01_BOTH","CRC_AR_01_ALT","CRC_AR_01_LOW","CRC_AR_01_NIBBLE","CNTR_AR_04","CRC_AR_04A","CNTR_AR_05","CRC_AR_05";
BA_DEF_ SG_ "GenSigDataID" STRING;
BA_DEF_DEF_ "CANFD_BRS" "1";
BA_DEF_DEF_ "GenSigStartValue" 0;
BA_DEF_DEF_ "VFrameFormat" "J1939PG";
BA_DEF_DEF_ "GenSigSendType" "NoSigSendType";
BA_DEF_DEF_ "GenMsgCycleTime" 0;
BA_DEF_DEF_ "GenMsgDelayTime" 0;
BA_DEF_DEF_ "GenMsgStartDelayTime" 0;
BA_DEF_DEF_ "GenMsgSendType" "NoMsgSendType";
BA_DEF_DEF_ "GenMsgILSupport" "Yes";
BA_DEF_DEF_ "NmAsrMessage" "No";
BA_DEF_DEF_ "GenSigFuncType" "NoFunction";
BA_DEF_DEF_ "GenSigDataID" "";
// Frame: SODLPrivateCANFD5Fr47
BA_ "GenMsgCycleTime" BO_ 100 50 ;
BA_ "GenMsgSendType" BO_ 100 0;
BA_ "VFrameFormat" BO_ 100 14;
// Frame: SODLPrivateCANFD5Fr48
BA_ "GenMsgCycleTime" BO_ 101 50 ;
BA_ "GenMsgSendType" BO_ 101 0;
BA_ "VFrameFormat" BO_ 101 14;
// Frame: SODLPrivateCANFD5Fr49
BA_ "GenMsgCycleTime" BO_ 102 50 ;
BA_ "GenMsgSendType" BO_ 102 0;
BA_ "VFrameFormat" BO_ 102 14;
// Frame: SODLPrivateCANFD5Fr50
BA_ "GenMsgCycleTime" BO_ 103 50 ;
BA_ "GenMsgSendType" BO_ 103 0;
BA_ "VFrameFormat" BO_ 103 14;
// Frame: SODLPrivateCANFD5Fr51
BA_ "GenMsgCycleTime" BO_ 104 50 ;
BA_ "GenMsgSendType" BO_ 104 0;
BA_ "VFrameFormat" BO_ 104 14;
// Frame: SODLPrivateCANFD5Fr52
BA_ "GenMsgCycleTime" BO_ 105 50 ;
BA_ "GenMsgSendType" BO_ 105 0;
BA_ "VFrameFormat" BO_ 105 14;
// Frame: SODLPrivateCANFD5Fr53
BA_ "GenMsgCycleTime" BO_ 112 50 ;
BA_ "GenMsgSendType" BO_ 112 0;
BA_ "VFrameFormat" BO_ 112 14;
BA_ "GenSigSendType" SG_ 103 ReSideRdrLeDetn100RdrDetnAmbigState 0;
BA_ "GenSigSendType" SG_ 103 ReSideRdrLeDetn100RdrDetnAssoTrkID 0;
BA_ "GenSigSendType" SG_ 103 ReSideRdrLeDetn100RdrDetnAzi 0;
BA_ "GenSigStartValue" SG_ 103 ReSideRdrLeDetn100RdrDetnAzi 900;
BA_ "GenSigDataID" SG_ 103 ReSideRdrLeDetn100RdrDetnChks "0x9F5";
BA_ "GenSigFuncType" SG_ 103 ReSideRdrLeDetn100RdrDetnChks 15;
BA_ "GenSigSendType" SG_ 103 ReSideRdrLeDetn100RdrDetnChks 0;
BA_ "GenSigFuncType" SG_ 103 ReSideRdrLeDetn100RdrDetnCntr 16;
BA_ "GenSigSendType" SG_ 103 ReSideRdrLeDetn100RdrDetnCntr 0;
BA_ "GenSigSendType" SG_ 103 ReSideRdrLeDetn100RdrDetnConf 0;
BA_ "GenSigSendType" SG_ 103 ReSideRdrLeDetn100RdrDetnElevn 0;
BA_ "GenSigStartValue" SG_ 103 ReSideRdrLeDetn100RdrDetnElevn 15;
BA_ "GenSigSendType" SG_ 103 ReSideRdrLeDetn100RdrDetnPwr 0;
BA_ "GenSigSendType" SG_ 103 ReSideRdrLeDetn100RdrDetnRng 0;
BA_ "GenSigStartValue" SG_ 103 ReSideRdrLeDetn100RdrDetnRng 10050;
BA_ "GenSigSendType" SG_ 103 ReSideRdrLeDetn100RdrDetnRngV 0;
BA_ "GenSigStartValue" SG_ 103 ReSideRdrLeDetn100RdrDetnRngV 4000;
BA_ "GenSigSendType" SG_ 103 ReSideRdrLeDetn100RdrDetnSameRV 0;
BA_ "GenSigSendType" SG_ 103 ReSideRdrLeDetn100RdrDetnSts 0;
BA_ "GenSigStartValue" SG_ 103 ReSideRdrLeDetn100RdrDetnSts 3;
BA_ "GenSigSendType" SG_ 103 ReSideRdrLeDetn101RdrDetnAmbigState 0;
BA_ "GenSigSendType" SG_ 103 ReSideRdrLeDetn101RdrDetnAssoTrkID 0;
BA_ "GenSigSendType" SG_ 103 ReSideRdrLeDetn101RdrDetnAzi 0;
BA_ "GenSigStartValue" SG_ 103 ReSideRdrLeDetn101RdrDetnAzi 900;
BA_ "GenSigDataID" SG_ 103 ReSideRdrLeDetn101RdrDetnChks "0x9F6";
BA_ "GenSigFuncType" SG_ 103 ReSideRdrLeDetn101RdrDetnChks 15;
BA_ "GenSigSendType" SG_ 103 ReSideRdrLeDetn101RdrDetnChks 0;
BA_ "GenSigFuncType" SG_ 103 ReSideRdrLeDetn101RdrDetnCntr 16;
BA_ "GenSigSendType" SG_ 103 ReSideRdrLeDetn101RdrDetnCntr 0;
BA_ "GenSigSendType" SG_ 103 ReSideRdrLeDetn101RdrDetnConf 0;
BA_ "GenSigSendType" SG_ 103 ReSideRdrLeDetn101RdrDetnElevn 0;
BA_ "GenSigStartValue" SG_ 103 ReSideRdrLeDetn101RdrDetnElevn 15;
BA_ "GenSigSendType" SG_ 103 ReSideRdrLeDetn101RdrDetnPwr 0;
BA_ "GenSigSendType" SG_ 103 ReSideRdrLeDetn101RdrDetnRng 0;
BA_ "GenSigStartValue" SG_ 103 ReSideRdrLeDetn101RdrDetnRng 10050;
BA_ "GenSigSendType" SG_ 103 ReSideRdrLeDetn101RdrDetnRngV 0;
BA_ "GenSigStartValue" SG_ 103 ReSideRdrLeDetn101RdrDetnRngV 4000;
BA_ "GenSigSendType" SG_ 103 ReSideRdrLeDetn101RdrDetnSameRV 0;
BA_ "GenSigSendType" SG_ 103 ReSideRdrLeDetn101RdrDetnSts 0;
BA_ "GenSigStartValue" SG_ 103 ReSideRdrLeDetn101RdrDetnSts 3;
BA_ "GenSigSendType" SG_ 103 ReSideRdrLeDetn102RdrDetnAmbigState 0;
BA_ "GenSigSendType" SG_ 103 ReSideRdrLeDetn102RdrDetnAssoTrkID 0;
BA_ "GenSigSendType" SG_ 103 ReSideRdrLeDetn102RdrDetnAzi 0;
BA_ "GenSigStartValue" SG_ 103 ReSideRdrLeDetn102RdrDetnAzi 900;
BA_ "GenSigDataID" SG_ 103 ReSideRdrLeDetn102RdrDetnChks "0x9F7";
BA_ "GenSigFuncType" SG_ 103 ReSideRdrLeDetn102RdrDetnChks 15;
BA_ "GenSigSendType" SG_ 103 ReSideRdrLeDetn102RdrDetnChks 0;
BA_ "GenSigFuncType" SG_ 103 ReSideRdrLeDetn102RdrDetnCntr 16;
BA_ "GenSigSendType" SG_ 103 ReSideRdrLeDetn102RdrDetnCntr 0;
BA_ "GenSigSendType" SG_ 103 ReSideRdrLeDetn102RdrDetnConf 0;
BA_ "GenSigSendType" SG_ 103 ReSideRdrLeDetn102RdrDetnElevn 0;
BA_ "GenSigStartValue" SG_ 103 ReSideRdrLeDetn102RdrDetnElevn 15;
BA_ "GenSigSendType" SG_ 103 ReSideRdrLeDetn102RdrDetnPwr 0;
BA_ "GenSigSendType" SG_ 103 ReSideRdrLeDetn102RdrDetnRng 0;
BA_ "GenSigStartValue" SG_ 103 ReSideRdrLeDetn102RdrDetnRng 10050;
BA_ "GenSigSendType" SG_ 103 ReSideRdrLeDetn102RdrDetnRngV 0;
BA_ "GenSigStartValue" SG_ 103 ReSideRdrLeDetn102RdrDetnRngV 4000;
BA_ "GenSigSendType" SG_ 103 ReSideRdrLeDetn102RdrDetnSameRV 0;
BA_ "GenSigSendType" SG_ 103 ReSideRdrLeDetn102RdrDetnSts 0;
BA_ "GenSigStartValue" SG_ 103 ReSideRdrLeDetn102RdrDetnSts 3;
BA_ "GenSigSendType" SG_ 104 ReSideRdrLeDetn103RdrDetnAmbigState 0;
BA_ "GenSigSendType" SG_ 104 ReSideRdrLeDetn103RdrDetnAssoTrkID 0;
BA_ "GenSigSendType" SG_ 104 ReSideRdrLeDetn103RdrDetnAzi 0;
BA_ "GenSigStartValue" SG_ 104 ReSideRdrLeDetn103RdrDetnAzi 900;
BA_ "GenSigDataID" SG_ 104 ReSideRdrLeDetn103RdrDetnChks "0x9F8";
BA_ "GenSigFuncType" SG_ 104 ReSideRdrLeDetn103RdrDetnChks 15;
BA_ "GenSigSendType" SG_ 104 ReSideRdrLeDetn103RdrDetnChks 0;
BA_ "GenSigFuncType" SG_ 104 ReSideRdrLeDetn103RdrDetnCntr 16;
BA_ "GenSigSendType" SG_ 104 ReSideRdrLeDetn103RdrDetnCntr 0;
BA_ "GenSigSendType" SG_ 104 ReSideRdrLeDetn103RdrDetnConf 0;
BA_ "GenSigSendType" SG_ 104 ReSideRdrLeDetn103RdrDetnElevn 0;
BA_ "GenSigStartValue" SG_ 104 ReSideRdrLeDetn103RdrDetnElevn 15;
BA_ "GenSigSendType" SG_ 104 ReSideRdrLeDetn103RdrDetnPwr 0;
BA_ "GenSigSendType" SG_ 104 ReSideRdrLeDetn103RdrDetnRng 0;
BA_ "GenSigStartValue" SG_ 104 ReSideRdrLeDetn103RdrDetnRng 10050;
BA_ "GenSigSendType" SG_ 104 ReSideRdrLeDetn103RdrDetnRngV 0;
BA_ "GenSigStartValue" SG_ 104 ReSideRdrLeDetn103RdrDetnRngV 4000;
BA_ "GenSigSendType" SG_ 104 ReSideRdrLeDetn103RdrDetnSameRV 0;
BA_ "GenSigSendType" SG_ 104 ReSideRdrLeDetn103RdrDetnSts 0;
BA_ "GenSigStartValue" SG_ 104 ReSideRdrLeDetn103RdrDetnSts 3;
BA_ "GenSigSendType" SG_ 104 ReSideRdrLeDetn104RdrDetnAmbigState 0;
BA_ "GenSigSendType" SG_ 104 ReSideRdrLeDetn104RdrDetnAssoTrkID 0;
BA_ "GenSigSendType" SG_ 104 ReSideRdrLeDetn104RdrDetnAzi 0;
BA_ "GenSigStartValue" SG_ 104 ReSideRdrLeDetn104RdrDetnAzi 900;
BA_ "GenSigDataID" SG_ 104 ReSideRdrLeDetn104RdrDetnChks "0x9F9";
BA_ "GenSigFuncType" SG_ 104 ReSideRdrLeDetn104RdrDetnChks 15;
BA_ "GenSigSendType" SG_ 104 ReSideRdrLeDetn104RdrDetnChks 0;
BA_ "GenSigFuncType" SG_ 104 ReSideRdrLeDetn104RdrDetnCntr 16;
BA_ "GenSigSendType" SG_ 104 ReSideRdrLeDetn104RdrDetnCntr 0;
BA_ "GenSigSendType" SG_ 104 ReSideRdrLeDetn104RdrDetnConf 0;
BA_ "GenSigSendType" SG_ 104 ReSideRdrLeDetn104RdrDetnElevn 0;
BA_ "GenSigStartValue" SG_ 104 ReSideRdrLeDetn104RdrDetnElevn 15;
BA_ "GenSigSendType" SG_ 104 ReSideRdrLeDetn104RdrDetnPwr 0;
BA_ "GenSigSendType" SG_ 104 ReSideRdrLeDetn104RdrDetnRng 0;
BA_ "GenSigStartValue" SG_ 104 ReSideRdrLeDetn104RdrDetnRng 10050;
BA_ "GenSigSendType" SG_ 104 ReSideRdrLeDetn104RdrDetnRngV 0;
BA_ "GenSigStartValue" SG_ 104 ReSideRdrLeDetn104RdrDetnRngV 4000;
BA_ "GenSigSendType" SG_ 104 ReSideRdrLeDetn104RdrDetnSameRV 0;
BA_ "GenSigSendType" SG_ 104 ReSideRdrLeDetn104RdrDetnSts 0;
BA_ "GenSigStartValue" SG_ 104 ReSideRdrLeDetn104RdrDetnSts 3;
BA_ "GenSigSendType" SG_ 104 ReSideRdrLeDetn105RdrDetnAmbigState 0;
BA_ "GenSigSendType" SG_ 104 ReSideRdrLeDetn105RdrDetnAssoTrkID 0;
BA_ "GenSigSendType" SG_ 104 ReSideRdrLeDetn105RdrDetnAzi 0;
BA_ "GenSigStartValue" SG_ 104 ReSideRdrLeDetn105RdrDetnAzi 900;
BA_ "GenSigDataID" SG_ 104 ReSideRdrLeDetn105RdrDetnChks "0x9FA";
BA_ "GenSigFuncType" SG_ 104 ReSideRdrLeDetn105RdrDetnChks 15;
BA_ "GenSigSendType" SG_ 104 ReSideRdrLeDetn105RdrDetnChks 0;
BA_ "GenSigFuncType" SG_ 104 ReSideRdrLeDetn105RdrDetnCntr 16;
BA_ "GenSigSendType" SG_ 104 ReSideRdrLeDetn105RdrDetnCntr 0;
BA_ "GenSigSendType" SG_ 104 ReSideRdrLeDetn105RdrDetnConf 0;
BA_ "GenSigSendType" SG_ 104 ReSideRdrLeDetn105RdrDetnElevn 0;
BA_ "GenSigStartValue" SG_ 104 ReSideRdrLeDetn105RdrDetnElevn 15;
BA_ "GenSigSendType" SG_ 104 ReSideRdrLeDetn105RdrDetnPwr 0;
BA_ "GenSigSendType" SG_ 104 ReSideRdrLeDetn105RdrDetnRng 0;
BA_ "GenSigStartValue" SG_ 104 ReSideRdrLeDetn105RdrDetnRng 10050;
BA_ "GenSigSendType" SG_ 104 ReSideRdrLeDetn105RdrDetnRngV 0;
BA_ "GenSigStartValue" SG_ 104 ReSideRdrLeDetn105RdrDetnRngV 4000;
BA_ "GenSigSendType" SG_ 104 ReSideRdrLeDetn105RdrDetnSameRV 0;
BA_ "GenSigSendType" SG_ 104 ReSideRdrLeDetn105RdrDetnSts 0;
BA_ "GenSigStartValue" SG_ 104 ReSideRdrLeDetn105RdrDetnSts 3;
BA_ "GenSigSendType" SG_ 104 ReSideRdrLeDetn106RdrDetnAmbigState 0;
BA_ "GenSigSendType" SG_ 104 ReSideRdrLeDetn106RdrDetnAssoTrkID 0;
BA_ "GenSigSendType" SG_ 104 ReSideRdrLeDetn106RdrDetnAzi 0;
BA_ "GenSigStartValue" SG_ 104 ReSideRdrLeDetn106RdrDetnAzi 900;
BA_ "GenSigDataID" SG_ 104 ReSideRdrLeDetn106RdrDetnChks "0x9FB";
BA_ "GenSigFuncType" SG_ 104 ReSideRdrLeDetn106RdrDetnChks 15;
BA_ "GenSigSendType" SG_ 104 ReSideRdrLeDetn106RdrDetnChks 0;
BA_ "GenSigFuncType" SG_ 104 ReSideRdrLeDetn106RdrDetnCntr 16;
BA_ "GenSigSendType" SG_ 104 ReSideRdrLeDetn106RdrDetnCntr 0;
BA_ "GenSigSendType" SG_ 104 ReSideRdrLeDetn106RdrDetnConf 0;
BA_ "GenSigSendType" SG_ 104 ReSideRdrLeDetn106RdrDetnElevn 0;
BA_ "GenSigStartValue" SG_ 104 ReSideRdrLeDetn106RdrDetnElevn 15;
BA_ "GenSigSendType" SG_ 104 ReSideRdrLeDetn106RdrDetnPwr 0;
BA_ "GenSigSendType" SG_ 104 ReSideRdrLeDetn106RdrDetnRng 0;
BA_ "GenSigStartValue" SG_ 104 ReSideRdrLeDetn106RdrDetnRng 10050;
BA_ "GenSigSendType" SG_ 104 ReSideRdrLeDetn106RdrDetnRngV 0;
BA_ "GenSigStartValue" SG_ 104 ReSideRdrLeDetn106RdrDetnRngV 4000;
BA_ "GenSigSendType" SG_ 104 ReSideRdrLeDetn106RdrDetnSameRV 0;
BA_ "GenSigSendType" SG_ 104 ReSideRdrLeDetn106RdrDetnSts 0;
BA_ "GenSigStartValue" SG_ 104 ReSideRdrLeDetn106RdrDetnSts 3;
BA_ "GenSigSendType" SG_ 104 ReSideRdrLeDetn107RdrDetnAmbigState 0;
BA_ "GenSigSendType" SG_ 104 ReSideRdrLeDetn107RdrDetnAssoTrkID 0;
BA_ "GenSigSendType" SG_ 104 ReSideRdrLeDetn107RdrDetnAzi 0;
BA_ "GenSigStartValue" SG_ 104 ReSideRdrLeDetn107RdrDetnAzi 900;
BA_ "GenSigDataID" SG_ 104 ReSideRdrLeDetn107RdrDetnChks "0x9FC";
BA_ "GenSigFuncType" SG_ 104 ReSideRdrLeDetn107RdrDetnChks 15;
BA_ "GenSigSendType" SG_ 104 ReSideRdrLeDetn107RdrDetnChks 0;
BA_ "GenSigFuncType" SG_ 104 ReSideRdrLeDetn107RdrDetnCntr 16;
BA_ "GenSigSendType" SG_ 104 ReSideRdrLeDetn107RdrDetnCntr 0;
BA_ "GenSigSendType" SG_ 104 ReSideRdrLeDetn107RdrDetnConf 0;
BA_ "GenSigSendType" SG_ 104 ReSideRdrLeDetn107RdrDetnElevn 0;
BA_ "GenSigStartValue" SG_ 104 ReSideRdrLeDetn107RdrDetnElevn 15;
BA_ "GenSigSendType" SG_ 104 ReSideRdrLeDetn107RdrDetnPwr 0;
BA_ "GenSigSendType" SG_ 104 ReSideRdrLeDetn107RdrDetnRng 0;
BA_ "GenSigStartValue" SG_ 104 ReSideRdrLeDetn107RdrDetnRng 10050;
BA_ "GenSigSendType" SG_ 104 ReSideRdrLeDetn107RdrDetnRngV 0;
BA_ "GenSigStartValue" SG_ 104 ReSideRdrLeDetn107RdrDetnRngV 4000;
BA_ "GenSigSendType" SG_ 104 ReSideRdrLeDetn107RdrDetnSameRV 0;
BA_ "GenSigSendType" SG_ 104 ReSideRdrLeDetn107RdrDetnSts 0;
BA_ "GenSigStartValue" SG_ 104 ReSideRdrLeDetn107RdrDetnSts 3;
BA_ "GenSigSendType" SG_ 104 ReSideRdrLeDetn108RdrDetnAmbigState 0;
BA_ "GenSigSendType" SG_ 104 ReSideRdrLeDetn108RdrDetnAssoTrkID 0;
BA_ "GenSigSendType" SG_ 104 ReSideRdrLeDetn108RdrDetnAzi 0;
BA_ "GenSigStartValue" SG_ 104 ReSideRdrLeDetn108RdrDetnAzi 900;
BA_ "GenSigDataID" SG_ 104 ReSideRdrLeDetn108RdrDetnChks "0x9FD";
BA_ "GenSigFuncType" SG_ 104 ReSideRdrLeDetn108RdrDetnChks 15;
BA_ "GenSigSendType" SG_ 104 ReSideRdrLeDetn108RdrDetnChks 0;
BA_ "GenSigFuncType" SG_ 104 ReSideRdrLeDetn108RdrDetnCntr 16;
BA_ "GenSigSendType" SG_ 104 ReSideRdrLeDetn108RdrDetnCntr 0;
BA_ "GenSigSendType" SG_ 104 ReSideRdrLeDetn108RdrDetnConf 0;
BA_ "GenSigSendType" SG_ 104 ReSideRdrLeDetn108RdrDetnElevn 0;
BA_ "GenSigStartValue" SG_ 104 ReSideRdrLeDetn108RdrDetnElevn 15;
BA_ "GenSigSendType" SG_ 104 ReSideRdrLeDetn108RdrDetnPwr 0;
BA_ "GenSigSendType" SG_ 104 ReSideRdrLeDetn108RdrDetnRng 0;
BA_ "GenSigStartValue" SG_ 104 ReSideRdrLeDetn108RdrDetnRng 10050;
BA_ "GenSigSendType" SG_ 104 ReSideRdrLeDetn108RdrDetnRngV 0;
BA_ "GenSigStartValue" SG_ 104 ReSideRdrLeDetn108RdrDetnRngV 4000;
BA_ "GenSigSendType" SG_ 104 ReSideRdrLeDetn108RdrDetnSameRV 0;
BA_ "GenSigSendType" SG_ 104 ReSideRdrLeDetn108RdrDetnSts 0;
BA_ "GenSigStartValue" SG_ 104 ReSideRdrLeDetn108RdrDetnSts 3;
BA_ "GenSigSendType" SG_ 105 ReSideRdrLeDetn109RdrDetnAmbigState 0;
BA_ "GenSigSendType" SG_ 105 ReSideRdrLeDetn109RdrDetnAssoTrkID 0;
BA_ "GenSigSendType" SG_ 105 ReSideRdrLeDetn109RdrDetnAzi 0;
BA_ "GenSigStartValue" SG_ 105 ReSideRdrLeDetn109RdrDetnAzi 900;
BA_ "GenSigDataID" SG_ 105 ReSideRdrLeDetn109RdrDetnChks "0x9FE";
BA_ "GenSigFuncType" SG_ 105 ReSideRdrLeDetn109RdrDetnChks 15;
BA_ "GenSigSendType" SG_ 105 ReSideRdrLeDetn109RdrDetnChks 0;
BA_ "GenSigFuncType" SG_ 105 ReSideRdrLeDetn109RdrDetnCntr 16;
BA_ "GenSigSendType" SG_ 105 ReSideRdrLeDetn109RdrDetnCntr 0;
BA_ "GenSigSendType" SG_ 105 ReSideRdrLeDetn109RdrDetnConf 0;
BA_ "GenSigSendType" SG_ 105 ReSideRdrLeDetn109RdrDetnElevn 0;
BA_ "GenSigStartValue" SG_ 105 ReSideRdrLeDetn109RdrDetnElevn 15;
BA_ "GenSigSendType" SG_ 105 ReSideRdrLeDetn109RdrDetnPwr 0;
BA_ "GenSigSendType" SG_ 105 ReSideRdrLeDetn109RdrDetnRng 0;
BA_ "GenSigStartValue" SG_ 105 ReSideRdrLeDetn109RdrDetnRng 10050;
BA_ "GenSigSendType" SG_ 105 ReSideRdrLeDetn109RdrDetnRngV 0;
BA_ "GenSigStartValue" SG_ 105 ReSideRdrLeDetn109RdrDetnRngV 4000;
BA_ "GenSigSendType" SG_ 105 ReSideRdrLeDetn109RdrDetnSameRV 0;
BA_ "GenSigSendType" SG_ 105 ReSideRdrLeDetn109RdrDetnSts 0;
BA_ "GenSigStartValue" SG_ 105 ReSideRdrLeDetn109RdrDetnSts 3;
BA_ "GenSigSendType" SG_ 105 ReSideRdrLeDetn110RdrDetnAmbigState 0;
BA_ "GenSigSendType" SG_ 105 ReSideRdrLeDetn110RdrDetnAssoTrkID 0;
BA_ "GenSigSendType" SG_ 105 ReSideRdrLeDetn110RdrDetnAzi 0;
BA_ "GenSigStartValue" SG_ 105 ReSideRdrLeDetn110RdrDetnAzi 900;
BA_ "GenSigDataID" SG_ 105 ReSideRdrLeDetn110RdrDetnChks "0x9FF";
BA_ "GenSigFuncType" SG_ 105 ReSideRdrLeDetn110RdrDetnChks 15;
BA_ "GenSigSendType" SG_ 105 ReSideRdrLeDetn110RdrDetnChks 0;
BA_ "GenSigFuncType" SG_ 105 ReSideRdrLeDetn110RdrDetnCntr 16;
BA_ "GenSigSendType" SG_ 105 ReSideRdrLeDetn110RdrDetnCntr 0;
BA_ "GenSigSendType" SG_ 105 ReSideRdrLeDetn110RdrDetnConf 0;
BA_ "GenSigSendType" SG_ 105 ReSideRdrLeDetn110RdrDetnElevn 0;
BA_ "GenSigStartValue" SG_ 105 ReSideRdrLeDetn110RdrDetnElevn 15;
BA_ "GenSigSendType" SG_ 105 ReSideRdrLeDetn110RdrDetnPwr 0;
BA_ "GenSigSendType" SG_ 105 ReSideRdrLeDetn110RdrDetnRng 0;
BA_ "GenSigStartValue" SG_ 105 ReSideRdrLeDetn110RdrDetnRng 10050;
BA_ "GenSigSendType" SG_ 105 ReSideRdrLeDetn110RdrDetnRngV 0;
BA_ "GenSigStartValue" SG_ 105 ReSideRdrLeDetn110RdrDetnRngV 4000;
BA_ "GenSigSendType" SG_ 105 ReSideRdrLeDetn110RdrDetnSameRV 0;
BA_ "GenSigSendType" SG_ 105 ReSideRdrLeDetn110RdrDetnSts 0;
BA_ "GenSigStartValue" SG_ 105 ReSideRdrLeDetn110RdrDetnSts 3;
BA_ "GenSigSendType" SG_ 105 ReSideRdrLeDetn111RdrDetnAmbigState 0;
BA_ "GenSigSendType" SG_ 105 ReSideRdrLeDetn111RdrDetnAssoTrkID 0;
BA_ "GenSigSendType" SG_ 105 ReSideRdrLeDetn111RdrDetnAzi 0;
BA_ "GenSigStartValue" SG_ 105 ReSideRdrLeDetn111RdrDetnAzi 900;
BA_ "GenSigDataID" SG_ 105 ReSideRdrLeDetn111RdrDetnChks "0xA00";
BA_ "GenSigFuncType" SG_ 105 ReSideRdrLeDetn111RdrDetnChks 15;
BA_ "GenSigSendType" SG_ 105 ReSideRdrLeDetn111RdrDetnChks 0;
BA_ "GenSigFuncType" SG_ 105 ReSideRdrLeDetn111RdrDetnCntr 16;
BA_ "GenSigSendType" SG_ 105 ReSideRdrLeDetn111RdrDetnCntr 0;
BA_ "GenSigSendType" SG_ 105 ReSideRdrLeDetn111RdrDetnConf 0;
BA_ "GenSigSendType" SG_ 105 ReSideRdrLeDetn111RdrDetnElevn 0;
BA_ "GenSigStartValue" SG_ 105 ReSideRdrLeDetn111RdrDetnElevn 15;
BA_ "GenSigSendType" SG_ 105 ReSideRdrLeDetn111RdrDetnPwr 0;
BA_ "GenSigSendType" SG_ 105 ReSideRdrLeDetn111RdrDetnRng 0;
BA_ "GenSigStartValue" SG_ 105 ReSideRdrLeDetn111RdrDetnRng 10050;
BA_ "GenSigSendType" SG_ 105 ReSideRdrLeDetn111RdrDetnRngV 0;
BA_ "GenSigStartValue" SG_ 105 ReSideRdrLeDetn111RdrDetnRngV 4000;
BA_ "GenSigSendType" SG_ 105 ReSideRdrLeDetn111RdrDetnSameRV 0;
BA_ "GenSigSendType" SG_ 105 ReSideRdrLeDetn111RdrDetnSts 0;
BA_ "GenSigStartValue" SG_ 105 ReSideRdrLeDetn111RdrDetnSts 3;
BA_ "GenSigSendType" SG_ 105 ReSideRdrLeDetn112RdrDetnAmbigState 0;
BA_ "GenSigSendType" SG_ 105 ReSideRdrLeDetn112RdrDetnAssoTrkID 0;
BA_ "GenSigSendType" SG_ 105 ReSideRdrLeDetn112RdrDetnAzi 0;
BA_ "GenSigStartValue" SG_ 105 ReSideRdrLeDetn112RdrDetnAzi 900;
BA_ "GenSigDataID" SG_ 105 ReSideRdrLeDetn112RdrDetnChks "0xA01";
BA_ "GenSigFuncType" SG_ 105 ReSideRdrLeDetn112RdrDetnChks 15;
BA_ "GenSigSendType" SG_ 105 ReSideRdrLeDetn112RdrDetnChks 0;
BA_ "GenSigFuncType" SG_ 105 ReSideRdrLeDetn112RdrDetnCntr 16;
BA_ "GenSigSendType" SG_ 105 ReSideRdrLeDetn112RdrDetnCntr 0;
BA_ "GenSigSendType" SG_ 105 ReSideRdrLeDetn112RdrDetnConf 0;
BA_ "GenSigSendType" SG_ 105 ReSideRdrLeDetn112RdrDetnElevn 0;
BA_ "GenSigStartValue" SG_ 105 ReSideRdrLeDetn112RdrDetnElevn 15;
BA_ "GenSigSendType" SG_ 105 ReSideRdrLeDetn112RdrDetnPwr 0;
BA_ "GenSigSendType" SG_ 105 ReSideRdrLeDetn112RdrDetnRng 0;
BA_ "GenSigStartValue" SG_ 105 ReSideRdrLeDetn112RdrDetnRng 10050;
BA_ "GenSigSendType" SG_ 105 ReSideRdrLeDetn112RdrDetnRngV 0;
BA_ "GenSigStartValue" SG_ 105 ReSideRdrLeDetn112RdrDetnRngV 4000;
BA_ "GenSigSendType" SG_ 105 ReSideRdrLeDetn112RdrDetnSameRV 0;
BA_ "GenSigSendType" SG_ 105 ReSideRdrLeDetn112RdrDetnSts 0;
BA_ "GenSigStartValue" SG_ 105 ReSideRdrLeDetn112RdrDetnSts 3;
BA_ "GenSigSendType" SG_ 105 ReSideRdrLeDetn113RdrDetnAmbigState 0;
BA_ "GenSigSendType" SG_ 105 ReSideRdrLeDetn113RdrDetnAssoTrkID 0;
BA_ "GenSigSendType" SG_ 105 ReSideRdrLeDetn113RdrDetnAzi 0;
BA_ "GenSigStartValue" SG_ 105 ReSideRdrLeDetn113RdrDetnAzi 900;
BA_ "GenSigDataID" SG_ 105 ReSideRdrLeDetn113RdrDetnChks "0xA02";
BA_ "GenSigFuncType" SG_ 105 ReSideRdrLeDetn113RdrDetnChks 15;
BA_ "GenSigSendType" SG_ 105 ReSideRdrLeDetn113RdrDetnChks 0;
BA_ "GenSigFuncType" SG_ 105 ReSideRdrLeDetn113RdrDetnCntr 16;
BA_ "GenSigSendType" SG_ 105 ReSideRdrLeDetn113RdrDetnCntr 0;
BA_ "GenSigSendType" SG_ 105 ReSideRdrLeDetn113RdrDetnConf 0;
BA_ "GenSigSendType" SG_ 105 ReSideRdrLeDetn113RdrDetnElevn 0;
BA_ "GenSigStartValue" SG_ 105 ReSideRdrLeDetn113RdrDetnElevn 15;
BA_ "GenSigSendType" SG_ 105 ReSideRdrLeDetn113RdrDetnPwr 0;
BA_ "GenSigSendType" SG_ 105 ReSideRdrLeDetn113RdrDetnRng 0;
BA_ "GenSigStartValue" SG_ 105 ReSideRdrLeDetn113RdrDetnRng 10050;
BA_ "GenSigSendType" SG_ 105 ReSideRdrLeDetn113RdrDetnRngV 0;
BA_ "GenSigStartValue" SG_ 105 ReSideRdrLeDetn113RdrDetnRngV 4000;
BA_ "GenSigSendType" SG_ 105 ReSideRdrLeDetn113RdrDetnSameRV 0;
BA_ "GenSigSendType" SG_ 105 ReSideRdrLeDetn113RdrDetnSts 0;
BA_ "GenSigStartValue" SG_ 105 ReSideRdrLeDetn113RdrDetnSts 3;
BA_ "GenSigSendType" SG_ 105 ReSideRdrLeDetn114RdrDetnAmbigState 0;
BA_ "GenSigSendType" SG_ 105 ReSideRdrLeDetn114RdrDetnAssoTrkID 0;
BA_ "GenSigSendType" SG_ 105 ReSideRdrLeDetn114RdrDetnAzi 0;
BA_ "GenSigStartValue" SG_ 105 ReSideRdrLeDetn114RdrDetnAzi 900;
BA_ "GenSigDataID" SG_ 105 ReSideRdrLeDetn114RdrDetnChks "0xA03";
BA_ "GenSigFuncType" SG_ 105 ReSideRdrLeDetn114RdrDetnChks 15;
BA_ "GenSigSendType" SG_ 105 ReSideRdrLeDetn114RdrDetnChks 0;
BA_ "GenSigFuncType" SG_ 105 ReSideRdrLeDetn114RdrDetnCntr 16;
BA_ "GenSigSendType" SG_ 105 ReSideRdrLeDetn114RdrDetnCntr 0;
BA_ "GenSigSendType" SG_ 105 ReSideRdrLeDetn114RdrDetnConf 0;
BA_ "GenSigSendType" SG_ 105 ReSideRdrLeDetn114RdrDetnElevn 0;
BA_ "GenSigStartValue" SG_ 105 ReSideRdrLeDetn114RdrDetnElevn 15;
BA_ "GenSigSendType" SG_ 105 ReSideRdrLeDetn114RdrDetnPwr 0;
BA_ "GenSigSendType" SG_ 105 ReSideRdrLeDetn114RdrDetnRng 0;
BA_ "GenSigStartValue" SG_ 105 ReSideRdrLeDetn114RdrDetnRng 10050;
BA_ "GenSigSendType" SG_ 105 ReSideRdrLeDetn114RdrDetnRngV 0;
BA_ "GenSigStartValue" SG_ 105 ReSideRdrLeDetn114RdrDetnRngV 4000;
BA_ "GenSigSendType" SG_ 105 ReSideRdrLeDetn114RdrDetnSameRV 0;
BA_ "GenSigSendType" SG_ 105 ReSideRdrLeDetn114RdrDetnSts 0;
BA_ "GenSigStartValue" SG_ 105 ReSideRdrLeDetn114RdrDetnSts 3;
BA_ "GenSigSendType" SG_ 112 ReSideRdrLeDetn115RdrDetnAmbigState 0;
BA_ "GenSigSendType" SG_ 112 ReSideRdrLeDetn115RdrDetnAssoTrkID 0;
BA_ "GenSigSendType" SG_ 112 ReSideRdrLeDetn115RdrDetnAzi 0;
BA_ "GenSigStartValue" SG_ 112 ReSideRdrLeDetn115RdrDetnAzi 900;
BA_ "GenSigDataID" SG_ 112 ReSideRdrLeDetn115RdrDetnChks "0xA04";
BA_ "GenSigFuncType" SG_ 112 ReSideRdrLeDetn115RdrDetnChks 15;
BA_ "GenSigSendType" SG_ 112 ReSideRdrLeDetn115RdrDetnChks 0;
BA_ "GenSigFuncType" SG_ 112 ReSideRdrLeDetn115RdrDetnCntr 16;
BA_ "GenSigSendType" SG_ 112 ReSideRdrLeDetn115RdrDetnCntr 0;
BA_ "GenSigSendType" SG_ 112 ReSideRdrLeDetn115RdrDetnConf 0;
BA_ "GenSigSendType" SG_ 112 ReSideRdrLeDetn115RdrDetnElevn 0;
BA_ "GenSigStartValue" SG_ 112 ReSideRdrLeDetn115RdrDetnElevn 15;
BA_ "GenSigSendType" SG_ 112 ReSideRdrLeDetn115RdrDetnPwr 0;
BA_ "GenSigSendType" SG_ 112 ReSideRdrLeDetn115RdrDetnRng 0;
BA_ "GenSigStartValue" SG_ 112 ReSideRdrLeDetn115RdrDetnRng 10050;
BA_ "GenSigSendType" SG_ 112 ReSideRdrLeDetn115RdrDetnRngV 0;
BA_ "GenSigStartValue" SG_ 112 ReSideRdrLeDetn115RdrDetnRngV 4000;
BA_ "GenSigSendType" SG_ 112 ReSideRdrLeDetn115RdrDetnSameRV 0;
BA_ "GenSigSendType" SG_ 112 ReSideRdrLeDetn115RdrDetnSts 0;
BA_ "GenSigStartValue" SG_ 112 ReSideRdrLeDetn115RdrDetnSts 3;
BA_ "GenSigSendType" SG_ 112 ReSideRdrLeDetn116RdrDetnAmbigState 0;
BA_ "GenSigSendType" SG_ 112 ReSideRdrLeDetn116RdrDetnAssoTrkID 0;
BA_ "GenSigSendType" SG_ 112 ReSideRdrLeDetn116RdrDetnAzi 0;
BA_ "GenSigStartValue" SG_ 112 ReSideRdrLeDetn116RdrDetnAzi 900;
BA_ "GenSigDataID" SG_ 112 ReSideRdrLeDetn116RdrDetnChks "0xA05";
BA_ "GenSigFuncType" SG_ 112 ReSideRdrLeDetn116RdrDetnChks 15;
BA_ "GenSigSendType" SG_ 112 ReSideRdrLeDetn116RdrDetnChks 0;
BA_ "GenSigFuncType" SG_ 112 ReSideRdrLeDetn116RdrDetnCntr 16;
BA_ "GenSigSendType" SG_ 112 ReSideRdrLeDetn116RdrDetnCntr 0;
BA_ "GenSigSendType" SG_ 112 ReSideRdrLeDetn116RdrDetnConf 0;
BA_ "GenSigSendType" SG_ 112 ReSideRdrLeDetn116RdrDetnElevn 0;
BA_ "GenSigStartValue" SG_ 112 ReSideRdrLeDetn116RdrDetnElevn 15;
BA_ "GenSigSendType" SG_ 112 ReSideRdrLeDetn116RdrDetnPwr 0;
BA_ "GenSigSendType" SG_ 112 ReSideRdrLeDetn116RdrDetnRng 0;
BA_ "GenSigStartValue" SG_ 112 ReSideRdrLeDetn116RdrDetnRng 10050;
BA_ "GenSigSendType" SG_ 112 ReSideRdrLeDetn116RdrDetnRngV 0;
BA_ "GenSigStartValue" SG_ 112 ReSideRdrLeDetn116RdrDetnRngV 4000;
BA_ "GenSigSendType" SG_ 112 ReSideRdrLeDetn116RdrDetnSameRV 0;
BA_ "GenSigSendType" SG_ 112 ReSideRdrLeDetn116RdrDetnSts 0;
BA_ "GenSigStartValue" SG_ 112 ReSideRdrLeDetn116RdrDetnSts 3;
BA_ "GenSigSendType" SG_ 112 ReSideRdrLeDetn117RdrDetnAmbigState 0;
BA_ "GenSigSendType" SG_ 112 ReSideRdrLeDetn117RdrDetnAssoTrkID 0;
BA_ "GenSigSendType" SG_ 112 ReSideRdrLeDetn117RdrDetnAzi 0;
BA_ "GenSigStartValue" SG_ 112 ReSideRdrLeDetn117RdrDetnAzi 900;
BA_ "GenSigDataID" SG_ 112 ReSideRdrLeDetn117RdrDetnChks "0xA06";
BA_ "GenSigFuncType" SG_ 112 ReSideRdrLeDetn117RdrDetnChks 15;
BA_ "GenSigSendType" SG_ 112 ReSideRdrLeDetn117RdrDetnChks 0;
BA_ "GenSigFuncType" SG_ 112 ReSideRdrLeDetn117RdrDetnCntr 16;
BA_ "GenSigSendType" SG_ 112 ReSideRdrLeDetn117RdrDetnCntr 0;
BA_ "GenSigSendType" SG_ 112 ReSideRdrLeDetn117RdrDetnConf 0;
BA_ "GenSigSendType" SG_ 112 ReSideRdrLeDetn117RdrDetnElevn 0;
BA_ "GenSigStartValue" SG_ 112 ReSideRdrLeDetn117RdrDetnElevn 15;
BA_ "GenSigSendType" SG_ 112 ReSideRdrLeDetn117RdrDetnPwr 0;
BA_ "GenSigSendType" SG_ 112 ReSideRdrLeDetn117RdrDetnRng 0;
BA_ "GenSigStartValue" SG_ 112 ReSideRdrLeDetn117RdrDetnRng 10050;
BA_ "GenSigSendType" SG_ 112 ReSideRdrLeDetn117RdrDetnRngV 0;
BA_ "GenSigStartValue" SG_ 112 ReSideRdrLeDetn117RdrDetnRngV 4000;
BA_ "GenSigSendType" SG_ 112 ReSideRdrLeDetn117RdrDetnSameRV 0;
BA_ "GenSigSendType" SG_ 112 ReSideRdrLeDetn117RdrDetnSts 0;
BA_ "GenSigStartValue" SG_ 112 ReSideRdrLeDetn117RdrDetnSts 3;
BA_ "GenSigSendType" SG_ 112 ReSideRdrLeDetn118RdrDetnAmbigState 0;
BA_ "GenSigSendType" SG_ 112 ReSideRdrLeDetn118RdrDetnAssoTrkID 0;
BA_ "GenSigSendType" SG_ 112 ReSideRdrLeDetn118RdrDetnAzi 0;
BA_ "GenSigStartValue" SG_ 112 ReSideRdrLeDetn118RdrDetnAzi 900;
BA_ "GenSigDataID" SG_ 112 ReSideRdrLeDetn118RdrDetnChks "0xA07";
BA_ "GenSigFuncType" SG_ 112 ReSideRdrLeDetn118RdrDetnChks 15;
BA_ "GenSigSendType" SG_ 112 ReSideRdrLeDetn118RdrDetnChks 0;
BA_ "GenSigFuncType" SG_ 112 ReSideRdrLeDetn118RdrDetnCntr 16;
BA_ "GenSigSendType" SG_ 112 ReSideRdrLeDetn118RdrDetnCntr 0;
BA_ "GenSigSendType" SG_ 112 ReSideRdrLeDetn118RdrDetnConf 0;
BA_ "GenSigSendType" SG_ 112 ReSideRdrLeDetn118RdrDetnElevn 0;
BA_ "GenSigStartValue" SG_ 112 ReSideRdrLeDetn118RdrDetnElevn 15;
BA_ "GenSigSendType" SG_ 112 ReSideRdrLeDetn118RdrDetnPwr 0;
BA_ "GenSigSendType" SG_ 112 ReSideRdrLeDetn118RdrDetnRng 0;
BA_ "GenSigStartValue" SG_ 112 ReSideRdrLeDetn118RdrDetnRng 10050;
BA_ "GenSigSendType" SG_ 112 ReSideRdrLeDetn118RdrDetnRngV 0;
BA_ "GenSigStartValue" SG_ 112 ReSideRdrLeDetn118RdrDetnRngV 4000;
BA_ "GenSigSendType" SG_ 112 ReSideRdrLeDetn118RdrDetnSameRV 0;
BA_ "GenSigSendType" SG_ 112 ReSideRdrLeDetn118RdrDetnSts 0;
BA_ "GenSigStartValue" SG_ 112 ReSideRdrLeDetn118RdrDetnSts 3;
BA_ "GenSigSendType" SG_ 112 ReSideRdrLeDetn119RdrDetnAmbigState 0;
BA_ "GenSigSendType" SG_ 112 ReSideRdrLeDetn119RdrDetnAssoTrkID 0;
BA_ "GenSigSendType" SG_ 112 ReSideRdrLeDetn119RdrDetnAzi 0;
BA_ "GenSigStartValue" SG_ 112 ReSideRdrLeDetn119RdrDetnAzi 900;
BA_ "GenSigDataID" SG_ 112 ReSideRdrLeDetn119RdrDetnChks "0xA08";
BA_ "GenSigFuncType" SG_ 112 ReSideRdrLeDetn119RdrDetnChks 15;
BA_ "GenSigSendType" SG_ 112 ReSideRdrLeDetn119RdrDetnChks 0;
BA_ "GenSigFuncType" SG_ 112 ReSideRdrLeDetn119RdrDetnCntr 16;
BA_ "GenSigSendType" SG_ 112 ReSideRdrLeDetn119RdrDetnCntr 0;
BA_ "GenSigSendType" SG_ 112 ReSideRdrLeDetn119RdrDetnConf 0;
BA_ "GenSigSendType" SG_ 112 ReSideRdrLeDetn119RdrDetnElevn 0;
BA_ "GenSigStartValue" SG_ 112 ReSideRdrLeDetn119RdrDetnElevn 15;
BA_ "GenSigSendType" SG_ 112 ReSideRdrLeDetn119RdrDetnPwr 0;
BA_ "GenSigSendType" SG_ 112 ReSideRdrLeDetn119RdrDetnRng 0;
BA_ "GenSigStartValue" SG_ 112 ReSideRdrLeDetn119RdrDetnRng 10050;
BA_ "GenSigSendType" SG_ 112 ReSideRdrLeDetn119RdrDetnRngV 0;
BA_ "GenSigStartValue" SG_ 112 ReSideRdrLeDetn119RdrDetnRngV 4000;
BA_ "GenSigSendType" SG_ 112 ReSideRdrLeDetn119RdrDetnSameRV 0;
BA_ "GenSigSendType" SG_ 112 ReSideRdrLeDetn119RdrDetnSts 0;
BA_ "GenSigStartValue" SG_ 112 ReSideRdrLeDetn119RdrDetnSts 3;
BA_ "GenSigSendType" SG_ 112 ReSideRdrLeDetn120RdrDetnAmbigState 0;
BA_ "GenSigSendType" SG_ 112 ReSideRdrLeDetn120RdrDetnAssoTrkID 0;
BA_ "GenSigSendType" SG_ 112 ReSideRdrLeDetn120RdrDetnAzi 0;
BA_ "GenSigStartValue" SG_ 112 ReSideRdrLeDetn120RdrDetnAzi 900;
BA_ "GenSigDataID" SG_ 112 ReSideRdrLeDetn120RdrDetnChks "0xA09";
BA_ "GenSigFuncType" SG_ 112 ReSideRdrLeDetn120RdrDetnChks 15;
BA_ "GenSigSendType" SG_ 112 ReSideRdrLeDetn120RdrDetnChks 0;
BA_ "GenSigFuncType" SG_ 112 ReSideRdrLeDetn120RdrDetnCntr 16;
BA_ "GenSigSendType" SG_ 112 ReSideRdrLeDetn120RdrDetnCntr 0;
BA_ "GenSigSendType" SG_ 112 ReSideRdrLeDetn120RdrDetnConf 0;
BA_ "GenSigSendType" SG_ 112 ReSideRdrLeDetn120RdrDetnElevn 0;
BA_ "GenSigStartValue" SG_ 112 ReSideRdrLeDetn120RdrDetnElevn 15;
BA_ "GenSigSendType" SG_ 112 ReSideRdrLeDetn120RdrDetnPwr 0;
BA_ "GenSigSendType" SG_ 112 ReSideRdrLeDetn120RdrDetnRng 0;
BA_ "GenSigStartValue" SG_ 112 ReSideRdrLeDetn120RdrDetnRng 10050;
BA_ "GenSigSendType" SG_ 112 ReSideRdrLeDetn120RdrDetnRngV 0;
BA_ "GenSigStartValue" SG_ 112 ReSideRdrLeDetn120RdrDetnRngV 4000;
BA_ "GenSigSendType" SG_ 112 ReSideRdrLeDetn120RdrDetnSameRV 0;
BA_ "GenSigSendType" SG_ 112 ReSideRdrLeDetn120RdrDetnSts 0;
BA_ "GenSigStartValue" SG_ 112 ReSideRdrLeDetn120RdrDetnSts 3;
BA_ "GenSigSendType" SG_ 100 ReSideRdrLeDetn79RdrDetnAmbigState 0;
BA_ "GenSigSendType" SG_ 100 ReSideRdrLeDetn79RdrDetnAssoTrkID 0;
BA_ "GenSigSendType" SG_ 100 ReSideRdrLeDetn79RdrDetnAzi 0;
BA_ "GenSigStartValue" SG_ 100 ReSideRdrLeDetn79RdrDetnAzi 900;
BA_ "GenSigDataID" SG_ 100 ReSideRdrLeDetn79RdrDetnChks "0x9E0";
BA_ "GenSigFuncType" SG_ 100 ReSideRdrLeDetn79RdrDetnChks 15;
BA_ "GenSigSendType" SG_ 100 ReSideRdrLeDetn79RdrDetnChks 0;
BA_ "GenSigFuncType" SG_ 100 ReSideRdrLeDetn79RdrDetnCntr 16;
BA_ "GenSigSendType" SG_ 100 ReSideRdrLeDetn79RdrDetnCntr 0;
BA_ "GenSigSendType" SG_ 100 ReSideRdrLeDetn79RdrDetnConf 0;
BA_ "GenSigSendType" SG_ 100 ReSideRdrLeDetn79RdrDetnElevn 0;
BA_ "GenSigStartValue" SG_ 100 ReSideRdrLeDetn79RdrDetnElevn 15;
BA_ "GenSigSendType" SG_ 100 ReSideRdrLeDetn79RdrDetnPwr 0;
BA_ "GenSigSendType" SG_ 100 ReSideRdrLeDetn79RdrDetnRng 0;
BA_ "GenSigStartValue" SG_ 100 ReSideRdrLeDetn79RdrDetnRng 10050;
BA_ "GenSigSendType" SG_ 100 ReSideRdrLeDetn79RdrDetnRngV 0;
BA_ "GenSigStartValue" SG_ 100 ReSideRdrLeDetn79RdrDetnRngV 4000;
BA_ "GenSigSendType" SG_ 100 ReSideRdrLeDetn79RdrDetnSameRV 0;
BA_ "GenSigSendType" SG_ 100 ReSideRdrLeDetn79RdrDetnSts 0;
BA_ "GenSigStartValue" SG_ 100 ReSideRdrLeDetn79RdrDetnSts 3;
BA_ "GenSigSendType" SG_ 100 ReSideRdrLeDetn80RdrDetnAmbigState 0;
BA_ "GenSigSendType" SG_ 100 ReSideRdrLeDetn80RdrDetnAssoTrkID 0;
BA_ "GenSigSendType" SG_ 100 ReSideRdrLeDetn80RdrDetnAzi 0;
BA_ "GenSigStartValue" SG_ 100 ReSideRdrLeDetn80RdrDetnAzi 900;
BA_ "GenSigDataID" SG_ 100 ReSideRdrLeDetn80RdrDetnChks "0x9E1";
BA_ "GenSigFuncType" SG_ 100 ReSideRdrLeDetn80RdrDetnChks 15;
BA_ "GenSigSendType" SG_ 100 ReSideRdrLeDetn80RdrDetnChks 0;
BA_ "GenSigFuncType" SG_ 100 ReSideRdrLeDetn80RdrDetnCntr 16;
BA_ "GenSigSendType" SG_ 100 ReSideRdrLeDetn80RdrDetnCntr 0;
BA_ "GenSigSendType" SG_ 100 ReSideRdrLeDetn80RdrDetnConf 0;
BA_ "GenSigSendType" SG_ 100 ReSideRdrLeDetn80RdrDetnElevn 0;
BA_ "GenSigStartValue" SG_ 100 ReSideRdrLeDetn80RdrDetnElevn 15;
BA_ "GenSigSendType" SG_ 100 ReSideRdrLeDetn80RdrDetnPwr 0;
BA_ "GenSigSendType" SG_ 100 ReSideRdrLeDetn80RdrDetnRng 0;
BA_ "GenSigStartValue" SG_ 100 ReSideRdrLeDetn80RdrDetnRng 10050;
BA_ "GenSigSendType" SG_ 100 ReSideRdrLeDetn80RdrDetnRngV 0;
BA_ "GenSigStartValue" SG_ 100 ReSideRdrLeDetn80RdrDetnRngV 4000;
BA_ "GenSigSendType" SG_ 100 ReSideRdrLeDetn80RdrDetnSameRV 0;
BA_ "GenSigSendType" SG_ 100 ReSideRdrLeDetn80RdrDetnSts 0;
BA_ "GenSigStartValue" SG_ 100 ReSideRdrLeDetn80RdrDetnSts 3;
BA_ "GenSigSendType" SG_ 100 ReSideRdrLeDetn81RdrDetnAmbigState 0;
BA_ "GenSigSendType" SG_ 100 ReSideRdrLeDetn81RdrDetnAssoTrkID 0;
BA_ "GenSigSendType" SG_ 100 ReSideRdrLeDetn81RdrDetnAzi 0;
BA_ "GenSigStartValue" SG_ 100 ReSideRdrLeDetn81RdrDetnAzi 900;
BA_ "GenSigDataID" SG_ 100 ReSideRdrLeDetn81RdrDetnChks "0x9E2";
BA_ "GenSigFuncType" SG_ 100 ReSideRdrLeDetn81RdrDetnChks 15;
BA_ "GenSigSendType" SG_ 100 ReSideRdrLeDetn81RdrDetnChks 0;
BA_ "GenSigFuncType" SG_ 100 ReSideRdrLeDetn81RdrDetnCntr 16;
BA_ "GenSigSendType" SG_ 100 ReSideRdrLeDetn81RdrDetnCntr 0;
BA_ "GenSigSendType" SG_ 100 ReSideRdrLeDetn81RdrDetnConf 0;
BA_ "GenSigSendType" SG_ 100 ReSideRdrLeDetn81RdrDetnElevn 0;
BA_ "GenSigStartValue" SG_ 100 ReSideRdrLeDetn81RdrDetnElevn 15;
BA_ "GenSigSendType" SG_ 100 ReSideRdrLeDetn81RdrDetnPwr 0;
BA_ "GenSigSendType" SG_ 100 ReSideRdrLeDetn81RdrDetnRng 0;
BA_ "GenSigStartValue" SG_ 100 ReSideRdrLeDetn81RdrDetnRng 10050;
BA_ "GenSigSendType" SG_ 100 ReSideRdrLeDetn81RdrDetnRngV 0;
BA_ "GenSigStartValue" SG_ 100 ReSideRdrLeDetn81RdrDetnRngV 4000;
BA_ "GenSigSendType" SG_ 100 ReSideRdrLeDetn81RdrDetnSameRV 0;
BA_ "GenSigSendType" SG_ 100 ReSideRdrLeDetn81RdrDetnSts 0;
BA_ "GenSigStartValue" SG_ 100 ReSideRdrLeDetn81RdrDetnSts 3;
BA_ "GenSigSendType" SG_ 100 ReSideRdrLeDetn82RdrDetnAmbigState 0;
BA_ "GenSigSendType" SG_ 100 ReSideRdrLeDetn82RdrDetnAssoTrkID 0;
BA_ "GenSigSendType" SG_ 100 ReSideRdrLeDetn82RdrDetnAzi 0;
BA_ "GenSigStartValue" SG_ 100 ReSideRdrLeDetn82RdrDetnAzi 900;
BA_ "GenSigDataID" SG_ 100 ReSideRdrLeDetn82RdrDetnChks "0x9E3";
BA_ "GenSigFuncType" SG_ 100 ReSideRdrLeDetn82RdrDetnChks 15;
BA_ "GenSigSendType" SG_ 100 ReSideRdrLeDetn82RdrDetnChks 0;
BA_ "GenSigFuncType" SG_ 100 ReSideRdrLeDetn82RdrDetnCntr 16;
BA_ "GenSigSendType" SG_ 100 ReSideRdrLeDetn82RdrDetnCntr 0;
BA_ "GenSigSendType" SG_ 100 ReSideRdrLeDetn82RdrDetnConf 0;
BA_ "GenSigSendType" SG_ 100 ReSideRdrLeDetn82RdrDetnElevn 0;
BA_ "GenSigStartValue" SG_ 100 ReSideRdrLeDetn82RdrDetnElevn 15;
BA_ "GenSigSendType" SG_ 100 ReSideRdrLeDetn82RdrDetnPwr 0;
BA_ "GenSigSendType" SG_ 100 ReSideRdrLeDetn82RdrDetnRng 0;
BA_ "GenSigStartValue" SG_ 100 ReSideRdrLeDetn82RdrDetnRng 10050;
BA_ "GenSigSendType" SG_ 100 ReSideRdrLeDetn82RdrDetnRngV 0;
BA_ "GenSigStartValue" SG_ 100 ReSideRdrLeDetn82RdrDetnRngV 4000;
BA_ "GenSigSendType" SG_ 100 ReSideRdrLeDetn82RdrDetnSameRV 0;
BA_ "GenSigSendType" SG_ 100 ReSideRdrLeDetn82RdrDetnSts 0;
BA_ "GenSigStartValue" SG_ 100 ReSideRdrLeDetn82RdrDetnSts 3;
BA_ "GenSigSendType" SG_ 100 ReSideRdrLeDetn83RdrDetnAmbigState 0;
BA_ "GenSigSendType" SG_ 100 ReSideRdrLeDetn83RdrDetnAssoTrkID 0;
BA_ "GenSigSendType" SG_ 100 ReSideRdrLeDetn83RdrDetnAzi 0;
BA_ "GenSigStartValue" SG_ 100 ReSideRdrLeDetn83RdrDetnAzi 900;
BA_ "GenSigDataID" SG_ 100 ReSideRdrLeDetn83RdrDetnChks "0x9E4";
BA_ "GenSigFuncType" SG_ 100 ReSideRdrLeDetn83RdrDetnChks 15;
BA_ "GenSigSendType" SG_ 100 ReSideRdrLeDetn83RdrDetnChks 0;
BA_ "GenSigFuncType" SG_ 100 ReSideRdrLeDetn83RdrDetnCntr 16;
BA_ "GenSigSendType" SG_ 100 ReSideRdrLeDetn83RdrDetnCntr 0;
BA_ "GenSigSendType" SG_ 100 ReSideRdrLeDetn83RdrDetnConf 0;
BA_ "GenSigSendType" SG_ 100 ReSideRdrLeDetn83RdrDetnElevn 0;
BA_ "GenSigStartValue" SG_ 100 ReSideRdrLeDetn83RdrDetnElevn 15;
BA_ "GenSigSendType" SG_ 100 ReSideRdrLeDetn83RdrDetnPwr 0;
BA_ "GenSigSendType" SG_ 100 ReSideRdrLeDetn83RdrDetnRng 0;
BA_ "GenSigStartValue" SG_ 100 ReSideRdrLeDetn83RdrDetnRng 10050;
BA_ "GenSigSendType" SG_ 100 ReSideRdrLeDetn83RdrDetnRngV 0;
BA_ "GenSigStartValue" SG_ 100 ReSideRdrLeDetn83RdrDetnRngV 4000;
BA_ "GenSigSendType" SG_ 100 ReSideRdrLeDetn83RdrDetnSameRV 0;
BA_ "GenSigSendType" SG_ 100 ReSideRdrLeDetn83RdrDetnSts 0;
BA_ "GenSigStartValue" SG_ 100 ReSideRdrLeDetn83RdrDetnSts 3;
BA_ "GenSigSendType" SG_ 100 ReSideRdrLeDetn84RdrDetnAmbigState 0;
BA_ "GenSigSendType" SG_ 100 ReSideRdrLeDetn84RdrDetnAssoTrkID 0;
BA_ "GenSigSendType" SG_ 100 ReSideRdrLeDetn84RdrDetnAzi 0;
BA_ "GenSigStartValue" SG_ 100 ReSideRdrLeDetn84RdrDetnAzi 900;
BA_ "GenSigDataID" SG_ 100 ReSideRdrLeDetn84RdrDetnChks "0x9E5";
BA_ "GenSigFuncType" SG_ 100 ReSideRdrLeDetn84RdrDetnChks 15;
BA_ "GenSigSendType" SG_ 100 ReSideRdrLeDetn84RdrDetnChks 0;
BA_ "GenSigFuncType" SG_ 100 ReSideRdrLeDetn84RdrDetnCntr 16;
BA_ "GenSigSendType" SG_ 100 ReSideRdrLeDetn84RdrDetnCntr 0;
BA_ "GenSigSendType" SG_ 100 ReSideRdrLeDetn84RdrDetnConf 0;
BA_ "GenSigSendType" SG_ 100 ReSideRdrLeDetn84RdrDetnElevn 0;
BA_ "GenSigStartValue" SG_ 100 ReSideRdrLeDetn84RdrDetnElevn 15;
BA_ "GenSigSendType" SG_ 100 ReSideRdrLeDetn84RdrDetnPwr 0;
BA_ "GenSigSendType" SG_ 100 ReSideRdrLeDetn84RdrDetnRng 0;
BA_ "GenSigStartValue" SG_ 100 ReSideRdrLeDetn84RdrDetnRng 10050;
BA_ "GenSigSendType" SG_ 100 ReSideRdrLeDetn84RdrDetnRngV 0;
BA_ "GenSigStartValue" SG_ 100 ReSideRdrLeDetn84RdrDetnRngV 4000;
BA_ "GenSigSendType" SG_ 100 ReSideRdrLeDetn84RdrDetnSameRV 0;
BA_ "GenSigSendType" SG_ 100 ReSideRdrLeDetn84RdrDetnSts 0;
BA_ "GenSigStartValue" SG_ 100 ReSideRdrLeDetn84RdrDetnSts 3;
BA_ "GenSigSendType" SG_ 101 ReSideRdrLeDetn85RdrDetnAmbigState 0;
BA_ "GenSigSendType" SG_ 101 ReSideRdrLeDetn85RdrDetnAssoTrkID 0;
BA_ "GenSigSendType" SG_ 101 ReSideRdrLeDetn85RdrDetnAzi 0;
BA_ "GenSigStartValue" SG_ 101 ReSideRdrLeDetn85RdrDetnAzi 900;
BA_ "GenSigDataID" SG_ 101 ReSideRdrLeDetn85RdrDetnChks "0x9E6";
BA_ "GenSigFuncType" SG_ 101 ReSideRdrLeDetn85RdrDetnChks 15;
BA_ "GenSigSendType" SG_ 101 ReSideRdrLeDetn85RdrDetnChks 0;
BA_ "GenSigFuncType" SG_ 101 ReSideRdrLeDetn85RdrDetnCntr 16;
BA_ "GenSigSendType" SG_ 101 ReSideRdrLeDetn85RdrDetnCntr 0;
BA_ "GenSigSendType" SG_ 101 ReSideRdrLeDetn85RdrDetnConf 0;
BA_ "GenSigSendType" SG_ 101 ReSideRdrLeDetn85RdrDetnElevn 0;
BA_ "GenSigStartValue" SG_ 101 ReSideRdrLeDetn85RdrDetnElevn 15;
BA_ "GenSigSendType" SG_ 101 ReSideRdrLeDetn85RdrDetnPwr 0;
BA_ "GenSigSendType" SG_ 101 ReSideRdrLeDetn85RdrDetnRng 0;
BA_ "GenSigStartValue" SG_ 101 ReSideRdrLeDetn85RdrDetnRng 10050;
BA_ "GenSigSendType" SG_ 101 ReSideRdrLeDetn85RdrDetnRngV 0;
BA_ "GenSigStartValue" SG_ 101 ReSideRdrLeDetn85RdrDetnRngV 4000;
BA_ "GenSigSendType" SG_ 101 ReSideRdrLeDetn85RdrDetnSameRV 0;
BA_ "GenSigSendType" SG_ 101 ReSideRdrLeDetn85RdrDetnSts 0;
BA_ "GenSigStartValue" SG_ 101 ReSideRdrLeDetn85RdrDetnSts 3;
BA_ "GenSigSendType" SG_ 101 ReSideRdrLeDetn86RdrDetnAmbigState 0;
BA_ "GenSigSendType" SG_ 101 ReSideRdrLeDetn86RdrDetnAssoTrkID 0;
BA_ "GenSigSendType" SG_ 101 ReSideRdrLeDetn86RdrDetnAzi 0;
BA_ "GenSigStartValue" SG_ 101 ReSideRdrLeDetn86RdrDetnAzi 900;
BA_ "GenSigDataID" SG_ 101 ReSideRdrLeDetn86RdrDetnChks "0x9E7";
BA_ "GenSigFuncType" SG_ 101 ReSideRdrLeDetn86RdrDetnChks 15;
BA_ "GenSigSendType" SG_ 101 ReSideRdrLeDetn86RdrDetnChks 0;
BA_ "GenSigFuncType" SG_ 101 ReSideRdrLeDetn86RdrDetnCntr 16;
BA_ "GenSigSendType" SG_ 101 ReSideRdrLeDetn86RdrDetnCntr 0;
BA_ "GenSigSendType" SG_ 101 ReSideRdrLeDetn86RdrDetnConf 0;
BA_ "GenSigSendType" SG_ 101 ReSideRdrLeDetn86RdrDetnElevn 0;
BA_ "GenSigStartValue" SG_ 101 ReSideRdrLeDetn86RdrDetnElevn 15;
BA_ "GenSigSendType" SG_ 101 ReSideRdrLeDetn86RdrDetnPwr 0;
BA_ "GenSigSendType" SG_ 101 ReSideRdrLeDetn86RdrDetnRng 0;
BA_ "GenSigStartValue" SG_ 101 ReSideRdrLeDetn86RdrDetnRng 10050;
BA_ "GenSigSendType" SG_ 101 ReSideRdrLeDetn86RdrDetnRngV 0;
BA_ "GenSigStartValue" SG_ 101 ReSideRdrLeDetn86RdrDetnRngV 4000;
BA_ "GenSigSendType" SG_ 101 ReSideRdrLeDetn86RdrDetnSameRV 0;
BA_ "GenSigSendType" SG_ 101 ReSideRdrLeDetn86RdrDetnSts 0;
BA_ "GenSigStartValue" SG_ 101 ReSideRdrLeDetn86RdrDetnSts 3;
BA_ "GenSigSendType" SG_ 101 ReSideRdrLeDetn87RdrDetnAmbigState 0;
BA_ "GenSigSendType" SG_ 101 ReSideRdrLeDetn87RdrDetnAssoTrkID 0;
BA_ "GenSigSendType" SG_ 101 ReSideRdrLeDetn87RdrDetnAzi 0;
BA_ "GenSigStartValue" SG_ 101 ReSideRdrLeDetn87RdrDetnAzi 900;
BA_ "GenSigDataID" SG_ 101 ReSideRdrLeDetn87RdrDetnChks "0x9E8";
BA_ "GenSigFuncType" SG_ 101 ReSideRdrLeDetn87RdrDetnChks 15;
BA_ "GenSigSendType" SG_ 101 ReSideRdrLeDetn87RdrDetnChks 0;
BA_ "GenSigFuncType" SG_ 101 ReSideRdrLeDetn87RdrDetnCntr 16;
BA_ "GenSigSendType" SG_ 101 ReSideRdrLeDetn87RdrDetnCntr 0;
BA_ "GenSigSendType" SG_ 101 ReSideRdrLeDetn87RdrDetnConf 0;
BA_ "GenSigSendType" SG_ 101 ReSideRdrLeDetn87RdrDetnElevn 0;
BA_ "GenSigStartValue" SG_ 101 ReSideRdrLeDetn87RdrDetnElevn 15;
BA_ "GenSigSendType" SG_ 101 ReSideRdrLeDetn87RdrDetnPwr 0;
BA_ "GenSigSendType" SG_ 101 ReSideRdrLeDetn87RdrDetnRng 0;
BA_ "GenSigStartValue" SG_ 101 ReSideRdrLeDetn87RdrDetnRng 10050;
BA_ "GenSigSendType" SG_ 101 ReSideRdrLeDetn87RdrDetnRngV 0;
BA_ "GenSigStartValue" SG_ 101 ReSideRdrLeDetn87RdrDetnRngV 4000;
BA_ "GenSigSendType" SG_ 101 ReSideRdrLeDetn87RdrDetnSameRV 0;
BA_ "GenSigSendType" SG_ 101 ReSideRdrLeDetn87RdrDetnSts 0;
BA_ "GenSigStartValue" SG_ 101 ReSideRdrLeDetn87RdrDetnSts 3;
BA_ "GenSigSendType" SG_ 101 ReSideRdrLeDetn88RdrDetnAmbigState 0;
BA_ "GenSigSendType" SG_ 101 ReSideRdrLeDetn88RdrDetnAssoTrkID 0;
BA_ "GenSigSendType" SG_ 101 ReSideRdrLeDetn88RdrDetnAzi 0;
BA_ "GenSigStartValue" SG_ 101 ReSideRdrLeDetn88RdrDetnAzi 900;
BA_ "GenSigDataID" SG_ 101 ReSideRdrLeDetn88RdrDetnChks "0x9E9";
BA_ "GenSigFuncType" SG_ 101 ReSideRdrLeDetn88RdrDetnChks 15;
BA_ "GenSigSendType" SG_ 101 ReSideRdrLeDetn88RdrDetnChks 0;
BA_ "GenSigFuncType" SG_ 101 ReSideRdrLeDetn88RdrDetnCntr 16;
BA_ "GenSigSendType" SG_ 101 ReSideRdrLeDetn88RdrDetnCntr 0;
BA_ "GenSigSendType" SG_ 101 ReSideRdrLeDetn88RdrDetnConf 0;
BA_ "GenSigSendType" SG_ 101 ReSideRdrLeDetn88RdrDetnElevn 0;
BA_ "GenSigStartValue" SG_ 101 ReSideRdrLeDetn88RdrDetnElevn 15;
BA_ "GenSigSendType" SG_ 101 ReSideRdrLeDetn88RdrDetnPwr 0;
BA_ "GenSigSendType" SG_ 101 ReSideRdrLeDetn88RdrDetnRng 0;
BA_ "GenSigStartValue" SG_ 101 ReSideRdrLeDetn88RdrDetnRng 10050;
BA_ "GenSigSendType" SG_ 101 ReSideRdrLeDetn88RdrDetnRngV 0;
BA_ "GenSigStartValue" SG_ 101 ReSideRdrLeDetn88RdrDetnRngV 4000;
BA_ "GenSigSendType" SG_ 101 ReSideRdrLeDetn88RdrDetnSameRV 0;
BA_ "GenSigSendType" SG_ 101 ReSideRdrLeDetn88RdrDetnSts 0;
BA_ "GenSigStartValue" SG_ 101 ReSideRdrLeDetn88RdrDetnSts 3;
BA_ "GenSigSendType" SG_ 101 ReSideRdrLeDetn89RdrDetnAmbigState 0;
BA_ "GenSigSendType" SG_ 101 ReSideRdrLeDetn89RdrDetnAssoTrkID 0;
BA_ "GenSigSendType" SG_ 101 ReSideRdrLeDetn89RdrDetnAzi 0;
BA_ "GenSigStartValue" SG_ 101 ReSideRdrLeDetn89RdrDetnAzi 900;
BA_ "GenSigDataID" SG_ 101 ReSideRdrLeDetn89RdrDetnChks "0x9EA";
BA_ "GenSigFuncType" SG_ 101 ReSideRdrLeDetn89RdrDetnChks 15;
BA_ "GenSigSendType" SG_ 101 ReSideRdrLeDetn89RdrDetnChks 0;
BA_ "GenSigFuncType" SG_ 101 ReSideRdrLeDetn89RdrDetnCntr 16;
BA_ "GenSigSendType" SG_ 101 ReSideRdrLeDetn89RdrDetnCntr 0;
BA_ "GenSigSendType" SG_ 101 ReSideRdrLeDetn89RdrDetnConf 0;
BA_ "GenSigSendType" SG_ 101 ReSideRdrLeDetn89RdrDetnElevn 0;
BA_ "GenSigStartValue" SG_ 101 ReSideRdrLeDetn89RdrDetnElevn 15;
BA_ "GenSigSendType" SG_ 101 ReSideRdrLeDetn89RdrDetnPwr 0;
BA_ "GenSigSendType" SG_ 101 ReSideRdrLeDetn89RdrDetnRng 0;
BA_ "GenSigStartValue" SG_ 101 ReSideRdrLeDetn89RdrDetnRng 10050;
BA_ "GenSigSendType" SG_ 101 ReSideRdrLeDetn89RdrDetnRngV 0;
BA_ "GenSigStartValue" SG_ 101 ReSideRdrLeDetn89RdrDetnRngV 4000;
BA_ "GenSigSendType" SG_ 101 ReSideRdrLeDetn89RdrDetnSameRV 0;
BA_ "GenSigSendType" SG_ 101 ReSideRdrLeDetn89RdrDetnSts 0;
BA_ "GenSigStartValue" SG_ 101 ReSideRdrLeDetn89RdrDetnSts 3;
BA_ "GenSigSendType" SG_ 101 ReSideRdrLeDetn90RdrDetnAmbigState 0;
BA_ "GenSigSendType" SG_ 101 ReSideRdrLeDetn90RdrDetnAssoTrkID 0;
BA_ "GenSigSendType" SG_ 101 ReSideRdrLeDetn90RdrDetnAzi 0;
BA_ "GenSigStartValue" SG_ 101 ReSideRdrLeDetn90RdrDetnAzi 900;
BA_ "GenSigDataID" SG_ 101 ReSideRdrLeDetn90RdrDetnChks "0x9EB";
BA_ "GenSigFuncType" SG_ 101 ReSideRdrLeDetn90RdrDetnChks 15;
BA_ "GenSigSendType" SG_ 101 ReSideRdrLeDetn90RdrDetnChks 0;
BA_ "GenSigFuncType" SG_ 101 ReSideRdrLeDetn90RdrDetnCntr 16;
BA_ "GenSigSendType" SG_ 101 ReSideRdrLeDetn90RdrDetnCntr 0;
BA_ "GenSigSendType" SG_ 101 ReSideRdrLeDetn90RdrDetnConf 0;
BA_ "GenSigSendType" SG_ 101 ReSideRdrLeDetn90RdrDetnElevn 0;
BA_ "GenSigStartValue" SG_ 101 ReSideRdrLeDetn90RdrDetnElevn 15;
BA_ "GenSigSendType" SG_ 101 ReSideRdrLeDetn90RdrDetnPwr 0;
BA_ "GenSigSendType" SG_ 101 ReSideRdrLeDetn90RdrDetnRng 0;
BA_ "GenSigStartValue" SG_ 101 ReSideRdrLeDetn90RdrDetnRng 10050;
BA_ "GenSigSendType" SG_ 101 ReSideRdrLeDetn90RdrDetnRngV 0;
BA_ "GenSigStartValue" SG_ 101 ReSideRdrLeDetn90RdrDetnRngV 4000;
BA_ "GenSigSendType" SG_ 101 ReSideRdrLeDetn90RdrDetnSameRV 0;
BA_ "GenSigSendType" SG_ 101 ReSideRdrLeDetn90RdrDetnSts 0;
BA_ "GenSigStartValue" SG_ 101 ReSideRdrLeDetn90RdrDetnSts 3;
BA_ "GenSigSendType" SG_ 102 ReSideRdrLeDetn91RdrDetnAmbigState 0;
BA_ "GenSigSendType" SG_ 102 ReSideRdrLeDetn91RdrDetnAssoTrkID 0;
BA_ "GenSigSendType" SG_ 102 ReSideRdrLeDetn91RdrDetnAzi 0;
BA_ "GenSigStartValue" SG_ 102 ReSideRdrLeDetn91RdrDetnAzi 900;
BA_ "GenSigDataID" SG_ 102 ReSideRdrLeDetn91RdrDetnChks "0x9EC";
BA_ "GenSigFuncType" SG_ 102 ReSideRdrLeDetn91RdrDetnChks 15;
BA_ "GenSigSendType" SG_ 102 ReSideRdrLeDetn91RdrDetnChks 0;
BA_ "GenSigFuncType" SG_ 102 ReSideRdrLeDetn91RdrDetnCntr 16;
BA_ "GenSigSendType" SG_ 102 ReSideRdrLeDetn91RdrDetnCntr 0;
BA_ "GenSigSendType" SG_ 102 ReSideRdrLeDetn91RdrDetnConf 0;
BA_ "GenSigSendType" SG_ 102 ReSideRdrLeDetn91RdrDetnElevn 0;
BA_ "GenSigStartValue" SG_ 102 ReSideRdrLeDetn91RdrDetnElevn 15;
BA_ "GenSigSendType" SG_ 102 ReSideRdrLeDetn91RdrDetnPwr 0;
BA_ "GenSigSendType" SG_ 102 ReSideRdrLeDetn91RdrDetnRng 0;
BA_ "GenSigStartValue" SG_ 102 ReSideRdrLeDetn91RdrDetnRng 10050;
BA_ "GenSigSendType" SG_ 102 ReSideRdrLeDetn91RdrDetnRngV 0;
BA_ "GenSigStartValue" SG_ 102 ReSideRdrLeDetn91RdrDetnRngV 4000;
BA_ "GenSigSendType" SG_ 102 ReSideRdrLeDetn91RdrDetnSameRV 0;
BA_ "GenSigSendType" SG_ 102 ReSideRdrLeDetn91RdrDetnSts 0;
BA_ "GenSigStartValue" SG_ 102 ReSideRdrLeDetn91RdrDetnSts 3;
BA_ "GenSigSendType" SG_ 102 ReSideRdrLeDetn92RdrDetnAmbigState 0;
BA_ "GenSigSendType" SG_ 102 ReSideRdrLeDetn92RdrDetnAssoTrkID 0;
BA_ "GenSigSendType" SG_ 102 ReSideRdrLeDetn92RdrDetnAzi 0;
BA_ "GenSigStartValue" SG_ 102 ReSideRdrLeDetn92RdrDetnAzi 900;
BA_ "GenSigDataID" SG_ 102 ReSideRdrLeDetn92RdrDetnChks "0x9ED";
BA_ "GenSigFuncType" SG_ 102 ReSideRdrLeDetn92RdrDetnChks 15;
BA_ "GenSigSendType" SG_ 102 ReSideRdrLeDetn92RdrDetnChks 0;
BA_ "GenSigFuncType" SG_ 102 ReSideRdrLeDetn92RdrDetnCntr 16;
BA_ "GenSigSendType" SG_ 102 ReSideRdrLeDetn92RdrDetnCntr 0;
BA_ "GenSigSendType" SG_ 102 ReSideRdrLeDetn92RdrDetnConf 0;
BA_ "GenSigSendType" SG_ 102 ReSideRdrLeDetn92RdrDetnElevn 0;
BA_ "GenSigStartValue" SG_ 102 ReSideRdrLeDetn92RdrDetnElevn 15;
BA_ "GenSigSendType" SG_ 102 ReSideRdrLeDetn92RdrDetnPwr 0;
BA_ "GenSigSendType" SG_ 102 ReSideRdrLeDetn92RdrDetnRng 0;
BA_ "GenSigStartValue" SG_ 102 ReSideRdrLeDetn92RdrDetnRng 10050;
BA_ "GenSigSendType" SG_ 102 ReSideRdrLeDetn92RdrDetnRngV 0;
BA_ "GenSigStartValue" SG_ 102 ReSideRdrLeDetn92RdrDetnRngV 4000;
BA_ "GenSigSendType" SG_ 102 ReSideRdrLeDetn92RdrDetnSameRV 0;
BA_ "GenSigSendType" SG_ 102 ReSideRdrLeDetn92RdrDetnSts 0;
BA_ "GenSigStartValue" SG_ 102 ReSideRdrLeDetn92RdrDetnSts 3;
BA_ "GenSigSendType" SG_ 102 ReSideRdrLeDetn93RdrDetnAmbigState 0;
BA_ "GenSigSendType" SG_ 102 ReSideRdrLeDetn93RdrDetnAssoTrkID 0;
BA_ "GenSigSendType" SG_ 102 ReSideRdrLeDetn93RdrDetnAzi 0;
BA_ "GenSigStartValue" SG_ 102 ReSideRdrLeDetn93RdrDetnAzi 900;
BA_ "GenSigDataID" SG_ 102 ReSideRdrLeDetn93RdrDetnChks "0x9EE";
BA_ "GenSigFuncType" SG_ 102 ReSideRdrLeDetn93RdrDetnChks 15;
BA_ "GenSigSendType" SG_ 102 ReSideRdrLeDetn93RdrDetnChks 0;
BA_ "GenSigFuncType" SG_ 102 ReSideRdrLeDetn93RdrDetnCntr 16;
BA_ "GenSigSendType" SG_ 102 ReSideRdrLeDetn93RdrDetnCntr 0;
BA_ "GenSigSendType" SG_ 102 ReSideRdrLeDetn93RdrDetnConf 0;
BA_ "GenSigSendType" SG_ 102 ReSideRdrLeDetn93RdrDetnElevn 0;
BA_ "GenSigStartValue" SG_ 102 ReSideRdrLeDetn93RdrDetnElevn 15;
BA_ "GenSigSendType" SG_ 102 ReSideRdrLeDetn93RdrDetnPwr 0;
BA_ "GenSigSendType" SG_ 102 ReSideRdrLeDetn93RdrDetnRng 0;
BA_ "GenSigStartValue" SG_ 102 ReSideRdrLeDetn93RdrDetnRng 10050;
BA_ "GenSigSendType" SG_ 102 ReSideRdrLeDetn93RdrDetnRngV 0;
BA_ "GenSigStartValue" SG_ 102 ReSideRdrLeDetn93RdrDetnRngV 4000;
BA_ "GenSigSendType" SG_ 102 ReSideRdrLeDetn93RdrDetnSameRV 0;
BA_ "GenSigSendType" SG_ 102 ReSideRdrLeDetn93RdrDetnSts 0;
BA_ "GenSigStartValue" SG_ 102 ReSideRdrLeDetn93RdrDetnSts 3;
BA_ "GenSigSendType" SG_ 102 ReSideRdrLeDetn94RdrDetnAmbigState 0;
BA_ "GenSigSendType" SG_ 102 ReSideRdrLeDetn94RdrDetnAssoTrkID 0;
BA_ "GenSigSendType" SG_ 102 ReSideRdrLeDetn94RdrDetnAzi 0;
BA_ "GenSigStartValue" SG_ 102 ReSideRdrLeDetn94RdrDetnAzi 900;
BA_ "GenSigDataID" SG_ 102 ReSideRdrLeDetn94RdrDetnChks "0x9EF";
BA_ "GenSigFuncType" SG_ 102 ReSideRdrLeDetn94RdrDetnChks 15;
BA_ "GenSigSendType" SG_ 102 ReSideRdrLeDetn94RdrDetnChks 0;
BA_ "GenSigFuncType" SG_ 102 ReSideRdrLeDetn94RdrDetnCntr 16;
BA_ "GenSigSendType" SG_ 102 ReSideRdrLeDetn94RdrDetnCntr 0;
BA_ "GenSigSendType" SG_ 102 ReSideRdrLeDetn94RdrDetnConf 0;
BA_ "GenSigSendType" SG_ 102 ReSideRdrLeDetn94RdrDetnElevn 0;
BA_ "GenSigStartValue" SG_ 102 ReSideRdrLeDetn94RdrDetnElevn 15;
BA_ "GenSigSendType" SG_ 102 ReSideRdrLeDetn94RdrDetnPwr 0;
BA_ "GenSigSendType" SG_ 102 ReSideRdrLeDetn94RdrDetnRng 0;
BA_ "GenSigStartValue" SG_ 102 ReSideRdrLeDetn94RdrDetnRng 10050;
BA_ "GenSigSendType" SG_ 102 ReSideRdrLeDetn94RdrDetnRngV 0;
BA_ "GenSigStartValue" SG_ 102 ReSideRdrLeDetn94RdrDetnRngV 4000;
BA_ "GenSigSendType" SG_ 102 ReSideRdrLeDetn94RdrDetnSameRV 0;
BA_ "GenSigSendType" SG_ 102 ReSideRdrLeDetn94RdrDetnSts 0;
BA_ "GenSigStartValue" SG_ 102 ReSideRdrLeDetn94RdrDetnSts 3;
BA_ "GenSigSendType" SG_ 102 ReSideRdrLeDetn95RdrDetnAmbigState 0;
BA_ "GenSigSendType" SG_ 102 ReSideRdrLeDetn95RdrDetnAssoTrkID 0;
BA_ "GenSigSendType" SG_ 102 ReSideRdrLeDetn95RdrDetnAzi 0;
BA_ "GenSigStartValue" SG_ 102 ReSideRdrLeDetn95RdrDetnAzi 900;
BA_ "GenSigDataID" SG_ 102 ReSideRdrLeDetn95RdrDetnChks "0x9F0";
BA_ "GenSigFuncType" SG_ 102 ReSideRdrLeDetn95RdrDetnChks 15;
BA_ "GenSigSendType" SG_ 102 ReSideRdrLeDetn95RdrDetnChks 0;
BA_ "GenSigFuncType" SG_ 102 ReSideRdrLeDetn95RdrDetnCntr 16;
BA_ "GenSigSendType" SG_ 102 ReSideRdrLeDetn95RdrDetnCntr 0;
BA_ "GenSigSendType" SG_ 102 ReSideRdrLeDetn95RdrDetnConf 0;
BA_ "GenSigSendType" SG_ 102 ReSideRdrLeDetn95RdrDetnElevn 0;
BA_ "GenSigStartValue" SG_ 102 ReSideRdrLeDetn95RdrDetnElevn 15;
BA_ "GenSigSendType" SG_ 102 ReSideRdrLeDetn95RdrDetnPwr 0;
BA_ "GenSigSendType" SG_ 102 ReSideRdrLeDetn95RdrDetnRng 0;
BA_ "GenSigStartValue" SG_ 102 ReSideRdrLeDetn95RdrDetnRng 10050;
BA_ "GenSigSendType" SG_ 102 ReSideRdrLeDetn95RdrDetnRngV 0;
BA_ "GenSigStartValue" SG_ 102 ReSideRdrLeDetn95RdrDetnRngV 4000;
BA_ "GenSigSendType" SG_ 102 ReSideRdrLeDetn95RdrDetnSameRV 0;
BA_ "GenSigSendType" SG_ 102 ReSideRdrLeDetn95RdrDetnSts 0;
BA_ "GenSigStartValue" SG_ 102 ReSideRdrLeDetn95RdrDetnSts 3;
BA_ "GenSigSendType" SG_ 102 ReSideRdrLeDetn96RdrDetnAmbigState 0;
BA_ "GenSigSendType" SG_ 102 ReSideRdrLeDetn96RdrDetnAssoTrkID 0;
BA_ "GenSigSendType" SG_ 102 ReSideRdrLeDetn96RdrDetnAzi 0;
BA_ "GenSigStartValue" SG_ 102 ReSideRdrLeDetn96RdrDetnAzi 900;
BA_ "GenSigDataID" SG_ 102 ReSideRdrLeDetn96RdrDetnChks "0x9F1";
BA_ "GenSigFuncType" SG_ 102 ReSideRdrLeDetn96RdrDetnChks 15;
BA_ "GenSigSendType" SG_ 102 ReSideRdrLeDetn96RdrDetnChks 0;
BA_ "GenSigFuncType" SG_ 102 ReSideRdrLeDetn96RdrDetnCntr 16;
BA_ "GenSigSendType" SG_ 102 ReSideRdrLeDetn96RdrDetnCntr 0;
BA_ "GenSigSendType" SG_ 102 ReSideRdrLeDetn96RdrDetnConf 0;
BA_ "GenSigSendType" SG_ 102 ReSideRdrLeDetn96RdrDetnElevn 0;
BA_ "GenSigStartValue" SG_ 102 ReSideRdrLeDetn96RdrDetnElevn 15;
BA_ "GenSigSendType" SG_ 102 ReSideRdrLeDetn96RdrDetnPwr 0;
BA_ "GenSigSendType" SG_ 102 ReSideRdrLeDetn96RdrDetnRng 0;
BA_ "GenSigStartValue" SG_ 102 ReSideRdrLeDetn96RdrDetnRng 10050;
BA_ "GenSigSendType" SG_ 102 ReSideRdrLeDetn96RdrDetnRngV 0;
BA_ "GenSigStartValue" SG_ 102 ReSideRdrLeDetn96RdrDetnRngV 4000;
BA_ "GenSigSendType" SG_ 102 ReSideRdrLeDetn96RdrDetnSameRV 0;
BA_ "GenSigSendType" SG_ 102 ReSideRdrLeDetn96RdrDetnSts 0;
BA_ "GenSigStartValue" SG_ 102 ReSideRdrLeDetn96RdrDetnSts 3;
BA_ "GenSigSendType" SG_ 103 ReSideRdrLeDetn97RdrDetnAmbigState 0;
BA_ "GenSigSendType" SG_ 103 ReSideRdrLeDetn97RdrDetnAssoTrkID 0;
BA_ "GenSigSendType" SG_ 103 ReSideRdrLeDetn97RdrDetnAzi 0;
BA_ "GenSigStartValue" SG_ 103 ReSideRdrLeDetn97RdrDetnAzi 900;
BA_ "GenSigDataID" SG_ 103 ReSideRdrLeDetn97RdrDetnChks "0x9F2";
BA_ "GenSigFuncType" SG_ 103 ReSideRdrLeDetn97RdrDetnChks 15;
BA_ "GenSigSendType" SG_ 103 ReSideRdrLeDetn97RdrDetnChks 0;
BA_ "GenSigFuncType" SG_ 103 ReSideRdrLeDetn97RdrDetnCntr 16;
BA_ "GenSigSendType" SG_ 103 ReSideRdrLeDetn97RdrDetnCntr 0;
BA_ "GenSigSendType" SG_ 103 ReSideRdrLeDetn97RdrDetnConf 0;
BA_ "GenSigSendType" SG_ 103 ReSideRdrLeDetn97RdrDetnElevn 0;
BA_ "GenSigStartValue" SG_ 103 ReSideRdrLeDetn97RdrDetnElevn 15;
BA_ "GenSigSendType" SG_ 103 ReSideRdrLeDetn97RdrDetnPwr 0;
BA_ "GenSigSendType" SG_ 103 ReSideRdrLeDetn97RdrDetnRng 0;
BA_ "GenSigStartValue" SG_ 103 ReSideRdrLeDetn97RdrDetnRng 10050;
BA_ "GenSigSendType" SG_ 103 ReSideRdrLeDetn97RdrDetnRngV 0;
BA_ "GenSigStartValue" SG_ 103 ReSideRdrLeDetn97RdrDetnRngV 4000;
BA_ "GenSigSendType" SG_ 103 ReSideRdrLeDetn97RdrDetnSameRV 0;
BA_ "GenSigSendType" SG_ 103 ReSideRdrLeDetn97RdrDetnSts 0;
BA_ "GenSigStartValue" SG_ 103 ReSideRdrLeDetn97RdrDetnSts 3;
BA_ "GenSigSendType" SG_ 103 ReSideRdrLeDetn98RdrDetnAmbigState 0;
BA_ "GenSigSendType" SG_ 103 ReSideRdrLeDetn98RdrDetnAssoTrkID 0;
BA_ "GenSigSendType" SG_ 103 ReSideRdrLeDetn98RdrDetnAzi 0;
BA_ "GenSigStartValue" SG_ 103 ReSideRdrLeDetn98RdrDetnAzi 900;
BA_ "GenSigDataID" SG_ 103 ReSideRdrLeDetn98RdrDetnChks "0x9F3";
BA_ "GenSigFuncType" SG_ 103 ReSideRdrLeDetn98RdrDetnChks 15;
BA_ "GenSigSendType" SG_ 103 ReSideRdrLeDetn98RdrDetnChks 0;
BA_ "GenSigFuncType" SG_ 103 ReSideRdrLeDetn98RdrDetnCntr 16;
BA_ "GenSigSendType" SG_ 103 ReSideRdrLeDetn98RdrDetnCntr 0;
BA_ "GenSigSendType" SG_ 103 ReSideRdrLeDetn98RdrDetnConf 0;
BA_ "GenSigSendType" SG_ 103 ReSideRdrLeDetn98RdrDetnElevn 0;
BA_ "GenSigStartValue" SG_ 103 ReSideRdrLeDetn98RdrDetnElevn 15;
BA_ "GenSigSendType" SG_ 103 ReSideRdrLeDetn98RdrDetnPwr 0;
BA_ "GenSigSendType" SG_ 103 ReSideRdrLeDetn98RdrDetnRng 0;
BA_ "GenSigStartValue" SG_ 103 ReSideRdrLeDetn98RdrDetnRng 10050;
BA_ "GenSigSendType" SG_ 103 ReSideRdrLeDetn98RdrDetnRngV 0;
BA_ "GenSigStartValue" SG_ 103 ReSideRdrLeDetn98RdrDetnRngV 4000;
BA_ "GenSigSendType" SG_ 103 ReSideRdrLeDetn98RdrDetnSameRV 0;
BA_ "GenSigSendType" SG_ 103 ReSideRdrLeDetn98RdrDetnSts 0;
BA_ "GenSigStartValue" SG_ 103 ReSideRdrLeDetn98RdrDetnSts 3;
BA_ "GenSigSendType" SG_ 103 ReSideRdrLeDetn99RdrDetnAmbigState 0;
BA_ "GenSigSendType" SG_ 103 ReSideRdrLeDetn99RdrDetnAssoTrkID 0;
BA_ "GenSigSendType" SG_ 103 ReSideRdrLeDetn99RdrDetnAzi 0;
BA_ "GenSigStartValue" SG_ 103 ReSideRdrLeDetn99RdrDetnAzi 900;
BA_ "GenSigDataID" SG_ 103 ReSideRdrLeDetn99RdrDetnChks "0x9F4";
BA_ "GenSigFuncType" SG_ 103 ReSideRdrLeDetn99RdrDetnChks 15;
BA_ "GenSigSendType" SG_ 103 ReSideRdrLeDetn99RdrDetnChks 0;
BA_ "GenSigFuncType" SG_ 103 ReSideRdrLeDetn99RdrDetnCntr 16;
BA_ "GenSigSendType" SG_ 103 ReSideRdrLeDetn99RdrDetnCntr 0;
BA_ "GenSigSendType" SG_ 103 ReSideRdrLeDetn99RdrDetnConf 0;
BA_ "GenSigSendType" SG_ 103 ReSideRdrLeDetn99RdrDetnElevn 0;
BA_ "GenSigStartValue" SG_ 103 ReSideRdrLeDetn99RdrDetnElevn 15;
BA_ "GenSigSendType" SG_ 103 ReSideRdrLeDetn99RdrDetnPwr 0;
BA_ "GenSigSendType" SG_ 103 ReSideRdrLeDetn99RdrDetnRng 0;
BA_ "GenSigStartValue" SG_ 103 ReSideRdrLeDetn99RdrDetnRng 10050;
BA_ "GenSigSendType" SG_ 103 ReSideRdrLeDetn99RdrDetnRngV 0;
BA_ "GenSigStartValue" SG_ 103 ReSideRdrLeDetn99RdrDetnRngV 4000;
BA_ "GenSigSendType" SG_ 103 ReSideRdrLeDetn99RdrDetnSameRV 0;
BA_ "GenSigSendType" SG_ 103 ReSideRdrLeDetn99RdrDetnSts 0;
BA_ "GenSigStartValue" SG_ 103 ReSideRdrLeDetn99RdrDetnSts 3;
VAL_ 100 ReSideRdrLeDetn79RdrDetnAmbigState 0 "YesNo1_Yes" 1 "YesNo1_No";
VAL_ 100 ReSideRdrLeDetn79RdrDetnSameRV 0 "Mode6_0" 1 "Mode6_1" 2 "Mode6_2";
VAL_ 100 ReSideRdrLeDetn79RdrDetnSts 0 "RdrDetnSts_Ukwn" 1 "RdrDetnSts_Movg" 2 "RdrDetnSts_Staty" 3 "RdrDetnSts_Invalid";
VAL_ 100 ReSideRdrLeDetn80RdrDetnAmbigState 0 "YesNo1_Yes" 1 "YesNo1_No";
VAL_ 100 ReSideRdrLeDetn80RdrDetnSameRV 0 "Mode6_0" 1 "Mode6_1" 2 "Mode6_2";
VAL_ 100 ReSideRdrLeDetn80RdrDetnSts 0 "RdrDetnSts_Ukwn" 1 "RdrDetnSts_Movg" 2 "RdrDetnSts_Staty" 3 "RdrDetnSts_Invalid";
VAL_ 100 ReSideRdrLeDetn81RdrDetnAmbigState 0 "YesNo1_Yes" 1 "YesNo1_No";
VAL_ 100 ReSideRdrLeDetn81RdrDetnSameRV 0 "Mode6_0" 1 "Mode6_1" 2 "Mode6_2";
VAL_ 100 ReSideRdrLeDetn81RdrDetnSts 0 "RdrDetnSts_Ukwn" 1 "RdrDetnSts_Movg" 2 "RdrDetnSts_Staty" 3 "RdrDetnSts_Invalid";
VAL_ 100 ReSideRdrLeDetn82RdrDetnAmbigState 0 "YesNo1_Yes" 1 "YesNo1_No";
VAL_ 100 ReSideRdrLeDetn82RdrDetnSameRV 0 "Mode6_0" 1 "Mode6_1" 2 "Mode6_2";
VAL_ 100 ReSideRdrLeDetn82RdrDetnSts 0 "RdrDetnSts_Ukwn" 1 "RdrDetnSts_Movg" 2 "RdrDetnSts_Staty" 3 "RdrDetnSts_Invalid";
VAL_ 100 ReSideRdrLeDetn83RdrDetnAmbigState 0 "YesNo1_Yes" 1 "YesNo1_No";
VAL_ 100 ReSideRdrLeDetn83RdrDetnSameRV 0 "Mode6_0" 1 "Mode6_1" 2 "Mode6_2";
VAL_ 100 ReSideRdrLeDetn83RdrDetnSts 0 "RdrDetnSts_Ukwn" 1 "RdrDetnSts_Movg" 2 "RdrDetnSts_Staty" 3 "RdrDetnSts_Invalid";
VAL_ 100 ReSideRdrLeDetn84RdrDetnAmbigState 0 "YesNo1_Yes" 1 "YesNo1_No";
VAL_ 100 ReSideRdrLeDetn84RdrDetnSameRV 0 "Mode6_0" 1 "Mode6_1" 2 "Mode6_2";
VAL_ 100 ReSideRdrLeDetn84RdrDetnSts 0 "RdrDetnSts_Ukwn" 1 "RdrDetnSts_Movg" 2 "RdrDetnSts_Staty" 3 "RdrDetnSts_Invalid";
VAL_ 101 ReSideRdrLeDetn85RdrDetnAmbigState 0 "YesNo1_Yes" 1 "YesNo1_No";
VAL_ 101 ReSideRdrLeDetn85RdrDetnSameRV 0 "Mode6_0" 1 "Mode6_1" 2 "Mode6_2";
VAL_ 101 ReSideRdrLeDetn85RdrDetnSts 0 "RdrDetnSts_Ukwn" 1 "RdrDetnSts_Movg" 2 "RdrDetnSts_Staty" 3 "RdrDetnSts_Invalid";
VAL_ 101 ReSideRdrLeDetn86RdrDetnAmbigState 0 "YesNo1_Yes" 1 "YesNo1_No";
VAL_ 101 ReSideRdrLeDetn86RdrDetnSameRV 0 "Mode6_0" 1 "Mode6_1" 2 "Mode6_2";
VAL_ 101 ReSideRdrLeDetn86RdrDetnSts 0 "RdrDetnSts_Ukwn" 1 "RdrDetnSts_Movg" 2 "RdrDetnSts_Staty" 3 "RdrDetnSts_Invalid";
VAL_ 101 ReSideRdrLeDetn87RdrDetnAmbigState 0 "YesNo1_Yes" 1 "YesNo1_No";
VAL_ 101 ReSideRdrLeDetn87RdrDetnSameRV 0 "Mode6_0" 1 "Mode6_1" 2 "Mode6_2";
VAL_ 101 ReSideRdrLeDetn87RdrDetnSts 0 "RdrDetnSts_Ukwn" 1 "RdrDetnSts_Movg" 2 "RdrDetnSts_Staty" 3 "RdrDetnSts_Invalid";
VAL_ 101 ReSideRdrLeDetn88RdrDetnAmbigState 0 "YesNo1_Yes" 1 "YesNo1_No";
VAL_ 101 ReSideRdrLeDetn88RdrDetnSameRV 0 "Mode6_0" 1 "Mode6_1" 2 "Mode6_2";
VAL_ 101 ReSideRdrLeDetn88RdrDetnSts 0 "RdrDetnSts_Ukwn" 1 "RdrDetnSts_Movg" 2 "RdrDetnSts_Staty" 3 "RdrDetnSts_Invalid";
VAL_ 101 ReSideRdrLeDetn89RdrDetnAmbigState 0 "YesNo1_Yes" 1 "YesNo1_No";
VAL_ 101 ReSideRdrLeDetn89RdrDetnSameRV 0 "Mode6_0" 1 "Mode6_1" 2 "Mode6_2";
VAL_ 101 ReSideRdrLeDetn89RdrDetnSts 0 "RdrDetnSts_Ukwn" 1 "RdrDetnSts_Movg" 2 "RdrDetnSts_Staty" 3 "RdrDetnSts_Invalid";
VAL_ 101 ReSideRdrLeDetn90RdrDetnAmbigState 0 "YesNo1_Yes" 1 "YesNo1_No";
VAL_ 101 ReSideRdrLeDetn90RdrDetnSameRV 0 "Mode6_0" 1 "Mode6_1" 2 "Mode6_2";
VAL_ 101 ReSideRdrLeDetn90RdrDetnSts 0 "RdrDetnSts_Ukwn" 1 "RdrDetnSts_Movg" 2 "RdrDetnSts_Staty" 3 "RdrDetnSts_Invalid";
VAL_ 102 ReSideRdrLeDetn91RdrDetnAmbigState 0 "YesNo1_Yes" 1 "YesNo1_No";
VAL_ 102 ReSideRdrLeDetn91RdrDetnSameRV 0 "Mode6_0" 1 "Mode6_1" 2 "Mode6_2";
VAL_ 102 ReSideRdrLeDetn91RdrDetnSts 0 "RdrDetnSts_Ukwn" 1 "RdrDetnSts_Movg" 2 "RdrDetnSts_Staty" 3 "RdrDetnSts_Invalid";
VAL_ 102 ReSideRdrLeDetn92RdrDetnAmbigState 0 "YesNo1_Yes" 1 "YesNo1_No";
VAL_ 102 ReSideRdrLeDetn92RdrDetnSameRV 0 "Mode6_0" 1 "Mode6_1" 2 "Mode6_2";
VAL_ 102 ReSideRdrLeDetn92RdrDetnSts 0 "RdrDetnSts_Ukwn" 1 "RdrDetnSts_Movg" 2 "RdrDetnSts_Staty" 3 "RdrDetnSts_Invalid";
VAL_ 102 ReSideRdrLeDetn93RdrDetnAmbigState 0 "YesNo1_Yes" 1 "YesNo1_No";
VAL_ 102 ReSideRdrLeDetn93RdrDetnSameRV 0 "Mode6_0" 1 "Mode6_1" 2 "Mode6_2";
VAL_ 102 ReSideRdrLeDetn93RdrDetnSts 0 "RdrDetnSts_Ukwn" 1 "RdrDetnSts_Movg" 2 "RdrDetnSts_Staty" 3 "RdrDetnSts_Invalid";
VAL_ 102 ReSideRdrLeDetn94RdrDetnAmbigState 0 "YesNo1_Yes" 1 "YesNo1_No";
VAL_ 102 ReSideRdrLeDetn94RdrDetnSameRV 0 "Mode6_0" 1 "Mode6_1" 2 "Mode6_2";
VAL_ 102 ReSideRdrLeDetn94RdrDetnSts 0 "RdrDetnSts_Ukwn" 1 "RdrDetnSts_Movg" 2 "RdrDetnSts_Staty" 3 "RdrDetnSts_Invalid";
VAL_ 102 ReSideRdrLeDetn95RdrDetnAmbigState 0 "YesNo1_Yes" 1 "YesNo1_No";
VAL_ 102 ReSideRdrLeDetn95RdrDetnSameRV 0 "Mode6_0" 1 "Mode6_1" 2 "Mode6_2";
VAL_ 102 ReSideRdrLeDetn95RdrDetnSts 0 "RdrDetnSts_Ukwn" 1 "RdrDetnSts_Movg" 2 "RdrDetnSts_Staty" 3 "RdrDetnSts_Invalid";
VAL_ 102 ReSideRdrLeDetn96RdrDetnAmbigState 0 "YesNo1_Yes" 1 "YesNo1_No";
VAL_ 102 ReSideRdrLeDetn96RdrDetnSameRV 0 "Mode6_0" 1 "Mode6_1" 2 "Mode6_2";
VAL_ 102 ReSideRdrLeDetn96RdrDetnSts 0 "RdrDetnSts_Ukwn" 1 "RdrDetnSts_Movg" 2 "RdrDetnSts_Staty" 3 "RdrDetnSts_Invalid";
VAL_ 103 ReSideRdrLeDetn100RdrDetnAmbigState 0 "YesNo1_Yes" 1 "YesNo1_No";
VAL_ 103 ReSideRdrLeDetn100RdrDetnSameRV 0 "Mode6_0" 1 "Mode6_1" 2 "Mode6_2";
VAL_ 103 ReSideRdrLeDetn100RdrDetnSts 0 "RdrDetnSts_Ukwn" 1 "RdrDetnSts_Movg" 2 "RdrDetnSts_Staty" 3 "RdrDetnSts_Invalid";
VAL_ 103 ReSideRdrLeDetn101RdrDetnAmbigState 0 "YesNo1_Yes" 1 "YesNo1_No";
VAL_ 103 ReSideRdrLeDetn101RdrDetnSameRV 0 "Mode6_0" 1 "Mode6_1" 2 "Mode6_2";
VAL_ 103 ReSideRdrLeDetn101RdrDetnSts 0 "RdrDetnSts_Ukwn" 1 "RdrDetnSts_Movg" 2 "RdrDetnSts_Staty" 3 "RdrDetnSts_Invalid";
VAL_ 103 ReSideRdrLeDetn102RdrDetnAmbigState 0 "YesNo1_Yes" 1 "YesNo1_No";
VAL_ 103 ReSideRdrLeDetn102RdrDetnSameRV 0 "Mode6_0" 1 "Mode6_1" 2 "Mode6_2";
VAL_ 103 ReSideRdrLeDetn102RdrDetnSts 0 "RdrDetnSts_Ukwn" 1 "RdrDetnSts_Movg" 2 "RdrDetnSts_Staty" 3 "RdrDetnSts_Invalid";
VAL_ 103 ReSideRdrLeDetn97RdrDetnAmbigState 0 "YesNo1_Yes" 1 "YesNo1_No";
VAL_ 103 ReSideRdrLeDetn97RdrDetnSameRV 0 "Mode6_0" 1 "Mode6_1" 2 "Mode6_2";
VAL_ 103 ReSideRdrLeDetn97RdrDetnSts 0 "RdrDetnSts_Ukwn" 1 "RdrDetnSts_Movg" 2 "RdrDetnSts_Staty" 3 "RdrDetnSts_Invalid";
VAL_ 103 ReSideRdrLeDetn98RdrDetnAmbigState 0 "YesNo1_Yes" 1 "YesNo1_No";
VAL_ 103 ReSideRdrLeDetn98RdrDetnSameRV 0 "Mode6_0" 1 "Mode6_1" 2 "Mode6_2";
VAL_ 103 ReSideRdrLeDetn98RdrDetnSts 0 "RdrDetnSts_Ukwn" 1 "RdrDetnSts_Movg" 2 "RdrDetnSts_Staty" 3 "RdrDetnSts_Invalid";
VAL_ 103 ReSideRdrLeDetn99RdrDetnAmbigState 0 "YesNo1_Yes" 1 "YesNo1_No";
VAL_ 103 ReSideRdrLeDetn99RdrDetnSameRV 0 "Mode6_0" 1 "Mode6_1" 2 "Mode6_2";
VAL_ 103 ReSideRdrLeDetn99RdrDetnSts 0 "RdrDetnSts_Ukwn" 1 "RdrDetnSts_Movg" 2 "RdrDetnSts_Staty" 3 "RdrDetnSts_Invalid";
VAL_ 104 ReSideRdrLeDetn103RdrDetnAmbigState 0 "YesNo1_Yes" 1 "YesNo1_No";
VAL_ 104 ReSideRdrLeDetn103RdrDetnSameRV 0 "Mode6_0" 1 "Mode6_1" 2 "Mode6_2";
VAL_ 104 ReSideRdrLeDetn103RdrDetnSts 0 "RdrDetnSts_Ukwn" 1 "RdrDetnSts_Movg" 2 "RdrDetnSts_Staty" 3 "RdrDetnSts_Invalid";
VAL_ 104 ReSideRdrLeDetn104RdrDetnAmbigState 0 "YesNo1_Yes" 1 "YesNo1_No";
VAL_ 104 ReSideRdrLeDetn104RdrDetnSameRV 0 "Mode6_0" 1 "Mode6_1" 2 "Mode6_2";
VAL_ 104 ReSideRdrLeDetn104RdrDetnSts 0 "RdrDetnSts_Ukwn" 1 "RdrDetnSts_Movg" 2 "RdrDetnSts_Staty" 3 "RdrDetnSts_Invalid";
VAL_ 104 ReSideRdrLeDetn105RdrDetnAmbigState 0 "YesNo1_Yes" 1 "YesNo1_No";
VAL_ 104 ReSideRdrLeDetn105RdrDetnSameRV 0 "Mode6_0" 1 "Mode6_1" 2 "Mode6_2";
VAL_ 104 ReSideRdrLeDetn105RdrDetnSts 0 "RdrDetnSts_Ukwn" 1 "RdrDetnSts_Movg" 2 "RdrDetnSts_Staty" 3 "RdrDetnSts_Invalid";
VAL_ 104 ReSideRdrLeDetn106RdrDetnAmbigState 0 "YesNo1_Yes" 1 "YesNo1_No";
VAL_ 104 ReSideRdrLeDetn106RdrDetnSameRV 0 "Mode6_0" 1 "Mode6_1" 2 "Mode6_2";
VAL_ 104 ReSideRdrLeDetn106RdrDetnSts 0 "RdrDetnSts_Ukwn" 1 "RdrDetnSts_Movg" 2 "RdrDetnSts_Staty" 3 "RdrDetnSts_Invalid";
VAL_ 104 ReSideRdrLeDetn107RdrDetnAmbigState 0 "YesNo1_Yes" 1 "YesNo1_No";
VAL_ 104 ReSideRdrLeDetn107RdrDetnSameRV 0 "Mode6_0" 1 "Mode6_1" 2 "Mode6_2";
VAL_ 104 ReSideRdrLeDetn107RdrDetnSts 0 "RdrDetnSts_Ukwn" 1 "RdrDetnSts_Movg" 2 "RdrDetnSts_Staty" 3 "RdrDetnSts_Invalid";
VAL_ 104 ReSideRdrLeDetn108RdrDetnAmbigState 0 "YesNo1_Yes" 1 "YesNo1_No";
VAL_ 104 ReSideRdrLeDetn108RdrDetnSameRV 0 "Mode6_0" 1 "Mode6_1" 2 "Mode6_2";
VAL_ 104 ReSideRdrLeDetn108RdrDetnSts 0 "RdrDetnSts_Ukwn" 1 "RdrDetnSts_Movg" 2 "RdrDetnSts_Staty" 3 "RdrDetnSts_Invalid";
VAL_ 105 ReSideRdrLeDetn109RdrDetnAmbigState 0 "YesNo1_Yes" 1 "YesNo1_No";
VAL_ 105 ReSideRdrLeDetn109RdrDetnSameRV 0 "Mode6_0" 1 "Mode6_1" 2 "Mode6_2";
VAL_ 105 ReSideRdrLeDetn109RdrDetnSts 0 "RdrDetnSts_Ukwn" 1 "RdrDetnSts_Movg" 2 "RdrDetnSts_Staty" 3 "RdrDetnSts_Invalid";
VAL_ 105 ReSideRdrLeDetn110RdrDetnAmbigState 0 "YesNo1_Yes" 1 "YesNo1_No";
VAL_ 105 ReSideRdrLeDetn110RdrDetnSameRV 0 "Mode6_0" 1 "Mode6_1" 2 "Mode6_2";
VAL_ 105 ReSideRdrLeDetn110RdrDetnSts 0 "RdrDetnSts_Ukwn" 1 "RdrDetnSts_Movg" 2 "RdrDetnSts_Staty" 3 "RdrDetnSts_Invalid";
VAL_ 105 ReSideRdrLeDetn111RdrDetnAmbigState 0 "YesNo1_Yes" 1 "YesNo1_No";
VAL_ 105 ReSideRdrLeDetn111RdrDetnSameRV 0 "Mode6_0" 1 "Mode6_1" 2 "Mode6_2";
VAL_ 105 ReSideRdrLeDetn111RdrDetnSts 0 "RdrDetnSts_Ukwn" 1 "RdrDetnSts_Movg" 2 "RdrDetnSts_Staty" 3 "RdrDetnSts_Invalid";
VAL_ 105 ReSideRdrLeDetn112RdrDetnAmbigState 0 "YesNo1_Yes" 1 "YesNo1_No";
VAL_ 105 ReSideRdrLeDetn112RdrDetnSameRV 0 "Mode6_0" 1 "Mode6_1" 2 "Mode6_2";
VAL_ 105 ReSideRdrLeDetn112RdrDetnSts 0 "RdrDetnSts_Ukwn" 1 "RdrDetnSts_Movg" 2 "RdrDetnSts_Staty" 3 "RdrDetnSts_Invalid";
VAL_ 105 ReSideRdrLeDetn113RdrDetnAmbigState 0 "YesNo1_Yes" 1 "YesNo1_No";
VAL_ 105 ReSideRdrLeDetn113RdrDetnSameRV 0 "Mode6_0" 1 "Mode6_1" 2 "Mode6_2";
VAL_ 105 ReSideRdrLeDetn113RdrDetnSts 0 "RdrDetnSts_Ukwn" 1 "RdrDetnSts_Movg" 2 "RdrDetnSts_Staty" 3 "RdrDetnSts_Invalid";
VAL_ 105 ReSideRdrLeDetn114RdrDetnAmbigState 0 "YesNo1_Yes" 1 "YesNo1_No";
VAL_ 105 ReSideRdrLeDetn114RdrDetnSameRV 0 "Mode6_0" 1 "Mode6_1" 2 "Mode6_2";
VAL_ 105 ReSideRdrLeDetn114RdrDetnSts 0 "RdrDetnSts_Ukwn" 1 "RdrDetnSts_Movg" 2 "RdrDetnSts_Staty" 3 "RdrDetnSts_Invalid";
VAL_ 112 ReSideRdrLeDetn115RdrDetnAmbigState 0 "YesNo1_Yes" 1 "YesNo1_No";
VAL_ 112 ReSideRdrLeDetn115RdrDetnSameRV 0 "Mode6_0" 1 "Mode6_1" 2 "Mode6_2";
VAL_ 112 ReSideRdrLeDetn115RdrDetnSts 0 "RdrDetnSts_Ukwn" 1 "RdrDetnSts_Movg" 2 "RdrDetnSts_Staty" 3 "RdrDetnSts_Invalid";
VAL_ 112 ReSideRdrLeDetn116RdrDetnAmbigState 0 "YesNo1_Yes" 1 "YesNo1_No";
VAL_ 112 ReSideRdrLeDetn116RdrDetnSameRV 0 "Mode6_0" 1 "Mode6_1" 2 "Mode6_2";
VAL_ 112 ReSideRdrLeDetn116RdrDetnSts 0 "RdrDetnSts_Ukwn" 1 "RdrDetnSts_Movg" 2 "RdrDetnSts_Staty" 3 "RdrDetnSts_Invalid";
VAL_ 112 ReSideRdrLeDetn117RdrDetnAmbigState 0 "YesNo1_Yes" 1 "YesNo1_No";
VAL_ 112 ReSideRdrLeDetn117RdrDetnSameRV 0 "Mode6_0" 1 "Mode6_1" 2 "Mode6_2";
VAL_ 112 ReSideRdrLeDetn117RdrDetnSts 0 "RdrDetnSts_Ukwn" 1 "RdrDetnSts_Movg" 2 "RdrDetnSts_Staty" 3 "RdrDetnSts_Invalid";
VAL_ 112 ReSideRdrLeDetn118RdrDetnAmbigState 0 "YesNo1_Yes" 1 "YesNo1_No";
VAL_ 112 ReSideRdrLeDetn118RdrDetnSameRV 0 "Mode6_0" 1 "Mode6_1" 2 "Mode6_2";
VAL_ 112 ReSideRdrLeDetn118RdrDetnSts 0 "RdrDetnSts_Ukwn" 1 "RdrDetnSts_Movg" 2 "RdrDetnSts_Staty" 3 "RdrDetnSts_Invalid";
VAL_ 112 ReSideRdrLeDetn119RdrDetnAmbigState 0 "YesNo1_Yes" 1 "YesNo1_No";
VAL_ 112 ReSideRdrLeDetn119RdrDetnSameRV 0 "Mode6_0" 1 "Mode6_1" 2 "Mode6_2";
VAL_ 112 ReSideRdrLeDetn119RdrDetnSts 0 "RdrDetnSts_Ukwn" 1 "RdrDetnSts_Movg" 2 "RdrDetnSts_Staty" 3 "RdrDetnSts_Invalid";
VAL_ 112 ReSideRdrLeDetn120RdrDetnAmbigState 0 "YesNo1_Yes" 1 "YesNo1_No";
VAL_ 112 ReSideRdrLeDetn120RdrDetnSameRV 0 "Mode6_0" 1 "Mode6_1" 2 "Mode6_2";
VAL_ 112 ReSideRdrLeDetn120RdrDetnSts 0 "RdrDetnSts_Ukwn" 1 "RdrDetnSts_Movg" 2 "RdrDetnSts_Staty" 3 "RdrDetnSts_Invalid";
SIG_GROUP_ 103 ReSideRdrLeDetn100 1 : ReSideRdrLeDetn100RdrDetnAmbigState ReSideRdrLeDetn100RdrDetnAssoTrkID ReSideRdrLeDetn100RdrDetnAzi ReSideRdrLeDetn100RdrDetnChks ReSideRdrLeDetn100RdrDetnCntr ReSideRdrLeDetn100RdrDetnConf ReSideRdrLeDetn100RdrDetnElevn ReSideRdrLeDetn100RdrDetnPwr ReSideRdrLeDetn100RdrDetnRng ReSideRdrLeDetn100RdrDetnRngV ReSideRdrLeDetn100RdrDetnSameRV ReSideRdrLeDetn100RdrDetnSts;
SIG_GROUP_ 103 ReSideRdrLeDetn101 1 : ReSideRdrLeDetn101RdrDetnAmbigState ReSideRdrLeDetn101RdrDetnAssoTrkID ReSideRdrLeDetn101RdrDetnAzi ReSideRdrLeDetn101RdrDetnChks ReSideRdrLeDetn101RdrDetnCntr ReSideRdrLeDetn101RdrDetnConf ReSideRdrLeDetn101RdrDetnElevn ReSideRdrLeDetn101RdrDetnPwr ReSideRdrLeDetn101RdrDetnRng ReSideRdrLeDetn101RdrDetnRngV ReSideRdrLeDetn101RdrDetnSameRV ReSideRdrLeDetn101RdrDetnSts;
SIG_GROUP_ 103 ReSideRdrLeDetn102 1 : ReSideRdrLeDetn102RdrDetnAmbigState ReSideRdrLeDetn102RdrDetnAssoTrkID ReSideRdrLeDetn102RdrDetnAzi ReSideRdrLeDetn102RdrDetnChks ReSideRdrLeDetn102RdrDetnCntr ReSideRdrLeDetn102RdrDetnConf ReSideRdrLeDetn102RdrDetnElevn ReSideRdrLeDetn102RdrDetnPwr ReSideRdrLeDetn102RdrDetnRng ReSideRdrLeDetn102RdrDetnRngV ReSideRdrLeDetn102RdrDetnSameRV ReSideRdrLeDetn102RdrDetnSts;
SIG_GROUP_ 104 ReSideRdrLeDetn103 1 : ReSideRdrLeDetn103RdrDetnAmbigState ReSideRdrLeDetn103RdrDetnAssoTrkID ReSideRdrLeDetn103RdrDetnAzi ReSideRdrLeDetn103RdrDetnChks ReSideRdrLeDetn103RdrDetnCntr ReSideRdrLeDetn103RdrDetnConf ReSideRdrLeDetn103RdrDetnElevn ReSideRdrLeDetn103RdrDetnPwr ReSideRdrLeDetn103RdrDetnRng ReSideRdrLeDetn103RdrDetnRngV ReSideRdrLeDetn103RdrDetnSameRV ReSideRdrLeDetn103RdrDetnSts;
SIG_GROUP_ 104 ReSideRdrLeDetn104 1 : ReSideRdrLeDetn104RdrDetnAmbigState ReSideRdrLeDetn104RdrDetnAssoTrkID ReSideRdrLeDetn104RdrDetnAzi ReSideRdrLeDetn104RdrDetnChks ReSideRdrLeDetn104RdrDetnCntr ReSideRdrLeDetn104RdrDetnConf ReSideRdrLeDetn104RdrDetnElevn ReSideRdrLeDetn104RdrDetnPwr ReSideRdrLeDetn104RdrDetnRng ReSideRdrLeDetn104RdrDetnRngV ReSideRdrLeDetn104RdrDetnSameRV ReSideRdrLeDetn104RdrDetnSts;
SIG_GROUP_ 104 ReSideRdrLeDetn105 1 : ReSideRdrLeDetn105RdrDetnAmbigState ReSideRdrLeDetn105RdrDetnAssoTrkID ReSideRdrLeDetn105RdrDetnAzi ReSideRdrLeDetn105RdrDetnChks ReSideRdrLeDetn105RdrDetnCntr ReSideRdrLeDetn105RdrDetnConf ReSideRdrLeDetn105RdrDetnElevn ReSideRdrLeDetn105RdrDetnPwr ReSideRdrLeDetn105RdrDetnRng ReSideRdrLeDetn105RdrDetnRngV ReSideRdrLeDetn105RdrDetnSameRV ReSideRdrLeDetn105RdrDetnSts;
SIG_GROUP_ 104 ReSideRdrLeDetn106 1 : ReSideRdrLeDetn106RdrDetnAmbigState ReSideRdrLeDetn106RdrDetnAssoTrkID ReSideRdrLeDetn106RdrDetnAzi ReSideRdrLeDetn106RdrDetnChks ReSideRdrLeDetn106RdrDetnCntr ReSideRdrLeDetn106RdrDetnConf ReSideRdrLeDetn106RdrDetnElevn ReSideRdrLeDetn106RdrDetnPwr ReSideRdrLeDetn106RdrDetnRng ReSideRdrLeDetn106RdrDetnRngV ReSideRdrLeDetn106RdrDetnSameRV ReSideRdrLeDetn106RdrDetnSts;
SIG_GROUP_ 104 ReSideRdrLeDetn107 1 : ReSideRdrLeDetn107RdrDetnAmbigState ReSideRdrLeDetn107RdrDetnAssoTrkID ReSideRdrLeDetn107RdrDetnAzi ReSideRdrLeDetn107RdrDetnChks ReSideRdrLeDetn107RdrDetnCntr ReSideRdrLeDetn107RdrDetnConf ReSideRdrLeDetn107RdrDetnElevn ReSideRdrLeDetn107RdrDetnPwr ReSideRdrLeDetn107RdrDetnRng ReSideRdrLeDetn107RdrDetnRngV ReSideRdrLeDetn107RdrDetnSameRV ReSideRdrLeDetn107RdrDetnSts;
SIG_GROUP_ 104 ReSideRdrLeDetn108 1 : ReSideRdrLeDetn108RdrDetnAmbigState ReSideRdrLeDetn108RdrDetnAssoTrkID ReSideRdrLeDetn108RdrDetnAzi ReSideRdrLeDetn108RdrDetnChks ReSideRdrLeDetn108RdrDetnCntr ReSideRdrLeDetn108RdrDetnConf ReSideRdrLeDetn108RdrDetnElevn ReSideRdrLeDetn108RdrDetnPwr ReSideRdrLeDetn108RdrDetnRng ReSideRdrLeDetn108RdrDetnRngV ReSideRdrLeDetn108RdrDetnSameRV ReSideRdrLeDetn108RdrDetnSts;
SIG_GROUP_ 105 ReSideRdrLeDetn109 1 : ReSideRdrLeDetn109RdrDetnAmbigState ReSideRdrLeDetn109RdrDetnAssoTrkID ReSideRdrLeDetn109RdrDetnAzi ReSideRdrLeDetn109RdrDetnChks ReSideRdrLeDetn109RdrDetnCntr ReSideRdrLeDetn109RdrDetnConf ReSideRdrLeDetn109RdrDetnElevn ReSideRdrLeDetn109RdrDetnPwr ReSideRdrLeDetn109RdrDetnRng ReSideRdrLeDetn109RdrDetnRngV ReSideRdrLeDetn109RdrDetnSameRV ReSideRdrLeDetn109RdrDetnSts;
SIG_GROUP_ 105 ReSideRdrLeDetn110 1 : ReSideRdrLeDetn110RdrDetnAmbigState ReSideRdrLeDetn110RdrDetnAssoTrkID ReSideRdrLeDetn110RdrDetnAzi ReSideRdrLeDetn110RdrDetnChks ReSideRdrLeDetn110RdrDetnCntr ReSideRdrLeDetn110RdrDetnConf ReSideRdrLeDetn110RdrDetnElevn ReSideRdrLeDetn110RdrDetnPwr ReSideRdrLeDetn110RdrDetnRng ReSideRdrLeDetn110RdrDetnRngV ReSideRdrLeDetn110RdrDetnSameRV ReSideRdrLeDetn110RdrDetnSts;
SIG_GROUP_ 105 ReSideRdrLeDetn111 1 : ReSideRdrLeDetn111RdrDetnAmbigState ReSideRdrLeDetn111RdrDetnAssoTrkID ReSideRdrLeDetn111RdrDetnAzi ReSideRdrLeDetn111RdrDetnChks ReSideRdrLeDetn111RdrDetnCntr ReSideRdrLeDetn111RdrDetnConf ReSideRdrLeDetn111RdrDetnElevn ReSideRdrLeDetn111RdrDetnPwr ReSideRdrLeDetn111RdrDetnRng ReSideRdrLeDetn111RdrDetnRngV ReSideRdrLeDetn111RdrDetnSameRV ReSideRdrLeDetn111RdrDetnSts;
SIG_GROUP_ 105 ReSideRdrLeDetn112 1 : ReSideRdrLeDetn112RdrDetnAmbigState ReSideRdrLeDetn112RdrDetnAssoTrkID ReSideRdrLeDetn112RdrDetnAzi ReSideRdrLeDetn112RdrDetnChks ReSideRdrLeDetn112RdrDetnCntr ReSideRdrLeDetn112RdrDetnConf ReSideRdrLeDetn112RdrDetnElevn ReSideRdrLeDetn112RdrDetnPwr ReSideRdrLeDetn112RdrDetnRng ReSideRdrLeDetn112RdrDetnRngV ReSideRdrLeDetn112RdrDetnSameRV ReSideRdrLeDetn112RdrDetnSts;
SIG_GROUP_ 105 ReSideRdrLeDetn113 1 : ReSideRdrLeDetn113RdrDetnAmbigState ReSideRdrLeDetn113RdrDetnAssoTrkID ReSideRdrLeDetn113RdrDetnAzi ReSideRdrLeDetn113RdrDetnChks ReSideRdrLeDetn113RdrDetnCntr ReSideRdrLeDetn113RdrDetnConf ReSideRdrLeDetn113RdrDetnElevn ReSideRdrLeDetn113RdrDetnPwr ReSideRdrLeDetn113RdrDetnRng ReSideRdrLeDetn113RdrDetnRngV ReSideRdrLeDetn113RdrDetnSameRV ReSideRdrLeDetn113RdrDetnSts;
SIG_GROUP_ 105 ReSideRdrLeDetn114 1 : ReSideRdrLeDetn114RdrDetnAmbigState ReSideRdrLeDetn114RdrDetnAssoTrkID ReSideRdrLeDetn114RdrDetnAzi ReSideRdrLeDetn114RdrDetnChks ReSideRdrLeDetn114RdrDetnCntr ReSideRdrLeDetn114RdrDetnConf ReSideRdrLeDetn114RdrDetnElevn ReSideRdrLeDetn114RdrDetnPwr ReSideRdrLeDetn114RdrDetnRng ReSideRdrLeDetn114RdrDetnRngV ReSideRdrLeDetn114RdrDetnSameRV ReSideRdrLeDetn114RdrDetnSts;
SIG_GROUP_ 112 ReSideRdrLeDetn115 1 : ReSideRdrLeDetn115RdrDetnAmbigState ReSideRdrLeDetn115RdrDetnAssoTrkID ReSideRdrLeDetn115RdrDetnAzi ReSideRdrLeDetn115RdrDetnChks ReSideRdrLeDetn115RdrDetnCntr ReSideRdrLeDetn115RdrDetnConf ReSideRdrLeDetn115RdrDetnElevn ReSideRdrLeDetn115RdrDetnPwr ReSideRdrLeDetn115RdrDetnRng ReSideRdrLeDetn115RdrDetnRngV ReSideRdrLeDetn115RdrDetnSameRV ReSideRdrLeDetn115RdrDetnSts;
SIG_GROUP_ 112 ReSideRdrLeDetn116 1 : ReSideRdrLeDetn116RdrDetnAmbigState ReSideRdrLeDetn116RdrDetnAssoTrkID ReSideRdrLeDetn116RdrDetnAzi ReSideRdrLeDetn116RdrDetnChks ReSideRdrLeDetn116RdrDetnCntr ReSideRdrLeDetn116RdrDetnConf ReSideRdrLeDetn116RdrDetnElevn ReSideRdrLeDetn116RdrDetnPwr ReSideRdrLeDetn116RdrDetnRng ReSideRdrLeDetn116RdrDetnRngV ReSideRdrLeDetn116RdrDetnSameRV ReSideRdrLeDetn116RdrDetnSts;
SIG_GROUP_ 112 ReSideRdrLeDetn117 1 : ReSideRdrLeDetn117RdrDetnAmbigState ReSideRdrLeDetn117RdrDetnAssoTrkID ReSideRdrLeDetn117RdrDetnAzi ReSideRdrLeDetn117RdrDetnChks ReSideRdrLeDetn117RdrDetnCntr ReSideRdrLeDetn117RdrDetnConf ReSideRdrLeDetn117RdrDetnElevn ReSideRdrLeDetn117RdrDetnPwr ReSideRdrLeDetn117RdrDetnRng ReSideRdrLeDetn117RdrDetnRngV ReSideRdrLeDetn117RdrDetnSameRV ReSideRdrLeDetn117RdrDetnSts;
SIG_GROUP_ 112 ReSideRdrLeDetn118 1 : ReSideRdrLeDetn118RdrDetnAmbigState ReSideRdrLeDetn118RdrDetnAssoTrkID ReSideRdrLeDetn118RdrDetnAzi ReSideRdrLeDetn118RdrDetnChks ReSideRdrLeDetn118RdrDetnCntr ReSideRdrLeDetn118RdrDetnConf ReSideRdrLeDetn118RdrDetnElevn ReSideRdrLeDetn118RdrDetnPwr ReSideRdrLeDetn118RdrDetnRng ReSideRdrLeDetn118RdrDetnRngV ReSideRdrLeDetn118RdrDetnSameRV ReSideRdrLeDetn118RdrDetnSts;
SIG_GROUP_ 112 ReSideRdrLeDetn119 1 : ReSideRdrLeDetn119RdrDetnAmbigState ReSideRdrLeDetn119RdrDetnAssoTrkID ReSideRdrLeDetn119RdrDetnAzi ReSideRdrLeDetn119RdrDetnChks ReSideRdrLeDetn119RdrDetnCntr ReSideRdrLeDetn119RdrDetnConf ReSideRdrLeDetn119RdrDetnElevn ReSideRdrLeDetn119RdrDetnPwr ReSideRdrLeDetn119RdrDetnRng ReSideRdrLeDetn119RdrDetnRngV ReSideRdrLeDetn119RdrDetnSameRV ReSideRdrLeDetn119RdrDetnSts;
SIG_GROUP_ 112 ReSideRdrLeDetn120 1 : ReSideRdrLeDetn120RdrDetnAmbigState ReSideRdrLeDetn120RdrDetnAssoTrkID ReSideRdrLeDetn120RdrDetnAzi ReSideRdrLeDetn120RdrDetnChks ReSideRdrLeDetn120RdrDetnCntr ReSideRdrLeDetn120RdrDetnConf ReSideRdrLeDetn120RdrDetnElevn ReSideRdrLeDetn120RdrDetnPwr ReSideRdrLeDetn120RdrDetnRng ReSideRdrLeDetn120RdrDetnRngV ReSideRdrLeDetn120RdrDetnSameRV ReSideRdrLeDetn120RdrDetnSts;
SIG_GROUP_ 100 ReSideRdrLeDetn79 1 : ReSideRdrLeDetn79RdrDetnAmbigState ReSideRdrLeDetn79RdrDetnAssoTrkID ReSideRdrLeDetn79RdrDetnAzi ReSideRdrLeDetn79RdrDetnChks ReSideRdrLeDetn79RdrDetnCntr ReSideRdrLeDetn79RdrDetnConf ReSideRdrLeDetn79RdrDetnElevn ReSideRdrLeDetn79RdrDetnPwr ReSideRdrLeDetn79RdrDetnRng ReSideRdrLeDetn79RdrDetnRngV ReSideRdrLeDetn79RdrDetnSameRV ReSideRdrLeDetn79RdrDetnSts;
SIG_GROUP_ 100 ReSideRdrLeDetn80 1 : ReSideRdrLeDetn80RdrDetnAmbigState ReSideRdrLeDetn80RdrDetnAssoTrkID ReSideRdrLeDetn80RdrDetnAzi ReSideRdrLeDetn80RdrDetnChks ReSideRdrLeDetn80RdrDetnCntr ReSideRdrLeDetn80RdrDetnConf ReSideRdrLeDetn80RdrDetnElevn ReSideRdrLeDetn80RdrDetnPwr ReSideRdrLeDetn80RdrDetnRng ReSideRdrLeDetn80RdrDetnRngV ReSideRdrLeDetn80RdrDetnSameRV ReSideRdrLeDetn80RdrDetnSts;
SIG_GROUP_ 100 ReSideRdrLeDetn81 1 : ReSideRdrLeDetn81RdrDetnAmbigState ReSideRdrLeDetn81RdrDetnAssoTrkID ReSideRdrLeDetn81RdrDetnAzi ReSideRdrLeDetn81RdrDetnChks ReSideRdrLeDetn81RdrDetnCntr ReSideRdrLeDetn81RdrDetnConf ReSideRdrLeDetn81RdrDetnElevn ReSideRdrLeDetn81RdrDetnPwr ReSideRdrLeDetn81RdrDetnRng ReSideRdrLeDetn81RdrDetnRngV ReSideRdrLeDetn81RdrDetnSameRV ReSideRdrLeDetn81RdrDetnSts;
SIG_GROUP_ 100 ReSideRdrLeDetn82 1 : ReSideRdrLeDetn82RdrDetnAmbigState ReSideRdrLeDetn82RdrDetnAssoTrkID ReSideRdrLeDetn82RdrDetnAzi ReSideRdrLeDetn82RdrDetnChks ReSideRdrLeDetn82RdrDetnCntr ReSideRdrLeDetn82RdrDetnConf ReSideRdrLeDetn82RdrDetnElevn ReSideRdrLeDetn82RdrDetnPwr ReSideRdrLeDetn82RdrDetnRng ReSideRdrLeDetn82RdrDetnRngV ReSideRdrLeDetn82RdrDetnSameRV ReSideRdrLeDetn82RdrDetnSts;
SIG_GROUP_ 100 ReSideRdrLeDetn83 1 : ReSideRdrLeDetn83RdrDetnAmbigState ReSideRdrLeDetn83RdrDetnAssoTrkID ReSideRdrLeDetn83RdrDetnAzi ReSideRdrLeDetn83RdrDetnChks ReSideRdrLeDetn83RdrDetnCntr ReSideRdrLeDetn83RdrDetnConf ReSideRdrLeDetn83RdrDetnElevn ReSideRdrLeDetn83RdrDetnPwr ReSideRdrLeDetn83RdrDetnRng ReSideRdrLeDetn83RdrDetnRngV ReSideRdrLeDetn83RdrDetnSameRV ReSideRdrLeDetn83RdrDetnSts;
SIG_GROUP_ 100 ReSideRdrLeDetn84 1 : ReSideRdrLeDetn84RdrDetnAmbigState ReSideRdrLeDetn84RdrDetnAssoTrkID ReSideRdrLeDetn84RdrDetnAzi ReSideRdrLeDetn84RdrDetnChks ReSideRdrLeDetn84RdrDetnCntr ReSideRdrLeDetn84RdrDetnConf ReSideRdrLeDetn84RdrDetnElevn ReSideRdrLeDetn84RdrDetnPwr ReSideRdrLeDetn84RdrDetnRng ReSideRdrLeDetn84RdrDetnRngV ReSideRdrLeDetn84RdrDetnSameRV ReSideRdrLeDetn84RdrDetnSts;
SIG_GROUP_ 101 ReSideRdrLeDetn85 1 : ReSideRdrLeDetn85RdrDetnAmbigState ReSideRdrLeDetn85RdrDetnAssoTrkID ReSideRdrLeDetn85RdrDetnAzi ReSideRdrLeDetn85RdrDetnChks ReSideRdrLeDetn85RdrDetnCntr ReSideRdrLeDetn85RdrDetnConf ReSideRdrLeDetn85RdrDetnElevn ReSideRdrLeDetn85RdrDetnPwr ReSideRdrLeDetn85RdrDetnRng ReSideRdrLeDetn85RdrDetnRngV ReSideRdrLeDetn85RdrDetnSameRV ReSideRdrLeDetn85RdrDetnSts;
SIG_GROUP_ 101 ReSideRdrLeDetn86 1 : ReSideRdrLeDetn86RdrDetnAmbigState ReSideRdrLeDetn86RdrDetnAssoTrkID ReSideRdrLeDetn86RdrDetnAzi ReSideRdrLeDetn86RdrDetnChks ReSideRdrLeDetn86RdrDetnCntr ReSideRdrLeDetn86RdrDetnConf ReSideRdrLeDetn86RdrDetnElevn ReSideRdrLeDetn86RdrDetnPwr ReSideRdrLeDetn86RdrDetnRng ReSideRdrLeDetn86RdrDetnRngV ReSideRdrLeDetn86RdrDetnSameRV ReSideRdrLeDetn86RdrDetnSts;
SIG_GROUP_ 101 ReSideRdrLeDetn87 1 : ReSideRdrLeDetn87RdrDetnAmbigState ReSideRdrLeDetn87RdrDetnAssoTrkID ReSideRdrLeDetn87RdrDetnAzi ReSideRdrLeDetn87RdrDetnChks ReSideRdrLeDetn87RdrDetnCntr ReSideRdrLeDetn87RdrDetnConf ReSideRdrLeDetn87RdrDetnElevn ReSideRdrLeDetn87RdrDetnPwr ReSideRdrLeDetn87RdrDetnRng ReSideRdrLeDetn87RdrDetnRngV ReSideRdrLeDetn87RdrDetnSameRV ReSideRdrLeDetn87RdrDetnSts;
SIG_GROUP_ 101 ReSideRdrLeDetn88 1 : ReSideRdrLeDetn88RdrDetnAmbigState ReSideRdrLeDetn88RdrDetnAssoTrkID ReSideRdrLeDetn88RdrDetnAzi ReSideRdrLeDetn88RdrDetnChks ReSideRdrLeDetn88RdrDetnCntr ReSideRdrLeDetn88RdrDetnConf ReSideRdrLeDetn88RdrDetnElevn ReSideRdrLeDetn88RdrDetnPwr ReSideRdrLeDetn88RdrDetnRng ReSideRdrLeDetn88RdrDetnRngV ReSideRdrLeDetn88RdrDetnSameRV ReSideRdrLeDetn88RdrDetnSts;
SIG_GROUP_ 101 ReSideRdrLeDetn89 1 : ReSideRdrLeDetn89RdrDetnAmbigState ReSideRdrLeDetn89RdrDetnAssoTrkID ReSideRdrLeDetn89RdrDetnAzi ReSideRdrLeDetn89RdrDetnChks ReSideRdrLeDetn89RdrDetnCntr ReSideRdrLeDetn89RdrDetnConf ReSideRdrLeDetn89RdrDetnElevn ReSideRdrLeDetn89RdrDetnPwr ReSideRdrLeDetn89RdrDetnRng ReSideRdrLeDetn89RdrDetnRngV ReSideRdrLeDetn89RdrDetnSameRV ReSideRdrLeDetn89RdrDetnSts;
SIG_GROUP_ 101 ReSideRdrLeDetn90 1 : ReSideRdrLeDetn90RdrDetnAmbigState ReSideRdrLeDetn90RdrDetnAssoTrkID ReSideRdrLeDetn90RdrDetnAzi ReSideRdrLeDetn90RdrDetnChks ReSideRdrLeDetn90RdrDetnCntr ReSideRdrLeDetn90RdrDetnConf ReSideRdrLeDetn90RdrDetnElevn ReSideRdrLeDetn90RdrDetnPwr ReSideRdrLeDetn90RdrDetnRng ReSideRdrLeDetn90RdrDetnRngV ReSideRdrLeDetn90RdrDetnSameRV ReSideRdrLeDetn90RdrDetnSts;
SIG_GROUP_ 102 ReSideRdrLeDetn91 1 : ReSideRdrLeDetn91RdrDetnAmbigState ReSideRdrLeDetn91RdrDetnAssoTrkID ReSideRdrLeDetn91RdrDetnAzi ReSideRdrLeDetn91RdrDetnChks ReSideRdrLeDetn91RdrDetnCntr ReSideRdrLeDetn91RdrDetnConf ReSideRdrLeDetn91RdrDetnElevn ReSideRdrLeDetn91RdrDetnPwr ReSideRdrLeDetn91RdrDetnRng ReSideRdrLeDetn91RdrDetnRngV ReSideRdrLeDetn91RdrDetnSameRV ReSideRdrLeDetn91RdrDetnSts;
SIG_GROUP_ 102 ReSideRdrLeDetn92 1 : ReSideRdrLeDetn92RdrDetnAmbigState ReSideRdrLeDetn92RdrDetnAssoTrkID ReSideRdrLeDetn92RdrDetnAzi ReSideRdrLeDetn92RdrDetnChks ReSideRdrLeDetn92RdrDetnCntr ReSideRdrLeDetn92RdrDetnConf ReSideRdrLeDetn92RdrDetnElevn ReSideRdrLeDetn92RdrDetnPwr ReSideRdrLeDetn92RdrDetnRng ReSideRdrLeDetn92RdrDetnRngV ReSideRdrLeDetn92RdrDetnSameRV ReSideRdrLeDetn92RdrDetnSts;
SIG_GROUP_ 102 ReSideRdrLeDetn93 1 : ReSideRdrLeDetn93RdrDetnAmbigState ReSideRdrLeDetn93RdrDetnAssoTrkID ReSideRdrLeDetn93RdrDetnAzi ReSideRdrLeDetn93RdrDetnChks ReSideRdrLeDetn93RdrDetnCntr ReSideRdrLeDetn93RdrDetnConf ReSideRdrLeDetn93RdrDetnElevn ReSideRdrLeDetn93RdrDetnPwr ReSideRdrLeDetn93RdrDetnRng ReSideRdrLeDetn93RdrDetnRngV ReSideRdrLeDetn93RdrDetnSameRV ReSideRdrLeDetn93RdrDetnSts;
SIG_GROUP_ 102 ReSideRdrLeDetn94 1 : ReSideRdrLeDetn94RdrDetnAmbigState ReSideRdrLeDetn94RdrDetnAssoTrkID ReSideRdrLeDetn94RdrDetnAzi ReSideRdrLeDetn94RdrDetnChks ReSideRdrLeDetn94RdrDetnCntr ReSideRdrLeDetn94RdrDetnConf ReSideRdrLeDetn94RdrDetnElevn ReSideRdrLeDetn94RdrDetnPwr ReSideRdrLeDetn94RdrDetnRng ReSideRdrLeDetn94RdrDetnRngV ReSideRdrLeDetn94RdrDetnSameRV ReSideRdrLeDetn94RdrDetnSts;
SIG_GROUP_ 102 ReSideRdrLeDetn95 1 : ReSideRdrLeDetn95RdrDetnAmbigState ReSideRdrLeDetn95RdrDetnAssoTrkID ReSideRdrLeDetn95RdrDetnAzi ReSideRdrLeDetn95RdrDetnChks ReSideRdrLeDetn95RdrDetnCntr ReSideRdrLeDetn95RdrDetnConf ReSideRdrLeDetn95RdrDetnElevn ReSideRdrLeDetn95RdrDetnPwr ReSideRdrLeDetn95RdrDetnRng ReSideRdrLeDetn95RdrDetnRngV ReSideRdrLeDetn95RdrDetnSameRV ReSideRdrLeDetn95RdrDetnSts;
SIG_GROUP_ 102 ReSideRdrLeDetn96 1 : ReSideRdrLeDetn96RdrDetnAmbigState ReSideRdrLeDetn96RdrDetnAssoTrkID ReSideRdrLeDetn96RdrDetnAzi ReSideRdrLeDetn96RdrDetnChks ReSideRdrLeDetn96RdrDetnCntr ReSideRdrLeDetn96RdrDetnConf ReSideRdrLeDetn96RdrDetnElevn ReSideRdrLeDetn96RdrDetnPwr ReSideRdrLeDetn96RdrDetnRng ReSideRdrLeDetn96RdrDetnRngV ReSideRdrLeDetn96RdrDetnSameRV ReSideRdrLeDetn96RdrDetnSts;
SIG_GROUP_ 103 ReSideRdrLeDetn97 1 : ReSideRdrLeDetn97RdrDetnAmbigState ReSideRdrLeDetn97RdrDetnAssoTrkID ReSideRdrLeDetn97RdrDetnAzi ReSideRdrLeDetn97RdrDetnChks ReSideRdrLeDetn97RdrDetnCntr ReSideRdrLeDetn97RdrDetnConf ReSideRdrLeDetn97RdrDetnElevn ReSideRdrLeDetn97RdrDetnPwr ReSideRdrLeDetn97RdrDetnRng ReSideRdrLeDetn97RdrDetnRngV ReSideRdrLeDetn97RdrDetnSameRV ReSideRdrLeDetn97RdrDetnSts;
SIG_GROUP_ 103 ReSideRdrLeDetn98 1 : ReSideRdrLeDetn98RdrDetnAmbigState ReSideRdrLeDetn98RdrDetnAssoTrkID ReSideRdrLeDetn98RdrDetnAzi ReSideRdrLeDetn98RdrDetnChks ReSideRdrLeDetn98RdrDetnCntr ReSideRdrLeDetn98RdrDetnConf ReSideRdrLeDetn98RdrDetnElevn ReSideRdrLeDetn98RdrDetnPwr ReSideRdrLeDetn98RdrDetnRng ReSideRdrLeDetn98RdrDetnRngV ReSideRdrLeDetn98RdrDetnSameRV ReSideRdrLeDetn98RdrDetnSts;
SIG_GROUP_ 103 ReSideRdrLeDetn99 1 : ReSideRdrLeDetn99RdrDetnAmbigState ReSideRdrLeDetn99RdrDetnAssoTrkID ReSideRdrLeDetn99RdrDetnAzi ReSideRdrLeDetn99RdrDetnChks ReSideRdrLeDetn99RdrDetnCntr ReSideRdrLeDetn99RdrDetnConf ReSideRdrLeDetn99RdrDetnElevn ReSideRdrLeDetn99RdrDetnPwr ReSideRdrLeDetn99RdrDetnRng ReSideRdrLeDetn99RdrDetnRngV ReSideRdrLeDetn99RdrDetnSameRV ReSideRdrLeDetn99RdrDetnSts;
