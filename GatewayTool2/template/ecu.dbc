// *************************************************************************** *
// *                                                                           *
// * Description:         CANDB File                                           *
// * Generated at:        2023-03-30 16:08                                     *
// * System:              ZSDB123101                                           *
// * Variant:             CS1E                                                 *
// * Network:             Private_CANFD5                                       *
// *                                                                           *
// *************************************************************************** *
VERSION "Private_CANFD5"

NS_ :

BS_ :

BU_ :  ASDM SODL

BO_ 113 SODLPrivateCANFD5Fr54 : 64 SODL
 SG_ ReSideRdrLeDetn121_UB : 487|1@0+ (1,0) [0|1] "" ASDM
 SG_ ReSideRdrLeDetn121RdrDetnAmbigState : 72|1@0+ (1,0) [0|1] "" ASDM
 SG_ ReSideRdrLeDetn121RdrDetnAssoTrkID : 79|7@0+ (1.0,0.0) [0.0|127.0] "Unitless" ASDM
 SG_ ReSideRdrLeDetn121RdrDetnAzi : 34|11@0+ (0.1,-90.0) [-90.0|90.0] "Deg" ASDM
 SG_ ReSideRdrLeDetn121RdrDetnChks : 7|8@0+ (1.0,0.0) [0.0|255.0] "Unitless" ASDM
 SG_ ReSideRdrLeDetn121RdrDetnCntr : 15|4@0+ (1.0,0.0) [0.0|15.0] "Unitless" ASDM
 SG_ ReSideRdrLeDetn121RdrDetnConf : 11|7@0+ (1.0,0.0) [0.0|100.0] "%" ASDM
 SG_ ReSideRdrLeDetn121RdrDetnElevn : 20|5@0+ (1.0,-15.0) [-15.0|15.0] "Deg" ASDM
 SG_ ReSideRdrLeDetn121RdrDetnPwr : 71|6@0+ (1.0,0.0) [0.0|63.0] "dB" ASDM
 SG_ ReSideRdrLeDetn121RdrDetnRng : 55|14@0+ (0.02,-1.0) [-1.0|200.0] "m" ASDM
 SG_ ReSideRdrLeDetn121RdrDetnRngV : 31|13@0+ (0.02,-80.0) [-80.0|80.0] "m/s" ASDM
 SG_ ReSideRdrLeDetn121RdrDetnSameRV : 65|2@0+ (1,0) [0|3] "" ASDM
 SG_ ReSideRdrLeDetn121RdrDetnSts : 57|2@0+ (1,0) [0|3] "" ASDM
 SG_ ReSideRdrLeDetn122_UB : 486|1@0+ (1,0) [0|1] "" ASDM
 SG_ ReSideRdrLeDetn122RdrDetnAmbigState : 152|1@0+ (1,0) [0|1] "" ASDM
 SG_ ReSideRdrLeDetn122RdrDetnAssoTrkID : 159|7@0+ (1.0,0.0) [0.0|127.0] "Unitless" ASDM
 SG_ ReSideRdrLeDetn122RdrDetnAzi : 114|11@0+ (0.1,-90.0) [-90.0|90.0] "Deg" ASDM
 SG_ ReSideRdrLeDetn122RdrDetnChks : 87|8@0+ (1.0,0.0) [0.0|255.0] "Unitless" ASDM
 SG_ ReSideRdrLeDetn122RdrDetnCntr : 95|4@0+ (1.0,0.0) [0.0|15.0] "Unitless" ASDM
 SG_ ReSideRdrLeDetn122RdrDetnConf : 91|7@0+ (1.0,0.0) [0.0|100.0] "%" ASDM
 SG_ ReSideRdrLeDetn122RdrDetnElevn : 100|5@0+ (1.0,-15.0) [-15.0|15.0] "Deg" ASDM
 SG_ ReSideRdrLeDetn122RdrDetnPwr : 151|6@0+ (1.0,0.0) [0.0|63.0] "dB" ASDM
 SG_ ReSideRdrLeDetn122RdrDetnRng : 135|14@0+ (0.02,-1.0) [-1.0|200.0] "m" ASDM
 SG_ ReSideRdrLeDetn122RdrDetnRngV : 111|13@0+ (0.02,-80.0) [-80.0|80.0] "m/s" ASDM
 SG_ ReSideRdrLeDetn122RdrDetnSameRV : 145|2@0+ (1,0) [0|3] "" ASDM
 SG_ ReSideRdrLeDetn122RdrDetnSts : 137|2@0+ (1,0) [0|3] "" ASDM
 SG_ ReSideRdrLeDetn123_UB : 485|1@0+ (1,0) [0|1] "" ASDM
 SG_ ReSideRdrLeDetn123RdrDetnAmbigState : 232|1@0+ (1,0) [0|1] "" ASDM
 SG_ ReSideRdrLeDetn123RdrDetnAssoTrkID : 239|7@0+ (1.0,0.0) [0.0|127.0] "Unitless" ASDM
 SG_ ReSideRdrLeDetn123RdrDetnAzi : 194|11@0+ (0.1,-90.0) [-90.0|90.0] "Deg" ASDM
 SG_ ReSideRdrLeDetn123RdrDetnChks : 167|8@0+ (1.0,0.0) [0.0|255.0] "Unitless" ASDM
 SG_ ReSideRdrLeDetn123RdrDetnCntr : 175|4@0+ (1.0,0.0) [0.0|15.0] "Unitless" ASDM
 SG_ ReSideRdrLeDetn123RdrDetnConf : 171|7@0+ (1.0,0.0) [0.0|100.0] "%" ASDM
 SG_ ReSideRdrLeDetn123RdrDetnElevn : 180|5@0+ (1.0,-15.0) [-15.0|15.0] "Deg" ASDM
 SG_ ReSideRdrLeDetn123RdrDetnPwr : 231|6@0+ (1.0,0.0) [0.0|63.0] "dB" ASDM
 SG_ ReSideRdrLeDetn123RdrDetnRng : 215|14@0+ (0.02,-1.0) [-1.0|200.0] "m" ASDM
 SG_ ReSideRdrLeDetn123RdrDetnRngV : 191|13@0+ (0.02,-80.0) [-80.0|80.0] "m/s" ASDM
 SG_ ReSideRdrLeDetn123RdrDetnSameRV : 225|2@0+ (1,0) [0|3] "" ASDM
 SG_ ReSideRdrLeDetn123RdrDetnSts : 217|2@0+ (1,0) [0|3] "" ASDM
 SG_ ReSideRdrLeDetn124_UB : 484|1@0+ (1,0) [0|1] "" ASDM
 SG_ ReSideRdrLeDetn124RdrDetnAmbigState : 312|1@0+ (1,0) [0|1] "" ASDM
 SG_ ReSideRdrLeDetn124RdrDetnAssoTrkID : 319|7@0+ (1.0,0.0) [0.0|127.0] "Unitless" ASDM
 SG_ ReSideRdrLeDetn124RdrDetnAzi : 274|11@0+ (0.1,-90.0) [-90.0|90.0] "Deg" ASDM
 SG_ ReSideRdrLeDetn124RdrDetnChks : 247|8@0+ (1.0,0.0) [0.0|255.0] "Unitless" ASDM
 SG_ ReSideRdrLeDetn124RdrDetnCntr : 255|4@0+ (1.0,0.0) [0.0|15.0] "Unitless" ASDM
 SG_ ReSideRdrLeDetn124RdrDetnConf : 251|7@0+ (1.0,0.0) [0.0|100.0] "%" ASDM
 SG_ ReSideRdrLeDetn124RdrDetnElevn : 260|5@0+ (1.0,-15.0) [-15.0|15.0] "Deg" ASDM
 SG_ ReSideRdrLeDetn124RdrDetnPwr : 311|6@0+ (1.0,0.0) [0.0|63.0] "dB" ASDM
 SG_ ReSideRdrLeDetn124RdrDetnRng : 295|14@0+ (0.02,-1.0) [-1.0|200.0] "m" ASDM
 SG_ ReSideRdrLeDetn124RdrDetnRngV : 271|13@0+ (0.02,-80.0) [-80.0|80.0] "m/s" ASDM
 SG_ ReSideRdrLeDetn124RdrDetnSameRV : 305|2@0+ (1,0) [0|3] "" ASDM
 SG_ ReSideRdrLeDetn124RdrDetnSts : 297|2@0+ (1,0) [0|3] "" ASDM
 SG_ ReSideRdrLeDetn125_UB : 483|1@0+ (1,0) [0|1] "" ASDM
 SG_ ReSideRdrLeDetn125RdrDetnAmbigState : 392|1@0+ (1,0) [0|1] "" ASDM
 SG_ ReSideRdrLeDetn125RdrDetnAssoTrkID : 399|7@0+ (1.0,0.0) [0.0|127.0] "Unitless" ASDM
 SG_ ReSideRdrLeDetn125RdrDetnAzi : 354|11@0+ (0.1,-90.0) [-90.0|90.0] "Deg" ASDM
 SG_ ReSideRdrLeDetn125RdrDetnChks : 327|8@0+ (1.0,0.0) [0.0|255.0] "Unitless" ASDM
 SG_ ReSideRdrLeDetn125RdrDetnCntr : 335|4@0+ (1.0,0.0) [0.0|15.0] "Unitless" ASDM
 SG_ ReSideRdrLeDetn125RdrDetnConf : 331|7@0+ (1.0,0.0) [0.0|100.0] "%" ASDM
 SG_ ReSideRdrLeDetn125RdrDetnElevn : 340|5@0+ (1.0,-15.0) [-15.0|15.0] "Deg" ASDM
 SG_ ReSideRdrLeDetn125RdrDetnPwr : 391|6@0+ (1.0,0.0) [0.0|63.0] "dB" ASDM
 SG_ ReSideRdrLeDetn125RdrDetnRng : 375|14@0+ (0.02,-1.0) [-1.0|200.0] "m" ASDM
 SG_ ReSideRdrLeDetn125RdrDetnRngV : 351|13@0+ (0.02,-80.0) [-80.0|80.0] "m/s" ASDM
 SG_ ReSideRdrLeDetn125RdrDetnSameRV : 385|2@0+ (1,0) [0|3] "" ASDM
 SG_ ReSideRdrLeDetn125RdrDetnSts : 377|2@0+ (1,0) [0|3] "" ASDM
 SG_ ReSideRdrLeDetn126_UB : 482|1@0+ (1,0) [0|1] "" ASDM
 SG_ ReSideRdrLeDetn126RdrDetnAmbigState : 472|1@0+ (1,0) [0|1] "" ASDM
 SG_ ReSideRdrLeDetn126RdrDetnAssoTrkID : 479|7@0+ (1.0,0.0) [0.0|127.0] "Unitless" ASDM
 SG_ ReSideRdrLeDetn126RdrDetnAzi : 434|11@0+ (0.1,-90.0) [-90.0|90.0] "Deg" ASDM
 SG_ ReSideRdrLeDetn126RdrDetnChks : 407|8@0+ (1.0,0.0) [0.0|255.0] "Unitless" ASDM
 SG_ ReSideRdrLeDetn126RdrDetnCntr : 415|4@0+ (1.0,0.0) [0.0|15.0] "Unitless" ASDM
 SG_ ReSideRdrLeDetn126RdrDetnConf : 411|7@0+ (1.0,0.0) [0.0|100.0] "%" ASDM
 SG_ ReSideRdrLeDetn126RdrDetnElevn : 420|5@0+ (1.0,-15.0) [-15.0|15.0] "Deg" ASDM
 SG_ ReSideRdrLeDetn126RdrDetnPwr : 471|6@0+ (1.0,0.0) [0.0|63.0] "dB" ASDM
 SG_ ReSideRdrLeDetn126RdrDetnRng : 455|14@0+ (0.02,-1.0) [-1.0|200.0] "m" ASDM
 SG_ ReSideRdrLeDetn126RdrDetnRngV : 431|13@0+ (0.02,-80.0) [-80.0|80.0] "m/s" ASDM
 SG_ ReSideRdrLeDetn126RdrDetnSameRV : 465|2@0+ (1,0) [0|3] "" ASDM
 SG_ ReSideRdrLeDetn126RdrDetnSts : 457|2@0+ (1,0) [0|3] "" ASDM

BO_ 114 SODLPrivateCANFD5Fr55 : 64 SODL
 SG_ ReSideRdrLeDetn127_UB : 487|1@0+ (1,0) [0|1] "" ASDM
 SG_ ReSideRdrLeDetn127RdrDetnAmbigState : 72|1@0+ (1,0) [0|1] "" ASDM
 SG_ ReSideRdrLeDetn127RdrDetnAssoTrkID : 79|7@0+ (1.0,0.0) [0.0|127.0] "Unitless" ASDM
 SG_ ReSideRdrLeDetn127RdrDetnAzi : 34|11@0+ (0.1,-90.0) [-90.0|90.0] "Deg" ASDM
 SG_ ReSideRdrLeDetn127RdrDetnChks : 7|8@0+ (1.0,0.0) [0.0|255.0] "Unitless" ASDM
 SG_ ReSideRdrLeDetn127RdrDetnCntr : 15|4@0+ (1.0,0.0) [0.0|15.0] "Unitless" ASDM
 SG_ ReSideRdrLeDetn127RdrDetnConf : 11|7@0+ (1.0,0.0) [0.0|100.0] "%" ASDM
 SG_ ReSideRdrLeDetn127RdrDetnElevn : 20|5@0+ (1.0,-15.0) [-15.0|15.0] "Deg" ASDM
 SG_ ReSideRdrLeDetn127RdrDetnPwr : 71|6@0+ (1.0,0.0) [0.0|63.0] "dB" ASDM
 SG_ ReSideRdrLeDetn127RdrDetnRng : 55|14@0+ (0.02,-1.0) [-1.0|200.0] "m" ASDM
 SG_ ReSideRdrLeDetn127RdrDetnRngV : 31|13@0+ (0.02,-80.0) [-80.0|80.0] "m/s" ASDM
 SG_ ReSideRdrLeDetn127RdrDetnSameRV : 65|2@0+ (1,0) [0|3] "" ASDM
 SG_ ReSideRdrLeDetn127RdrDetnSts : 57|2@0+ (1,0) [0|3] "" ASDM
 SG_ ReSideRdrLeDetn128_UB : 486|1@0+ (1,0) [0|1] "" ASDM
 SG_ ReSideRdrLeDetn128RdrDetnAmbigState : 152|1@0+ (1,0) [0|1] "" ASDM
 SG_ ReSideRdrLeDetn128RdrDetnAssoTrkID : 159|7@0+ (1.0,0.0) [0.0|127.0] "Unitless" ASDM
 SG_ ReSideRdrLeDetn128RdrDetnAzi : 114|11@0+ (0.1,-90.0) [-90.0|90.0] "Deg" ASDM
 SG_ ReSideRdrLeDetn128RdrDetnChks : 87|8@0+ (1.0,0.0) [0.0|255.0] "Unitless" ASDM
 SG_ ReSideRdrLeDetn128RdrDetnCntr : 95|4@0+ (1.0,0.0) [0.0|15.0] "Unitless" ASDM
 SG_ ReSideRdrLeDetn128RdrDetnConf : 91|7@0+ (1.0,0.0) [0.0|100.0] "%" ASDM
 SG_ ReSideRdrLeDetn128RdrDetnElevn : 100|5@0+ (1.0,-15.0) [-15.0|15.0] "Deg" ASDM
 SG_ ReSideRdrLeDetn128RdrDetnPwr : 151|6@0+ (1.0,0.0) [0.0|63.0] "dB" ASDM
 SG_ ReSideRdrLeDetn128RdrDetnRng : 135|14@0+ (0.02,-1.0) [-1.0|200.0] "m" ASDM
 SG_ ReSideRdrLeDetn128RdrDetnRngV : 111|13@0+ (0.02,-80.0) [-80.0|80.0] "m/s" ASDM
 SG_ ReSideRdrLeDetn128RdrDetnSameRV : 145|2@0+ (1,0) [0|3] "" ASDM
 SG_ ReSideRdrLeDetn128RdrDetnSts : 137|2@0+ (1,0) [0|3] "" ASDM
 SG_ ReSideRdrLeDetn129_UB : 485|1@0+ (1,0) [0|1] "" ASDM
 SG_ ReSideRdrLeDetn129RdrDetnAmbigState : 232|1@0+ (1,0) [0|1] "" ASDM
 SG_ ReSideRdrLeDetn129RdrDetnAssoTrkID : 239|7@0+ (1.0,0.0) [0.0|127.0] "Unitless" ASDM
 SG_ ReSideRdrLeDetn129RdrDetnAzi : 194|11@0+ (0.1,-90.0) [-90.0|90.0] "Deg" ASDM
 SG_ ReSideRdrLeDetn129RdrDetnChks : 167|8@0+ (1.0,0.0) [0.0|255.0] "Unitless" ASDM
 SG_ ReSideRdrLeDetn129RdrDetnCntr : 175|4@0+ (1.0,0.0) [0.0|15.0] "Unitless" ASDM
 SG_ ReSideRdrLeDetn129RdrDetnConf : 171|7@0+ (1.0,0.0) [0.0|100.0] "%" ASDM
 SG_ ReSideRdrLeDetn129RdrDetnElevn : 180|5@0+ (1.0,-15.0) [-15.0|15.0] "Deg" ASDM
 SG_ ReSideRdrLeDetn129RdrDetnPwr : 231|6@0+ (1.0,0.0) [0.0|63.0] "dB" ASDM
 SG_ ReSideRdrLeDetn129RdrDetnRng : 215|14@0+ (0.02,-1.0) [-1.0|200.0] "m" ASDM
 SG_ ReSideRdrLeDetn129RdrDetnRngV : 191|13@0+ (0.02,-80.0) [-80.0|80.0] "m/s" ASDM
 SG_ ReSideRdrLeDetn129RdrDetnSameRV : 225|2@0+ (1,0) [0|3] "" ASDM
 SG_ ReSideRdrLeDetn129RdrDetnSts : 217|2@0+ (1,0) [0|3] "" ASDM
 SG_ ReSideRdrLeDetn130_UB : 484|1@0+ (1,0) [0|1] "" ASDM
 SG_ ReSideRdrLeDetn130RdrDetnAmbigState : 312|1@0+ (1,0) [0|1] "" ASDM
 SG_ ReSideRdrLeDetn130RdrDetnAssoTrkID : 319|7@0+ (1.0,0.0) [0.0|127.0] "Unitless" ASDM
 SG_ ReSideRdrLeDetn130RdrDetnAzi : 274|11@0+ (0.1,-90.0) [-90.0|90.0] "Deg" ASDM
 SG_ ReSideRdrLeDetn130RdrDetnChks : 247|8@0+ (1.0,0.0) [0.0|255.0] "Unitless" ASDM
 SG_ ReSideRdrLeDetn130RdrDetnCntr : 255|4@0+ (1.0,0.0) [0.0|15.0] "Unitless" ASDM
 SG_ ReSideRdrLeDetn130RdrDetnConf : 251|7@0+ (1.0,0.0) [0.0|100.0] "%" ASDM
 SG_ ReSideRdrLeDetn130RdrDetnElevn : 260|5@0+ (1.0,-15.0) [-15.0|15.0] "Deg" ASDM
 SG_ ReSideRdrLeDetn130RdrDetnPwr : 311|6@0+ (1.0,0.0) [0.0|63.0] "dB" ASDM
 SG_ ReSideRdrLeDetn130RdrDetnRng : 295|14@0+ (0.02,-1.0) [-1.0|200.0] "m" ASDM
 SG_ ReSideRdrLeDetn130RdrDetnRngV : 271|13@0+ (0.02,-80.0) [-80.0|80.0] "m/s" ASDM
 SG_ ReSideRdrLeDetn130RdrDetnSameRV : 305|2@0+ (1,0) [0|3] "" ASDM
 SG_ ReSideRdrLeDetn130RdrDetnSts : 297|2@0+ (1,0) [0|3] "" ASDM
 SG_ ReSideRdrLeDetn131_UB : 483|1@0+ (1,0) [0|1] "" ASDM
 SG_ ReSideRdrLeDetn131RdrDetnAmbigState : 392|1@0+ (1,0) [0|1] "" ASDM
 SG_ ReSideRdrLeDetn131RdrDetnAssoTrkID : 399|7@0+ (1.0,0.0) [0.0|127.0] "Unitless" ASDM
 SG_ ReSideRdrLeDetn131RdrDetnAzi : 354|11@0+ (0.1,-90.0) [-90.0|90.0] "Deg" ASDM
 SG_ ReSideRdrLeDetn131RdrDetnChks : 327|8@0+ (1.0,0.0) [0.0|255.0] "Unitless" ASDM
 SG_ ReSideRdrLeDetn131RdrDetnCntr : 335|4@0+ (1.0,0.0) [0.0|15.0] "Unitless" ASDM
 SG_ ReSideRdrLeDetn131RdrDetnConf : 331|7@0+ (1.0,0.0) [0.0|100.0] "%" ASDM
 SG_ ReSideRdrLeDetn131RdrDetnElevn : 340|5@0+ (1.0,-15.0) [-15.0|15.0] "Deg" ASDM
 SG_ ReSideRdrLeDetn131RdrDetnPwr : 391|6@0+ (1.0,0.0) [0.0|63.0] "dB" ASDM
 SG_ ReSideRdrLeDetn131RdrDetnRng : 375|14@0+ (0.02,-1.0) [-1.0|200.0] "m" ASDM
 SG_ ReSideRdrLeDetn131RdrDetnRngV : 351|13@0+ (0.02,-80.0) [-80.0|80.0] "m/s" ASDM
 SG_ ReSideRdrLeDetn131RdrDetnSameRV : 385|2@0+ (1,0) [0|3] "" ASDM
 SG_ ReSideRdrLeDetn131RdrDetnSts : 377|2@0+ (1,0) [0|3] "" ASDM
 SG_ ReSideRdrLeDetn132_UB : 482|1@0+ (1,0) [0|1] "" ASDM
 SG_ ReSideRdrLeDetn132RdrDetnAmbigState : 472|1@0+ (1,0) [0|1] "" ASDM
 SG_ ReSideRdrLeDetn132RdrDetnAssoTrkID : 479|7@0+ (1.0,0.0) [0.0|127.0] "Unitless" ASDM
 SG_ ReSideRdrLeDetn132RdrDetnAzi : 434|11@0+ (0.1,-90.0) [-90.0|90.0] "Deg" ASDM
 SG_ ReSideRdrLeDetn132RdrDetnChks : 407|8@0+ (1.0,0.0) [0.0|255.0] "Unitless" ASDM
 SG_ ReSideRdrLeDetn132RdrDetnCntr : 415|4@0+ (1.0,0.0) [0.0|15.0] "Unitless" ASDM
 SG_ ReSideRdrLeDetn132RdrDetnConf : 411|7@0+ (1.0,0.0) [0.0|100.0] "%" ASDM
 SG_ ReSideRdrLeDetn132RdrDetnElevn : 420|5@0+ (1.0,-15.0) [-15.0|15.0] "Deg" ASDM
 SG_ ReSideRdrLeDetn132RdrDetnPwr : 471|6@0+ (1.0,0.0) [0.0|63.0] "dB" ASDM
 SG_ ReSideRdrLeDetn132RdrDetnRng : 455|14@0+ (0.02,-1.0) [-1.0|200.0] "m" ASDM
 SG_ ReSideRdrLeDetn132RdrDetnRngV : 431|13@0+ (0.02,-80.0) [-80.0|80.0] "m/s" ASDM
 SG_ ReSideRdrLeDetn132RdrDetnSameRV : 465|2@0+ (1,0) [0|3] "" ASDM
 SG_ ReSideRdrLeDetn132RdrDetnSts : 457|2@0+ (1,0) [0|3] "" ASDM

BO_ 115 SODLPrivateCANFD5Fr56 : 64 SODL
 SG_ ReSideRdrLeDetn133_UB : 487|1@0+ (1,0) [0|1] "" ASDM
 SG_ ReSideRdrLeDetn133RdrDetnAmbigState : 72|1@0+ (1,0) [0|1] "" ASDM
 SG_ ReSideRdrLeDetn133RdrDetnAssoTrkID : 79|7@0+ (1.0,0.0) [0.0|127.0] "Unitless" ASDM
 SG_ ReSideRdrLeDetn133RdrDetnAzi : 34|11@0+ (0.1,-90.0) [-90.0|90.0] "Deg" ASDM
 SG_ ReSideRdrLeDetn133RdrDetnChks : 7|8@0+ (1.0,0.0) [0.0|255.0] "Unitless" ASDM
 SG_ ReSideRdrLeDetn133RdrDetnCntr : 15|4@0+ (1.0,0.0) [0.0|15.0] "Unitless" ASDM
 SG_ ReSideRdrLeDetn133RdrDetnConf : 11|7@0+ (1.0,0.0) [0.0|100.0] "%" ASDM
 SG_ ReSideRdrLeDetn133RdrDetnElevn : 20|5@0+ (1.0,-15.0) [-15.0|15.0] "Deg" ASDM
 SG_ ReSideRdrLeDetn133RdrDetnPwr : 71|6@0+ (1.0,0.0) [0.0|63.0] "dB" ASDM
 SG_ ReSideRdrLeDetn133RdrDetnRng : 55|14@0+ (0.02,-1.0) [-1.0|200.0] "m" ASDM
 SG_ ReSideRdrLeDetn133RdrDetnRngV : 31|13@0+ (0.02,-80.0) [-80.0|80.0] "m/s" ASDM
 SG_ ReSideRdrLeDetn133RdrDetnSameRV : 65|2@0+ (1,0) [0|3] "" ASDM
 SG_ ReSideRdrLeDetn133RdrDetnSts : 57|2@0+ (1,0) [0|3] "" ASDM
 SG_ ReSideRdrLeDetn134_UB : 486|1@0+ (1,0) [0|1] "" ASDM
 SG_ ReSideRdrLeDetn134RdrDetnAmbigState : 152|1@0+ (1,0) [0|1] "" ASDM
 SG_ ReSideRdrLeDetn134RdrDetnAssoTrkID : 159|7@0+ (1.0,0.0) [0.0|127.0] "Unitless" ASDM
 SG_ ReSideRdrLeDetn134RdrDetnAzi : 114|11@0+ (0.1,-90.0) [-90.0|90.0] "Deg" ASDM
 SG_ ReSideRdrLeDetn134RdrDetnChks : 87|8@0+ (1.0,0.0) [0.0|255.0] "Unitless" ASDM
 SG_ ReSideRdrLeDetn134RdrDetnCntr : 95|4@0+ (1.0,0.0) [0.0|15.0] "Unitless" ASDM
 SG_ ReSideRdrLeDetn134RdrDetnConf : 91|7@0+ (1.0,0.0) [0.0|100.0] "%" ASDM
 SG_ ReSideRdrLeDetn134RdrDetnElevn : 100|5@0+ (1.0,-15.0) [-15.0|15.0] "Deg" ASDM
 SG_ ReSideRdrLeDetn134RdrDetnPwr : 151|6@0+ (1.0,0.0) [0.0|63.0] "dB" ASDM
 SG_ ReSideRdrLeDetn134RdrDetnRng : 135|14@0+ (0.02,-1.0) [-1.0|200.0] "m" ASDM
 SG_ ReSideRdrLeDetn134RdrDetnRngV : 111|13@0+ (0.02,-80.0) [-80.0|80.0] "m/s" ASDM
 SG_ ReSideRdrLeDetn134RdrDetnSameRV : 145|2@0+ (1,0) [0|3] "" ASDM
 SG_ ReSideRdrLeDetn134RdrDetnSts : 137|2@0+ (1,0) [0|3] "" ASDM
 SG_ ReSideRdrLeDetn135_UB : 485|1@0+ (1,0) [0|1] "" ASDM
 SG_ ReSideRdrLeDetn135RdrDetnAmbigState : 232|1@0+ (1,0) [0|1] "" ASDM
 SG_ ReSideRdrLeDetn135RdrDetnAssoTrkID : 239|7@0+ (1.0,0.0) [0.0|127.0] "Unitless" ASDM
 SG_ ReSideRdrLeDetn135RdrDetnAzi : 194|11@0+ (0.1,-90.0) [-90.0|90.0] "Deg" ASDM
 SG_ ReSideRdrLeDetn135RdrDetnChks : 167|8@0+ (1.0,0.0) [0.0|255.0] "Unitless" ASDM
 SG_ ReSideRdrLeDetn135RdrDetnCntr : 175|4@0+ (1.0,0.0) [0.0|15.0] "Unitless" ASDM
 SG_ ReSideRdrLeDetn135RdrDetnConf : 171|7@0+ (1.0,0.0) [0.0|100.0] "%" ASDM
 SG_ ReSideRdrLeDetn135RdrDetnElevn : 180|5@0+ (1.0,-15.0) [-15.0|15.0] "Deg" ASDM
 SG_ ReSideRdrLeDetn135RdrDetnPwr : 231|6@0+ (1.0,0.0) [0.0|63.0] "dB" ASDM
 SG_ ReSideRdrLeDetn135RdrDetnRng : 215|14@0+ (0.02,-1.0) [-1.0|200.0] "m" ASDM
 SG_ ReSideRdrLeDetn135RdrDetnRngV : 191|13@0+ (0.02,-80.0) [-80.0|80.0] "m/s" ASDM
 SG_ ReSideRdrLeDetn135RdrDetnSameRV : 225|2@0+ (1,0) [0|3] "" ASDM
 SG_ ReSideRdrLeDetn135RdrDetnSts : 217|2@0+ (1,0) [0|3] "" ASDM
 SG_ ReSideRdrLeDetn136_UB : 484|1@0+ (1,0) [0|1] "" ASDM
 SG_ ReSideRdrLeDetn136RdrDetnAmbigState : 312|1@0+ (1,0) [0|1] "" ASDM
 SG_ ReSideRdrLeDetn136RdrDetnAssoTrkID : 319|7@0+ (1.0,0.0) [0.0|127.0] "Unitless" ASDM
 SG_ ReSideRdrLeDetn136RdrDetnAzi : 274|11@0+ (0.1,-90.0) [-90.0|90.0] "Deg" ASDM
 SG_ ReSideRdrLeDetn136RdrDetnChks : 247|8@0+ (1.0,0.0) [0.0|255.0] "Unitless" ASDM
 SG_ ReSideRdrLeDetn136RdrDetnCntr : 255|4@0+ (1.0,0.0) [0.0|15.0] "Unitless" ASDM
 SG_ ReSideRdrLeDetn136RdrDetnConf : 251|7@0+ (1.0,0.0) [0.0|100.0] "%" ASDM
 SG_ ReSideRdrLeDetn136RdrDetnElevn : 260|5@0+ (1.0,-15.0) [-15.0|15.0] "Deg" ASDM
 SG_ ReSideRdrLeDetn136RdrDetnPwr : 311|6@0+ (1.0,0.0) [0.0|63.0] "dB" ASDM
 SG_ ReSideRdrLeDetn136RdrDetnRng : 295|14@0+ (0.02,-1.0) [-1.0|200.0] "m" ASDM
 SG_ ReSideRdrLeDetn136RdrDetnRngV : 271|13@0+ (0.02,-80.0) [-80.0|80.0] "m/s" ASDM
 SG_ ReSideRdrLeDetn136RdrDetnSameRV : 305|2@0+ (1,0) [0|3] "" ASDM
 SG_ ReSideRdrLeDetn136RdrDetnSts : 297|2@0+ (1,0) [0|3] "" ASDM
 SG_ ReSideRdrLeDetn137_UB : 483|1@0+ (1,0) [0|1] "" ASDM
 SG_ ReSideRdrLeDetn137RdrDetnAmbigState : 392|1@0+ (1,0) [0|1] "" ASDM
 SG_ ReSideRdrLeDetn137RdrDetnAssoTrkID : 399|7@0+ (1.0,0.0) [0.0|127.0] "Unitless" ASDM
 SG_ ReSideRdrLeDetn137RdrDetnAzi : 354|11@0+ (0.1,-90.0) [-90.0|90.0] "Deg" ASDM
 SG_ ReSideRdrLeDetn137RdrDetnChks : 327|8@0+ (1.0,0.0) [0.0|255.0] "Unitless" ASDM
 SG_ ReSideRdrLeDetn137RdrDetnCntr : 335|4@0+ (1.0,0.0) [0.0|15.0] "Unitless" ASDM
 SG_ ReSideRdrLeDetn137RdrDetnConf : 331|7@0+ (1.0,0.0) [0.0|100.0] "%" ASDM
 SG_ ReSideRdrLeDetn137RdrDetnElevn : 340|5@0+ (1.0,-15.0) [-15.0|15.0] "Deg" ASDM
 SG_ ReSideRdrLeDetn137RdrDetnPwr : 391|6@0+ (1.0,0.0) [0.0|63.0] "dB" ASDM
 SG_ ReSideRdrLeDetn137RdrDetnRng : 375|14@0+ (0.02,-1.0) [-1.0|200.0] "m" ASDM
 SG_ ReSideRdrLeDetn137RdrDetnRngV : 351|13@0+ (0.02,-80.0) [-80.0|80.0] "m/s" ASDM
 SG_ ReSideRdrLeDetn137RdrDetnSameRV : 385|2@0+ (1,0) [0|3] "" ASDM
 SG_ ReSideRdrLeDetn137RdrDetnSts : 377|2@0+ (1,0) [0|3] "" ASDM
 SG_ ReSideRdrLeDetn138_UB : 482|1@0+ (1,0) [0|1] "" ASDM
 SG_ ReSideRdrLeDetn138RdrDetnAmbigState : 472|1@0+ (1,0) [0|1] "" ASDM
 SG_ ReSideRdrLeDetn138RdrDetnAssoTrkID : 479|7@0+ (1.0,0.0) [0.0|127.0] "Unitless" ASDM
 SG_ ReSideRdrLeDetn138RdrDetnAzi : 434|11@0+ (0.1,-90.0) [-90.0|90.0] "Deg" ASDM
 SG_ ReSideRdrLeDetn138RdrDetnChks : 407|8@0+ (1.0,0.0) [0.0|255.0] "Unitless" ASDM
 SG_ ReSideRdrLeDetn138RdrDetnCntr : 415|4@0+ (1.0,0.0) [0.0|15.0] "Unitless" ASDM
 SG_ ReSideRdrLeDetn138RdrDetnConf : 411|7@0+ (1.0,0.0) [0.0|100.0] "%" ASDM
 SG_ ReSideRdrLeDetn138RdrDetnElevn : 420|5@0+ (1.0,-15.0) [-15.0|15.0] "Deg" ASDM
 SG_ ReSideRdrLeDetn138RdrDetnPwr : 471|6@0+ (1.0,0.0) [0.0|63.0] "dB" ASDM
 SG_ ReSideRdrLeDetn138RdrDetnRng : 455|14@0+ (0.02,-1.0) [-1.0|200.0] "m" ASDM
 SG_ ReSideRdrLeDetn138RdrDetnRngV : 431|13@0+ (0.02,-80.0) [-80.0|80.0] "m/s" ASDM
 SG_ ReSideRdrLeDetn138RdrDetnSameRV : 465|2@0+ (1,0) [0|3] "" ASDM
 SG_ ReSideRdrLeDetn138RdrDetnSts : 457|2@0+ (1,0) [0|3] "" ASDM

BO_ 116 SODLPrivateCANFD5Fr57 : 64 SODL
 SG_ ReSideRdrLeDetn139_UB : 487|1@0+ (1,0) [0|1] "" ASDM
 SG_ ReSideRdrLeDetn139RdrDetnAmbigState : 72|1@0+ (1,0) [0|1] "" ASDM
 SG_ ReSideRdrLeDetn139RdrDetnAssoTrkID : 79|7@0+ (1.0,0.0) [0.0|127.0] "Unitless" ASDM
 SG_ ReSideRdrLeDetn139RdrDetnAzi : 34|11@0+ (0.1,-90.0) [-90.0|90.0] "Deg" ASDM
 SG_ ReSideRdrLeDetn139RdrDetnChks : 7|8@0+ (1.0,0.0) [0.0|255.0] "Unitless" ASDM
 SG_ ReSideRdrLeDetn139RdrDetnCntr : 15|4@0+ (1.0,0.0) [0.0|15.0] "Unitless" ASDM
 SG_ ReSideRdrLeDetn139RdrDetnConf : 11|7@0+ (1.0,0.0) [0.0|100.0] "%" ASDM
 SG_ ReSideRdrLeDetn139RdrDetnElevn : 20|5@0+ (1.0,-15.0) [-15.0|15.0] "Deg" ASDM
 SG_ ReSideRdrLeDetn139RdrDetnPwr : 71|6@0+ (1.0,0.0) [0.0|63.0] "dB" ASDM
 SG_ ReSideRdrLeDetn139RdrDetnRng : 55|14@0+ (0.02,-1.0) [-1.0|200.0] "m" ASDM
 SG_ ReSideRdrLeDetn139RdrDetnRngV : 31|13@0+ (0.02,-80.0) [-80.0|80.0] "m/s" ASDM
 SG_ ReSideRdrLeDetn139RdrDetnSameRV : 65|2@0+ (1,0) [0|3] "" ASDM
 SG_ ReSideRdrLeDetn139RdrDetnSts : 57|2@0+ (1,0) [0|3] "" ASDM
 SG_ ReSideRdrLeDetn140_UB : 486|1@0+ (1,0) [0|1] "" ASDM
 SG_ ReSideRdrLeDetn140RdrDetnAmbigState : 152|1@0+ (1,0) [0|1] "" ASDM
 SG_ ReSideRdrLeDetn140RdrDetnAssoTrkID : 159|7@0+ (1.0,0.0) [0.0|127.0] "Unitless" ASDM
 SG_ ReSideRdrLeDetn140RdrDetnAzi : 114|11@0+ (0.1,-90.0) [-90.0|90.0] "Deg" ASDM
 SG_ ReSideRdrLeDetn140RdrDetnChks : 87|8@0+ (1.0,0.0) [0.0|255.0] "Unitless" ASDM
 SG_ ReSideRdrLeDetn140RdrDetnCntr : 95|4@0+ (1.0,0.0) [0.0|15.0] "Unitless" ASDM
 SG_ ReSideRdrLeDetn140RdrDetnConf : 91|7@0+ (1.0,0.0) [0.0|100.0] "%" ASDM
 SG_ ReSideRdrLeDetn140RdrDetnElevn : 100|5@0+ (1.0,-15.0) [-15.0|15.0] "Deg" ASDM
 SG_ ReSideRdrLeDetn140RdrDetnPwr : 151|6@0+ (1.0,0.0) [0.0|63.0] "dB" ASDM
 SG_ ReSideRdrLeDetn140RdrDetnRng : 135|14@0+ (0.02,-1.0) [-1.0|200.0] "m" ASDM
 SG_ ReSideRdrLeDetn140RdrDetnRngV : 111|13@0+ (0.02,-80.0) [-80.0|80.0] "m/s" ASDM
 SG_ ReSideRdrLeDetn140RdrDetnSameRV : 145|2@0+ (1,0) [0|3] "" ASDM
 SG_ ReSideRdrLeDetn140RdrDetnSts : 137|2@0+ (1,0) [0|3] "" ASDM
 SG_ ReSideRdrLeDetn141_UB : 485|1@0+ (1,0) [0|1] "" ASDM
 SG_ ReSideRdrLeDetn141RdrDetnAmbigState : 232|1@0+ (1,0) [0|1] "" ASDM
 SG_ ReSideRdrLeDetn141RdrDetnAssoTrkID : 239|7@0+ (1.0,0.0) [0.0|127.0] "Unitless" ASDM
 SG_ ReSideRdrLeDetn141RdrDetnAzi : 194|11@0+ (0.1,-90.0) [-90.0|90.0] "Deg" ASDM
 SG_ ReSideRdrLeDetn141RdrDetnChks : 167|8@0+ (1.0,0.0) [0.0|255.0] "Unitless" ASDM
 SG_ ReSideRdrLeDetn141RdrDetnCntr : 175|4@0+ (1.0,0.0) [0.0|15.0] "Unitless" ASDM
 SG_ ReSideRdrLeDetn141RdrDetnConf : 171|7@0+ (1.0,0.0) [0.0|100.0] "%" ASDM
 SG_ ReSideRdrLeDetn141RdrDetnElevn : 180|5@0+ (1.0,-15.0) [-15.0|15.0] "Deg" ASDM
 SG_ ReSideRdrLeDetn141RdrDetnPwr : 231|6@0+ (1.0,0.0) [0.0|63.0] "dB" ASDM
 SG_ ReSideRdrLeDetn141RdrDetnRng : 215|14@0+ (0.02,-1.0) [-1.0|200.0] "m" ASDM
 SG_ ReSideRdrLeDetn141RdrDetnRngV : 191|13@0+ (0.02,-80.0) [-80.0|80.0] "m/s" ASDM
 SG_ ReSideRdrLeDetn141RdrDetnSameRV : 225|2@0+ (1,0) [0|3] "" ASDM
 SG_ ReSideRdrLeDetn141RdrDetnSts : 217|2@0+ (1,0) [0|3] "" ASDM
 SG_ ReSideRdrLeDetn142_UB : 484|1@0+ (1,0) [0|1] "" ASDM
 SG_ ReSideRdrLeDetn142RdrDetnAmbigState : 312|1@0+ (1,0) [0|1] "" ASDM
 SG_ ReSideRdrLeDetn142RdrDetnAssoTrkID : 319|7@0+ (1.0,0.0) [0.0|127.0] "Unitless" ASDM
 SG_ ReSideRdrLeDetn142RdrDetnAzi : 274|11@0+ (0.1,-90.0) [-90.0|90.0] "Deg" ASDM
 SG_ ReSideRdrLeDetn142RdrDetnChks : 247|8@0+ (1.0,0.0) [0.0|255.0] "Unitless" ASDM
 SG_ ReSideRdrLeDetn142RdrDetnCntr : 255|4@0+ (1.0,0.0) [0.0|15.0] "Unitless" ASDM
 SG_ ReSideRdrLeDetn142RdrDetnConf : 251|7@0+ (1.0,0.0) [0.0|100.0] "%" ASDM
 SG_ ReSideRdrLeDetn142RdrDetnElevn : 260|5@0+ (1.0,-15.0) [-15.0|15.0] "Deg" ASDM
 SG_ ReSideRdrLeDetn142RdrDetnPwr : 311|6@0+ (1.0,0.0) [0.0|63.0] "dB" ASDM
 SG_ ReSideRdrLeDetn142RdrDetnRng : 295|14@0+ (0.02,-1.0) [-1.0|200.0] "m" ASDM
 SG_ ReSideRdrLeDetn142RdrDetnRngV : 271|13@0+ (0.02,-80.0) [-80.0|80.0] "m/s" ASDM
 SG_ ReSideRdrLeDetn142RdrDetnSameRV : 305|2@0+ (1,0) [0|3] "" ASDM
 SG_ ReSideRdrLeDetn142RdrDetnSts : 297|2@0+ (1,0) [0|3] "" ASDM
 SG_ ReSideRdrLeDetn143_UB : 483|1@0+ (1,0) [0|1] "" ASDM
 SG_ ReSideRdrLeDetn143RdrDetnAmbigState : 392|1@0+ (1,0) [0|1] "" ASDM
 SG_ ReSideRdrLeDetn143RdrDetnAssoTrkID : 399|7@0+ (1.0,0.0) [0.0|127.0] "Unitless" ASDM
 SG_ ReSideRdrLeDetn143RdrDetnAzi : 354|11@0+ (0.1,-90.0) [-90.0|90.0] "Deg" ASDM
 SG_ ReSideRdrLeDetn143RdrDetnChks : 327|8@0+ (1.0,0.0) [0.0|255.0] "Unitless" ASDM
 SG_ ReSideRdrLeDetn143RdrDetnCntr : 335|4@0+ (1.0,0.0) [0.0|15.0] "Unitless" ASDM
 SG_ ReSideRdrLeDetn143RdrDetnConf : 331|7@0+ (1.0,0.0) [0.0|100.0] "%" ASDM
 SG_ ReSideRdrLeDetn143RdrDetnElevn : 340|5@0+ (1.0,-15.0) [-15.0|15.0] "Deg" ASDM
 SG_ ReSideRdrLeDetn143RdrDetnPwr : 391|6@0+ (1.0,0.0) [0.0|63.0] "dB" ASDM
 SG_ ReSideRdrLeDetn143RdrDetnRng : 375|14@0+ (0.02,-1.0) [-1.0|200.0] "m" ASDM
 SG_ ReSideRdrLeDetn143RdrDetnRngV : 351|13@0+ (0.02,-80.0) [-80.0|80.0] "m/s" ASDM
 SG_ ReSideRdrLeDetn143RdrDetnSameRV : 385|2@0+ (1,0) [0|3] "" ASDM
 SG_ ReSideRdrLeDetn143RdrDetnSts : 377|2@0+ (1,0) [0|3] "" ASDM
 SG_ ReSideRdrLeDetn144_UB : 482|1@0+ (1,0) [0|1] "" ASDM
 SG_ ReSideRdrLeDetn144RdrDetnAmbigState : 472|1@0+ (1,0) [0|1] "" ASDM
 SG_ ReSideRdrLeDetn144RdrDetnAssoTrkID : 479|7@0+ (1.0,0.0) [0.0|127.0] "Unitless" ASDM
 SG_ ReSideRdrLeDetn144RdrDetnAzi : 434|11@0+ (0.1,-90.0) [-90.0|90.0] "Deg" ASDM
 SG_ ReSideRdrLeDetn144RdrDetnChks : 407|8@0+ (1.0,0.0) [0.0|255.0] "Unitless" ASDM
 SG_ ReSideRdrLeDetn144RdrDetnCntr : 415|4@0+ (1.0,0.0) [0.0|15.0] "Unitless" ASDM
 SG_ ReSideRdrLeDetn144RdrDetnConf : 411|7@0+ (1.0,0.0) [0.0|100.0] "%" ASDM
 SG_ ReSideRdrLeDetn144RdrDetnElevn : 420|5@0+ (1.0,-15.0) [-15.0|15.0] "Deg" ASDM
 SG_ ReSideRdrLeDetn144RdrDetnPwr : 471|6@0+ (1.0,0.0) [0.0|63.0] "dB" ASDM
 SG_ ReSideRdrLeDetn144RdrDetnRng : 455|14@0+ (0.02,-1.0) [-1.0|200.0] "m" ASDM
 SG_ ReSideRdrLeDetn144RdrDetnRngV : 431|13@0+ (0.02,-80.0) [-80.0|80.0] "m/s" ASDM
 SG_ ReSideRdrLeDetn144RdrDetnSameRV : 465|2@0+ (1,0) [0|3] "" ASDM
 SG_ ReSideRdrLeDetn144RdrDetnSts : 457|2@0+ (1,0) [0|3] "" ASDM

BO_ 117 SODLPrivateCANFD5Fr58 : 64 SODL
 SG_ ReSideRdrLeDetn145_UB : 487|1@0+ (1,0) [0|1] "" ASDM
 SG_ ReSideRdrLeDetn145RdrDetnAmbigState : 72|1@0+ (1,0) [0|1] "" ASDM
 SG_ ReSideRdrLeDetn145RdrDetnAssoTrkID : 79|7@0+ (1.0,0.0) [0.0|127.0] "Unitless" ASDM
 SG_ ReSideRdrLeDetn145RdrDetnAzi : 34|11@0+ (0.1,-90.0) [-90.0|90.0] "Deg" ASDM
 SG_ ReSideRdrLeDetn145RdrDetnChks : 7|8@0+ (1.0,0.0) [0.0|255.0] "Unitless" ASDM
 SG_ ReSideRdrLeDetn145RdrDetnCntr : 15|4@0+ (1.0,0.0) [0.0|15.0] "Unitless" ASDM
 SG_ ReSideRdrLeDetn145RdrDetnConf : 11|7@0+ (1.0,0.0) [0.0|100.0] "%" ASDM
 SG_ ReSideRdrLeDetn145RdrDetnElevn : 20|5@0+ (1.0,-15.0) [-15.0|15.0] "Deg" ASDM
 SG_ ReSideRdrLeDetn145RdrDetnPwr : 71|6@0+ (1.0,0.0) [0.0|63.0] "dB" ASDM
 SG_ ReSideRdrLeDetn145RdrDetnRng : 55|14@0+ (0.02,-1.0) [-1.0|200.0] "m" ASDM
 SG_ ReSideRdrLeDetn145RdrDetnRngV : 31|13@0+ (0.02,-80.0) [-80.0|80.0] "m/s" ASDM
 SG_ ReSideRdrLeDetn145RdrDetnSameRV : 65|2@0+ (1,0) [0|3] "" ASDM
 SG_ ReSideRdrLeDetn145RdrDetnSts : 57|2@0+ (1,0) [0|3] "" ASDM
 SG_ ReSideRdrLeDetn146_UB : 486|1@0+ (1,0) [0|1] "" ASDM
 SG_ ReSideRdrLeDetn146RdrDetnAmbigState : 152|1@0+ (1,0) [0|1] "" ASDM
 SG_ ReSideRdrLeDetn146RdrDetnAssoTrkID : 159|7@0+ (1.0,0.0) [0.0|127.0] "Unitless" ASDM
 SG_ ReSideRdrLeDetn146RdrDetnAzi : 114|11@0+ (0.1,-90.0) [-90.0|90.0] "Deg" ASDM
 SG_ ReSideRdrLeDetn146RdrDetnChks : 87|8@0+ (1.0,0.0) [0.0|255.0] "Unitless" ASDM
 SG_ ReSideRdrLeDetn146RdrDetnCntr : 95|4@0+ (1.0,0.0) [0.0|15.0] "Unitless" ASDM
 SG_ ReSideRdrLeDetn146RdrDetnConf : 91|7@0+ (1.0,0.0) [0.0|100.0] "%" ASDM
 SG_ ReSideRdrLeDetn146RdrDetnElevn : 100|5@0+ (1.0,-15.0) [-15.0|15.0] "Deg" ASDM
 SG_ ReSideRdrLeDetn146RdrDetnPwr : 151|6@0+ (1.0,0.0) [0.0|63.0] "dB" ASDM
 SG_ ReSideRdrLeDetn146RdrDetnRng : 135|14@0+ (0.02,-1.0) [-1.0|200.0] "m" ASDM
 SG_ ReSideRdrLeDetn146RdrDetnRngV : 111|13@0+ (0.02,-80.0) [-80.0|80.0] "m/s" ASDM
 SG_ ReSideRdrLeDetn146RdrDetnSameRV : 145|2@0+ (1,0) [0|3] "" ASDM
 SG_ ReSideRdrLeDetn146RdrDetnSts : 137|2@0+ (1,0) [0|3] "" ASDM
 SG_ ReSideRdrLeDetn147_UB : 485|1@0+ (1,0) [0|1] "" ASDM
 SG_ ReSideRdrLeDetn147RdrDetnAmbigState : 232|1@0+ (1,0) [0|1] "" ASDM
 SG_ ReSideRdrLeDetn147RdrDetnAssoTrkID : 239|7@0+ (1.0,0.0) [0.0|127.0] "Unitless" ASDM
 SG_ ReSideRdrLeDetn147RdrDetnAzi : 194|11@0+ (0.1,-90.0) [-90.0|90.0] "Deg" ASDM
 SG_ ReSideRdrLeDetn147RdrDetnChks : 167|8@0+ (1.0,0.0) [0.0|255.0] "Unitless" ASDM
 SG_ ReSideRdrLeDetn147RdrDetnCntr : 175|4@0+ (1.0,0.0) [0.0|15.0] "Unitless" ASDM
 SG_ ReSideRdrLeDetn147RdrDetnConf : 171|7@0+ (1.0,0.0) [0.0|100.0] "%" ASDM
 SG_ ReSideRdrLeDetn147RdrDetnElevn : 180|5@0+ (1.0,-15.0) [-15.0|15.0] "Deg" ASDM
 SG_ ReSideRdrLeDetn147RdrDetnPwr : 231|6@0+ (1.0,0.0) [0.0|63.0] "dB" ASDM
 SG_ ReSideRdrLeDetn147RdrDetnRng : 215|14@0+ (0.02,-1.0) [-1.0|200.0] "m" ASDM
 SG_ ReSideRdrLeDetn147RdrDetnRngV : 191|13@0+ (0.02,-80.0) [-80.0|80.0] "m/s" ASDM
 SG_ ReSideRdrLeDetn147RdrDetnSameRV : 225|2@0+ (1,0) [0|3] "" ASDM
 SG_ ReSideRdrLeDetn147RdrDetnSts : 217|2@0+ (1,0) [0|3] "" ASDM
 SG_ ReSideRdrLeDetn148_UB : 484|1@0+ (1,0) [0|1] "" ASDM
 SG_ ReSideRdrLeDetn148RdrDetnAmbigState : 312|1@0+ (1,0) [0|1] "" ASDM
 SG_ ReSideRdrLeDetn148RdrDetnAssoTrkID : 319|7@0+ (1.0,0.0) [0.0|127.0] "Unitless" ASDM
 SG_ ReSideRdrLeDetn148RdrDetnAzi : 274|11@0+ (0.1,-90.0) [-90.0|90.0] "Deg" ASDM
 SG_ ReSideRdrLeDetn148RdrDetnChks : 247|8@0+ (1.0,0.0) [0.0|255.0] "Unitless" ASDM
 SG_ ReSideRdrLeDetn148RdrDetnCntr : 255|4@0+ (1.0,0.0) [0.0|15.0] "Unitless" ASDM
 SG_ ReSideRdrLeDetn148RdrDetnConf : 251|7@0+ (1.0,0.0) [0.0|100.0] "%" ASDM
 SG_ ReSideRdrLeDetn148RdrDetnElevn : 260|5@0+ (1.0,-15.0) [-15.0|15.0] "Deg" ASDM
 SG_ ReSideRdrLeDetn148RdrDetnPwr : 311|6@0+ (1.0,0.0) [0.0|63.0] "dB" ASDM
 SG_ ReSideRdrLeDetn148RdrDetnRng : 295|14@0+ (0.02,-1.0) [-1.0|200.0] "m" ASDM
 SG_ ReSideRdrLeDetn148RdrDetnRngV : 271|13@0+ (0.02,-80.0) [-80.0|80.0] "m/s" ASDM
 SG_ ReSideRdrLeDetn148RdrDetnSameRV : 305|2@0+ (1,0) [0|3] "" ASDM
 SG_ ReSideRdrLeDetn148RdrDetnSts : 297|2@0+ (1,0) [0|3] "" ASDM
 SG_ ReSideRdrLeDetn149_UB : 483|1@0+ (1,0) [0|1] "" ASDM
 SG_ ReSideRdrLeDetn149RdrDetnAmbigState : 392|1@0+ (1,0) [0|1] "" ASDM
 SG_ ReSideRdrLeDetn149RdrDetnAssoTrkID : 399|7@0+ (1.0,0.0) [0.0|127.0] "Unitless" ASDM
 SG_ ReSideRdrLeDetn149RdrDetnAzi : 354|11@0+ (0.1,-90.0) [-90.0|90.0] "Deg" ASDM
 SG_ ReSideRdrLeDetn149RdrDetnChks : 327|8@0+ (1.0,0.0) [0.0|255.0] "Unitless" ASDM
 SG_ ReSideRdrLeDetn149RdrDetnCntr : 335|4@0+ (1.0,0.0) [0.0|15.0] "Unitless" ASDM
 SG_ ReSideRdrLeDetn149RdrDetnConf : 331|7@0+ (1.0,0.0) [0.0|100.0] "%" ASDM
 SG_ ReSideRdrLeDetn149RdrDetnElevn : 340|5@0+ (1.0,-15.0) [-15.0|15.0] "Deg" ASDM
 SG_ ReSideRdrLeDetn149RdrDetnPwr : 391|6@0+ (1.0,0.0) [0.0|63.0] "dB" ASDM
 SG_ ReSideRdrLeDetn149RdrDetnRng : 375|14@0+ (0.02,-1.0) [-1.0|200.0] "m" ASDM
 SG_ ReSideRdrLeDetn149RdrDetnRngV : 351|13@0+ (0.02,-80.0) [-80.0|80.0] "m/s" ASDM
 SG_ ReSideRdrLeDetn149RdrDetnSameRV : 385|2@0+ (1,0) [0|3] "" ASDM
 SG_ ReSideRdrLeDetn149RdrDetnSts : 377|2@0+ (1,0) [0|3] "" ASDM
 SG_ ReSideRdrLeDetn150_UB : 482|1@0+ (1,0) [0|1] "" ASDM
 SG_ ReSideRdrLeDetn150RdrDetnAmbigState : 472|1@0+ (1,0) [0|1] "" ASDM
 SG_ ReSideRdrLeDetn150RdrDetnAssoTrkID : 479|7@0+ (1.0,0.0) [0.0|127.0] "Unitless" ASDM
 SG_ ReSideRdrLeDetn150RdrDetnAzi : 434|11@0+ (0.1,-90.0) [-90.0|90.0] "Deg" ASDM
 SG_ ReSideRdrLeDetn150RdrDetnChks : 407|8@0+ (1.0,0.0) [0.0|255.0] "Unitless" ASDM
 SG_ ReSideRdrLeDetn150RdrDetnCntr : 415|4@0+ (1.0,0.0) [0.0|15.0] "Unitless" ASDM
 SG_ ReSideRdrLeDetn150RdrDetnConf : 411|7@0+ (1.0,0.0) [0.0|100.0] "%" ASDM
 SG_ ReSideRdrLeDetn150RdrDetnElevn : 420|5@0+ (1.0,-15.0) [-15.0|15.0] "Deg" ASDM
 SG_ ReSideRdrLeDetn150RdrDetnPwr : 471|6@0+ (1.0,0.0) [0.0|63.0] "dB" ASDM
 SG_ ReSideRdrLeDetn150RdrDetnRng : 455|14@0+ (0.02,-1.0) [-1.0|200.0] "m" ASDM
 SG_ ReSideRdrLeDetn150RdrDetnRngV : 431|13@0+ (0.02,-80.0) [-80.0|80.0] "m/s" ASDM
 SG_ ReSideRdrLeDetn150RdrDetnSameRV : 465|2@0+ (1,0) [0|3] "" ASDM
 SG_ ReSideRdrLeDetn150RdrDetnSts : 457|2@0+ (1,0) [0|3] "" ASDM

BO_ 118 SODLPrivateCANFD5Fr59 : 64 SODL
 SG_ ReSideRdrLeDetn151_UB : 487|1@0+ (1,0) [0|1] "" ASDM
 SG_ ReSideRdrLeDetn151RdrDetnAmbigState : 72|1@0+ (1,0) [0|1] "" ASDM
 SG_ ReSideRdrLeDetn151RdrDetnAssoTrkID : 79|7@0+ (1.0,0.0) [0.0|127.0] "Unitless" ASDM
 SG_ ReSideRdrLeDetn151RdrDetnAzi : 34|11@0+ (0.1,-90.0) [-90.0|90.0] "Deg" ASDM
 SG_ ReSideRdrLeDetn151RdrDetnChks : 7|8@0+ (1.0,0.0) [0.0|255.0] "Unitless" ASDM
 SG_ ReSideRdrLeDetn151RdrDetnCntr : 15|4@0+ (1.0,0.0) [0.0|15.0] "Unitless" ASDM
 SG_ ReSideRdrLeDetn151RdrDetnConf : 11|7@0+ (1.0,0.0) [0.0|100.0] "%" ASDM
 SG_ ReSideRdrLeDetn151RdrDetnElevn : 20|5@0+ (1.0,-15.0) [-15.0|15.0] "Deg" ASDM
 SG_ ReSideRdrLeDetn151RdrDetnPwr : 71|6@0+ (1.0,0.0) [0.0|63.0] "dB" ASDM
 SG_ ReSideRdrLeDetn151RdrDetnRng : 55|14@0+ (0.02,-1.0) [-1.0|200.0] "m" ASDM
 SG_ ReSideRdrLeDetn151RdrDetnRngV : 31|13@0+ (0.02,-80.0) [-80.0|80.0] "m/s" ASDM
 SG_ ReSideRdrLeDetn151RdrDetnSameRV : 65|2@0+ (1,0) [0|3] "" ASDM
 SG_ ReSideRdrLeDetn151RdrDetnSts : 57|2@0+ (1,0) [0|3] "" ASDM
 SG_ ReSideRdrLeDetn152_UB : 486|1@0+ (1,0) [0|1] "" ASDM
 SG_ ReSideRdrLeDetn152RdrDetnAmbigState : 152|1@0+ (1,0) [0|1] "" ASDM
 SG_ ReSideRdrLeDetn152RdrDetnAssoTrkID : 159|7@0+ (1.0,0.0) [0.0|127.0] "Unitless" ASDM
 SG_ ReSideRdrLeDetn152RdrDetnAzi : 114|11@0+ (0.1,-90.0) [-90.0|90.0] "Deg" ASDM
 SG_ ReSideRdrLeDetn152RdrDetnChks : 87|8@0+ (1.0,0.0) [0.0|255.0] "Unitless" ASDM
 SG_ ReSideRdrLeDetn152RdrDetnCntr : 95|4@0+ (1.0,0.0) [0.0|15.0] "Unitless" ASDM
 SG_ ReSideRdrLeDetn152RdrDetnConf : 91|7@0+ (1.0,0.0) [0.0|100.0] "%" ASDM
 SG_ ReSideRdrLeDetn152RdrDetnElevn : 100|5@0+ (1.0,-15.0) [-15.0|15.0] "Deg" ASDM
 SG_ ReSideRdrLeDetn152RdrDetnPwr : 151|6@0+ (1.0,0.0) [0.0|63.0] "dB" ASDM
 SG_ ReSideRdrLeDetn152RdrDetnRng : 135|14@0+ (0.02,-1.0) [-1.0|200.0] "m" ASDM
 SG_ ReSideRdrLeDetn152RdrDetnRngV : 111|13@0+ (0.02,-80.0) [-80.0|80.0] "m/s" ASDM
 SG_ ReSideRdrLeDetn152RdrDetnSameRV : 145|2@0+ (1,0) [0|3] "" ASDM
 SG_ ReSideRdrLeDetn152RdrDetnSts : 137|2@0+ (1,0) [0|3] "" ASDM
 SG_ ReSideRdrLeDetn153_UB : 485|1@0+ (1,0) [0|1] "" ASDM
 SG_ ReSideRdrLeDetn153RdrDetnAmbigState : 232|1@0+ (1,0) [0|1] "" ASDM
 SG_ ReSideRdrLeDetn153RdrDetnAssoTrkID : 239|7@0+ (1.0,0.0) [0.0|127.0] "Unitless" ASDM
 SG_ ReSideRdrLeDetn153RdrDetnAzi : 194|11@0+ (0.1,-90.0) [-90.0|90.0] "Deg" ASDM
 SG_ ReSideRdrLeDetn153RdrDetnChks : 167|8@0+ (1.0,0.0) [0.0|255.0] "Unitless" ASDM
 SG_ ReSideRdrLeDetn153RdrDetnCntr : 175|4@0+ (1.0,0.0) [0.0|15.0] "Unitless" ASDM
 SG_ ReSideRdrLeDetn153RdrDetnConf : 171|7@0+ (1.0,0.0) [0.0|100.0] "%" ASDM
 SG_ ReSideRdrLeDetn153RdrDetnElevn : 180|5@0+ (1.0,-15.0) [-15.0|15.0] "Deg" ASDM
 SG_ ReSideRdrLeDetn153RdrDetnPwr : 231|6@0+ (1.0,0.0) [0.0|63.0] "dB" ASDM
 SG_ ReSideRdrLeDetn153RdrDetnRng : 215|14@0+ (0.02,-1.0) [-1.0|200.0] "m" ASDM
 SG_ ReSideRdrLeDetn153RdrDetnRngV : 191|13@0+ (0.02,-80.0) [-80.0|80.0] "m/s" ASDM
 SG_ ReSideRdrLeDetn153RdrDetnSameRV : 225|2@0+ (1,0) [0|3] "" ASDM
 SG_ ReSideRdrLeDetn153RdrDetnSts : 217|2@0+ (1,0) [0|3] "" ASDM
 SG_ ReSideRdrLeDetn154_UB : 484|1@0+ (1,0) [0|1] "" ASDM
 SG_ ReSideRdrLeDetn154RdrDetnAmbigState : 312|1@0+ (1,0) [0|1] "" ASDM
 SG_ ReSideRdrLeDetn154RdrDetnAssoTrkID : 319|7@0+ (1.0,0.0) [0.0|127.0] "Unitless" ASDM
 SG_ ReSideRdrLeDetn154RdrDetnAzi : 274|11@0+ (0.1,-90.0) [-90.0|90.0] "Deg" ASDM
 SG_ ReSideRdrLeDetn154RdrDetnChks : 247|8@0+ (1.0,0.0) [0.0|255.0] "Unitless" ASDM
 SG_ ReSideRdrLeDetn154RdrDetnCntr : 255|4@0+ (1.0,0.0) [0.0|15.0] "Unitless" ASDM
 SG_ ReSideRdrLeDetn154RdrDetnConf : 251|7@0+ (1.0,0.0) [0.0|100.0] "%" ASDM
 SG_ ReSideRdrLeDetn154RdrDetnElevn : 260|5@0+ (1.0,-15.0) [-15.0|15.0] "Deg" ASDM
 SG_ ReSideRdrLeDetn154RdrDetnPwr : 311|6@0+ (1.0,0.0) [0.0|63.0] "dB" ASDM
 SG_ ReSideRdrLeDetn154RdrDetnRng : 295|14@0+ (0.02,-1.0) [-1.0|200.0] "m" ASDM
 SG_ ReSideRdrLeDetn154RdrDetnRngV : 271|13@0+ (0.02,-80.0) [-80.0|80.0] "m/s" ASDM
 SG_ ReSideRdrLeDetn154RdrDetnSameRV : 305|2@0+ (1,0) [0|3] "" ASDM
 SG_ ReSideRdrLeDetn154RdrDetnSts : 297|2@0+ (1,0) [0|3] "" ASDM
 SG_ ReSideRdrLeDetn155_UB : 483|1@0+ (1,0) [0|1] "" ASDM
 SG_ ReSideRdrLeDetn155RdrDetnAmbigState : 392|1@0+ (1,0) [0|1] "" ASDM
 SG_ ReSideRdrLeDetn155RdrDetnAssoTrkID : 399|7@0+ (1.0,0.0) [0.0|127.0] "Unitless" ASDM
 SG_ ReSideRdrLeDetn155RdrDetnAzi : 354|11@0+ (0.1,-90.0) [-90.0|90.0] "Deg" ASDM
 SG_ ReSideRdrLeDetn155RdrDetnChks : 327|8@0+ (1.0,0.0) [0.0|255.0] "Unitless" ASDM
 SG_ ReSideRdrLeDetn155RdrDetnCntr : 335|4@0+ (1.0,0.0) [0.0|15.0] "Unitless" ASDM
 SG_ ReSideRdrLeDetn155RdrDetnConf : 331|7@0+ (1.0,0.0) [0.0|100.0] "%" ASDM
 SG_ ReSideRdrLeDetn155RdrDetnElevn : 340|5@0+ (1.0,-15.0) [-15.0|15.0] "Deg" ASDM
 SG_ ReSideRdrLeDetn155RdrDetnPwr : 391|6@0+ (1.0,0.0) [0.0|63.0] "dB" ASDM
 SG_ ReSideRdrLeDetn155RdrDetnRng : 375|14@0+ (0.02,-1.0) [-1.0|200.0] "m" ASDM
 SG_ ReSideRdrLeDetn155RdrDetnRngV : 351|13@0+ (0.02,-80.0) [-80.0|80.0] "m/s" ASDM
 SG_ ReSideRdrLeDetn155RdrDetnSameRV : 385|2@0+ (1,0) [0|3] "" ASDM
 SG_ ReSideRdrLeDetn155RdrDetnSts : 377|2@0+ (1,0) [0|3] "" ASDM
 SG_ ReSideRdrLeDetn156_UB : 482|1@0+ (1,0) [0|1] "" ASDM
 SG_ ReSideRdrLeDetn156RdrDetnAmbigState : 472|1@0+ (1,0) [0|1] "" ASDM
 SG_ ReSideRdrLeDetn156RdrDetnAssoTrkID : 479|7@0+ (1.0,0.0) [0.0|127.0] "Unitless" ASDM
 SG_ ReSideRdrLeDetn156RdrDetnAzi : 434|11@0+ (0.1,-90.0) [-90.0|90.0] "Deg" ASDM
 SG_ ReSideRdrLeDetn156RdrDetnChks : 407|8@0+ (1.0,0.0) [0.0|255.0] "Unitless" ASDM
 SG_ ReSideRdrLeDetn156RdrDetnCntr : 415|4@0+ (1.0,0.0) [0.0|15.0] "Unitless" ASDM
 SG_ ReSideRdrLeDetn156RdrDetnConf : 411|7@0+ (1.0,0.0) [0.0|100.0] "%" ASDM
 SG_ ReSideRdrLeDetn156RdrDetnElevn : 420|5@0+ (1.0,-15.0) [-15.0|15.0] "Deg" ASDM
 SG_ ReSideRdrLeDetn156RdrDetnPwr : 471|6@0+ (1.0,0.0) [0.0|63.0] "dB" ASDM
 SG_ ReSideRdrLeDetn156RdrDetnRng : 455|14@0+ (0.02,-1.0) [-1.0|200.0] "m" ASDM
 SG_ ReSideRdrLeDetn156RdrDetnRngV : 431|13@0+ (0.02,-80.0) [-80.0|80.0] "m/s" ASDM
 SG_ ReSideRdrLeDetn156RdrDetnSameRV : 465|2@0+ (1,0) [0|3] "" ASDM
 SG_ ReSideRdrLeDetn156RdrDetnSts : 457|2@0+ (1,0) [0|3] "" ASDM

CM_ SG_ 113 ReSideRdrLeDetn121RdrDetnAmbigState "Dection ambiguous status";
CM_ SG_ 113 ReSideRdrLeDetn121RdrDetnAssoTrkID "Associated tracker ID
";
CM_ SG_ 113 ReSideRdrLeDetn121RdrDetnAzi "Refer to the data element description in ReSideRdrLeDetn1 with the same data element name";
CM_ SG_ 113 ReSideRdrLeDetn121RdrDetnChks "Refer to the data element description in ReSideRdrLeDetn1 with the same data element name";
CM_ SG_ 113 ReSideRdrLeDetn121RdrDetnCntr "Refer to the data element description in ReSideRdrLeDetn1 with the same data element name";
CM_ SG_ 113 ReSideRdrLeDetn121RdrDetnConf "Refer to the data element description in ReSideRdrLeDetn1 with the same data element name";
CM_ SG_ 113 ReSideRdrLeDetn121RdrDetnElevn "Refer to the data element description in ReSideRdrLeDetn1 with the same data element name";
CM_ SG_ 113 ReSideRdrLeDetn121RdrDetnPwr "Refer to the data element description in ReSideRdrLeDetn1 with the same data element name";
CM_ SG_ 113 ReSideRdrLeDetn121RdrDetnRng "Refer to the data element description in ReSideRdrLeDetn1 with the same data element name";
CM_ SG_ 113 ReSideRdrLeDetn121RdrDetnRngV "Range Velocity";
CM_ SG_ 113 ReSideRdrLeDetn121RdrDetnSameRV "object with same distance and speed";
CM_ SG_ 113 ReSideRdrLeDetn121RdrDetnSts "Refer to the data element description in ReSideRdrLeDetn1 with the same data element name";
CM_ SG_ 113 ReSideRdrLeDetn122RdrDetnAmbigState "Dection ambiguous status";
CM_ SG_ 113 ReSideRdrLeDetn122RdrDetnAssoTrkID "Associated tracker ID
";
CM_ SG_ 113 ReSideRdrLeDetn122RdrDetnAzi "Refer to the data element description in ReSideRdrLeDetn1 with the same data element name";
CM_ SG_ 113 ReSideRdrLeDetn122RdrDetnChks "Refer to the data element description in ReSideRdrLeDetn1 with the same data element name";
CM_ SG_ 113 ReSideRdrLeDetn122RdrDetnCntr "Refer to the data element description in ReSideRdrLeDetn1 with the same data element name";
CM_ SG_ 113 ReSideRdrLeDetn122RdrDetnConf "Refer to the data element description in ReSideRdrLeDetn1 with the same data element name";
CM_ SG_ 113 ReSideRdrLeDetn122RdrDetnElevn "Refer to the data element description in ReSideRdrLeDetn1 with the same data element name";
CM_ SG_ 113 ReSideRdrLeDetn122RdrDetnPwr "Refer to the data element description in ReSideRdrLeDetn1 with the same data element name";
CM_ SG_ 113 ReSideRdrLeDetn122RdrDetnRng "Refer to the data element description in ReSideRdrLeDetn1 with the same data element name";
CM_ SG_ 113 ReSideRdrLeDetn122RdrDetnRngV "Range Velocity";
CM_ SG_ 113 ReSideRdrLeDetn122RdrDetnSameRV "object with same distance and speed";
CM_ SG_ 113 ReSideRdrLeDetn122RdrDetnSts "Refer to the data element description in ReSideRdrLeDetn1 with the same data element name";
CM_ SG_ 113 ReSideRdrLeDetn123RdrDetnAmbigState "Dection ambiguous status";
CM_ SG_ 113 ReSideRdrLeDetn123RdrDetnAssoTrkID "Associated tracker ID
";
CM_ SG_ 113 ReSideRdrLeDetn123RdrDetnAzi "Refer to the data element description in ReSideRdrLeDetn1 with the same data element name";
CM_ SG_ 113 ReSideRdrLeDetn123RdrDetnChks "Refer to the data element description in ReSideRdrLeDetn1 with the same data element name";
CM_ SG_ 113 ReSideRdrLeDetn123RdrDetnCntr "Refer to the data element description in ReSideRdrLeDetn1 with the same data element name";
CM_ SG_ 113 ReSideRdrLeDetn123RdrDetnConf "Refer to the data element description in ReSideRdrLeDetn1 with the same data element name";
CM_ SG_ 113 ReSideRdrLeDetn123RdrDetnElevn "Refer to the data element description in ReSideRdrLeDetn1 with the same data element name";
CM_ SG_ 113 ReSideRdrLeDetn123RdrDetnPwr "Refer to the data element description in ReSideRdrLeDetn1 with the same data element name";
CM_ SG_ 113 ReSideRdrLeDetn123RdrDetnRng "Refer to the data element description in ReSideRdrLeDetn1 with the same data element name";
CM_ SG_ 113 ReSideRdrLeDetn123RdrDetnRngV "Range Velocity";
CM_ SG_ 113 ReSideRdrLeDetn123RdrDetnSameRV "object with same distance and speed";
CM_ SG_ 113 ReSideRdrLeDetn123RdrDetnSts "Refer to the data element description in ReSideRdrLeDetn1 with the same data element name";
CM_ SG_ 113 ReSideRdrLeDetn124RdrDetnAmbigState "Dection ambiguous status";
CM_ SG_ 113 ReSideRdrLeDetn124RdrDetnAssoTrkID "Associated tracker ID
";
CM_ SG_ 113 ReSideRdrLeDetn124RdrDetnAzi "Refer to the data element description in ReSideRdrLeDetn1 with the same data element name";
CM_ SG_ 113 ReSideRdrLeDetn124RdrDetnChks "Refer to the data element description in ReSideRdrLeDetn1 with the same data element name";
CM_ SG_ 113 ReSideRdrLeDetn124RdrDetnCntr "Refer to the data element description in ReSideRdrLeDetn1 with the same data element name";
CM_ SG_ 113 ReSideRdrLeDetn124RdrDetnConf "Refer to the data element description in ReSideRdrLeDetn1 with the same data element name";
CM_ SG_ 113 ReSideRdrLeDetn124RdrDetnElevn "Refer to the data element description in ReSideRdrLeDetn1 with the same data element name";
CM_ SG_ 113 ReSideRdrLeDetn124RdrDetnPwr "Refer to the data element description in ReSideRdrLeDetn1 with the same data element name";
CM_ SG_ 113 ReSideRdrLeDetn124RdrDetnRng "Refer to the data element description in ReSideRdrLeDetn1 with the same data element name";
CM_ SG_ 113 ReSideRdrLeDetn124RdrDetnRngV "Range Velocity";
CM_ SG_ 113 ReSideRdrLeDetn124RdrDetnSameRV "object with same distance and speed";
CM_ SG_ 113 ReSideRdrLeDetn124RdrDetnSts "Refer to the data element description in ReSideRdrLeDetn1 with the same data element name";
CM_ SG_ 113 ReSideRdrLeDetn125RdrDetnAmbigState "Dection ambiguous status";
CM_ SG_ 113 ReSideRdrLeDetn125RdrDetnAssoTrkID "Associated tracker ID
";
CM_ SG_ 113 ReSideRdrLeDetn125RdrDetnAzi "Refer to the data element description in ReSideRdrLeDetn1 with the same data element name";
CM_ SG_ 113 ReSideRdrLeDetn125RdrDetnChks "Refer to the data element description in ReSideRdrLeDetn1 with the same data element name";
CM_ SG_ 113 ReSideRdrLeDetn125RdrDetnCntr "Refer to the data element description in ReSideRdrLeDetn1 with the same data element name";
CM_ SG_ 113 ReSideRdrLeDetn125RdrDetnConf "Refer to the data element description in ReSideRdrLeDetn1 with the same data element name";
CM_ SG_ 113 ReSideRdrLeDetn125RdrDetnElevn "Refer to the data element description in ReSideRdrLeDetn1 with the same data element name";
CM_ SG_ 113 ReSideRdrLeDetn125RdrDetnPwr "Refer to the data element description in ReSideRdrLeDetn1 with the same data element name";
CM_ SG_ 113 ReSideRdrLeDetn125RdrDetnRng "Refer to the data element description in ReSideRdrLeDetn1 with the same data element name";
CM_ SG_ 113 ReSideRdrLeDetn125RdrDetnRngV "Range Velocity";
CM_ SG_ 113 ReSideRdrLeDetn125RdrDetnSameRV "object with same distance and speed";
CM_ SG_ 113 ReSideRdrLeDetn125RdrDetnSts "Refer to the data element description in ReSideRdrLeDetn1 with the same data element name";
CM_ SG_ 113 ReSideRdrLeDetn126RdrDetnAmbigState "Dection ambiguous status";
CM_ SG_ 113 ReSideRdrLeDetn126RdrDetnAssoTrkID "Associated tracker ID
";
CM_ SG_ 113 ReSideRdrLeDetn126RdrDetnAzi "Refer to the data element description in ReSideRdrLeDetn1 with the same data element name";
CM_ SG_ 113 ReSideRdrLeDetn126RdrDetnChks "Refer to the data element description in ReSideRdrLeDetn1 with the same data element name";
CM_ SG_ 113 ReSideRdrLeDetn126RdrDetnCntr "Refer to the data element description in ReSideRdrLeDetn1 with the same data element name";
CM_ SG_ 113 ReSideRdrLeDetn126RdrDetnConf "Refer to the data element description in ReSideRdrLeDetn1 with the same data element name";
CM_ SG_ 113 ReSideRdrLeDetn126RdrDetnElevn "Refer to the data element description in ReSideRdrLeDetn1 with the same data element name";
CM_ SG_ 113 ReSideRdrLeDetn126RdrDetnPwr "Refer to the data element description in ReSideRdrLeDetn1 with the same data element name";
CM_ SG_ 113 ReSideRdrLeDetn126RdrDetnRng "Refer to the data element description in ReSideRdrLeDetn1 with the same data element name";
CM_ SG_ 113 ReSideRdrLeDetn126RdrDetnRngV "Range Velocity";
CM_ SG_ 113 ReSideRdrLeDetn126RdrDetnSameRV "object with same distance and speed";
CM_ SG_ 113 ReSideRdrLeDetn126RdrDetnSts "Refer to the data element description in ReSideRdrLeDetn1 with the same data element name";
CM_ SG_ 114 ReSideRdrLeDetn127RdrDetnAmbigState "Dection ambiguous status";
CM_ SG_ 114 ReSideRdrLeDetn127RdrDetnAssoTrkID "Associated tracker ID
";
CM_ SG_ 114 ReSideRdrLeDetn127RdrDetnAzi "Refer to the data element description in ReSideRdrLeDetn1 with the same data element name";
CM_ SG_ 114 ReSideRdrLeDetn127RdrDetnChks "Refer to the data element description in ReSideRdrLeDetn1 with the same data element name";
CM_ SG_ 114 ReSideRdrLeDetn127RdrDetnCntr "Refer to the data element description in ReSideRdrLeDetn1 with the same data element name";
CM_ SG_ 114 ReSideRdrLeDetn127RdrDetnConf "Refer to the data element description in ReSideRdrLeDetn1 with the same data element name";
CM_ SG_ 114 ReSideRdrLeDetn127RdrDetnElevn "Refer to the data element description in ReSideRdrLeDetn1 with the same data element name";
CM_ SG_ 114 ReSideRdrLeDetn127RdrDetnPwr "Refer to the data element description in ReSideRdrLeDetn1 with the same data element name";
CM_ SG_ 114 ReSideRdrLeDetn127RdrDetnRng "Refer to the data element description in ReSideRdrLeDetn1 with the same data element name";
CM_ SG_ 114 ReSideRdrLeDetn127RdrDetnRngV "Range Velocity";
CM_ SG_ 114 ReSideRdrLeDetn127RdrDetnSameRV "object with same distance and speed";
CM_ SG_ 114 ReSideRdrLeDetn127RdrDetnSts "Refer to the data element description in ReSideRdrLeDetn1 with the same data element name";
CM_ SG_ 114 ReSideRdrLeDetn128RdrDetnAmbigState "Dection ambiguous status";
CM_ SG_ 114 ReSideRdrLeDetn128RdrDetnAssoTrkID "Associated tracker ID
";
CM_ SG_ 114 ReSideRdrLeDetn128RdrDetnAzi "Refer to the data element description in ReSideRdrLeDetn1 with the same data element name";
CM_ SG_ 114 ReSideRdrLeDetn128RdrDetnChks "Refer to the data element description in ReSideRdrLeDetn1 with the same data element name";
CM_ SG_ 114 ReSideRdrLeDetn128RdrDetnCntr "Refer to the data element description in ReSideRdrLeDetn1 with the same data element name";
CM_ SG_ 114 ReSideRdrLeDetn128RdrDetnConf "Refer to the data element description in ReSideRdrLeDetn1 with the same data element name";
CM_ SG_ 114 ReSideRdrLeDetn128RdrDetnElevn "Refer to the data element description in ReSideRdrLeDetn1 with the same data element name";
CM_ SG_ 114 ReSideRdrLeDetn128RdrDetnPwr "Refer to the data element description in ReSideRdrLeDetn1 with the same data element name";
CM_ SG_ 114 ReSideRdrLeDetn128RdrDetnRng "Refer to the data element description in ReSideRdrLeDetn1 with the same data element name";
CM_ SG_ 114 ReSideRdrLeDetn128RdrDetnRngV "Range Velocity";
CM_ SG_ 114 ReSideRdrLeDetn128RdrDetnSameRV "object with same distance and speed";
CM_ SG_ 114 ReSideRdrLeDetn128RdrDetnSts "Refer to the data element description in ReSideRdrLeDetn1 with the same data element name";
CM_ SG_ 114 ReSideRdrLeDetn129RdrDetnAmbigState "Dection ambiguous status";
CM_ SG_ 114 ReSideRdrLeDetn129RdrDetnAssoTrkID "Associated tracker ID
";
CM_ SG_ 114 ReSideRdrLeDetn129RdrDetnAzi "Refer to the data element description in ReSideRdrLeDetn1 with the same data element name";
CM_ SG_ 114 ReSideRdrLeDetn129RdrDetnChks "Refer to the data element description in ReSideRdrLeDetn1 with the same data element name";
CM_ SG_ 114 ReSideRdrLeDetn129RdrDetnCntr "Refer to the data element description in ReSideRdrLeDetn1 with the same data element name";
CM_ SG_ 114 ReSideRdrLeDetn129RdrDetnConf "Refer to the data element description in ReSideRdrLeDetn1 with the same data element name";
CM_ SG_ 114 ReSideRdrLeDetn129RdrDetnElevn "Refer to the data element description in ReSideRdrLeDetn1 with the same data element name";
CM_ SG_ 114 ReSideRdrLeDetn129RdrDetnPwr "Refer to the data element description in ReSideRdrLeDetn1 with the same data element name";
CM_ SG_ 114 ReSideRdrLeDetn129RdrDetnRng "Refer to the data element description in ReSideRdrLeDetn1 with the same data element name";
CM_ SG_ 114 ReSideRdrLeDetn129RdrDetnRngV "Range Velocity";
CM_ SG_ 114 ReSideRdrLeDetn129RdrDetnSameRV "object with same distance and speed";
CM_ SG_ 114 ReSideRdrLeDetn129RdrDetnSts "Refer to the data element description in ReSideRdrLeDetn1 with the same data element name";
CM_ SG_ 114 ReSideRdrLeDetn130RdrDetnAmbigState "Dection ambiguous status";
CM_ SG_ 114 ReSideRdrLeDetn130RdrDetnAssoTrkID "Associated tracker ID
";
CM_ SG_ 114 ReSideRdrLeDetn130RdrDetnAzi "Refer to the data element description in ReSideRdrLeDetn1 with the same data element name";
CM_ SG_ 114 ReSideRdrLeDetn130RdrDetnChks "Refer to the data element description in ReSideRdrLeDetn1 with the same data element name";
CM_ SG_ 114 ReSideRdrLeDetn130RdrDetnCntr "Refer to the data element description in ReSideRdrLeDetn1 with the same data element name";
CM_ SG_ 114 ReSideRdrLeDetn130RdrDetnConf "Refer to the data element description in ReSideRdrLeDetn1 with the same data element name";
CM_ SG_ 114 ReSideRdrLeDetn130RdrDetnElevn "Refer to the data element description in ReSideRdrLeDetn1 with the same data element name";
CM_ SG_ 114 ReSideRdrLeDetn130RdrDetnPwr "Refer to the data element description in ReSideRdrLeDetn1 with the same data element name";
CM_ SG_ 114 ReSideRdrLeDetn130RdrDetnRng "Refer to the data element description in ReSideRdrLeDetn1 with the same data element name";
CM_ SG_ 114 ReSideRdrLeDetn130RdrDetnRngV "Range Velocity";
CM_ SG_ 114 ReSideRdrLeDetn130RdrDetnSameRV "object with same distance and speed";
CM_ SG_ 114 ReSideRdrLeDetn130RdrDetnSts "Refer to the data element description in ReSideRdrLeDetn1 with the same data element name";
CM_ SG_ 114 ReSideRdrLeDetn131RdrDetnAmbigState "Dection ambiguous status";
CM_ SG_ 114 ReSideRdrLeDetn131RdrDetnAssoTrkID "Associated tracker ID
";
CM_ SG_ 114 ReSideRdrLeDetn131RdrDetnAzi "Refer to the data element description in ReSideRdrLeDetn1 with the same data element name";
CM_ SG_ 114 ReSideRdrLeDetn131RdrDetnChks "Refer to the data element description in ReSideRdrLeDetn1 with the same data element name";
CM_ SG_ 114 ReSideRdrLeDetn131RdrDetnCntr "Refer to the data element description in ReSideRdrLeDetn1 with the same data element name";
CM_ SG_ 114 ReSideRdrLeDetn131RdrDetnConf "Refer to the data element description in ReSideRdrLeDetn1 with the same data element name";
CM_ SG_ 114 ReSideRdrLeDetn131RdrDetnElevn "Refer to the data element description in ReSideRdrLeDetn1 with the same data element name";
CM_ SG_ 114 ReSideRdrLeDetn131RdrDetnPwr "Refer to the data element description in ReSideRdrLeDetn1 with the same data element name";
CM_ SG_ 114 ReSideRdrLeDetn131RdrDetnRng "Refer to the data element description in ReSideRdrLeDetn1 with the same data element name";
CM_ SG_ 114 ReSideRdrLeDetn131RdrDetnRngV "Range Velocity";
CM_ SG_ 114 ReSideRdrLeDetn131RdrDetnSameRV "object with same distance and speed";
CM_ SG_ 114 ReSideRdrLeDetn131RdrDetnSts "Refer to the data element description in ReSideRdrLeDetn1 with the same data element name";
CM_ SG_ 114 ReSideRdrLeDetn132RdrDetnAmbigState "Dection ambiguous status";
CM_ SG_ 114 ReSideRdrLeDetn132RdrDetnAssoTrkID "Associated tracker ID
";
CM_ SG_ 114 ReSideRdrLeDetn132RdrDetnAzi "Refer to the data element description in ReSideRdrLeDetn1 with the same data element name";
CM_ SG_ 114 ReSideRdrLeDetn132RdrDetnChks "Refer to the data element description in ReSideRdrLeDetn1 with the same data element name";
CM_ SG_ 114 ReSideRdrLeDetn132RdrDetnCntr "Refer to the data element description in ReSideRdrLeDetn1 with the same data element name";
CM_ SG_ 114 ReSideRdrLeDetn132RdrDetnConf "Refer to the data element description in ReSideRdrLeDetn1 with the same data element name";
CM_ SG_ 114 ReSideRdrLeDetn132RdrDetnElevn "Refer to the data element description in ReSideRdrLeDetn1 with the same data element name";
CM_ SG_ 114 ReSideRdrLeDetn132RdrDetnPwr "Refer to the data element description in ReSideRdrLeDetn1 with the same data element name";
CM_ SG_ 114 ReSideRdrLeDetn132RdrDetnRng "Refer to the data element description in ReSideRdrLeDetn1 with the same data element name";
CM_ SG_ 114 ReSideRdrLeDetn132RdrDetnRngV "Range Velocity";
CM_ SG_ 114 ReSideRdrLeDetn132RdrDetnSameRV "object with same distance and speed";
CM_ SG_ 114 ReSideRdrLeDetn132RdrDetnSts "Refer to the data element description in ReSideRdrLeDetn1 with the same data element name";
CM_ SG_ 115 ReSideRdrLeDetn133RdrDetnAmbigState "Dection ambiguous status";
CM_ SG_ 115 ReSideRdrLeDetn133RdrDetnAssoTrkID "Associated tracker ID
";
CM_ SG_ 115 ReSideRdrLeDetn133RdrDetnAzi "Refer to the data element description in ReSideRdrLeDetn1 with the same data element name";
CM_ SG_ 115 ReSideRdrLeDetn133RdrDetnChks "Refer to the data element description in ReSideRdrLeDetn1 with the same data element name";
CM_ SG_ 115 ReSideRdrLeDetn133RdrDetnCntr "Refer to the data element description in ReSideRdrLeDetn1 with the same data element name";
CM_ SG_ 115 ReSideRdrLeDetn133RdrDetnConf "Refer to the data element description in ReSideRdrLeDetn1 with the same data element name";
CM_ SG_ 115 ReSideRdrLeDetn133RdrDetnElevn "Refer to the data element description in ReSideRdrLeDetn1 with the same data element name";
CM_ SG_ 115 ReSideRdrLeDetn133RdrDetnPwr "Refer to the data element description in ReSideRdrLeDetn1 with the same data element name";
CM_ SG_ 115 ReSideRdrLeDetn133RdrDetnRng "Refer to the data element description in ReSideRdrLeDetn1 with the same data element name";
CM_ SG_ 115 ReSideRdrLeDetn133RdrDetnRngV "Range Velocity";
CM_ SG_ 115 ReSideRdrLeDetn133RdrDetnSameRV "object with same distance and speed";
CM_ SG_ 115 ReSideRdrLeDetn133RdrDetnSts "Refer to the data element description in ReSideRdrLeDetn1 with the same data element name";
CM_ SG_ 115 ReSideRdrLeDetn134RdrDetnAmbigState "Dection ambiguous status";
CM_ SG_ 115 ReSideRdrLeDetn134RdrDetnAssoTrkID "Associated tracker ID
";
CM_ SG_ 115 ReSideRdrLeDetn134RdrDetnAzi "Refer to the data element description in ReSideRdrLeDetn1 with the same data element name";
CM_ SG_ 115 ReSideRdrLeDetn134RdrDetnChks "Refer to the data element description in ReSideRdrLeDetn1 with the same data element name";
CM_ SG_ 115 ReSideRdrLeDetn134RdrDetnCntr "Refer to the data element description in ReSideRdrLeDetn1 with the same data element name";
CM_ SG_ 115 ReSideRdrLeDetn134RdrDetnConf "Refer to the data element description in ReSideRdrLeDetn1 with the same data element name";
CM_ SG_ 115 ReSideRdrLeDetn134RdrDetnElevn "Refer to the data element description in ReSideRdrLeDetn1 with the same data element name";
CM_ SG_ 115 ReSideRdrLeDetn134RdrDetnPwr "Refer to the data element description in ReSideRdrLeDetn1 with the same data element name";
CM_ SG_ 115 ReSideRdrLeDetn134RdrDetnRng "Refer to the data element description in ReSideRdrLeDetn1 with the same data element name";
CM_ SG_ 115 ReSideRdrLeDetn134RdrDetnRngV "Range Velocity";
CM_ SG_ 115 ReSideRdrLeDetn134RdrDetnSameRV "object with same distance and speed";
CM_ SG_ 115 ReSideRdrLeDetn134RdrDetnSts "Refer to the data element description in ReSideRdrLeDetn1 with the same data element name";
CM_ SG_ 115 ReSideRdrLeDetn135RdrDetnAmbigState "Dection ambiguous status";
CM_ SG_ 115 ReSideRdrLeDetn135RdrDetnAssoTrkID "Associated tracker ID
";
CM_ SG_ 115 ReSideRdrLeDetn135RdrDetnAzi "Refer to the data element description in ReSideRdrLeDetn1 with the same data element name";
CM_ SG_ 115 ReSideRdrLeDetn135RdrDetnChks "Refer to the data element description in ReSideRdrLeDetn1 with the same data element name";
CM_ SG_ 115 ReSideRdrLeDetn135RdrDetnCntr "Refer to the data element description in ReSideRdrLeDetn1 with the same data element name";
CM_ SG_ 115 ReSideRdrLeDetn135RdrDetnConf "Refer to the data element description in ReSideRdrLeDetn1 with the same data element name";
CM_ SG_ 115 ReSideRdrLeDetn135RdrDetnElevn "Refer to the data element description in ReSideRdrLeDetn1 with the same data element name";
CM_ SG_ 115 ReSideRdrLeDetn135RdrDetnPwr "Refer to the data element description in ReSideRdrLeDetn1 with the same data element name";
CM_ SG_ 115 ReSideRdrLeDetn135RdrDetnRng "Refer to the data element description in ReSideRdrLeDetn1 with the same data element name";
CM_ SG_ 115 ReSideRdrLeDetn135RdrDetnRngV "Range Velocity";
CM_ SG_ 115 ReSideRdrLeDetn135RdrDetnSameRV "object with same distance and speed";
CM_ SG_ 115 ReSideRdrLeDetn135RdrDetnSts "Refer to the data element description in ReSideRdrLeDetn1 with the same data element name";
CM_ SG_ 115 ReSideRdrLeDetn136RdrDetnAmbigState "Dection ambiguous status";
CM_ SG_ 115 ReSideRdrLeDetn136RdrDetnAssoTrkID "Associated tracker ID
";
CM_ SG_ 115 ReSideRdrLeDetn136RdrDetnAzi "Refer to the data element description in ReSideRdrLeDetn1 with the same data element name";
CM_ SG_ 115 ReSideRdrLeDetn136RdrDetnChks "Refer to the data element description in ReSideRdrLeDetn1 with the same data element name";
CM_ SG_ 115 ReSideRdrLeDetn136RdrDetnCntr "Refer to the data element description in ReSideRdrLeDetn1 with the same data element name";
CM_ SG_ 115 ReSideRdrLeDetn136RdrDetnConf "Refer to the data element description in ReSideRdrLeDetn1 with the same data element name";
CM_ SG_ 115 ReSideRdrLeDetn136RdrDetnElevn "Refer to the data element description in ReSideRdrLeDetn1 with the same data element name";
CM_ SG_ 115 ReSideRdrLeDetn136RdrDetnPwr "Refer to the data element description in ReSideRdrLeDetn1 with the same data element name";
CM_ SG_ 115 ReSideRdrLeDetn136RdrDetnRng "Refer to the data element description in ReSideRdrLeDetn1 with the same data element name";
CM_ SG_ 115 ReSideRdrLeDetn136RdrDetnRngV "Range Velocity";
CM_ SG_ 115 ReSideRdrLeDetn136RdrDetnSameRV "object with same distance and speed";
CM_ SG_ 115 ReSideRdrLeDetn136RdrDetnSts "Refer to the data element description in ReSideRdrLeDetn1 with the same data element name";
CM_ SG_ 115 ReSideRdrLeDetn137RdrDetnAmbigState "Dection ambiguous status";
CM_ SG_ 115 ReSideRdrLeDetn137RdrDetnAssoTrkID "Associated tracker ID
";
CM_ SG_ 115 ReSideRdrLeDetn137RdrDetnAzi "Refer to the data element description in ReSideRdrLeDetn1 with the same data element name";
CM_ SG_ 115 ReSideRdrLeDetn137RdrDetnChks "Refer to the data element description in ReSideRdrLeDetn1 with the same data element name";
CM_ SG_ 115 ReSideRdrLeDetn137RdrDetnCntr "Refer to the data element description in ReSideRdrLeDetn1 with the same data element name";
CM_ SG_ 115 ReSideRdrLeDetn137RdrDetnConf "Refer to the data element description in ReSideRdrLeDetn1 with the same data element name";
CM_ SG_ 115 ReSideRdrLeDetn137RdrDetnElevn "Refer to the data element description in ReSideRdrLeDetn1 with the same data element name";
CM_ SG_ 115 ReSideRdrLeDetn137RdrDetnPwr "Refer to the data element description in ReSideRdrLeDetn1 with the same data element name";
CM_ SG_ 115 ReSideRdrLeDetn137RdrDetnRng "Refer to the data element description in ReSideRdrLeDetn1 with the same data element name";
CM_ SG_ 115 ReSideRdrLeDetn137RdrDetnRngV "Range Velocity";
CM_ SG_ 115 ReSideRdrLeDetn137RdrDetnSameRV "object with same distance and speed";
CM_ SG_ 115 ReSideRdrLeDetn137RdrDetnSts "Refer to the data element description in ReSideRdrLeDetn1 with the same data element name";
CM_ SG_ 115 ReSideRdrLeDetn138RdrDetnAmbigState "Dection ambiguous status";
CM_ SG_ 115 ReSideRdrLeDetn138RdrDetnAssoTrkID "Associated tracker ID
";
CM_ SG_ 115 ReSideRdrLeDetn138RdrDetnAzi "Refer to the data element description in ReSideRdrLeDetn1 with the same data element name";
CM_ SG_ 115 ReSideRdrLeDetn138RdrDetnChks "Refer to the data element description in ReSideRdrLeDetn1 with the same data element name";
CM_ SG_ 115 ReSideRdrLeDetn138RdrDetnCntr "Refer to the data element description in ReSideRdrLeDetn1 with the same data element name";
CM_ SG_ 115 ReSideRdrLeDetn138RdrDetnConf "Refer to the data element description in ReSideRdrLeDetn1 with the same data element name";
CM_ SG_ 115 ReSideRdrLeDetn138RdrDetnElevn "Refer to the data element description in ReSideRdrLeDetn1 with the same data element name";
CM_ SG_ 115 ReSideRdrLeDetn138RdrDetnPwr "Refer to the data element description in ReSideRdrLeDetn1 with the same data element name";
CM_ SG_ 115 ReSideRdrLeDetn138RdrDetnRng "Refer to the data element description in ReSideRdrLeDetn1 with the same data element name";
CM_ SG_ 115 ReSideRdrLeDetn138RdrDetnRngV "Range Velocity";
CM_ SG_ 115 ReSideRdrLeDetn138RdrDetnSameRV "object with same distance and speed";
CM_ SG_ 115 ReSideRdrLeDetn138RdrDetnSts "Refer to the data element description in ReSideRdrLeDetn1 with the same data element name";
CM_ SG_ 116 ReSideRdrLeDetn139RdrDetnAmbigState "Dection ambiguous status";
CM_ SG_ 116 ReSideRdrLeDetn139RdrDetnAssoTrkID "Associated tracker ID
";
CM_ SG_ 116 ReSideRdrLeDetn139RdrDetnAzi "Refer to the data element description in ReSideRdrLeDetn1 with the same data element name";
CM_ SG_ 116 ReSideRdrLeDetn139RdrDetnChks "Refer to the data element description in ReSideRdrLeDetn1 with the same data element name";
CM_ SG_ 116 ReSideRdrLeDetn139RdrDetnCntr "Refer to the data element description in ReSideRdrLeDetn1 with the same data element name";
CM_ SG_ 116 ReSideRdrLeDetn139RdrDetnConf "Refer to the data element description in ReSideRdrLeDetn1 with the same data element name";
CM_ SG_ 116 ReSideRdrLeDetn139RdrDetnElevn "Refer to the data element description in ReSideRdrLeDetn1 with the same data element name";
CM_ SG_ 116 ReSideRdrLeDetn139RdrDetnPwr "Refer to the data element description in ReSideRdrLeDetn1 with the same data element name";
CM_ SG_ 116 ReSideRdrLeDetn139RdrDetnRng "Refer to the data element description in ReSideRdrLeDetn1 with the same data element name";
CM_ SG_ 116 ReSideRdrLeDetn139RdrDetnRngV "Range Velocity";
CM_ SG_ 116 ReSideRdrLeDetn139RdrDetnSameRV "object with same distance and speed";
CM_ SG_ 116 ReSideRdrLeDetn139RdrDetnSts "Refer to the data element description in ReSideRdrLeDetn1 with the same data element name";
CM_ SG_ 116 ReSideRdrLeDetn140RdrDetnAmbigState "Dection ambiguous status";
CM_ SG_ 116 ReSideRdrLeDetn140RdrDetnAssoTrkID "Associated tracker ID
";
CM_ SG_ 116 ReSideRdrLeDetn140RdrDetnAzi "Refer to the data element description in ReSideRdrLeDetn1 with the same data element name";
CM_ SG_ 116 ReSideRdrLeDetn140RdrDetnChks "Refer to the data element description in ReSideRdrLeDetn1 with the same data element name";
CM_ SG_ 116 ReSideRdrLeDetn140RdrDetnCntr "Refer to the data element description in ReSideRdrLeDetn1 with the same data element name";
CM_ SG_ 116 ReSideRdrLeDetn140RdrDetnConf "Refer to the data element description in ReSideRdrLeDetn1 with the same data element name";
CM_ SG_ 116 ReSideRdrLeDetn140RdrDetnElevn "Refer to the data element description in ReSideRdrLeDetn1 with the same data element name";
CM_ SG_ 116 ReSideRdrLeDetn140RdrDetnPwr "Refer to the data element description in ReSideRdrLeDetn1 with the same data element name";
CM_ SG_ 116 ReSideRdrLeDetn140RdrDetnRng "Refer to the data element description in ReSideRdrLeDetn1 with the same data element name";
CM_ SG_ 116 ReSideRdrLeDetn140RdrDetnRngV "Range Velocity";
CM_ SG_ 116 ReSideRdrLeDetn140RdrDetnSameRV "object with same distance and speed";
CM_ SG_ 116 ReSideRdrLeDetn140RdrDetnSts "Refer to the data element description in ReSideRdrLeDetn1 with the same data element name";
CM_ SG_ 116 ReSideRdrLeDetn141RdrDetnAmbigState "Dection ambiguous status";
CM_ SG_ 116 ReSideRdrLeDetn141RdrDetnAssoTrkID "Associated tracker ID
";
CM_ SG_ 116 ReSideRdrLeDetn141RdrDetnAzi "Refer to the data element description in ReSideRdrLeDetn1 with the same data element name";
CM_ SG_ 116 ReSideRdrLeDetn141RdrDetnChks "Refer to the data element description in ReSideRdrLeDetn1 with the same data element name";
CM_ SG_ 116 ReSideRdrLeDetn141RdrDetnCntr "Refer to the data element description in ReSideRdrLeDetn1 with the same data element name";
CM_ SG_ 116 ReSideRdrLeDetn141RdrDetnConf "Refer to the data element description in ReSideRdrLeDetn1 with the same data element name";
CM_ SG_ 116 ReSideRdrLeDetn141RdrDetnElevn "Refer to the data element description in ReSideRdrLeDetn1 with the same data element name";
CM_ SG_ 116 ReSideRdrLeDetn141RdrDetnPwr "Refer to the data element description in ReSideRdrLeDetn1 with the same data element name";
CM_ SG_ 116 ReSideRdrLeDetn141RdrDetnRng "Refer to the data element description in ReSideRdrLeDetn1 with the same data element name";
CM_ SG_ 116 ReSideRdrLeDetn141RdrDetnRngV "Range Velocity";
CM_ SG_ 116 ReSideRdrLeDetn141RdrDetnSameRV "object with same distance and speed";
CM_ SG_ 116 ReSideRdrLeDetn141RdrDetnSts "Refer to the data element description in ReSideRdrLeDetn1 with the same data element name";
CM_ SG_ 116 ReSideRdrLeDetn142RdrDetnAmbigState "Dection ambiguous status";
CM_ SG_ 116 ReSideRdrLeDetn142RdrDetnAssoTrkID "Associated tracker ID
";
CM_ SG_ 116 ReSideRdrLeDetn142RdrDetnAzi "Refer to the data element description in ReSideRdrLeDetn1 with the same data element name";
CM_ SG_ 116 ReSideRdrLeDetn142RdrDetnChks "Refer to the data element description in ReSideRdrLeDetn1 with the same data element name";
CM_ SG_ 116 ReSideRdrLeDetn142RdrDetnCntr "Refer to the data element description in ReSideRdrLeDetn1 with the same data element name";
CM_ SG_ 116 ReSideRdrLeDetn142RdrDetnConf "Refer to the data element description in ReSideRdrLeDetn1 with the same data element name";
CM_ SG_ 116 ReSideRdrLeDetn142RdrDetnElevn "Refer to the data element description in ReSideRdrLeDetn1 with the same data element name";
CM_ SG_ 116 ReSideRdrLeDetn142RdrDetnPwr "Refer to the data element description in ReSideRdrLeDetn1 with the same data element name";
CM_ SG_ 116 ReSideRdrLeDetn142RdrDetnRng "Refer to the data element description in ReSideRdrLeDetn1 with the same data element name";
CM_ SG_ 116 ReSideRdrLeDetn142RdrDetnRngV "Range Velocity";
CM_ SG_ 116 ReSideRdrLeDetn142RdrDetnSameRV "object with same distance and speed";
CM_ SG_ 116 ReSideRdrLeDetn142RdrDetnSts "Refer to the data element description in ReSideRdrLeDetn1 with the same data element name";
CM_ SG_ 116 ReSideRdrLeDetn143RdrDetnAmbigState "Dection ambiguous status";
CM_ SG_ 116 ReSideRdrLeDetn143RdrDetnAssoTrkID "Associated tracker ID
";
CM_ SG_ 116 ReSideRdrLeDetn143RdrDetnAzi "Refer to the data element description in ReSideRdrLeDetn1 with the same data element name";
CM_ SG_ 116 ReSideRdrLeDetn143RdrDetnChks "Refer to the data element description in ReSideRdrLeDetn1 with the same data element name";
CM_ SG_ 116 ReSideRdrLeDetn143RdrDetnCntr "Refer to the data element description in ReSideRdrLeDetn1 with the same data element name";
CM_ SG_ 116 ReSideRdrLeDetn143RdrDetnConf "Refer to the data element description in ReSideRdrLeDetn1 with the same data element name";
CM_ SG_ 116 ReSideRdrLeDetn143RdrDetnElevn "Refer to the data element description in ReSideRdrLeDetn1 with the same data element name";
CM_ SG_ 116 ReSideRdrLeDetn143RdrDetnPwr "Refer to the data element description in ReSideRdrLeDetn1 with the same data element name";
CM_ SG_ 116 ReSideRdrLeDetn143RdrDetnRng "Refer to the data element description in ReSideRdrLeDetn1 with the same data element name";
CM_ SG_ 116 ReSideRdrLeDetn143RdrDetnRngV "Range Velocity";
CM_ SG_ 116 ReSideRdrLeDetn143RdrDetnSameRV "object with same distance and speed";
CM_ SG_ 116 ReSideRdrLeDetn143RdrDetnSts "Refer to the data element description in ReSideRdrLeDetn1 with the same data element name";
CM_ SG_ 116 ReSideRdrLeDetn144RdrDetnAmbigState "Dection ambiguous status";
CM_ SG_ 116 ReSideRdrLeDetn144RdrDetnAssoTrkID "Associated tracker ID
";
CM_ SG_ 116 ReSideRdrLeDetn144RdrDetnAzi "Refer to the data element description in ReSideRdrLeDetn1 with the same data element name";
CM_ SG_ 116 ReSideRdrLeDetn144RdrDetnChks "Refer to the data element description in ReSideRdrLeDetn1 with the same data element name";
CM_ SG_ 116 ReSideRdrLeDetn144RdrDetnCntr "Refer to the data element description in ReSideRdrLeDetn1 with the same data element name";
CM_ SG_ 116 ReSideRdrLeDetn144RdrDetnConf "Refer to the data element description in ReSideRdrLeDetn1 with the same data element name";
CM_ SG_ 116 ReSideRdrLeDetn144RdrDetnElevn "Refer to the data element description in ReSideRdrLeDetn1 with the same data element name";
CM_ SG_ 116 ReSideRdrLeDetn144RdrDetnPwr "Refer to the data element description in ReSideRdrLeDetn1 with the same data element name";
CM_ SG_ 116 ReSideRdrLeDetn144RdrDetnRng "Refer to the data element description in ReSideRdrLeDetn1 with the same data element name";
CM_ SG_ 116 ReSideRdrLeDetn144RdrDetnRngV "Range Velocity";
CM_ SG_ 116 ReSideRdrLeDetn144RdrDetnSameRV "object with same distance and speed";
CM_ SG_ 116 ReSideRdrLeDetn144RdrDetnSts "Refer to the data element description in ReSideRdrLeDetn1 with the same data element name";
CM_ SG_ 117 ReSideRdrLeDetn145RdrDetnAmbigState "Dection ambiguous status";
CM_ SG_ 117 ReSideRdrLeDetn145RdrDetnAssoTrkID "Associated tracker ID
";
CM_ SG_ 117 ReSideRdrLeDetn145RdrDetnAzi "Refer to the data element description in ReSideRdrLeDetn1 with the same data element name";
CM_ SG_ 117 ReSideRdrLeDetn145RdrDetnChks "Refer to the data element description in ReSideRdrLeDetn1 with the same data element name";
CM_ SG_ 117 ReSideRdrLeDetn145RdrDetnCntr "Refer to the data element description in ReSideRdrLeDetn1 with the same data element name";
CM_ SG_ 117 ReSideRdrLeDetn145RdrDetnConf "Refer to the data element description in ReSideRdrLeDetn1 with the same data element name";
CM_ SG_ 117 ReSideRdrLeDetn145RdrDetnElevn "Refer to the data element description in ReSideRdrLeDetn1 with the same data element name";
CM_ SG_ 117 ReSideRdrLeDetn145RdrDetnPwr "Refer to the data element description in ReSideRdrLeDetn1 with the same data element name";
CM_ SG_ 117 ReSideRdrLeDetn145RdrDetnRng "Refer to the data element description in ReSideRdrLeDetn1 with the same data element name";
CM_ SG_ 117 ReSideRdrLeDetn145RdrDetnRngV "Range Velocity";
CM_ SG_ 117 ReSideRdrLeDetn145RdrDetnSameRV "object with same distance and speed";
CM_ SG_ 117 ReSideRdrLeDetn145RdrDetnSts "Refer to the data element description in ReSideRdrLeDetn1 with the same data element name";
CM_ SG_ 117 ReSideRdrLeDetn146RdrDetnAmbigState "Dection ambiguous status";
CM_ SG_ 117 ReSideRdrLeDetn146RdrDetnAssoTrkID "Associated tracker ID
";
CM_ SG_ 117 ReSideRdrLeDetn146RdrDetnAzi "Refer to the data element description in ReSideRdrLeDetn1 with the same data element name";
CM_ SG_ 117 ReSideRdrLeDetn146RdrDetnChks "Refer to the data element description in ReSideRdrLeDetn1 with the same data element name";
CM_ SG_ 117 ReSideRdrLeDetn146RdrDetnCntr "Refer to the data element description in ReSideRdrLeDetn1 with the same data element name";
CM_ SG_ 117 ReSideRdrLeDetn146RdrDetnConf "Refer to the data element description in ReSideRdrLeDetn1 with the same data element name";
CM_ SG_ 117 ReSideRdrLeDetn146RdrDetnElevn "Refer to the data element description in ReSideRdrLeDetn1 with the same data element name";
CM_ SG_ 117 ReSideRdrLeDetn146RdrDetnPwr "Refer to the data element description in ReSideRdrLeDetn1 with the same data element name";
CM_ SG_ 117 ReSideRdrLeDetn146RdrDetnRng "Refer to the data element description in ReSideRdrLeDetn1 with the same data element name";
CM_ SG_ 117 ReSideRdrLeDetn146RdrDetnRngV "Range Velocity";
CM_ SG_ 117 ReSideRdrLeDetn146RdrDetnSameRV "object with same distance and speed";
CM_ SG_ 117 ReSideRdrLeDetn146RdrDetnSts "Refer to the data element description in ReSideRdrLeDetn1 with the same data element name";
CM_ SG_ 117 ReSideRdrLeDetn147RdrDetnAmbigState "Dection ambiguous status";
CM_ SG_ 117 ReSideRdrLeDetn147RdrDetnAssoTrkID "Associated tracker ID
";
CM_ SG_ 117 ReSideRdrLeDetn147RdrDetnAzi "Refer to the data element description in ReSideRdrLeDetn1 with the same data element name";
CM_ SG_ 117 ReSideRdrLeDetn147RdrDetnChks "Refer to the data element description in ReSideRdrLeDetn1 with the same data element name";
CM_ SG_ 117 ReSideRdrLeDetn147RdrDetnCntr "Refer to the data element description in ReSideRdrLeDetn1 with the same data element name";
CM_ SG_ 117 ReSideRdrLeDetn147RdrDetnConf "Refer to the data element description in ReSideRdrLeDetn1 with the same data element name";
CM_ SG_ 117 ReSideRdrLeDetn147RdrDetnElevn "Refer to the data element description in ReSideRdrLeDetn1 with the same data element name";
CM_ SG_ 117 ReSideRdrLeDetn147RdrDetnPwr "Refer to the data element description in ReSideRdrLeDetn1 with the same data element name";
CM_ SG_ 117 ReSideRdrLeDetn147RdrDetnRng "Refer to the data element description in ReSideRdrLeDetn1 with the same data element name";
CM_ SG_ 117 ReSideRdrLeDetn147RdrDetnRngV "Range Velocity";
CM_ SG_ 117 ReSideRdrLeDetn147RdrDetnSameRV "object with same distance and speed";
CM_ SG_ 117 ReSideRdrLeDetn147RdrDetnSts "Refer to the data element description in ReSideRdrLeDetn1 with the same data element name";
CM_ SG_ 117 ReSideRdrLeDetn148RdrDetnAmbigState "Dection ambiguous status";
CM_ SG_ 117 ReSideRdrLeDetn148RdrDetnAssoTrkID "Associated tracker ID
";
CM_ SG_ 117 ReSideRdrLeDetn148RdrDetnAzi "Refer to the data element description in ReSideRdrLeDetn1 with the same data element name";
CM_ SG_ 117 ReSideRdrLeDetn148RdrDetnChks "Refer to the data element description in ReSideRdrLeDetn1 with the same data element name";
CM_ SG_ 117 ReSideRdrLeDetn148RdrDetnCntr "Refer to the data element description in ReSideRdrLeDetn1 with the same data element name";
CM_ SG_ 117 ReSideRdrLeDetn148RdrDetnConf "Refer to the data element description in ReSideRdrLeDetn1 with the same data element name";
CM_ SG_ 117 ReSideRdrLeDetn148RdrDetnElevn "Refer to the data element description in ReSideRdrLeDetn1 with the same data element name";
CM_ SG_ 117 ReSideRdrLeDetn148RdrDetnPwr "Refer to the data element description in ReSideRdrLeDetn1 with the same data element name";
CM_ SG_ 117 ReSideRdrLeDetn148RdrDetnRng "Refer to the data element description in ReSideRdrLeDetn1 with the same data element name";
CM_ SG_ 117 ReSideRdrLeDetn148RdrDetnRngV "Range Velocity";
CM_ SG_ 117 ReSideRdrLeDetn148RdrDetnSameRV "object with same distance and speed";
CM_ SG_ 117 ReSideRdrLeDetn148RdrDetnSts "Refer to the data element description in ReSideRdrLeDetn1 with the same data element name";
CM_ SG_ 117 ReSideRdrLeDetn149RdrDetnAmbigState "Dection ambiguous status";
CM_ SG_ 117 ReSideRdrLeDetn149RdrDetnAssoTrkID "Associated tracker ID
";
CM_ SG_ 117 ReSideRdrLeDetn149RdrDetnAzi "Refer to the data element description in ReSideRdrLeDetn1 with the same data element name";
CM_ SG_ 117 ReSideRdrLeDetn149RdrDetnChks "Refer to the data element description in ReSideRdrLeDetn1 with the same data element name";
CM_ SG_ 117 ReSideRdrLeDetn149RdrDetnCntr "Refer to the data element description in ReSideRdrLeDetn1 with the same data element name";
CM_ SG_ 117 ReSideRdrLeDetn149RdrDetnConf "Refer to the data element description in ReSideRdrLeDetn1 with the same data element name";
CM_ SG_ 117 ReSideRdrLeDetn149RdrDetnElevn "Refer to the data element description in ReSideRdrLeDetn1 with the same data element name";
CM_ SG_ 117 ReSideRdrLeDetn149RdrDetnPwr "Refer to the data element description in ReSideRdrLeDetn1 with the same data element name";
CM_ SG_ 117 ReSideRdrLeDetn149RdrDetnRng "Refer to the data element description in ReSideRdrLeDetn1 with the same data element name";
CM_ SG_ 117 ReSideRdrLeDetn149RdrDetnRngV "Range Velocity";
CM_ SG_ 117 ReSideRdrLeDetn149RdrDetnSameRV "object with same distance and speed";
CM_ SG_ 117 ReSideRdrLeDetn149RdrDetnSts "Refer to the data element description in ReSideRdrLeDetn1 with the same data element name";
CM_ SG_ 117 ReSideRdrLeDetn150RdrDetnAmbigState "Dection ambiguous status";
CM_ SG_ 117 ReSideRdrLeDetn150RdrDetnAssoTrkID "Associated tracker ID
";
CM_ SG_ 117 ReSideRdrLeDetn150RdrDetnAzi "Refer to the data element description in ReSideRdrLeDetn1 with the same data element name";
CM_ SG_ 117 ReSideRdrLeDetn150RdrDetnChks "Refer to the data element description in ReSideRdrLeDetn1 with the same data element name";
CM_ SG_ 117 ReSideRdrLeDetn150RdrDetnCntr "Refer to the data element description in ReSideRdrLeDetn1 with the same data element name";
CM_ SG_ 117 ReSideRdrLeDetn150RdrDetnConf "Refer to the data element description in ReSideRdrLeDetn1 with the same data element name";
CM_ SG_ 117 ReSideRdrLeDetn150RdrDetnElevn "Refer to the data element description in ReSideRdrLeDetn1 with the same data element name";
CM_ SG_ 117 ReSideRdrLeDetn150RdrDetnPwr "Refer to the data element description in ReSideRdrLeDetn1 with the same data element name";
CM_ SG_ 117 ReSideRdrLeDetn150RdrDetnRng "Refer to the data element description in ReSideRdrLeDetn1 with the same data element name";
CM_ SG_ 117 ReSideRdrLeDetn150RdrDetnRngV "Range Velocity";
CM_ SG_ 117 ReSideRdrLeDetn150RdrDetnSameRV "object with same distance and speed";
CM_ SG_ 117 ReSideRdrLeDetn150RdrDetnSts "Refer to the data element description in ReSideRdrLeDetn1 with the same data element name";
CM_ SG_ 118 ReSideRdrLeDetn151RdrDetnAmbigState "Dection ambiguous status";
CM_ SG_ 118 ReSideRdrLeDetn151RdrDetnAssoTrkID "Associated tracker ID
";
CM_ SG_ 118 ReSideRdrLeDetn151RdrDetnAzi "Refer to the data element description in ReSideRdrLeDetn1 with the same data element name";
CM_ SG_ 118 ReSideRdrLeDetn151RdrDetnChks "Refer to the data element description in ReSideRdrLeDetn1 with the same data element name";
CM_ SG_ 118 ReSideRdrLeDetn151RdrDetnCntr "Refer to the data element description in ReSideRdrLeDetn1 with the same data element name";
CM_ SG_ 118 ReSideRdrLeDetn151RdrDetnConf "Refer to the data element description in ReSideRdrLeDetn1 with the same data element name";
CM_ SG_ 118 ReSideRdrLeDetn151RdrDetnElevn "Refer to the data element description in ReSideRdrLeDetn1 with the same data element name";
CM_ SG_ 118 ReSideRdrLeDetn151RdrDetnPwr "Refer to the data element description in ReSideRdrLeDetn1 with the same data element name";
CM_ SG_ 118 ReSideRdrLeDetn151RdrDetnRng "Refer to the data element description in ReSideRdrLeDetn1 with the same data element name";
CM_ SG_ 118 ReSideRdrLeDetn151RdrDetnRngV "Range Velocity";
CM_ SG_ 118 ReSideRdrLeDetn151RdrDetnSameRV "object with same distance and speed";
CM_ SG_ 118 ReSideRdrLeDetn151RdrDetnSts "Refer to the data element description in ReSideRdrLeDetn1 with the same data element name";
CM_ SG_ 118 ReSideRdrLeDetn152RdrDetnAmbigState "Dection ambiguous status";
CM_ SG_ 118 ReSideRdrLeDetn152RdrDetnAssoTrkID "Associated tracker ID
";
CM_ SG_ 118 ReSideRdrLeDetn152RdrDetnAzi "Refer to the data element description in ReSideRdrLeDetn1 with the same data element name";
CM_ SG_ 118 ReSideRdrLeDetn152RdrDetnChks "Refer to the data element description in ReSideRdrLeDetn1 with the same data element name";
CM_ SG_ 118 ReSideRdrLeDetn152RdrDetnCntr "Refer to the data element description in ReSideRdrLeDetn1 with the same data element name";
CM_ SG_ 118 ReSideRdrLeDetn152RdrDetnConf "Refer to the data element description in ReSideRdrLeDetn1 with the same data element name";
CM_ SG_ 118 ReSideRdrLeDetn152RdrDetnElevn "Refer to the data element description in ReSideRdrLeDetn1 with the same data element name";
CM_ SG_ 118 ReSideRdrLeDetn152RdrDetnPwr "Refer to the data element description in ReSideRdrLeDetn1 with the same data element name";
CM_ SG_ 118 ReSideRdrLeDetn152RdrDetnRng "Refer to the data element description in ReSideRdrLeDetn1 with the same data element name";
CM_ SG_ 118 ReSideRdrLeDetn152RdrDetnRngV "Range Velocity";
CM_ SG_ 118 ReSideRdrLeDetn152RdrDetnSameRV "object with same distance and speed";
CM_ SG_ 118 ReSideRdrLeDetn152RdrDetnSts "Refer to the data element description in ReSideRdrLeDetn1 with the same data element name";
CM_ SG_ 118 ReSideRdrLeDetn153RdrDetnAmbigState "Dection ambiguous status";
CM_ SG_ 118 ReSideRdrLeDetn153RdrDetnAssoTrkID "Associated tracker ID
";
CM_ SG_ 118 ReSideRdrLeDetn153RdrDetnAzi "Refer to the data element description in ReSideRdrLeDetn1 with the same data element name";
CM_ SG_ 118 ReSideRdrLeDetn153RdrDetnChks "Refer to the data element description in ReSideRdrLeDetn1 with the same data element name";
CM_ SG_ 118 ReSideRdrLeDetn153RdrDetnCntr "Refer to the data element description in ReSideRdrLeDetn1 with the same data element name";
CM_ SG_ 118 ReSideRdrLeDetn153RdrDetnConf "Refer to the data element description in ReSideRdrLeDetn1 with the same data element name";
CM_ SG_ 118 ReSideRdrLeDetn153RdrDetnElevn "Refer to the data element description in ReSideRdrLeDetn1 with the same data element name";
CM_ SG_ 118 ReSideRdrLeDetn153RdrDetnPwr "Refer to the data element description in ReSideRdrLeDetn1 with the same data element name";
CM_ SG_ 118 ReSideRdrLeDetn153RdrDetnRng "Refer to the data element description in ReSideRdrLeDetn1 with the same data element name";
CM_ SG_ 118 ReSideRdrLeDetn153RdrDetnRngV "Range Velocity";
CM_ SG_ 118 ReSideRdrLeDetn153RdrDetnSameRV "object with same distance and speed";
CM_ SG_ 118 ReSideRdrLeDetn153RdrDetnSts "Refer to the data element description in ReSideRdrLeDetn1 with the same data element name";
CM_ SG_ 118 ReSideRdrLeDetn154RdrDetnAmbigState "Dection ambiguous status";
CM_ SG_ 118 ReSideRdrLeDetn154RdrDetnAssoTrkID "Associated tracker ID
";
CM_ SG_ 118 ReSideRdrLeDetn154RdrDetnAzi "Refer to the data element description in ReSideRdrLeDetn1 with the same data element name";
CM_ SG_ 118 ReSideRdrLeDetn154RdrDetnChks "Refer to the data element description in ReSideRdrLeDetn1 with the same data element name";
CM_ SG_ 118 ReSideRdrLeDetn154RdrDetnCntr "Refer to the data element description in ReSideRdrLeDetn1 with the same data element name";
CM_ SG_ 118 ReSideRdrLeDetn154RdrDetnConf "Refer to the data element description in ReSideRdrLeDetn1 with the same data element name";
CM_ SG_ 118 ReSideRdrLeDetn154RdrDetnElevn "Refer to the data element description in ReSideRdrLeDetn1 with the same data element name";
CM_ SG_ 118 ReSideRdrLeDetn154RdrDetnPwr "Refer to the data element description in ReSideRdrLeDetn1 with the same data element name";
CM_ SG_ 118 ReSideRdrLeDetn154RdrDetnRng "Refer to the data element description in ReSideRdrLeDetn1 with the same data element name";
CM_ SG_ 118 ReSideRdrLeDetn154RdrDetnRngV "Range Velocity";
CM_ SG_ 118 ReSideRdrLeDetn154RdrDetnSameRV "object with same distance and speed";
CM_ SG_ 118 ReSideRdrLeDetn154RdrDetnSts "Refer to the data element description in ReSideRdrLeDetn1 with the same data element name";
CM_ SG_ 118 ReSideRdrLeDetn155RdrDetnAmbigState "Dection ambiguous status";
CM_ SG_ 118 ReSideRdrLeDetn155RdrDetnAssoTrkID "Associated tracker ID
";
CM_ SG_ 118 ReSideRdrLeDetn155RdrDetnAzi "Refer to the data element description in ReSideRdrLeDetn1 with the same data element name";
CM_ SG_ 118 ReSideRdrLeDetn155RdrDetnChks "Refer to the data element description in ReSideRdrLeDetn1 with the same data element name";
CM_ SG_ 118 ReSideRdrLeDetn155RdrDetnCntr "Refer to the data element description in ReSideRdrLeDetn1 with the same data element name";
CM_ SG_ 118 ReSideRdrLeDetn155RdrDetnConf "Refer to the data element description in ReSideRdrLeDetn1 with the same data element name";
CM_ SG_ 118 ReSideRdrLeDetn155RdrDetnElevn "Refer to the data element description in ReSideRdrLeDetn1 with the same data element name";
CM_ SG_ 118 ReSideRdrLeDetn155RdrDetnPwr "Refer to the data element description in ReSideRdrLeDetn1 with the same data element name";
CM_ SG_ 118 ReSideRdrLeDetn155RdrDetnRng "Refer to the data element description in ReSideRdrLeDetn1 with the same data element name";
CM_ SG_ 118 ReSideRdrLeDetn155RdrDetnRngV "Range Velocity";
CM_ SG_ 118 ReSideRdrLeDetn155RdrDetnSameRV "object with same distance and speed";
CM_ SG_ 118 ReSideRdrLeDetn155RdrDetnSts "Refer to the data element description in ReSideRdrLeDetn1 with the same data element name";
CM_ SG_ 118 ReSideRdrLeDetn156RdrDetnAmbigState "Dection ambiguous status";
CM_ SG_ 118 ReSideRdrLeDetn156RdrDetnAssoTrkID "Associated tracker ID
";
CM_ SG_ 118 ReSideRdrLeDetn156RdrDetnAzi "Refer to the data element description in ReSideRdrLeDetn1 with the same data element name";
CM_ SG_ 118 ReSideRdrLeDetn156RdrDetnChks "Refer to the data element description in ReSideRdrLeDetn1 with the same data element name";
CM_ SG_ 118 ReSideRdrLeDetn156RdrDetnCntr "Refer to the data element description in ReSideRdrLeDetn1 with the same data element name";
CM_ SG_ 118 ReSideRdrLeDetn156RdrDetnConf "Refer to the data element description in ReSideRdrLeDetn1 with the same data element name";
CM_ SG_ 118 ReSideRdrLeDetn156RdrDetnElevn "Refer to the data element description in ReSideRdrLeDetn1 with the same data element name";
CM_ SG_ 118 ReSideRdrLeDetn156RdrDetnPwr "Refer to the data element description in ReSideRdrLeDetn1 with the same data element name";
CM_ SG_ 118 ReSideRdrLeDetn156RdrDetnRng "Refer to the data element description in ReSideRdrLeDetn1 with the same data element name";
CM_ SG_ 118 ReSideRdrLeDetn156RdrDetnRngV "Range Velocity";
CM_ SG_ 118 ReSideRdrLeDetn156RdrDetnSameRV "object with same distance and speed";
CM_ SG_ 118 ReSideRdrLeDetn156RdrDetnSts "Refer to the data element description in ReSideRdrLeDetn1 with the same data element name";
BA_DEF_ BO_ "CANFD_BRS" ENUM "0","1";
BA_DEF_ BO_ "GenMsgCycleTime" INT 0 65536; // [ms]
BA_DEF_ BO_ "GenMsgDelayTime" INT 0 65536; // [ms]
BA_DEF_ BO_ "GenMsgSendType" ENUM "cyclic", "spontaneous", "not-used", "not-used", "not-used", "cyclicAndSpontaneous", "not-used", "cyclicIfActive", "NoMsgSendType"; // [us]
BA_DEF_ BO_ "GenMsgStartDelayTime" INT 0 65536; // [ms]
BA_DEF_ BO_ "VFrameFormat" ENUM "StandardCAN","ExtendedCAN","reserved","J1939PG","reserved","reserved","reserved","reserved","reserved","reserved","reserved","reserved","reserved","reserved","StandardCAN_FD","ExtendedCAN_FD";
BA_DEF_ SG_ "GenSigSendType" ENUM "Cyclic","OnWrite","OnWriteWithRepetition","OnChange","OnChangeWithRepetition","IfActive","IfActiveWithRepetition","NoSigSendType";
BA_DEF_ SG_ "GenSigStartValue" HEX 0 80000000;
BA_DEF_ BO_ "GenMsgILSupport" ENUM "No","Yes";
BA_DEF_ BO_ "NmAsrMessage" ENUM "No","Yes";
BA_DEF_ SG_ "GenSigFuncType" ENUM "NoFunction","n/a","n/a","n/a","n/a","n/a","n/a","n/a","n/a","n/a","n/a","n/a","n/a","n/a","n/a","CHK","CNTR","n/a","n/a","n/a","CNTR_AR_01","CRC_AR_01_BOTH","CRC_AR_01_ALT","CRC_AR_01_LOW","CRC_AR_01_NIBBLE","CNTR_AR_04","CRC_AR_04A","CNTR_AR_05","CRC_AR_05";
BA_DEF_ SG_ "GenSigDataID" STRING;
BA_DEF_DEF_ "CANFD_BRS" "1";
BA_DEF_DEF_ "GenSigStartValue" 0;
BA_DEF_DEF_ "VFrameFormat" "J1939PG";
BA_DEF_DEF_ "GenSigSendType" "NoSigSendType";
BA_DEF_DEF_ "GenMsgCycleTime" 0;
BA_DEF_DEF_ "GenMsgDelayTime" 0;
BA_DEF_DEF_ "GenMsgStartDelayTime" 0;
BA_DEF_DEF_ "GenMsgSendType" "NoMsgSendType";
BA_DEF_DEF_ "GenMsgILSupport" "Yes";
BA_DEF_DEF_ "NmAsrMessage" "No";
BA_DEF_DEF_ "GenSigFuncType" "NoFunction";
BA_DEF_DEF_ "GenSigDataID" "";
// Frame: SODLPrivateCANFD5Fr54
BA_ "GenMsgCycleTime" BO_ 113 50 ;
BA_ "GenMsgSendType" BO_ 113 0;
BA_ "VFrameFormat" BO_ 113 14;
// Frame: SODLPrivateCANFD5Fr55
BA_ "GenMsgCycleTime" BO_ 114 50 ;
BA_ "GenMsgSendType" BO_ 114 0;
BA_ "VFrameFormat" BO_ 114 14;
// Frame: SODLPrivateCANFD5Fr56
BA_ "GenMsgCycleTime" BO_ 115 50 ;
BA_ "GenMsgSendType" BO_ 115 0;
BA_ "VFrameFormat" BO_ 115 14;
// Frame: SODLPrivateCANFD5Fr57
BA_ "GenMsgCycleTime" BO_ 116 50 ;
BA_ "GenMsgSendType" BO_ 116 0;
BA_ "VFrameFormat" BO_ 116 14;
// Frame: SODLPrivateCANFD5Fr58
BA_ "GenMsgCycleTime" BO_ 117 50 ;
BA_ "GenMsgSendType" BO_ 117 0;
BA_ "VFrameFormat" BO_ 117 14;
// Frame: SODLPrivateCANFD5Fr59
BA_ "GenMsgCycleTime" BO_ 118 50 ;
BA_ "GenMsgSendType" BO_ 118 0;
BA_ "VFrameFormat" BO_ 118 14;
BA_ "GenSigSendType" SG_ 113 ReSideRdrLeDetn121RdrDetnAmbigState 0;
BA_ "GenSigSendType" SG_ 113 ReSideRdrLeDetn121RdrDetnAssoTrkID 0;
BA_ "GenSigSendType" SG_ 113 ReSideRdrLeDetn121RdrDetnAzi 0;
BA_ "GenSigStartValue" SG_ 113 ReSideRdrLeDetn121RdrDetnAzi 900;
BA_ "GenSigDataID" SG_ 113 ReSideRdrLeDetn121RdrDetnChks "0xA0A";
BA_ "GenSigFuncType" SG_ 113 ReSideRdrLeDetn121RdrDetnChks 15;
BA_ "GenSigSendType" SG_ 113 ReSideRdrLeDetn121RdrDetnChks 0;
BA_ "GenSigFuncType" SG_ 113 ReSideRdrLeDetn121RdrDetnCntr 16;
BA_ "GenSigSendType" SG_ 113 ReSideRdrLeDetn121RdrDetnCntr 0;
BA_ "GenSigSendType" SG_ 113 ReSideRdrLeDetn121RdrDetnConf 0;
BA_ "GenSigSendType" SG_ 113 ReSideRdrLeDetn121RdrDetnElevn 0;
BA_ "GenSigStartValue" SG_ 113 ReSideRdrLeDetn121RdrDetnElevn 15;
BA_ "GenSigSendType" SG_ 113 ReSideRdrLeDetn121RdrDetnPwr 0;
BA_ "GenSigSendType" SG_ 113 ReSideRdrLeDetn121RdrDetnRng 0;
BA_ "GenSigStartValue" SG_ 113 ReSideRdrLeDetn121RdrDetnRng 10050;
BA_ "GenSigSendType" SG_ 113 ReSideRdrLeDetn121RdrDetnRngV 0;
BA_ "GenSigStartValue" SG_ 113 ReSideRdrLeDetn121RdrDetnRngV 4000;
BA_ "GenSigSendType" SG_ 113 ReSideRdrLeDetn121RdrDetnSameRV 0;
BA_ "GenSigSendType" SG_ 113 ReSideRdrLeDetn121RdrDetnSts 0;
BA_ "GenSigStartValue" SG_ 113 ReSideRdrLeDetn121RdrDetnSts 3;
BA_ "GenSigSendType" SG_ 113 ReSideRdrLeDetn122RdrDetnAmbigState 0;
BA_ "GenSigSendType" SG_ 113 ReSideRdrLeDetn122RdrDetnAssoTrkID 0;
BA_ "GenSigSendType" SG_ 113 ReSideRdrLeDetn122RdrDetnAzi 0;
BA_ "GenSigStartValue" SG_ 113 ReSideRdrLeDetn122RdrDetnAzi 900;
BA_ "GenSigDataID" SG_ 113 ReSideRdrLeDetn122RdrDetnChks "0xA0B";
BA_ "GenSigFuncType" SG_ 113 ReSideRdrLeDetn122RdrDetnChks 15;
BA_ "GenSigSendType" SG_ 113 ReSideRdrLeDetn122RdrDetnChks 0;
BA_ "GenSigFuncType" SG_ 113 ReSideRdrLeDetn122RdrDetnCntr 16;
BA_ "GenSigSendType" SG_ 113 ReSideRdrLeDetn122RdrDetnCntr 0;
BA_ "GenSigSendType" SG_ 113 ReSideRdrLeDetn122RdrDetnConf 0;
BA_ "GenSigSendType" SG_ 113 ReSideRdrLeDetn122RdrDetnElevn 0;
BA_ "GenSigStartValue" SG_ 113 ReSideRdrLeDetn122RdrDetnElevn 15;
BA_ "GenSigSendType" SG_ 113 ReSideRdrLeDetn122RdrDetnPwr 0;
BA_ "GenSigSendType" SG_ 113 ReSideRdrLeDetn122RdrDetnRng 0;
BA_ "GenSigStartValue" SG_ 113 ReSideRdrLeDetn122RdrDetnRng 10050;
BA_ "GenSigSendType" SG_ 113 ReSideRdrLeDetn122RdrDetnRngV 0;
BA_ "GenSigStartValue" SG_ 113 ReSideRdrLeDetn122RdrDetnRngV 4000;
BA_ "GenSigSendType" SG_ 113 ReSideRdrLeDetn122RdrDetnSameRV 0;
BA_ "GenSigSendType" SG_ 113 ReSideRdrLeDetn122RdrDetnSts 0;
BA_ "GenSigStartValue" SG_ 113 ReSideRdrLeDetn122RdrDetnSts 3;
BA_ "GenSigSendType" SG_ 113 ReSideRdrLeDetn123RdrDetnAmbigState 0;
BA_ "GenSigSendType" SG_ 113 ReSideRdrLeDetn123RdrDetnAssoTrkID 0;
BA_ "GenSigSendType" SG_ 113 ReSideRdrLeDetn123RdrDetnAzi 0;
BA_ "GenSigStartValue" SG_ 113 ReSideRdrLeDetn123RdrDetnAzi 900;
BA_ "GenSigDataID" SG_ 113 ReSideRdrLeDetn123RdrDetnChks "0xA0C";
BA_ "GenSigFuncType" SG_ 113 ReSideRdrLeDetn123RdrDetnChks 15;
BA_ "GenSigSendType" SG_ 113 ReSideRdrLeDetn123RdrDetnChks 0;
BA_ "GenSigFuncType" SG_ 113 ReSideRdrLeDetn123RdrDetnCntr 16;
BA_ "GenSigSendType" SG_ 113 ReSideRdrLeDetn123RdrDetnCntr 0;
BA_ "GenSigSendType" SG_ 113 ReSideRdrLeDetn123RdrDetnConf 0;
BA_ "GenSigSendType" SG_ 113 ReSideRdrLeDetn123RdrDetnElevn 0;
BA_ "GenSigStartValue" SG_ 113 ReSideRdrLeDetn123RdrDetnElevn 15;
BA_ "GenSigSendType" SG_ 113 ReSideRdrLeDetn123RdrDetnPwr 0;
BA_ "GenSigSendType" SG_ 113 ReSideRdrLeDetn123RdrDetnRng 0;
BA_ "GenSigStartValue" SG_ 113 ReSideRdrLeDetn123RdrDetnRng 10050;
BA_ "GenSigSendType" SG_ 113 ReSideRdrLeDetn123RdrDetnRngV 0;
BA_ "GenSigStartValue" SG_ 113 ReSideRdrLeDetn123RdrDetnRngV 4000;
BA_ "GenSigSendType" SG_ 113 ReSideRdrLeDetn123RdrDetnSameRV 0;
BA_ "GenSigSendType" SG_ 113 ReSideRdrLeDetn123RdrDetnSts 0;
BA_ "GenSigStartValue" SG_ 113 ReSideRdrLeDetn123RdrDetnSts 3;
BA_ "GenSigSendType" SG_ 113 ReSideRdrLeDetn124RdrDetnAmbigState 0;
BA_ "GenSigSendType" SG_ 113 ReSideRdrLeDetn124RdrDetnAssoTrkID 0;
BA_ "GenSigSendType" SG_ 113 ReSideRdrLeDetn124RdrDetnAzi 0;
BA_ "GenSigStartValue" SG_ 113 ReSideRdrLeDetn124RdrDetnAzi 900;
BA_ "GenSigDataID" SG_ 113 ReSideRdrLeDetn124RdrDetnChks "0xA0D";
BA_ "GenSigFuncType" SG_ 113 ReSideRdrLeDetn124RdrDetnChks 15;
BA_ "GenSigSendType" SG_ 113 ReSideRdrLeDetn124RdrDetnChks 0;
BA_ "GenSigFuncType" SG_ 113 ReSideRdrLeDetn124RdrDetnCntr 16;
BA_ "GenSigSendType" SG_ 113 ReSideRdrLeDetn124RdrDetnCntr 0;
BA_ "GenSigSendType" SG_ 113 ReSideRdrLeDetn124RdrDetnConf 0;
BA_ "GenSigSendType" SG_ 113 ReSideRdrLeDetn124RdrDetnElevn 0;
BA_ "GenSigStartValue" SG_ 113 ReSideRdrLeDetn124RdrDetnElevn 15;
BA_ "GenSigSendType" SG_ 113 ReSideRdrLeDetn124RdrDetnPwr 0;
BA_ "GenSigSendType" SG_ 113 ReSideRdrLeDetn124RdrDetnRng 0;
BA_ "GenSigStartValue" SG_ 113 ReSideRdrLeDetn124RdrDetnRng 10050;
BA_ "GenSigSendType" SG_ 113 ReSideRdrLeDetn124RdrDetnRngV 0;
BA_ "GenSigStartValue" SG_ 113 ReSideRdrLeDetn124RdrDetnRngV 4000;
BA_ "GenSigSendType" SG_ 113 ReSideRdrLeDetn124RdrDetnSameRV 0;
BA_ "GenSigSendType" SG_ 113 ReSideRdrLeDetn124RdrDetnSts 0;
BA_ "GenSigStartValue" SG_ 113 ReSideRdrLeDetn124RdrDetnSts 3;
BA_ "GenSigSendType" SG_ 113 ReSideRdrLeDetn125RdrDetnAmbigState 0;
BA_ "GenSigSendType" SG_ 113 ReSideRdrLeDetn125RdrDetnAssoTrkID 0;
BA_ "GenSigSendType" SG_ 113 ReSideRdrLeDetn125RdrDetnAzi 0;
BA_ "GenSigStartValue" SG_ 113 ReSideRdrLeDetn125RdrDetnAzi 900;
BA_ "GenSigDataID" SG_ 113 ReSideRdrLeDetn125RdrDetnChks "0xA0E";
BA_ "GenSigFuncType" SG_ 113 ReSideRdrLeDetn125RdrDetnChks 15;
BA_ "GenSigSendType" SG_ 113 ReSideRdrLeDetn125RdrDetnChks 0;
BA_ "GenSigFuncType" SG_ 113 ReSideRdrLeDetn125RdrDetnCntr 16;
BA_ "GenSigSendType" SG_ 113 ReSideRdrLeDetn125RdrDetnCntr 0;
BA_ "GenSigSendType" SG_ 113 ReSideRdrLeDetn125RdrDetnConf 0;
BA_ "GenSigSendType" SG_ 113 ReSideRdrLeDetn125RdrDetnElevn 0;
BA_ "GenSigStartValue" SG_ 113 ReSideRdrLeDetn125RdrDetnElevn 15;
BA_ "GenSigSendType" SG_ 113 ReSideRdrLeDetn125RdrDetnPwr 0;
BA_ "GenSigSendType" SG_ 113 ReSideRdrLeDetn125RdrDetnRng 0;
BA_ "GenSigStartValue" SG_ 113 ReSideRdrLeDetn125RdrDetnRng 10050;
BA_ "GenSigSendType" SG_ 113 ReSideRdrLeDetn125RdrDetnRngV 0;
BA_ "GenSigStartValue" SG_ 113 ReSideRdrLeDetn125RdrDetnRngV 4000;
BA_ "GenSigSendType" SG_ 113 ReSideRdrLeDetn125RdrDetnSameRV 0;
BA_ "GenSigSendType" SG_ 113 ReSideRdrLeDetn125RdrDetnSts 0;
BA_ "GenSigStartValue" SG_ 113 ReSideRdrLeDetn125RdrDetnSts 3;
BA_ "GenSigSendType" SG_ 113 ReSideRdrLeDetn126RdrDetnAmbigState 0;
BA_ "GenSigSendType" SG_ 113 ReSideRdrLeDetn126RdrDetnAssoTrkID 0;
BA_ "GenSigSendType" SG_ 113 ReSideRdrLeDetn126RdrDetnAzi 0;
BA_ "GenSigStartValue" SG_ 113 ReSideRdrLeDetn126RdrDetnAzi 900;
BA_ "GenSigDataID" SG_ 113 ReSideRdrLeDetn126RdrDetnChks "0xA0F";
BA_ "GenSigFuncType" SG_ 113 ReSideRdrLeDetn126RdrDetnChks 15;
BA_ "GenSigSendType" SG_ 113 ReSideRdrLeDetn126RdrDetnChks 0;
BA_ "GenSigFuncType" SG_ 113 ReSideRdrLeDetn126RdrDetnCntr 16;
BA_ "GenSigSendType" SG_ 113 ReSideRdrLeDetn126RdrDetnCntr 0;
BA_ "GenSigSendType" SG_ 113 ReSideRdrLeDetn126RdrDetnConf 0;
BA_ "GenSigSendType" SG_ 113 ReSideRdrLeDetn126RdrDetnElevn 0;
BA_ "GenSigStartValue" SG_ 113 ReSideRdrLeDetn126RdrDetnElevn 15;
BA_ "GenSigSendType" SG_ 113 ReSideRdrLeDetn126RdrDetnPwr 0;
BA_ "GenSigSendType" SG_ 113 ReSideRdrLeDetn126RdrDetnRng 0;
BA_ "GenSigStartValue" SG_ 113 ReSideRdrLeDetn126RdrDetnRng 10050;
BA_ "GenSigSendType" SG_ 113 ReSideRdrLeDetn126RdrDetnRngV 0;
BA_ "GenSigStartValue" SG_ 113 ReSideRdrLeDetn126RdrDetnRngV 4000;
BA_ "GenSigSendType" SG_ 113 ReSideRdrLeDetn126RdrDetnSameRV 0;
BA_ "GenSigSendType" SG_ 113 ReSideRdrLeDetn126RdrDetnSts 0;
BA_ "GenSigStartValue" SG_ 113 ReSideRdrLeDetn126RdrDetnSts 3;
BA_ "GenSigSendType" SG_ 114 ReSideRdrLeDetn127RdrDetnAmbigState 0;
BA_ "GenSigSendType" SG_ 114 ReSideRdrLeDetn127RdrDetnAssoTrkID 0;
BA_ "GenSigSendType" SG_ 114 ReSideRdrLeDetn127RdrDetnAzi 0;
BA_ "GenSigStartValue" SG_ 114 ReSideRdrLeDetn127RdrDetnAzi 900;
BA_ "GenSigDataID" SG_ 114 ReSideRdrLeDetn127RdrDetnChks "0xA10";
BA_ "GenSigFuncType" SG_ 114 ReSideRdrLeDetn127RdrDetnChks 15;
BA_ "GenSigSendType" SG_ 114 ReSideRdrLeDetn127RdrDetnChks 0;
BA_ "GenSigFuncType" SG_ 114 ReSideRdrLeDetn127RdrDetnCntr 16;
BA_ "GenSigSendType" SG_ 114 ReSideRdrLeDetn127RdrDetnCntr 0;
BA_ "GenSigSendType" SG_ 114 ReSideRdrLeDetn127RdrDetnConf 0;
BA_ "GenSigSendType" SG_ 114 ReSideRdrLeDetn127RdrDetnElevn 0;
BA_ "GenSigStartValue" SG_ 114 ReSideRdrLeDetn127RdrDetnElevn 15;
BA_ "GenSigSendType" SG_ 114 ReSideRdrLeDetn127RdrDetnPwr 0;
BA_ "GenSigSendType" SG_ 114 ReSideRdrLeDetn127RdrDetnRng 0;
BA_ "GenSigStartValue" SG_ 114 ReSideRdrLeDetn127RdrDetnRng 10050;
BA_ "GenSigSendType" SG_ 114 ReSideRdrLeDetn127RdrDetnRngV 0;
BA_ "GenSigStartValue" SG_ 114 ReSideRdrLeDetn127RdrDetnRngV 4000;
BA_ "GenSigSendType" SG_ 114 ReSideRdrLeDetn127RdrDetnSameRV 0;
BA_ "GenSigSendType" SG_ 114 ReSideRdrLeDetn127RdrDetnSts 0;
BA_ "GenSigStartValue" SG_ 114 ReSideRdrLeDetn127RdrDetnSts 3;
BA_ "GenSigSendType" SG_ 114 ReSideRdrLeDetn128RdrDetnAmbigState 0;
BA_ "GenSigSendType" SG_ 114 ReSideRdrLeDetn128RdrDetnAssoTrkID 0;
BA_ "GenSigSendType" SG_ 114 ReSideRdrLeDetn128RdrDetnAzi 0;
BA_ "GenSigStartValue" SG_ 114 ReSideRdrLeDetn128RdrDetnAzi 900;
BA_ "GenSigDataID" SG_ 114 ReSideRdrLeDetn128RdrDetnChks "0xA11";
BA_ "GenSigFuncType" SG_ 114 ReSideRdrLeDetn128RdrDetnChks 15;
BA_ "GenSigSendType" SG_ 114 ReSideRdrLeDetn128RdrDetnChks 0;
BA_ "GenSigFuncType" SG_ 114 ReSideRdrLeDetn128RdrDetnCntr 16;
BA_ "GenSigSendType" SG_ 114 ReSideRdrLeDetn128RdrDetnCntr 0;
BA_ "GenSigSendType" SG_ 114 ReSideRdrLeDetn128RdrDetnConf 0;
BA_ "GenSigSendType" SG_ 114 ReSideRdrLeDetn128RdrDetnElevn 0;
BA_ "GenSigStartValue" SG_ 114 ReSideRdrLeDetn128RdrDetnElevn 15;
BA_ "GenSigSendType" SG_ 114 ReSideRdrLeDetn128RdrDetnPwr 0;
BA_ "GenSigSendType" SG_ 114 ReSideRdrLeDetn128RdrDetnRng 0;
BA_ "GenSigStartValue" SG_ 114 ReSideRdrLeDetn128RdrDetnRng 10050;
BA_ "GenSigSendType" SG_ 114 ReSideRdrLeDetn128RdrDetnRngV 0;
BA_ "GenSigStartValue" SG_ 114 ReSideRdrLeDetn128RdrDetnRngV 4000;
BA_ "GenSigSendType" SG_ 114 ReSideRdrLeDetn128RdrDetnSameRV 0;
BA_ "GenSigSendType" SG_ 114 ReSideRdrLeDetn128RdrDetnSts 0;
BA_ "GenSigStartValue" SG_ 114 ReSideRdrLeDetn128RdrDetnSts 3;
BA_ "GenSigSendType" SG_ 114 ReSideRdrLeDetn129RdrDetnAmbigState 0;
BA_ "GenSigSendType" SG_ 114 ReSideRdrLeDetn129RdrDetnAssoTrkID 0;
BA_ "GenSigSendType" SG_ 114 ReSideRdrLeDetn129RdrDetnAzi 0;
BA_ "GenSigStartValue" SG_ 114 ReSideRdrLeDetn129RdrDetnAzi 900;
BA_ "GenSigDataID" SG_ 114 ReSideRdrLeDetn129RdrDetnChks "0x10DD";
BA_ "GenSigFuncType" SG_ 114 ReSideRdrLeDetn129RdrDetnChks 15;
BA_ "GenSigSendType" SG_ 114 ReSideRdrLeDetn129RdrDetnChks 0;
BA_ "GenSigFuncType" SG_ 114 ReSideRdrLeDetn129RdrDetnCntr 16;
BA_ "GenSigSendType" SG_ 114 ReSideRdrLeDetn129RdrDetnCntr 0;
BA_ "GenSigSendType" SG_ 114 ReSideRdrLeDetn129RdrDetnConf 0;
BA_ "GenSigSendType" SG_ 114 ReSideRdrLeDetn129RdrDetnElevn 0;
BA_ "GenSigStartValue" SG_ 114 ReSideRdrLeDetn129RdrDetnElevn 15;
BA_ "GenSigSendType" SG_ 114 ReSideRdrLeDetn129RdrDetnPwr 0;
BA_ "GenSigSendType" SG_ 114 ReSideRdrLeDetn129RdrDetnRng 0;
BA_ "GenSigStartValue" SG_ 114 ReSideRdrLeDetn129RdrDetnRng 10050;
BA_ "GenSigSendType" SG_ 114 ReSideRdrLeDetn129RdrDetnRngV 0;
BA_ "GenSigStartValue" SG_ 114 ReSideRdrLeDetn129RdrDetnRngV 4000;
BA_ "GenSigSendType" SG_ 114 ReSideRdrLeDetn129RdrDetnSameRV 0;
BA_ "GenSigSendType" SG_ 114 ReSideRdrLeDetn129RdrDetnSts 0;
BA_ "GenSigStartValue" SG_ 114 ReSideRdrLeDetn129RdrDetnSts 3;
BA_ "GenSigSendType" SG_ 114 ReSideRdrLeDetn130RdrDetnAmbigState 0;
BA_ "GenSigSendType" SG_ 114 ReSideRdrLeDetn130RdrDetnAssoTrkID 0;
BA_ "GenSigSendType" SG_ 114 ReSideRdrLeDetn130RdrDetnAzi 0;
BA_ "GenSigStartValue" SG_ 114 ReSideRdrLeDetn130RdrDetnAzi 900;
BA_ "GenSigDataID" SG_ 114 ReSideRdrLeDetn130RdrDetnChks "0x10DE";
BA_ "GenSigFuncType" SG_ 114 ReSideRdrLeDetn130RdrDetnChks 15;
BA_ "GenSigSendType" SG_ 114 ReSideRdrLeDetn130RdrDetnChks 0;
BA_ "GenSigFuncType" SG_ 114 ReSideRdrLeDetn130RdrDetnCntr 16;
BA_ "GenSigSendType" SG_ 114 ReSideRdrLeDetn130RdrDetnCntr 0;
BA_ "GenSigSendType" SG_ 114 ReSideRdrLeDetn130RdrDetnConf 0;
BA_ "GenSigSendType" SG_ 114 ReSideRdrLeDetn130RdrDetnElevn 0;
BA_ "GenSigStartValue" SG_ 114 ReSideRdrLeDetn130RdrDetnElevn 15;
BA_ "GenSigSendType" SG_ 114 ReSideRdrLeDetn130RdrDetnPwr 0;
BA_ "GenSigSendType" SG_ 114 ReSideRdrLeDetn130RdrDetnRng 0;
BA_ "GenSigStartValue" SG_ 114 ReSideRdrLeDetn130RdrDetnRng 10050;
BA_ "GenSigSendType" SG_ 114 ReSideRdrLeDetn130RdrDetnRngV 0;
BA_ "GenSigStartValue" SG_ 114 ReSideRdrLeDetn130RdrDetnRngV 4000;
BA_ "GenSigSendType" SG_ 114 ReSideRdrLeDetn130RdrDetnSameRV 0;
BA_ "GenSigSendType" SG_ 114 ReSideRdrLeDetn130RdrDetnSts 0;
BA_ "GenSigStartValue" SG_ 114 ReSideRdrLeDetn130RdrDetnSts 3;
BA_ "GenSigSendType" SG_ 114 ReSideRdrLeDetn131RdrDetnAmbigState 0;
BA_ "GenSigSendType" SG_ 114 ReSideRdrLeDetn131RdrDetnAssoTrkID 0;
BA_ "GenSigSendType" SG_ 114 ReSideRdrLeDetn131RdrDetnAzi 0;
BA_ "GenSigStartValue" SG_ 114 ReSideRdrLeDetn131RdrDetnAzi 900;
BA_ "GenSigDataID" SG_ 114 ReSideRdrLeDetn131RdrDetnChks "0x10DF";
BA_ "GenSigFuncType" SG_ 114 ReSideRdrLeDetn131RdrDetnChks 15;
BA_ "GenSigSendType" SG_ 114 ReSideRdrLeDetn131RdrDetnChks 0;
BA_ "GenSigFuncType" SG_ 114 ReSideRdrLeDetn131RdrDetnCntr 16;
BA_ "GenSigSendType" SG_ 114 ReSideRdrLeDetn131RdrDetnCntr 0;
BA_ "GenSigSendType" SG_ 114 ReSideRdrLeDetn131RdrDetnConf 0;
BA_ "GenSigSendType" SG_ 114 ReSideRdrLeDetn131RdrDetnElevn 0;
BA_ "GenSigStartValue" SG_ 114 ReSideRdrLeDetn131RdrDetnElevn 15;
BA_ "GenSigSendType" SG_ 114 ReSideRdrLeDetn131RdrDetnPwr 0;
BA_ "GenSigSendType" SG_ 114 ReSideRdrLeDetn131RdrDetnRng 0;
BA_ "GenSigStartValue" SG_ 114 ReSideRdrLeDetn131RdrDetnRng 10050;
BA_ "GenSigSendType" SG_ 114 ReSideRdrLeDetn131RdrDetnRngV 0;
BA_ "GenSigStartValue" SG_ 114 ReSideRdrLeDetn131RdrDetnRngV 4000;
BA_ "GenSigSendType" SG_ 114 ReSideRdrLeDetn131RdrDetnSameRV 0;
BA_ "GenSigSendType" SG_ 114 ReSideRdrLeDetn131RdrDetnSts 0;
BA_ "GenSigStartValue" SG_ 114 ReSideRdrLeDetn131RdrDetnSts 3;
BA_ "GenSigSendType" SG_ 114 ReSideRdrLeDetn132RdrDetnAmbigState 0;
BA_ "GenSigSendType" SG_ 114 ReSideRdrLeDetn132RdrDetnAssoTrkID 0;
BA_ "GenSigSendType" SG_ 114 ReSideRdrLeDetn132RdrDetnAzi 0;
BA_ "GenSigStartValue" SG_ 114 ReSideRdrLeDetn132RdrDetnAzi 900;
BA_ "GenSigDataID" SG_ 114 ReSideRdrLeDetn132RdrDetnChks "0x10E0";
BA_ "GenSigFuncType" SG_ 114 ReSideRdrLeDetn132RdrDetnChks 15;
BA_ "GenSigSendType" SG_ 114 ReSideRdrLeDetn132RdrDetnChks 0;
BA_ "GenSigFuncType" SG_ 114 ReSideRdrLeDetn132RdrDetnCntr 16;
BA_ "GenSigSendType" SG_ 114 ReSideRdrLeDetn132RdrDetnCntr 0;
BA_ "GenSigSendType" SG_ 114 ReSideRdrLeDetn132RdrDetnConf 0;
BA_ "GenSigSendType" SG_ 114 ReSideRdrLeDetn132RdrDetnElevn 0;
BA_ "GenSigStartValue" SG_ 114 ReSideRdrLeDetn132RdrDetnElevn 15;
BA_ "GenSigSendType" SG_ 114 ReSideRdrLeDetn132RdrDetnPwr 0;
BA_ "GenSigSendType" SG_ 114 ReSideRdrLeDetn132RdrDetnRng 0;
BA_ "GenSigStartValue" SG_ 114 ReSideRdrLeDetn132RdrDetnRng 10050;
BA_ "GenSigSendType" SG_ 114 ReSideRdrLeDetn132RdrDetnRngV 0;
BA_ "GenSigStartValue" SG_ 114 ReSideRdrLeDetn132RdrDetnRngV 4000;
BA_ "GenSigSendType" SG_ 114 ReSideRdrLeDetn132RdrDetnSameRV 0;
BA_ "GenSigSendType" SG_ 114 ReSideRdrLeDetn132RdrDetnSts 0;
BA_ "GenSigStartValue" SG_ 114 ReSideRdrLeDetn132RdrDetnSts 3;
BA_ "GenSigSendType" SG_ 115 ReSideRdrLeDetn133RdrDetnAmbigState 0;
BA_ "GenSigSendType" SG_ 115 ReSideRdrLeDetn133RdrDetnAssoTrkID 0;
BA_ "GenSigSendType" SG_ 115 ReSideRdrLeDetn133RdrDetnAzi 0;
BA_ "GenSigStartValue" SG_ 115 ReSideRdrLeDetn133RdrDetnAzi 900;
BA_ "GenSigDataID" SG_ 115 ReSideRdrLeDetn133RdrDetnChks "0x10E1";
BA_ "GenSigFuncType" SG_ 115 ReSideRdrLeDetn133RdrDetnChks 15;
BA_ "GenSigSendType" SG_ 115 ReSideRdrLeDetn133RdrDetnChks 0;
BA_ "GenSigFuncType" SG_ 115 ReSideRdrLeDetn133RdrDetnCntr 16;
BA_ "GenSigSendType" SG_ 115 ReSideRdrLeDetn133RdrDetnCntr 0;
BA_ "GenSigSendType" SG_ 115 ReSideRdrLeDetn133RdrDetnConf 0;
BA_ "GenSigSendType" SG_ 115 ReSideRdrLeDetn133RdrDetnElevn 0;
BA_ "GenSigStartValue" SG_ 115 ReSideRdrLeDetn133RdrDetnElevn 15;
BA_ "GenSigSendType" SG_ 115 ReSideRdrLeDetn133RdrDetnPwr 0;
BA_ "GenSigSendType" SG_ 115 ReSideRdrLeDetn133RdrDetnRng 0;
BA_ "GenSigStartValue" SG_ 115 ReSideRdrLeDetn133RdrDetnRng 10050;
BA_ "GenSigSendType" SG_ 115 ReSideRdrLeDetn133RdrDetnRngV 0;
BA_ "GenSigStartValue" SG_ 115 ReSideRdrLeDetn133RdrDetnRngV 4000;
BA_ "GenSigSendType" SG_ 115 ReSideRdrLeDetn133RdrDetnSameRV 0;
BA_ "GenSigSendType" SG_ 115 ReSideRdrLeDetn133RdrDetnSts 0;
BA_ "GenSigStartValue" SG_ 115 ReSideRdrLeDetn133RdrDetnSts 3;
BA_ "GenSigSendType" SG_ 115 ReSideRdrLeDetn134RdrDetnAmbigState 0;
BA_ "GenSigSendType" SG_ 115 ReSideRdrLeDetn134RdrDetnAssoTrkID 0;
BA_ "GenSigSendType" SG_ 115 ReSideRdrLeDetn134RdrDetnAzi 0;
BA_ "GenSigStartValue" SG_ 115 ReSideRdrLeDetn134RdrDetnAzi 900;
BA_ "GenSigDataID" SG_ 115 ReSideRdrLeDetn134RdrDetnChks "0x10E2";
BA_ "GenSigFuncType" SG_ 115 ReSideRdrLeDetn134RdrDetnChks 15;
BA_ "GenSigSendType" SG_ 115 ReSideRdrLeDetn134RdrDetnChks 0;
BA_ "GenSigFuncType" SG_ 115 ReSideRdrLeDetn134RdrDetnCntr 16;
BA_ "GenSigSendType" SG_ 115 ReSideRdrLeDetn134RdrDetnCntr 0;
BA_ "GenSigSendType" SG_ 115 ReSideRdrLeDetn134RdrDetnConf 0;
BA_ "GenSigSendType" SG_ 115 ReSideRdrLeDetn134RdrDetnElevn 0;
BA_ "GenSigStartValue" SG_ 115 ReSideRdrLeDetn134RdrDetnElevn 15;
BA_ "GenSigSendType" SG_ 115 ReSideRdrLeDetn134RdrDetnPwr 0;
BA_ "GenSigSendType" SG_ 115 ReSideRdrLeDetn134RdrDetnRng 0;
BA_ "GenSigStartValue" SG_ 115 ReSideRdrLeDetn134RdrDetnRng 10050;
BA_ "GenSigSendType" SG_ 115 ReSideRdrLeDetn134RdrDetnRngV 0;
BA_ "GenSigStartValue" SG_ 115 ReSideRdrLeDetn134RdrDetnRngV 4000;
BA_ "GenSigSendType" SG_ 115 ReSideRdrLeDetn134RdrDetnSameRV 0;
BA_ "GenSigSendType" SG_ 115 ReSideRdrLeDetn134RdrDetnSts 0;
BA_ "GenSigStartValue" SG_ 115 ReSideRdrLeDetn134RdrDetnSts 3;
BA_ "GenSigSendType" SG_ 115 ReSideRdrLeDetn135RdrDetnAmbigState 0;
BA_ "GenSigSendType" SG_ 115 ReSideRdrLeDetn135RdrDetnAssoTrkID 0;
BA_ "GenSigSendType" SG_ 115 ReSideRdrLeDetn135RdrDetnAzi 0;
BA_ "GenSigStartValue" SG_ 115 ReSideRdrLeDetn135RdrDetnAzi 900;
BA_ "GenSigDataID" SG_ 115 ReSideRdrLeDetn135RdrDetnChks "0x10E3";
BA_ "GenSigFuncType" SG_ 115 ReSideRdrLeDetn135RdrDetnChks 15;
BA_ "GenSigSendType" SG_ 115 ReSideRdrLeDetn135RdrDetnChks 0;
BA_ "GenSigFuncType" SG_ 115 ReSideRdrLeDetn135RdrDetnCntr 16;
BA_ "GenSigSendType" SG_ 115 ReSideRdrLeDetn135RdrDetnCntr 0;
BA_ "GenSigSendType" SG_ 115 ReSideRdrLeDetn135RdrDetnConf 0;
BA_ "GenSigSendType" SG_ 115 ReSideRdrLeDetn135RdrDetnElevn 0;
BA_ "GenSigStartValue" SG_ 115 ReSideRdrLeDetn135RdrDetnElevn 15;
BA_ "GenSigSendType" SG_ 115 ReSideRdrLeDetn135RdrDetnPwr 0;
BA_ "GenSigSendType" SG_ 115 ReSideRdrLeDetn135RdrDetnRng 0;
BA_ "GenSigStartValue" SG_ 115 ReSideRdrLeDetn135RdrDetnRng 10050;
BA_ "GenSigSendType" SG_ 115 ReSideRdrLeDetn135RdrDetnRngV 0;
BA_ "GenSigStartValue" SG_ 115 ReSideRdrLeDetn135RdrDetnRngV 4000;
BA_ "GenSigSendType" SG_ 115 ReSideRdrLeDetn135RdrDetnSameRV 0;
BA_ "GenSigSendType" SG_ 115 ReSideRdrLeDetn135RdrDetnSts 0;
BA_ "GenSigStartValue" SG_ 115 ReSideRdrLeDetn135RdrDetnSts 3;
BA_ "GenSigSendType" SG_ 115 ReSideRdrLeDetn136RdrDetnAmbigState 0;
BA_ "GenSigSendType" SG_ 115 ReSideRdrLeDetn136RdrDetnAssoTrkID 0;
BA_ "GenSigSendType" SG_ 115 ReSideRdrLeDetn136RdrDetnAzi 0;
BA_ "GenSigStartValue" SG_ 115 ReSideRdrLeDetn136RdrDetnAzi 900;
BA_ "GenSigDataID" SG_ 115 ReSideRdrLeDetn136RdrDetnChks "0x10E4";
BA_ "GenSigFuncType" SG_ 115 ReSideRdrLeDetn136RdrDetnChks 15;
BA_ "GenSigSendType" SG_ 115 ReSideRdrLeDetn136RdrDetnChks 0;
BA_ "GenSigFuncType" SG_ 115 ReSideRdrLeDetn136RdrDetnCntr 16;
BA_ "GenSigSendType" SG_ 115 ReSideRdrLeDetn136RdrDetnCntr 0;
BA_ "GenSigSendType" SG_ 115 ReSideRdrLeDetn136RdrDetnConf 0;
BA_ "GenSigSendType" SG_ 115 ReSideRdrLeDetn136RdrDetnElevn 0;
BA_ "GenSigStartValue" SG_ 115 ReSideRdrLeDetn136RdrDetnElevn 15;
BA_ "GenSigSendType" SG_ 115 ReSideRdrLeDetn136RdrDetnPwr 0;
BA_ "GenSigSendType" SG_ 115 ReSideRdrLeDetn136RdrDetnRng 0;
BA_ "GenSigStartValue" SG_ 115 ReSideRdrLeDetn136RdrDetnRng 10050;
BA_ "GenSigSendType" SG_ 115 ReSideRdrLeDetn136RdrDetnRngV 0;
BA_ "GenSigStartValue" SG_ 115 ReSideRdrLeDetn136RdrDetnRngV 4000;
BA_ "GenSigSendType" SG_ 115 ReSideRdrLeDetn136RdrDetnSameRV 0;
BA_ "GenSigSendType" SG_ 115 ReSideRdrLeDetn136RdrDetnSts 0;
BA_ "GenSigStartValue" SG_ 115 ReSideRdrLeDetn136RdrDetnSts 3;
BA_ "GenSigSendType" SG_ 115 ReSideRdrLeDetn137RdrDetnAmbigState 0;
BA_ "GenSigSendType" SG_ 115 ReSideRdrLeDetn137RdrDetnAssoTrkID 0;
BA_ "GenSigSendType" SG_ 115 ReSideRdrLeDetn137RdrDetnAzi 0;
BA_ "GenSigStartValue" SG_ 115 ReSideRdrLeDetn137RdrDetnAzi 900;
BA_ "GenSigDataID" SG_ 115 ReSideRdrLeDetn137RdrDetnChks "0x10E5";
BA_ "GenSigFuncType" SG_ 115 ReSideRdrLeDetn137RdrDetnChks 15;
BA_ "GenSigSendType" SG_ 115 ReSideRdrLeDetn137RdrDetnChks 0;
BA_ "GenSigFuncType" SG_ 115 ReSideRdrLeDetn137RdrDetnCntr 16;
BA_ "GenSigSendType" SG_ 115 ReSideRdrLeDetn137RdrDetnCntr 0;
BA_ "GenSigSendType" SG_ 115 ReSideRdrLeDetn137RdrDetnConf 0;
BA_ "GenSigSendType" SG_ 115 ReSideRdrLeDetn137RdrDetnElevn 0;
BA_ "GenSigStartValue" SG_ 115 ReSideRdrLeDetn137RdrDetnElevn 15;
BA_ "GenSigSendType" SG_ 115 ReSideRdrLeDetn137RdrDetnPwr 0;
BA_ "GenSigSendType" SG_ 115 ReSideRdrLeDetn137RdrDetnRng 0;
BA_ "GenSigStartValue" SG_ 115 ReSideRdrLeDetn137RdrDetnRng 10050;
BA_ "GenSigSendType" SG_ 115 ReSideRdrLeDetn137RdrDetnRngV 0;
BA_ "GenSigStartValue" SG_ 115 ReSideRdrLeDetn137RdrDetnRngV 4000;
BA_ "GenSigSendType" SG_ 115 ReSideRdrLeDetn137RdrDetnSameRV 0;
BA_ "GenSigSendType" SG_ 115 ReSideRdrLeDetn137RdrDetnSts 0;
BA_ "GenSigStartValue" SG_ 115 ReSideRdrLeDetn137RdrDetnSts 3;
BA_ "GenSigSendType" SG_ 115 ReSideRdrLeDetn138RdrDetnAmbigState 0;
BA_ "GenSigSendType" SG_ 115 ReSideRdrLeDetn138RdrDetnAssoTrkID 0;
BA_ "GenSigSendType" SG_ 115 ReSideRdrLeDetn138RdrDetnAzi 0;
BA_ "GenSigStartValue" SG_ 115 ReSideRdrLeDetn138RdrDetnAzi 900;
BA_ "GenSigDataID" SG_ 115 ReSideRdrLeDetn138RdrDetnChks "0x10E6";
BA_ "GenSigFuncType" SG_ 115 ReSideRdrLeDetn138RdrDetnChks 15;
BA_ "GenSigSendType" SG_ 115 ReSideRdrLeDetn138RdrDetnChks 0;
BA_ "GenSigFuncType" SG_ 115 ReSideRdrLeDetn138RdrDetnCntr 16;
BA_ "GenSigSendType" SG_ 115 ReSideRdrLeDetn138RdrDetnCntr 0;
BA_ "GenSigSendType" SG_ 115 ReSideRdrLeDetn138RdrDetnConf 0;
BA_ "GenSigSendType" SG_ 115 ReSideRdrLeDetn138RdrDetnElevn 0;
BA_ "GenSigStartValue" SG_ 115 ReSideRdrLeDetn138RdrDetnElevn 15;
BA_ "GenSigSendType" SG_ 115 ReSideRdrLeDetn138RdrDetnPwr 0;
BA_ "GenSigSendType" SG_ 115 ReSideRdrLeDetn138RdrDetnRng 0;
BA_ "GenSigStartValue" SG_ 115 ReSideRdrLeDetn138RdrDetnRng 10050;
BA_ "GenSigSendType" SG_ 115 ReSideRdrLeDetn138RdrDetnRngV 0;
BA_ "GenSigStartValue" SG_ 115 ReSideRdrLeDetn138RdrDetnRngV 4000;
BA_ "GenSigSendType" SG_ 115 ReSideRdrLeDetn138RdrDetnSameRV 0;
BA_ "GenSigSendType" SG_ 115 ReSideRdrLeDetn138RdrDetnSts 0;
BA_ "GenSigStartValue" SG_ 115 ReSideRdrLeDetn138RdrDetnSts 3;
BA_ "GenSigSendType" SG_ 116 ReSideRdrLeDetn139RdrDetnAmbigState 0;
BA_ "GenSigSendType" SG_ 116 ReSideRdrLeDetn139RdrDetnAssoTrkID 0;
BA_ "GenSigSendType" SG_ 116 ReSideRdrLeDetn139RdrDetnAzi 0;
BA_ "GenSigStartValue" SG_ 116 ReSideRdrLeDetn139RdrDetnAzi 900;
BA_ "GenSigDataID" SG_ 116 ReSideRdrLeDetn139RdrDetnChks "0x10E7";
BA_ "GenSigFuncType" SG_ 116 ReSideRdrLeDetn139RdrDetnChks 15;
BA_ "GenSigSendType" SG_ 116 ReSideRdrLeDetn139RdrDetnChks 0;
BA_ "GenSigFuncType" SG_ 116 ReSideRdrLeDetn139RdrDetnCntr 16;
BA_ "GenSigSendType" SG_ 116 ReSideRdrLeDetn139RdrDetnCntr 0;
BA_ "GenSigSendType" SG_ 116 ReSideRdrLeDetn139RdrDetnConf 0;
BA_ "GenSigSendType" SG_ 116 ReSideRdrLeDetn139RdrDetnElevn 0;
BA_ "GenSigStartValue" SG_ 116 ReSideRdrLeDetn139RdrDetnElevn 15;
BA_ "GenSigSendType" SG_ 116 ReSideRdrLeDetn139RdrDetnPwr 0;
BA_ "GenSigSendType" SG_ 116 ReSideRdrLeDetn139RdrDetnRng 0;
BA_ "GenSigStartValue" SG_ 116 ReSideRdrLeDetn139RdrDetnRng 10050;
BA_ "GenSigSendType" SG_ 116 ReSideRdrLeDetn139RdrDetnRngV 0;
BA_ "GenSigStartValue" SG_ 116 ReSideRdrLeDetn139RdrDetnRngV 4000;
BA_ "GenSigSendType" SG_ 116 ReSideRdrLeDetn139RdrDetnSameRV 0;
BA_ "GenSigSendType" SG_ 116 ReSideRdrLeDetn139RdrDetnSts 0;
BA_ "GenSigStartValue" SG_ 116 ReSideRdrLeDetn139RdrDetnSts 3;
BA_ "GenSigSendType" SG_ 116 ReSideRdrLeDetn140RdrDetnAmbigState 0;
BA_ "GenSigSendType" SG_ 116 ReSideRdrLeDetn140RdrDetnAssoTrkID 0;
BA_ "GenSigSendType" SG_ 116 ReSideRdrLeDetn140RdrDetnAzi 0;
BA_ "GenSigStartValue" SG_ 116 ReSideRdrLeDetn140RdrDetnAzi 900;
BA_ "GenSigDataID" SG_ 116 ReSideRdrLeDetn140RdrDetnChks "0x10E8";
BA_ "GenSigFuncType" SG_ 116 ReSideRdrLeDetn140RdrDetnChks 15;
BA_ "GenSigSendType" SG_ 116 ReSideRdrLeDetn140RdrDetnChks 0;
BA_ "GenSigFuncType" SG_ 116 ReSideRdrLeDetn140RdrDetnCntr 16;
BA_ "GenSigSendType" SG_ 116 ReSideRdrLeDetn140RdrDetnCntr 0;
BA_ "GenSigSendType" SG_ 116 ReSideRdrLeDetn140RdrDetnConf 0;
BA_ "GenSigSendType" SG_ 116 ReSideRdrLeDetn140RdrDetnElevn 0;
BA_ "GenSigStartValue" SG_ 116 ReSideRdrLeDetn140RdrDetnElevn 15;
BA_ "GenSigSendType" SG_ 116 ReSideRdrLeDetn140RdrDetnPwr 0;
BA_ "GenSigSendType" SG_ 116 ReSideRdrLeDetn140RdrDetnRng 0;
BA_ "GenSigStartValue" SG_ 116 ReSideRdrLeDetn140RdrDetnRng 10050;
BA_ "GenSigSendType" SG_ 116 ReSideRdrLeDetn140RdrDetnRngV 0;
BA_ "GenSigStartValue" SG_ 116 ReSideRdrLeDetn140RdrDetnRngV 4000;
BA_ "GenSigSendType" SG_ 116 ReSideRdrLeDetn140RdrDetnSameRV 0;
BA_ "GenSigSendType" SG_ 116 ReSideRdrLeDetn140RdrDetnSts 0;
BA_ "GenSigStartValue" SG_ 116 ReSideRdrLeDetn140RdrDetnSts 3;
BA_ "GenSigSendType" SG_ 116 ReSideRdrLeDetn141RdrDetnAmbigState 0;
BA_ "GenSigSendType" SG_ 116 ReSideRdrLeDetn141RdrDetnAssoTrkID 0;
BA_ "GenSigSendType" SG_ 116 ReSideRdrLeDetn141RdrDetnAzi 0;
BA_ "GenSigStartValue" SG_ 116 ReSideRdrLeDetn141RdrDetnAzi 900;
BA_ "GenSigDataID" SG_ 116 ReSideRdrLeDetn141RdrDetnChks "0x10E9";
BA_ "GenSigFuncType" SG_ 116 ReSideRdrLeDetn141RdrDetnChks 15;
BA_ "GenSigSendType" SG_ 116 ReSideRdrLeDetn141RdrDetnChks 0;
BA_ "GenSigFuncType" SG_ 116 ReSideRdrLeDetn141RdrDetnCntr 16;
BA_ "GenSigSendType" SG_ 116 ReSideRdrLeDetn141RdrDetnCntr 0;
BA_ "GenSigSendType" SG_ 116 ReSideRdrLeDetn141RdrDetnConf 0;
BA_ "GenSigSendType" SG_ 116 ReSideRdrLeDetn141RdrDetnElevn 0;
BA_ "GenSigStartValue" SG_ 116 ReSideRdrLeDetn141RdrDetnElevn 15;
BA_ "GenSigSendType" SG_ 116 ReSideRdrLeDetn141RdrDetnPwr 0;
BA_ "GenSigSendType" SG_ 116 ReSideRdrLeDetn141RdrDetnRng 0;
BA_ "GenSigStartValue" SG_ 116 ReSideRdrLeDetn141RdrDetnRng 10050;
BA_ "GenSigSendType" SG_ 116 ReSideRdrLeDetn141RdrDetnRngV 0;
BA_ "GenSigStartValue" SG_ 116 ReSideRdrLeDetn141RdrDetnRngV 4000;
BA_ "GenSigSendType" SG_ 116 ReSideRdrLeDetn141RdrDetnSameRV 0;
BA_ "GenSigSendType" SG_ 116 ReSideRdrLeDetn141RdrDetnSts 0;
BA_ "GenSigStartValue" SG_ 116 ReSideRdrLeDetn141RdrDetnSts 3;
BA_ "GenSigSendType" SG_ 116 ReSideRdrLeDetn142RdrDetnAmbigState 0;
BA_ "GenSigSendType" SG_ 116 ReSideRdrLeDetn142RdrDetnAssoTrkID 0;
BA_ "GenSigSendType" SG_ 116 ReSideRdrLeDetn142RdrDetnAzi 0;
BA_ "GenSigStartValue" SG_ 116 ReSideRdrLeDetn142RdrDetnAzi 900;
BA_ "GenSigDataID" SG_ 116 ReSideRdrLeDetn142RdrDetnChks "0x10EA";
BA_ "GenSigFuncType" SG_ 116 ReSideRdrLeDetn142RdrDetnChks 15;
BA_ "GenSigSendType" SG_ 116 ReSideRdrLeDetn142RdrDetnChks 0;
BA_ "GenSigFuncType" SG_ 116 ReSideRdrLeDetn142RdrDetnCntr 16;
BA_ "GenSigSendType" SG_ 116 ReSideRdrLeDetn142RdrDetnCntr 0;
BA_ "GenSigSendType" SG_ 116 ReSideRdrLeDetn142RdrDetnConf 0;
BA_ "GenSigSendType" SG_ 116 ReSideRdrLeDetn142RdrDetnElevn 0;
BA_ "GenSigStartValue" SG_ 116 ReSideRdrLeDetn142RdrDetnElevn 15;
BA_ "GenSigSendType" SG_ 116 ReSideRdrLeDetn142RdrDetnPwr 0;
BA_ "GenSigSendType" SG_ 116 ReSideRdrLeDetn142RdrDetnRng 0;
BA_ "GenSigStartValue" SG_ 116 ReSideRdrLeDetn142RdrDetnRng 10050;
BA_ "GenSigSendType" SG_ 116 ReSideRdrLeDetn142RdrDetnRngV 0;
BA_ "GenSigStartValue" SG_ 116 ReSideRdrLeDetn142RdrDetnRngV 4000;
BA_ "GenSigSendType" SG_ 116 ReSideRdrLeDetn142RdrDetnSameRV 0;
BA_ "GenSigSendType" SG_ 116 ReSideRdrLeDetn142RdrDetnSts 0;
BA_ "GenSigStartValue" SG_ 116 ReSideRdrLeDetn142RdrDetnSts 3;
BA_ "GenSigSendType" SG_ 116 ReSideRdrLeDetn143RdrDetnAmbigState 0;
BA_ "GenSigSendType" SG_ 116 ReSideRdrLeDetn143RdrDetnAssoTrkID 0;
BA_ "GenSigSendType" SG_ 116 ReSideRdrLeDetn143RdrDetnAzi 0;
BA_ "GenSigStartValue" SG_ 116 ReSideRdrLeDetn143RdrDetnAzi 900;
BA_ "GenSigDataID" SG_ 116 ReSideRdrLeDetn143RdrDetnChks "0x10EB";
BA_ "GenSigFuncType" SG_ 116 ReSideRdrLeDetn143RdrDetnChks 15;
BA_ "GenSigSendType" SG_ 116 ReSideRdrLeDetn143RdrDetnChks 0;
BA_ "GenSigFuncType" SG_ 116 ReSideRdrLeDetn143RdrDetnCntr 16;
BA_ "GenSigSendType" SG_ 116 ReSideRdrLeDetn143RdrDetnCntr 0;
BA_ "GenSigSendType" SG_ 116 ReSideRdrLeDetn143RdrDetnConf 0;
BA_ "GenSigSendType" SG_ 116 ReSideRdrLeDetn143RdrDetnElevn 0;
BA_ "GenSigStartValue" SG_ 116 ReSideRdrLeDetn143RdrDetnElevn 15;
BA_ "GenSigSendType" SG_ 116 ReSideRdrLeDetn143RdrDetnPwr 0;
BA_ "GenSigSendType" SG_ 116 ReSideRdrLeDetn143RdrDetnRng 0;
BA_ "GenSigStartValue" SG_ 116 ReSideRdrLeDetn143RdrDetnRng 10050;
BA_ "GenSigSendType" SG_ 116 ReSideRdrLeDetn143RdrDetnRngV 0;
BA_ "GenSigStartValue" SG_ 116 ReSideRdrLeDetn143RdrDetnRngV 4000;
BA_ "GenSigSendType" SG_ 116 ReSideRdrLeDetn143RdrDetnSameRV 0;
BA_ "GenSigSendType" SG_ 116 ReSideRdrLeDetn143RdrDetnSts 0;
BA_ "GenSigStartValue" SG_ 116 ReSideRdrLeDetn143RdrDetnSts 3;
BA_ "GenSigSendType" SG_ 116 ReSideRdrLeDetn144RdrDetnAmbigState 0;
BA_ "GenSigSendType" SG_ 116 ReSideRdrLeDetn144RdrDetnAssoTrkID 0;
BA_ "GenSigSendType" SG_ 116 ReSideRdrLeDetn144RdrDetnAzi 0;
BA_ "GenSigStartValue" SG_ 116 ReSideRdrLeDetn144RdrDetnAzi 900;
BA_ "GenSigDataID" SG_ 116 ReSideRdrLeDetn144RdrDetnChks "0x10EC";
BA_ "GenSigFuncType" SG_ 116 ReSideRdrLeDetn144RdrDetnChks 15;
BA_ "GenSigSendType" SG_ 116 ReSideRdrLeDetn144RdrDetnChks 0;
BA_ "GenSigFuncType" SG_ 116 ReSideRdrLeDetn144RdrDetnCntr 16;
BA_ "GenSigSendType" SG_ 116 ReSideRdrLeDetn144RdrDetnCntr 0;
BA_ "GenSigSendType" SG_ 116 ReSideRdrLeDetn144RdrDetnConf 0;
BA_ "GenSigSendType" SG_ 116 ReSideRdrLeDetn144RdrDetnElevn 0;
BA_ "GenSigStartValue" SG_ 116 ReSideRdrLeDetn144RdrDetnElevn 15;
BA_ "GenSigSendType" SG_ 116 ReSideRdrLeDetn144RdrDetnPwr 0;
BA_ "GenSigSendType" SG_ 116 ReSideRdrLeDetn144RdrDetnRng 0;
BA_ "GenSigStartValue" SG_ 116 ReSideRdrLeDetn144RdrDetnRng 10050;
BA_ "GenSigSendType" SG_ 116 ReSideRdrLeDetn144RdrDetnRngV 0;
BA_ "GenSigStartValue" SG_ 116 ReSideRdrLeDetn144RdrDetnRngV 4000;
BA_ "GenSigSendType" SG_ 116 ReSideRdrLeDetn144RdrDetnSameRV 0;
BA_ "GenSigSendType" SG_ 116 ReSideRdrLeDetn144RdrDetnSts 0;
BA_ "GenSigStartValue" SG_ 116 ReSideRdrLeDetn144RdrDetnSts 3;
BA_ "GenSigSendType" SG_ 117 ReSideRdrLeDetn145RdrDetnAmbigState 0;
BA_ "GenSigSendType" SG_ 117 ReSideRdrLeDetn145RdrDetnAssoTrkID 0;
BA_ "GenSigSendType" SG_ 117 ReSideRdrLeDetn145RdrDetnAzi 0;
BA_ "GenSigStartValue" SG_ 117 ReSideRdrLeDetn145RdrDetnAzi 900;
BA_ "GenSigDataID" SG_ 117 ReSideRdrLeDetn145RdrDetnChks "0x10ED";
BA_ "GenSigFuncType" SG_ 117 ReSideRdrLeDetn145RdrDetnChks 15;
BA_ "GenSigSendType" SG_ 117 ReSideRdrLeDetn145RdrDetnChks 0;
BA_ "GenSigFuncType" SG_ 117 ReSideRdrLeDetn145RdrDetnCntr 16;
BA_ "GenSigSendType" SG_ 117 ReSideRdrLeDetn145RdrDetnCntr 0;
BA_ "GenSigSendType" SG_ 117 ReSideRdrLeDetn145RdrDetnConf 0;
BA_ "GenSigSendType" SG_ 117 ReSideRdrLeDetn145RdrDetnElevn 0;
BA_ "GenSigStartValue" SG_ 117 ReSideRdrLeDetn145RdrDetnElevn 15;
BA_ "GenSigSendType" SG_ 117 ReSideRdrLeDetn145RdrDetnPwr 0;
BA_ "GenSigSendType" SG_ 117 ReSideRdrLeDetn145RdrDetnRng 0;
BA_ "GenSigStartValue" SG_ 117 ReSideRdrLeDetn145RdrDetnRng 10050;
BA_ "GenSigSendType" SG_ 117 ReSideRdrLeDetn145RdrDetnRngV 0;
BA_ "GenSigStartValue" SG_ 117 ReSideRdrLeDetn145RdrDetnRngV 4000;
BA_ "GenSigSendType" SG_ 117 ReSideRdrLeDetn145RdrDetnSameRV 0;
BA_ "GenSigSendType" SG_ 117 ReSideRdrLeDetn145RdrDetnSts 0;
BA_ "GenSigStartValue" SG_ 117 ReSideRdrLeDetn145RdrDetnSts 3;
BA_ "GenSigSendType" SG_ 117 ReSideRdrLeDetn146RdrDetnAmbigState 0;
BA_ "GenSigSendType" SG_ 117 ReSideRdrLeDetn146RdrDetnAssoTrkID 0;
BA_ "GenSigSendType" SG_ 117 ReSideRdrLeDetn146RdrDetnAzi 0;
BA_ "GenSigStartValue" SG_ 117 ReSideRdrLeDetn146RdrDetnAzi 900;
BA_ "GenSigDataID" SG_ 117 ReSideRdrLeDetn146RdrDetnChks "0x10EE";
BA_ "GenSigFuncType" SG_ 117 ReSideRdrLeDetn146RdrDetnChks 15;
BA_ "GenSigSendType" SG_ 117 ReSideRdrLeDetn146RdrDetnChks 0;
BA_ "GenSigFuncType" SG_ 117 ReSideRdrLeDetn146RdrDetnCntr 16;
BA_ "GenSigSendType" SG_ 117 ReSideRdrLeDetn146RdrDetnCntr 0;
BA_ "GenSigSendType" SG_ 117 ReSideRdrLeDetn146RdrDetnConf 0;
BA_ "GenSigSendType" SG_ 117 ReSideRdrLeDetn146RdrDetnElevn 0;
BA_ "GenSigStartValue" SG_ 117 ReSideRdrLeDetn146RdrDetnElevn 15;
BA_ "GenSigSendType" SG_ 117 ReSideRdrLeDetn146RdrDetnPwr 0;
BA_ "GenSigSendType" SG_ 117 ReSideRdrLeDetn146RdrDetnRng 0;
BA_ "GenSigStartValue" SG_ 117 ReSideRdrLeDetn146RdrDetnRng 10050;
BA_ "GenSigSendType" SG_ 117 ReSideRdrLeDetn146RdrDetnRngV 0;
BA_ "GenSigStartValue" SG_ 117 ReSideRdrLeDetn146RdrDetnRngV 4000;
BA_ "GenSigSendType" SG_ 117 ReSideRdrLeDetn146RdrDetnSameRV 0;
BA_ "GenSigSendType" SG_ 117 ReSideRdrLeDetn146RdrDetnSts 0;
BA_ "GenSigStartValue" SG_ 117 ReSideRdrLeDetn146RdrDetnSts 3;
BA_ "GenSigSendType" SG_ 117 ReSideRdrLeDetn147RdrDetnAmbigState 0;
BA_ "GenSigSendType" SG_ 117 ReSideRdrLeDetn147RdrDetnAssoTrkID 0;
BA_ "GenSigSendType" SG_ 117 ReSideRdrLeDetn147RdrDetnAzi 0;
BA_ "GenSigStartValue" SG_ 117 ReSideRdrLeDetn147RdrDetnAzi 900;
BA_ "GenSigDataID" SG_ 117 ReSideRdrLeDetn147RdrDetnChks "0x10EF";
BA_ "GenSigFuncType" SG_ 117 ReSideRdrLeDetn147RdrDetnChks 15;
BA_ "GenSigSendType" SG_ 117 ReSideRdrLeDetn147RdrDetnChks 0;
BA_ "GenSigFuncType" SG_ 117 ReSideRdrLeDetn147RdrDetnCntr 16;
BA_ "GenSigSendType" SG_ 117 ReSideRdrLeDetn147RdrDetnCntr 0;
BA_ "GenSigSendType" SG_ 117 ReSideRdrLeDetn147RdrDetnConf 0;
BA_ "GenSigSendType" SG_ 117 ReSideRdrLeDetn147RdrDetnElevn 0;
BA_ "GenSigStartValue" SG_ 117 ReSideRdrLeDetn147RdrDetnElevn 15;
BA_ "GenSigSendType" SG_ 117 ReSideRdrLeDetn147RdrDetnPwr 0;
BA_ "GenSigSendType" SG_ 117 ReSideRdrLeDetn147RdrDetnRng 0;
BA_ "GenSigStartValue" SG_ 117 ReSideRdrLeDetn147RdrDetnRng 10050;
BA_ "GenSigSendType" SG_ 117 ReSideRdrLeDetn147RdrDetnRngV 0;
BA_ "GenSigStartValue" SG_ 117 ReSideRdrLeDetn147RdrDetnRngV 4000;
BA_ "GenSigSendType" SG_ 117 ReSideRdrLeDetn147RdrDetnSameRV 0;
BA_ "GenSigSendType" SG_ 117 ReSideRdrLeDetn147RdrDetnSts 0;
BA_ "GenSigStartValue" SG_ 117 ReSideRdrLeDetn147RdrDetnSts 3;
BA_ "GenSigSendType" SG_ 117 ReSideRdrLeDetn148RdrDetnAmbigState 0;
BA_ "GenSigSendType" SG_ 117 ReSideRdrLeDetn148RdrDetnAssoTrkID 0;
BA_ "GenSigSendType" SG_ 117 ReSideRdrLeDetn148RdrDetnAzi 0;
BA_ "GenSigStartValue" SG_ 117 ReSideRdrLeDetn148RdrDetnAzi 900;
BA_ "GenSigDataID" SG_ 117 ReSideRdrLeDetn148RdrDetnChks "0x10F0";
BA_ "GenSigFuncType" SG_ 117 ReSideRdrLeDetn148RdrDetnChks 15;
BA_ "GenSigSendType" SG_ 117 ReSideRdrLeDetn148RdrDetnChks 0;
BA_ "GenSigFuncType" SG_ 117 ReSideRdrLeDetn148RdrDetnCntr 16;
BA_ "GenSigSendType" SG_ 117 ReSideRdrLeDetn148RdrDetnCntr 0;
BA_ "GenSigSendType" SG_ 117 ReSideRdrLeDetn148RdrDetnConf 0;
BA_ "GenSigSendType" SG_ 117 ReSideRdrLeDetn148RdrDetnElevn 0;
BA_ "GenSigStartValue" SG_ 117 ReSideRdrLeDetn148RdrDetnElevn 15;
BA_ "GenSigSendType" SG_ 117 ReSideRdrLeDetn148RdrDetnPwr 0;
BA_ "GenSigSendType" SG_ 117 ReSideRdrLeDetn148RdrDetnRng 0;
BA_ "GenSigStartValue" SG_ 117 ReSideRdrLeDetn148RdrDetnRng 10050;
BA_ "GenSigSendType" SG_ 117 ReSideRdrLeDetn148RdrDetnRngV 0;
BA_ "GenSigStartValue" SG_ 117 ReSideRdrLeDetn148RdrDetnRngV 4000;
BA_ "GenSigSendType" SG_ 117 ReSideRdrLeDetn148RdrDetnSameRV 0;
BA_ "GenSigSendType" SG_ 117 ReSideRdrLeDetn148RdrDetnSts 0;
BA_ "GenSigStartValue" SG_ 117 ReSideRdrLeDetn148RdrDetnSts 3;
BA_ "GenSigSendType" SG_ 117 ReSideRdrLeDetn149RdrDetnAmbigState 0;
BA_ "GenSigSendType" SG_ 117 ReSideRdrLeDetn149RdrDetnAssoTrkID 0;
BA_ "GenSigSendType" SG_ 117 ReSideRdrLeDetn149RdrDetnAzi 0;
BA_ "GenSigStartValue" SG_ 117 ReSideRdrLeDetn149RdrDetnAzi 900;
BA_ "GenSigDataID" SG_ 117 ReSideRdrLeDetn149RdrDetnChks "0x10F1";
BA_ "GenSigFuncType" SG_ 117 ReSideRdrLeDetn149RdrDetnChks 15;
BA_ "GenSigSendType" SG_ 117 ReSideRdrLeDetn149RdrDetnChks 0;
BA_ "GenSigFuncType" SG_ 117 ReSideRdrLeDetn149RdrDetnCntr 16;
BA_ "GenSigSendType" SG_ 117 ReSideRdrLeDetn149RdrDetnCntr 0;
BA_ "GenSigSendType" SG_ 117 ReSideRdrLeDetn149RdrDetnConf 0;
BA_ "GenSigSendType" SG_ 117 ReSideRdrLeDetn149RdrDetnElevn 0;
BA_ "GenSigStartValue" SG_ 117 ReSideRdrLeDetn149RdrDetnElevn 15;
BA_ "GenSigSendType" SG_ 117 ReSideRdrLeDetn149RdrDetnPwr 0;
BA_ "GenSigSendType" SG_ 117 ReSideRdrLeDetn149RdrDetnRng 0;
BA_ "GenSigStartValue" SG_ 117 ReSideRdrLeDetn149RdrDetnRng 10050;
BA_ "GenSigSendType" SG_ 117 ReSideRdrLeDetn149RdrDetnRngV 0;
BA_ "GenSigStartValue" SG_ 117 ReSideRdrLeDetn149RdrDetnRngV 4000;
BA_ "GenSigSendType" SG_ 117 ReSideRdrLeDetn149RdrDetnSameRV 0;
BA_ "GenSigSendType" SG_ 117 ReSideRdrLeDetn149RdrDetnSts 0;
BA_ "GenSigStartValue" SG_ 117 ReSideRdrLeDetn149RdrDetnSts 3;
BA_ "GenSigSendType" SG_ 117 ReSideRdrLeDetn150RdrDetnAmbigState 0;
BA_ "GenSigSendType" SG_ 117 ReSideRdrLeDetn150RdrDetnAssoTrkID 0;
BA_ "GenSigSendType" SG_ 117 ReSideRdrLeDetn150RdrDetnAzi 0;
BA_ "GenSigStartValue" SG_ 117 ReSideRdrLeDetn150RdrDetnAzi 900;
BA_ "GenSigDataID" SG_ 117 ReSideRdrLeDetn150RdrDetnChks "0x10F2";
BA_ "GenSigFuncType" SG_ 117 ReSideRdrLeDetn150RdrDetnChks 15;
BA_ "GenSigSendType" SG_ 117 ReSideRdrLeDetn150RdrDetnChks 0;
BA_ "GenSigFuncType" SG_ 117 ReSideRdrLeDetn150RdrDetnCntr 16;
BA_ "GenSigSendType" SG_ 117 ReSideRdrLeDetn150RdrDetnCntr 0;
BA_ "GenSigSendType" SG_ 117 ReSideRdrLeDetn150RdrDetnConf 0;
BA_ "GenSigSendType" SG_ 117 ReSideRdrLeDetn150RdrDetnElevn 0;
BA_ "GenSigStartValue" SG_ 117 ReSideRdrLeDetn150RdrDetnElevn 15;
BA_ "GenSigSendType" SG_ 117 ReSideRdrLeDetn150RdrDetnPwr 0;
BA_ "GenSigSendType" SG_ 117 ReSideRdrLeDetn150RdrDetnRng 0;
BA_ "GenSigStartValue" SG_ 117 ReSideRdrLeDetn150RdrDetnRng 10050;
BA_ "GenSigSendType" SG_ 117 ReSideRdrLeDetn150RdrDetnRngV 0;
BA_ "GenSigStartValue" SG_ 117 ReSideRdrLeDetn150RdrDetnRngV 4000;
BA_ "GenSigSendType" SG_ 117 ReSideRdrLeDetn150RdrDetnSameRV 0;
BA_ "GenSigSendType" SG_ 117 ReSideRdrLeDetn150RdrDetnSts 0;
BA_ "GenSigStartValue" SG_ 117 ReSideRdrLeDetn150RdrDetnSts 3;
BA_ "GenSigSendType" SG_ 118 ReSideRdrLeDetn151RdrDetnAmbigState 0;
BA_ "GenSigSendType" SG_ 118 ReSideRdrLeDetn151RdrDetnAssoTrkID 0;
BA_ "GenSigSendType" SG_ 118 ReSideRdrLeDetn151RdrDetnAzi 0;
BA_ "GenSigStartValue" SG_ 118 ReSideRdrLeDetn151RdrDetnAzi 900;
BA_ "GenSigDataID" SG_ 118 ReSideRdrLeDetn151RdrDetnChks "0x10F3";
BA_ "GenSigFuncType" SG_ 118 ReSideRdrLeDetn151RdrDetnChks 15;
BA_ "GenSigSendType" SG_ 118 ReSideRdrLeDetn151RdrDetnChks 0;
BA_ "GenSigFuncType" SG_ 118 ReSideRdrLeDetn151RdrDetnCntr 16;
BA_ "GenSigSendType" SG_ 118 ReSideRdrLeDetn151RdrDetnCntr 0;
BA_ "GenSigSendType" SG_ 118 ReSideRdrLeDetn151RdrDetnConf 0;
BA_ "GenSigSendType" SG_ 118 ReSideRdrLeDetn151RdrDetnElevn 0;
BA_ "GenSigStartValue" SG_ 118 ReSideRdrLeDetn151RdrDetnElevn 15;
BA_ "GenSigSendType" SG_ 118 ReSideRdrLeDetn151RdrDetnPwr 0;
BA_ "GenSigSendType" SG_ 118 ReSideRdrLeDetn151RdrDetnRng 0;
BA_ "GenSigStartValue" SG_ 118 ReSideRdrLeDetn151RdrDetnRng 10050;
BA_ "GenSigSendType" SG_ 118 ReSideRdrLeDetn151RdrDetnRngV 0;
BA_ "GenSigStartValue" SG_ 118 ReSideRdrLeDetn151RdrDetnRngV 4000;
BA_ "GenSigSendType" SG_ 118 ReSideRdrLeDetn151RdrDetnSameRV 0;
BA_ "GenSigSendType" SG_ 118 ReSideRdrLeDetn151RdrDetnSts 0;
BA_ "GenSigStartValue" SG_ 118 ReSideRdrLeDetn151RdrDetnSts 3;
BA_ "GenSigSendType" SG_ 118 ReSideRdrLeDetn152RdrDetnAmbigState 0;
BA_ "GenSigSendType" SG_ 118 ReSideRdrLeDetn152RdrDetnAssoTrkID 0;
BA_ "GenSigSendType" SG_ 118 ReSideRdrLeDetn152RdrDetnAzi 0;
BA_ "GenSigStartValue" SG_ 118 ReSideRdrLeDetn152RdrDetnAzi 900;
BA_ "GenSigDataID" SG_ 118 ReSideRdrLeDetn152RdrDetnChks "0x10F4";
BA_ "GenSigFuncType" SG_ 118 ReSideRdrLeDetn152RdrDetnChks 15;
BA_ "GenSigSendType" SG_ 118 ReSideRdrLeDetn152RdrDetnChks 0;
BA_ "GenSigFuncType" SG_ 118 ReSideRdrLeDetn152RdrDetnCntr 16;
BA_ "GenSigSendType" SG_ 118 ReSideRdrLeDetn152RdrDetnCntr 0;
BA_ "GenSigSendType" SG_ 118 ReSideRdrLeDetn152RdrDetnConf 0;
BA_ "GenSigSendType" SG_ 118 ReSideRdrLeDetn152RdrDetnElevn 0;
BA_ "GenSigStartValue" SG_ 118 ReSideRdrLeDetn152RdrDetnElevn 15;
BA_ "GenSigSendType" SG_ 118 ReSideRdrLeDetn152RdrDetnPwr 0;
BA_ "GenSigSendType" SG_ 118 ReSideRdrLeDetn152RdrDetnRng 0;
BA_ "GenSigStartValue" SG_ 118 ReSideRdrLeDetn152RdrDetnRng 10050;
BA_ "GenSigSendType" SG_ 118 ReSideRdrLeDetn152RdrDetnRngV 0;
BA_ "GenSigStartValue" SG_ 118 ReSideRdrLeDetn152RdrDetnRngV 4000;
BA_ "GenSigSendType" SG_ 118 ReSideRdrLeDetn152RdrDetnSameRV 0;
BA_ "GenSigSendType" SG_ 118 ReSideRdrLeDetn152RdrDetnSts 0;
BA_ "GenSigStartValue" SG_ 118 ReSideRdrLeDetn152RdrDetnSts 3;
BA_ "GenSigSendType" SG_ 118 ReSideRdrLeDetn153RdrDetnAmbigState 0;
BA_ "GenSigSendType" SG_ 118 ReSideRdrLeDetn153RdrDetnAssoTrkID 0;
BA_ "GenSigSendType" SG_ 118 ReSideRdrLeDetn153RdrDetnAzi 0;
BA_ "GenSigStartValue" SG_ 118 ReSideRdrLeDetn153RdrDetnAzi 900;
BA_ "GenSigDataID" SG_ 118 ReSideRdrLeDetn153RdrDetnChks "0x10F5";
BA_ "GenSigFuncType" SG_ 118 ReSideRdrLeDetn153RdrDetnChks 15;
BA_ "GenSigSendType" SG_ 118 ReSideRdrLeDetn153RdrDetnChks 0;
BA_ "GenSigFuncType" SG_ 118 ReSideRdrLeDetn153RdrDetnCntr 16;
BA_ "GenSigSendType" SG_ 118 ReSideRdrLeDetn153RdrDetnCntr 0;
BA_ "GenSigSendType" SG_ 118 ReSideRdrLeDetn153RdrDetnConf 0;
BA_ "GenSigSendType" SG_ 118 ReSideRdrLeDetn153RdrDetnElevn 0;
BA_ "GenSigStartValue" SG_ 118 ReSideRdrLeDetn153RdrDetnElevn 15;
BA_ "GenSigSendType" SG_ 118 ReSideRdrLeDetn153RdrDetnPwr 0;
BA_ "GenSigSendType" SG_ 118 ReSideRdrLeDetn153RdrDetnRng 0;
BA_ "GenSigStartValue" SG_ 118 ReSideRdrLeDetn153RdrDetnRng 10050;
BA_ "GenSigSendType" SG_ 118 ReSideRdrLeDetn153RdrDetnRngV 0;
BA_ "GenSigStartValue" SG_ 118 ReSideRdrLeDetn153RdrDetnRngV 4000;
BA_ "GenSigSendType" SG_ 118 ReSideRdrLeDetn153RdrDetnSameRV 0;
BA_ "GenSigSendType" SG_ 118 ReSideRdrLeDetn153RdrDetnSts 0;
BA_ "GenSigStartValue" SG_ 118 ReSideRdrLeDetn153RdrDetnSts 3;
BA_ "GenSigSendType" SG_ 118 ReSideRdrLeDetn154RdrDetnAmbigState 0;
BA_ "GenSigSendType" SG_ 118 ReSideRdrLeDetn154RdrDetnAssoTrkID 0;
BA_ "GenSigSendType" SG_ 118 ReSideRdrLeDetn154RdrDetnAzi 0;
BA_ "GenSigStartValue" SG_ 118 ReSideRdrLeDetn154RdrDetnAzi 900;
BA_ "GenSigDataID" SG_ 118 ReSideRdrLeDetn154RdrDetnChks "0x122E";
BA_ "GenSigFuncType" SG_ 118 ReSideRdrLeDetn154RdrDetnChks 15;
BA_ "GenSigSendType" SG_ 118 ReSideRdrLeDetn154RdrDetnChks 0;
BA_ "GenSigFuncType" SG_ 118 ReSideRdrLeDetn154RdrDetnCntr 16;
BA_ "GenSigSendType" SG_ 118 ReSideRdrLeDetn154RdrDetnCntr 0;
BA_ "GenSigSendType" SG_ 118 ReSideRdrLeDetn154RdrDetnConf 0;
BA_ "GenSigSendType" SG_ 118 ReSideRdrLeDetn154RdrDetnElevn 0;
BA_ "GenSigStartValue" SG_ 118 ReSideRdrLeDetn154RdrDetnElevn 15;
BA_ "GenSigSendType" SG_ 118 ReSideRdrLeDetn154RdrDetnPwr 0;
BA_ "GenSigSendType" SG_ 118 ReSideRdrLeDetn154RdrDetnRng 0;
BA_ "GenSigStartValue" SG_ 118 ReSideRdrLeDetn154RdrDetnRng 10050;
BA_ "GenSigSendType" SG_ 118 ReSideRdrLeDetn154RdrDetnRngV 0;
BA_ "GenSigStartValue" SG_ 118 ReSideRdrLeDetn154RdrDetnRngV 4000;
BA_ "GenSigSendType" SG_ 118 ReSideRdrLeDetn154RdrDetnSameRV 0;
BA_ "GenSigSendType" SG_ 118 ReSideRdrLeDetn154RdrDetnSts 0;
BA_ "GenSigStartValue" SG_ 118 ReSideRdrLeDetn154RdrDetnSts 3;
BA_ "GenSigSendType" SG_ 118 ReSideRdrLeDetn155RdrDetnAmbigState 0;
BA_ "GenSigSendType" SG_ 118 ReSideRdrLeDetn155RdrDetnAssoTrkID 0;
BA_ "GenSigSendType" SG_ 118 ReSideRdrLeDetn155RdrDetnAzi 0;
BA_ "GenSigStartValue" SG_ 118 ReSideRdrLeDetn155RdrDetnAzi 900;
BA_ "GenSigDataID" SG_ 118 ReSideRdrLeDetn155RdrDetnChks "0x122D";
BA_ "GenSigFuncType" SG_ 118 ReSideRdrLeDetn155RdrDetnChks 15;
BA_ "GenSigSendType" SG_ 118 ReSideRdrLeDetn155RdrDetnChks 0;
BA_ "GenSigFuncType" SG_ 118 ReSideRdrLeDetn155RdrDetnCntr 16;
BA_ "GenSigSendType" SG_ 118 ReSideRdrLeDetn155RdrDetnCntr 0;
BA_ "GenSigSendType" SG_ 118 ReSideRdrLeDetn155RdrDetnConf 0;
BA_ "GenSigSendType" SG_ 118 ReSideRdrLeDetn155RdrDetnElevn 0;
BA_ "GenSigStartValue" SG_ 118 ReSideRdrLeDetn155RdrDetnElevn 15;
BA_ "GenSigSendType" SG_ 118 ReSideRdrLeDetn155RdrDetnPwr 0;
BA_ "GenSigSendType" SG_ 118 ReSideRdrLeDetn155RdrDetnRng 0;
BA_ "GenSigStartValue" SG_ 118 ReSideRdrLeDetn155RdrDetnRng 10050;
BA_ "GenSigSendType" SG_ 118 ReSideRdrLeDetn155RdrDetnRngV 0;
BA_ "GenSigStartValue" SG_ 118 ReSideRdrLeDetn155RdrDetnRngV 4000;
BA_ "GenSigSendType" SG_ 118 ReSideRdrLeDetn155RdrDetnSameRV 0;
BA_ "GenSigSendType" SG_ 118 ReSideRdrLeDetn155RdrDetnSts 0;
BA_ "GenSigStartValue" SG_ 118 ReSideRdrLeDetn155RdrDetnSts 3;
BA_ "GenSigSendType" SG_ 118 ReSideRdrLeDetn156RdrDetnAmbigState 0;
BA_ "GenSigSendType" SG_ 118 ReSideRdrLeDetn156RdrDetnAssoTrkID 0;
BA_ "GenSigSendType" SG_ 118 ReSideRdrLeDetn156RdrDetnAzi 0;
BA_ "GenSigStartValue" SG_ 118 ReSideRdrLeDetn156RdrDetnAzi 900;
BA_ "GenSigDataID" SG_ 118 ReSideRdrLeDetn156RdrDetnChks "0x122C";
BA_ "GenSigFuncType" SG_ 118 ReSideRdrLeDetn156RdrDetnChks 15;
BA_ "GenSigSendType" SG_ 118 ReSideRdrLeDetn156RdrDetnChks 0;
BA_ "GenSigFuncType" SG_ 118 ReSideRdrLeDetn156RdrDetnCntr 16;
BA_ "GenSigSendType" SG_ 118 ReSideRdrLeDetn156RdrDetnCntr 0;
BA_ "GenSigSendType" SG_ 118 ReSideRdrLeDetn156RdrDetnConf 0;
BA_ "GenSigSendType" SG_ 118 ReSideRdrLeDetn156RdrDetnElevn 0;
BA_ "GenSigStartValue" SG_ 118 ReSideRdrLeDetn156RdrDetnElevn 15;
BA_ "GenSigSendType" SG_ 118 ReSideRdrLeDetn156RdrDetnPwr 0;
BA_ "GenSigSendType" SG_ 118 ReSideRdrLeDetn156RdrDetnRng 0;
BA_ "GenSigStartValue" SG_ 118 ReSideRdrLeDetn156RdrDetnRng 10050;
BA_ "GenSigSendType" SG_ 118 ReSideRdrLeDetn156RdrDetnRngV 0;
BA_ "GenSigStartValue" SG_ 118 ReSideRdrLeDetn156RdrDetnRngV 4000;
BA_ "GenSigSendType" SG_ 118 ReSideRdrLeDetn156RdrDetnSameRV 0;
BA_ "GenSigSendType" SG_ 118 ReSideRdrLeDetn156RdrDetnSts 0;
BA_ "GenSigStartValue" SG_ 118 ReSideRdrLeDetn156RdrDetnSts 3;
VAL_ 113 ReSideRdrLeDetn121RdrDetnAmbigState 0 "YesNo1_Yes" 1 "YesNo1_No";
VAL_ 113 ReSideRdrLeDetn121RdrDetnSameRV 0 "Mode6_0" 1 "Mode6_1" 2 "Mode6_2";
VAL_ 113 ReSideRdrLeDetn121RdrDetnSts 0 "RdrDetnSts_Ukwn" 1 "RdrDetnSts_Movg" 2 "RdrDetnSts_Staty" 3 "RdrDetnSts_Invalid";
VAL_ 113 ReSideRdrLeDetn122RdrDetnAmbigState 0 "YesNo1_Yes" 1 "YesNo1_No";
VAL_ 113 ReSideRdrLeDetn122RdrDetnSameRV 0 "Mode6_0" 1 "Mode6_1" 2 "Mode6_2";
VAL_ 113 ReSideRdrLeDetn122RdrDetnSts 0 "RdrDetnSts_Ukwn" 1 "RdrDetnSts_Movg" 2 "RdrDetnSts_Staty" 3 "RdrDetnSts_Invalid";
VAL_ 113 ReSideRdrLeDetn123RdrDetnAmbigState 0 "YesNo1_Yes" 1 "YesNo1_No";
VAL_ 113 ReSideRdrLeDetn123RdrDetnSameRV 0 "Mode6_0" 1 "Mode6_1" 2 "Mode6_2";
VAL_ 113 ReSideRdrLeDetn123RdrDetnSts 0 "RdrDetnSts_Ukwn" 1 "RdrDetnSts_Movg" 2 "RdrDetnSts_Staty" 3 "RdrDetnSts_Invalid";
VAL_ 113 ReSideRdrLeDetn124RdrDetnAmbigState 0 "YesNo1_Yes" 1 "YesNo1_No";
VAL_ 113 ReSideRdrLeDetn124RdrDetnSameRV 0 "Mode6_0" 1 "Mode6_1" 2 "Mode6_2";
VAL_ 113 ReSideRdrLeDetn124RdrDetnSts 0 "RdrDetnSts_Ukwn" 1 "RdrDetnSts_Movg" 2 "RdrDetnSts_Staty" 3 "RdrDetnSts_Invalid";
VAL_ 113 ReSideRdrLeDetn125RdrDetnAmbigState 0 "YesNo1_Yes" 1 "YesNo1_No";
VAL_ 113 ReSideRdrLeDetn125RdrDetnSameRV 0 "Mode6_0" 1 "Mode6_1" 2 "Mode6_2";
VAL_ 113 ReSideRdrLeDetn125RdrDetnSts 0 "RdrDetnSts_Ukwn" 1 "RdrDetnSts_Movg" 2 "RdrDetnSts_Staty" 3 "RdrDetnSts_Invalid";
VAL_ 113 ReSideRdrLeDetn126RdrDetnAmbigState 0 "YesNo1_Yes" 1 "YesNo1_No";
VAL_ 113 ReSideRdrLeDetn126RdrDetnSameRV 0 "Mode6_0" 1 "Mode6_1" 2 "Mode6_2";
VAL_ 113 ReSideRdrLeDetn126RdrDetnSts 0 "RdrDetnSts_Ukwn" 1 "RdrDetnSts_Movg" 2 "RdrDetnSts_Staty" 3 "RdrDetnSts_Invalid";
VAL_ 114 ReSideRdrLeDetn127RdrDetnAmbigState 0 "YesNo1_Yes" 1 "YesNo1_No";
VAL_ 114 ReSideRdrLeDetn127RdrDetnSameRV 0 "Mode6_0" 1 "Mode6_1" 2 "Mode6_2";
VAL_ 114 ReSideRdrLeDetn127RdrDetnSts 0 "RdrDetnSts_Ukwn" 1 "RdrDetnSts_Movg" 2 "RdrDetnSts_Staty" 3 "RdrDetnSts_Invalid";
VAL_ 114 ReSideRdrLeDetn128RdrDetnAmbigState 0 "YesNo1_Yes" 1 "YesNo1_No";
VAL_ 114 ReSideRdrLeDetn128RdrDetnSameRV 0 "Mode6_0" 1 "Mode6_1" 2 "Mode6_2";
VAL_ 114 ReSideRdrLeDetn128RdrDetnSts 0 "RdrDetnSts_Ukwn" 1 "RdrDetnSts_Movg" 2 "RdrDetnSts_Staty" 3 "RdrDetnSts_Invalid";
VAL_ 114 ReSideRdrLeDetn129RdrDetnAmbigState 0 "YesNo1_Yes" 1 "YesNo1_No";
VAL_ 114 ReSideRdrLeDetn129RdrDetnSameRV 0 "Mode6_0" 1 "Mode6_1" 2 "Mode6_2";
VAL_ 114 ReSideRdrLeDetn129RdrDetnSts 0 "RdrDetnSts_Ukwn" 1 "RdrDetnSts_Movg" 2 "RdrDetnSts_Staty" 3 "RdrDetnSts_Invalid";
VAL_ 114 ReSideRdrLeDetn130RdrDetnAmbigState 0 "YesNo1_Yes" 1 "YesNo1_No";
VAL_ 114 ReSideRdrLeDetn130RdrDetnSameRV 0 "Mode6_0" 1 "Mode6_1" 2 "Mode6_2";
VAL_ 114 ReSideRdrLeDetn130RdrDetnSts 0 "RdrDetnSts_Ukwn" 1 "RdrDetnSts_Movg" 2 "RdrDetnSts_Staty" 3 "RdrDetnSts_Invalid";
VAL_ 114 ReSideRdrLeDetn131RdrDetnAmbigState 0 "YesNo1_Yes" 1 "YesNo1_No";
VAL_ 114 ReSideRdrLeDetn131RdrDetnSameRV 0 "Mode6_0" 1 "Mode6_1" 2 "Mode6_2";
VAL_ 114 ReSideRdrLeDetn131RdrDetnSts 0 "RdrDetnSts_Ukwn" 1 "RdrDetnSts_Movg" 2 "RdrDetnSts_Staty" 3 "RdrDetnSts_Invalid";
VAL_ 114 ReSideRdrLeDetn132RdrDetnAmbigState 0 "YesNo1_Yes" 1 "YesNo1_No";
VAL_ 114 ReSideRdrLeDetn132RdrDetnSameRV 0 "Mode6_0" 1 "Mode6_1" 2 "Mode6_2";
VAL_ 114 ReSideRdrLeDetn132RdrDetnSts 0 "RdrDetnSts_Ukwn" 1 "RdrDetnSts_Movg" 2 "RdrDetnSts_Staty" 3 "RdrDetnSts_Invalid";
VAL_ 115 ReSideRdrLeDetn133RdrDetnAmbigState 0 "YesNo1_Yes" 1 "YesNo1_No";
VAL_ 115 ReSideRdrLeDetn133RdrDetnSameRV 0 "Mode6_0" 1 "Mode6_1" 2 "Mode6_2";
VAL_ 115 ReSideRdrLeDetn133RdrDetnSts 0 "RdrDetnSts_Ukwn" 1 "RdrDetnSts_Movg" 2 "RdrDetnSts_Staty" 3 "RdrDetnSts_Invalid";
VAL_ 115 ReSideRdrLeDetn134RdrDetnAmbigState 0 "YesNo1_Yes" 1 "YesNo1_No";
VAL_ 115 ReSideRdrLeDetn134RdrDetnSameRV 0 "Mode6_0" 1 "Mode6_1" 2 "Mode6_2";
VAL_ 115 ReSideRdrLeDetn134RdrDetnSts 0 "RdrDetnSts_Ukwn" 1 "RdrDetnSts_Movg" 2 "RdrDetnSts_Staty" 3 "RdrDetnSts_Invalid";
VAL_ 115 ReSideRdrLeDetn135RdrDetnAmbigState 0 "YesNo1_Yes" 1 "YesNo1_No";
VAL_ 115 ReSideRdrLeDetn135RdrDetnSameRV 0 "Mode6_0" 1 "Mode6_1" 2 "Mode6_2";
VAL_ 115 ReSideRdrLeDetn135RdrDetnSts 0 "RdrDetnSts_Ukwn" 1 "RdrDetnSts_Movg" 2 "RdrDetnSts_Staty" 3 "RdrDetnSts_Invalid";
VAL_ 115 ReSideRdrLeDetn136RdrDetnAmbigState 0 "YesNo1_Yes" 1 "YesNo1_No";
VAL_ 115 ReSideRdrLeDetn136RdrDetnSameRV 0 "Mode6_0" 1 "Mode6_1" 2 "Mode6_2";
VAL_ 115 ReSideRdrLeDetn136RdrDetnSts 0 "RdrDetnSts_Ukwn" 1 "RdrDetnSts_Movg" 2 "RdrDetnSts_Staty" 3 "RdrDetnSts_Invalid";
VAL_ 115 ReSideRdrLeDetn137RdrDetnAmbigState 0 "YesNo1_Yes" 1 "YesNo1_No";
VAL_ 115 ReSideRdrLeDetn137RdrDetnSameRV 0 "Mode6_0" 1 "Mode6_1" 2 "Mode6_2";
VAL_ 115 ReSideRdrLeDetn137RdrDetnSts 0 "RdrDetnSts_Ukwn" 1 "RdrDetnSts_Movg" 2 "RdrDetnSts_Staty" 3 "RdrDetnSts_Invalid";
VAL_ 115 ReSideRdrLeDetn138RdrDetnAmbigState 0 "YesNo1_Yes" 1 "YesNo1_No";
VAL_ 115 ReSideRdrLeDetn138RdrDetnSameRV 0 "Mode6_0" 1 "Mode6_1" 2 "Mode6_2";
VAL_ 115 ReSideRdrLeDetn138RdrDetnSts 0 "RdrDetnSts_Ukwn" 1 "RdrDetnSts_Movg" 2 "RdrDetnSts_Staty" 3 "RdrDetnSts_Invalid";
VAL_ 116 ReSideRdrLeDetn139RdrDetnAmbigState 0 "YesNo1_Yes" 1 "YesNo1_No";
VAL_ 116 ReSideRdrLeDetn139RdrDetnSameRV 0 "Mode6_0" 1 "Mode6_1" 2 "Mode6_2";
VAL_ 116 ReSideRdrLeDetn139RdrDetnSts 0 "RdrDetnSts_Ukwn" 1 "RdrDetnSts_Movg" 2 "RdrDetnSts_Staty" 3 "RdrDetnSts_Invalid";
VAL_ 116 ReSideRdrLeDetn140RdrDetnAmbigState 0 "YesNo1_Yes" 1 "YesNo1_No";
VAL_ 116 ReSideRdrLeDetn140RdrDetnSameRV 0 "Mode6_0" 1 "Mode6_1" 2 "Mode6_2";
VAL_ 116 ReSideRdrLeDetn140RdrDetnSts 0 "RdrDetnSts_Ukwn" 1 "RdrDetnSts_Movg" 2 "RdrDetnSts_Staty" 3 "RdrDetnSts_Invalid";
VAL_ 116 ReSideRdrLeDetn141RdrDetnAmbigState 0 "YesNo1_Yes" 1 "YesNo1_No";
VAL_ 116 ReSideRdrLeDetn141RdrDetnSameRV 0 "Mode6_0" 1 "Mode6_1" 2 "Mode6_2";
VAL_ 116 ReSideRdrLeDetn141RdrDetnSts 0 "RdrDetnSts_Ukwn" 1 "RdrDetnSts_Movg" 2 "RdrDetnSts_Staty" 3 "RdrDetnSts_Invalid";
VAL_ 116 ReSideRdrLeDetn142RdrDetnAmbigState 0 "YesNo1_Yes" 1 "YesNo1_No";
VAL_ 116 ReSideRdrLeDetn142RdrDetnSameRV 0 "Mode6_0" 1 "Mode6_1" 2 "Mode6_2";
VAL_ 116 ReSideRdrLeDetn142RdrDetnSts 0 "RdrDetnSts_Ukwn" 1 "RdrDetnSts_Movg" 2 "RdrDetnSts_Staty" 3 "RdrDetnSts_Invalid";
VAL_ 116 ReSideRdrLeDetn143RdrDetnAmbigState 0 "YesNo1_Yes" 1 "YesNo1_No";
VAL_ 116 ReSideRdrLeDetn143RdrDetnSameRV 0 "Mode6_0" 1 "Mode6_1" 2 "Mode6_2";
VAL_ 116 ReSideRdrLeDetn143RdrDetnSts 0 "RdrDetnSts_Ukwn" 1 "RdrDetnSts_Movg" 2 "RdrDetnSts_Staty" 3 "RdrDetnSts_Invalid";
VAL_ 116 ReSideRdrLeDetn144RdrDetnAmbigState 0 "YesNo1_Yes" 1 "YesNo1_No";
VAL_ 116 ReSideRdrLeDetn144RdrDetnSameRV 0 "Mode6_0" 1 "Mode6_1" 2 "Mode6_2";
VAL_ 116 ReSideRdrLeDetn144RdrDetnSts 0 "RdrDetnSts_Ukwn" 1 "RdrDetnSts_Movg" 2 "RdrDetnSts_Staty" 3 "RdrDetnSts_Invalid";
VAL_ 117 ReSideRdrLeDetn145RdrDetnAmbigState 0 "YesNo1_Yes" 1 "YesNo1_No";
VAL_ 117 ReSideRdrLeDetn145RdrDetnSameRV 0 "Mode6_0" 1 "Mode6_1" 2 "Mode6_2";
VAL_ 117 ReSideRdrLeDetn145RdrDetnSts 0 "RdrDetnSts_Ukwn" 1 "RdrDetnSts_Movg" 2 "RdrDetnSts_Staty" 3 "RdrDetnSts_Invalid";
VAL_ 117 ReSideRdrLeDetn146RdrDetnAmbigState 0 "YesNo1_Yes" 1 "YesNo1_No";
VAL_ 117 ReSideRdrLeDetn146RdrDetnSameRV 0 "Mode6_0" 1 "Mode6_1" 2 "Mode6_2";
VAL_ 117 ReSideRdrLeDetn146RdrDetnSts 0 "RdrDetnSts_Ukwn" 1 "RdrDetnSts_Movg" 2 "RdrDetnSts_Staty" 3 "RdrDetnSts_Invalid";
VAL_ 117 ReSideRdrLeDetn147RdrDetnAmbigState 0 "YesNo1_Yes" 1 "YesNo1_No";
VAL_ 117 ReSideRdrLeDetn147RdrDetnSameRV 0 "Mode6_0" 1 "Mode6_1" 2 "Mode6_2";
VAL_ 117 ReSideRdrLeDetn147RdrDetnSts 0 "RdrDetnSts_Ukwn" 1 "RdrDetnSts_Movg" 2 "RdrDetnSts_Staty" 3 "RdrDetnSts_Invalid";
VAL_ 117 ReSideRdrLeDetn148RdrDetnAmbigState 0 "YesNo1_Yes" 1 "YesNo1_No";
VAL_ 117 ReSideRdrLeDetn148RdrDetnSameRV 0 "Mode6_0" 1 "Mode6_1" 2 "Mode6_2";
VAL_ 117 ReSideRdrLeDetn148RdrDetnSts 0 "RdrDetnSts_Ukwn" 1 "RdrDetnSts_Movg" 2 "RdrDetnSts_Staty" 3 "RdrDetnSts_Invalid";
VAL_ 117 ReSideRdrLeDetn149RdrDetnAmbigState 0 "YesNo1_Yes" 1 "YesNo1_No";
VAL_ 117 ReSideRdrLeDetn149RdrDetnSameRV 0 "Mode6_0" 1 "Mode6_1" 2 "Mode6_2";
VAL_ 117 ReSideRdrLeDetn149RdrDetnSts 0 "RdrDetnSts_Ukwn" 1 "RdrDetnSts_Movg" 2 "RdrDetnSts_Staty" 3 "RdrDetnSts_Invalid";
VAL_ 117 ReSideRdrLeDetn150RdrDetnAmbigState 0 "YesNo1_Yes" 1 "YesNo1_No";
VAL_ 117 ReSideRdrLeDetn150RdrDetnSameRV 0 "Mode6_0" 1 "Mode6_1" 2 "Mode6_2";
VAL_ 117 ReSideRdrLeDetn150RdrDetnSts 0 "RdrDetnSts_Ukwn" 1 "RdrDetnSts_Movg" 2 "RdrDetnSts_Staty" 3 "RdrDetnSts_Invalid";
VAL_ 118 ReSideRdrLeDetn151RdrDetnAmbigState 0 "YesNo1_Yes" 1 "YesNo1_No";
VAL_ 118 ReSideRdrLeDetn151RdrDetnSameRV 0 "Mode6_0" 1 "Mode6_1" 2 "Mode6_2";
VAL_ 118 ReSideRdrLeDetn151RdrDetnSts 0 "RdrDetnSts_Ukwn" 1 "RdrDetnSts_Movg" 2 "RdrDetnSts_Staty" 3 "RdrDetnSts_Invalid";
VAL_ 118 ReSideRdrLeDetn152RdrDetnAmbigState 0 "YesNo1_Yes" 1 "YesNo1_No";
VAL_ 118 ReSideRdrLeDetn152RdrDetnSameRV 0 "Mode6_0" 1 "Mode6_1" 2 "Mode6_2";
VAL_ 118 ReSideRdrLeDetn152RdrDetnSts 0 "RdrDetnSts_Ukwn" 1 "RdrDetnSts_Movg" 2 "RdrDetnSts_Staty" 3 "RdrDetnSts_Invalid";
VAL_ 118 ReSideRdrLeDetn153RdrDetnAmbigState 0 "YesNo1_Yes" 1 "YesNo1_No";
VAL_ 118 ReSideRdrLeDetn153RdrDetnSameRV 0 "Mode6_0" 1 "Mode6_1" 2 "Mode6_2";
VAL_ 118 ReSideRdrLeDetn153RdrDetnSts 0 "RdrDetnSts_Ukwn" 1 "RdrDetnSts_Movg" 2 "RdrDetnSts_Staty" 3 "RdrDetnSts_Invalid";
VAL_ 118 ReSideRdrLeDetn154RdrDetnAmbigState 0 "YesNo1_Yes" 1 "YesNo1_No";
VAL_ 118 ReSideRdrLeDetn154RdrDetnSameRV 0 "Mode6_0" 1 "Mode6_1" 2 "Mode6_2";
VAL_ 118 ReSideRdrLeDetn154RdrDetnSts 0 "RdrDetnSts_Ukwn" 1 "RdrDetnSts_Movg" 2 "RdrDetnSts_Staty" 3 "RdrDetnSts_Invalid";
VAL_ 118 ReSideRdrLeDetn155RdrDetnAmbigState 0 "YesNo1_Yes" 1 "YesNo1_No";
VAL_ 118 ReSideRdrLeDetn155RdrDetnSameRV 0 "Mode6_0" 1 "Mode6_1" 2 "Mode6_2";
VAL_ 118 ReSideRdrLeDetn155RdrDetnSts 0 "RdrDetnSts_Ukwn" 1 "RdrDetnSts_Movg" 2 "RdrDetnSts_Staty" 3 "RdrDetnSts_Invalid";
VAL_ 118 ReSideRdrLeDetn156RdrDetnAmbigState 0 "YesNo1_Yes" 1 "YesNo1_No";
VAL_ 118 ReSideRdrLeDetn156RdrDetnSameRV 0 "Mode6_0" 1 "Mode6_1" 2 "Mode6_2";
VAL_ 118 ReSideRdrLeDetn156RdrDetnSts 0 "RdrDetnSts_Ukwn" 1 "RdrDetnSts_Movg" 2 "RdrDetnSts_Staty" 3 "RdrDetnSts_Invalid";
SIG_GROUP_ 113 ReSideRdrLeDetn121 1 : ReSideRdrLeDetn121RdrDetnAmbigState ReSideRdrLeDetn121RdrDetnAssoTrkID ReSideRdrLeDetn121RdrDetnAzi ReSideRdrLeDetn121RdrDetnChks ReSideRdrLeDetn121RdrDetnCntr ReSideRdrLeDetn121RdrDetnConf ReSideRdrLeDetn121RdrDetnElevn ReSideRdrLeDetn121RdrDetnPwr ReSideRdrLeDetn121RdrDetnRng ReSideRdrLeDetn121RdrDetnRngV ReSideRdrLeDetn121RdrDetnSameRV ReSideRdrLeDetn121RdrDetnSts;
SIG_GROUP_ 113 ReSideRdrLeDetn122 1 : ReSideRdrLeDetn122RdrDetnAmbigState ReSideRdrLeDetn122RdrDetnAssoTrkID ReSideRdrLeDetn122RdrDetnAzi ReSideRdrLeDetn122RdrDetnChks ReSideRdrLeDetn122RdrDetnCntr ReSideRdrLeDetn122RdrDetnConf ReSideRdrLeDetn122RdrDetnElevn ReSideRdrLeDetn122RdrDetnPwr ReSideRdrLeDetn122RdrDetnRng ReSideRdrLeDetn122RdrDetnRngV ReSideRdrLeDetn122RdrDetnSameRV ReSideRdrLeDetn122RdrDetnSts;
SIG_GROUP_ 113 ReSideRdrLeDetn123 1 : ReSideRdrLeDetn123RdrDetnAmbigState ReSideRdrLeDetn123RdrDetnAssoTrkID ReSideRdrLeDetn123RdrDetnAzi ReSideRdrLeDetn123RdrDetnChks ReSideRdrLeDetn123RdrDetnCntr ReSideRdrLeDetn123RdrDetnConf ReSideRdrLeDetn123RdrDetnElevn ReSideRdrLeDetn123RdrDetnPwr ReSideRdrLeDetn123RdrDetnRng ReSideRdrLeDetn123RdrDetnRngV ReSideRdrLeDetn123RdrDetnSameRV ReSideRdrLeDetn123RdrDetnSts;
SIG_GROUP_ 113 ReSideRdrLeDetn124 1 : ReSideRdrLeDetn124RdrDetnAmbigState ReSideRdrLeDetn124RdrDetnAssoTrkID ReSideRdrLeDetn124RdrDetnAzi ReSideRdrLeDetn124RdrDetnChks ReSideRdrLeDetn124RdrDetnCntr ReSideRdrLeDetn124RdrDetnConf ReSideRdrLeDetn124RdrDetnElevn ReSideRdrLeDetn124RdrDetnPwr ReSideRdrLeDetn124RdrDetnRng ReSideRdrLeDetn124RdrDetnRngV ReSideRdrLeDetn124RdrDetnSameRV ReSideRdrLeDetn124RdrDetnSts;
SIG_GROUP_ 113 ReSideRdrLeDetn125 1 : ReSideRdrLeDetn125RdrDetnAmbigState ReSideRdrLeDetn125RdrDetnAssoTrkID ReSideRdrLeDetn125RdrDetnAzi ReSideRdrLeDetn125RdrDetnChks ReSideRdrLeDetn125RdrDetnCntr ReSideRdrLeDetn125RdrDetnConf ReSideRdrLeDetn125RdrDetnElevn ReSideRdrLeDetn125RdrDetnPwr ReSideRdrLeDetn125RdrDetnRng ReSideRdrLeDetn125RdrDetnRngV ReSideRdrLeDetn125RdrDetnSameRV ReSideRdrLeDetn125RdrDetnSts;
SIG_GROUP_ 113 ReSideRdrLeDetn126 1 : ReSideRdrLeDetn126RdrDetnAmbigState ReSideRdrLeDetn126RdrDetnAssoTrkID ReSideRdrLeDetn126RdrDetnAzi ReSideRdrLeDetn126RdrDetnChks ReSideRdrLeDetn126RdrDetnCntr ReSideRdrLeDetn126RdrDetnConf ReSideRdrLeDetn126RdrDetnElevn ReSideRdrLeDetn126RdrDetnPwr ReSideRdrLeDetn126RdrDetnRng ReSideRdrLeDetn126RdrDetnRngV ReSideRdrLeDetn126RdrDetnSameRV ReSideRdrLeDetn126RdrDetnSts;
SIG_GROUP_ 114 ReSideRdrLeDetn127 1 : ReSideRdrLeDetn127RdrDetnAmbigState ReSideRdrLeDetn127RdrDetnAssoTrkID ReSideRdrLeDetn127RdrDetnAzi ReSideRdrLeDetn127RdrDetnChks ReSideRdrLeDetn127RdrDetnCntr ReSideRdrLeDetn127RdrDetnConf ReSideRdrLeDetn127RdrDetnElevn ReSideRdrLeDetn127RdrDetnPwr ReSideRdrLeDetn127RdrDetnRng ReSideRdrLeDetn127RdrDetnRngV ReSideRdrLeDetn127RdrDetnSameRV ReSideRdrLeDetn127RdrDetnSts;
SIG_GROUP_ 114 ReSideRdrLeDetn128 1 : ReSideRdrLeDetn128RdrDetnAmbigState ReSideRdrLeDetn128RdrDetnAssoTrkID ReSideRdrLeDetn128RdrDetnAzi ReSideRdrLeDetn128RdrDetnChks ReSideRdrLeDetn128RdrDetnCntr ReSideRdrLeDetn128RdrDetnConf ReSideRdrLeDetn128RdrDetnElevn ReSideRdrLeDetn128RdrDetnPwr ReSideRdrLeDetn128RdrDetnRng ReSideRdrLeDetn128RdrDetnRngV ReSideRdrLeDetn128RdrDetnSameRV ReSideRdrLeDetn128RdrDetnSts;
SIG_GROUP_ 114 ReSideRdrLeDetn129 1 : ReSideRdrLeDetn129RdrDetnAmbigState ReSideRdrLeDetn129RdrDetnAssoTrkID ReSideRdrLeDetn129RdrDetnAzi ReSideRdrLeDetn129RdrDetnChks ReSideRdrLeDetn129RdrDetnCntr ReSideRdrLeDetn129RdrDetnConf ReSideRdrLeDetn129RdrDetnElevn ReSideRdrLeDetn129RdrDetnPwr ReSideRdrLeDetn129RdrDetnRng ReSideRdrLeDetn129RdrDetnRngV ReSideRdrLeDetn129RdrDetnSameRV ReSideRdrLeDetn129RdrDetnSts;
SIG_GROUP_ 114 ReSideRdrLeDetn130 1 : ReSideRdrLeDetn130RdrDetnAmbigState ReSideRdrLeDetn130RdrDetnAssoTrkID ReSideRdrLeDetn130RdrDetnAzi ReSideRdrLeDetn130RdrDetnChks ReSideRdrLeDetn130RdrDetnCntr ReSideRdrLeDetn130RdrDetnConf ReSideRdrLeDetn130RdrDetnElevn ReSideRdrLeDetn130RdrDetnPwr ReSideRdrLeDetn130RdrDetnRng ReSideRdrLeDetn130RdrDetnRngV ReSideRdrLeDetn130RdrDetnSameRV ReSideRdrLeDetn130RdrDetnSts;
SIG_GROUP_ 114 ReSideRdrLeDetn131 1 : ReSideRdrLeDetn131RdrDetnAmbigState ReSideRdrLeDetn131RdrDetnAssoTrkID ReSideRdrLeDetn131RdrDetnAzi ReSideRdrLeDetn131RdrDetnChks ReSideRdrLeDetn131RdrDetnCntr ReSideRdrLeDetn131RdrDetnConf ReSideRdrLeDetn131RdrDetnElevn ReSideRdrLeDetn131RdrDetnPwr ReSideRdrLeDetn131RdrDetnRng ReSideRdrLeDetn131RdrDetnRngV ReSideRdrLeDetn131RdrDetnSameRV ReSideRdrLeDetn131RdrDetnSts;
SIG_GROUP_ 114 ReSideRdrLeDetn132 1 : ReSideRdrLeDetn132RdrDetnAmbigState ReSideRdrLeDetn132RdrDetnAssoTrkID ReSideRdrLeDetn132RdrDetnAzi ReSideRdrLeDetn132RdrDetnChks ReSideRdrLeDetn132RdrDetnCntr ReSideRdrLeDetn132RdrDetnConf ReSideRdrLeDetn132RdrDetnElevn ReSideRdrLeDetn132RdrDetnPwr ReSideRdrLeDetn132RdrDetnRng ReSideRdrLeDetn132RdrDetnRngV ReSideRdrLeDetn132RdrDetnSameRV ReSideRdrLeDetn132RdrDetnSts;
SIG_GROUP_ 115 ReSideRdrLeDetn133 1 : ReSideRdrLeDetn133RdrDetnAmbigState ReSideRdrLeDetn133RdrDetnAssoTrkID ReSideRdrLeDetn133RdrDetnAzi ReSideRdrLeDetn133RdrDetnChks ReSideRdrLeDetn133RdrDetnCntr ReSideRdrLeDetn133RdrDetnConf ReSideRdrLeDetn133RdrDetnElevn ReSideRdrLeDetn133RdrDetnPwr ReSideRdrLeDetn133RdrDetnRng ReSideRdrLeDetn133RdrDetnRngV ReSideRdrLeDetn133RdrDetnSameRV ReSideRdrLeDetn133RdrDetnSts;
SIG_GROUP_ 115 ReSideRdrLeDetn134 1 : ReSideRdrLeDetn134RdrDetnAmbigState ReSideRdrLeDetn134RdrDetnAssoTrkID ReSideRdrLeDetn134RdrDetnAzi ReSideRdrLeDetn134RdrDetnChks ReSideRdrLeDetn134RdrDetnCntr ReSideRdrLeDetn134RdrDetnConf ReSideRdrLeDetn134RdrDetnElevn ReSideRdrLeDetn134RdrDetnPwr ReSideRdrLeDetn134RdrDetnRng ReSideRdrLeDetn134RdrDetnRngV ReSideRdrLeDetn134RdrDetnSameRV ReSideRdrLeDetn134RdrDetnSts;
SIG_GROUP_ 115 ReSideRdrLeDetn135 1 : ReSideRdrLeDetn135RdrDetnAmbigState ReSideRdrLeDetn135RdrDetnAssoTrkID ReSideRdrLeDetn135RdrDetnAzi ReSideRdrLeDetn135RdrDetnChks ReSideRdrLeDetn135RdrDetnCntr ReSideRdrLeDetn135RdrDetnConf ReSideRdrLeDetn135RdrDetnElevn ReSideRdrLeDetn135RdrDetnPwr ReSideRdrLeDetn135RdrDetnRng ReSideRdrLeDetn135RdrDetnRngV ReSideRdrLeDetn135RdrDetnSameRV ReSideRdrLeDetn135RdrDetnSts;
SIG_GROUP_ 115 ReSideRdrLeDetn136 1 : ReSideRdrLeDetn136RdrDetnAmbigState ReSideRdrLeDetn136RdrDetnAssoTrkID ReSideRdrLeDetn136RdrDetnAzi ReSideRdrLeDetn136RdrDetnChks ReSideRdrLeDetn136RdrDetnCntr ReSideRdrLeDetn136RdrDetnConf ReSideRdrLeDetn136RdrDetnElevn ReSideRdrLeDetn136RdrDetnPwr ReSideRdrLeDetn136RdrDetnRng ReSideRdrLeDetn136RdrDetnRngV ReSideRdrLeDetn136RdrDetnSameRV ReSideRdrLeDetn136RdrDetnSts;
SIG_GROUP_ 115 ReSideRdrLeDetn137 1 : ReSideRdrLeDetn137RdrDetnAmbigState ReSideRdrLeDetn137RdrDetnAssoTrkID ReSideRdrLeDetn137RdrDetnAzi ReSideRdrLeDetn137RdrDetnChks ReSideRdrLeDetn137RdrDetnCntr ReSideRdrLeDetn137RdrDetnConf ReSideRdrLeDetn137RdrDetnElevn ReSideRdrLeDetn137RdrDetnPwr ReSideRdrLeDetn137RdrDetnRng ReSideRdrLeDetn137RdrDetnRngV ReSideRdrLeDetn137RdrDetnSameRV ReSideRdrLeDetn137RdrDetnSts;
SIG_GROUP_ 115 ReSideRdrLeDetn138 1 : ReSideRdrLeDetn138RdrDetnAmbigState ReSideRdrLeDetn138RdrDetnAssoTrkID ReSideRdrLeDetn138RdrDetnAzi ReSideRdrLeDetn138RdrDetnChks ReSideRdrLeDetn138RdrDetnCntr ReSideRdrLeDetn138RdrDetnConf ReSideRdrLeDetn138RdrDetnElevn ReSideRdrLeDetn138RdrDetnPwr ReSideRdrLeDetn138RdrDetnRng ReSideRdrLeDetn138RdrDetnRngV ReSideRdrLeDetn138RdrDetnSameRV ReSideRdrLeDetn138RdrDetnSts;
SIG_GROUP_ 116 ReSideRdrLeDetn139 1 : ReSideRdrLeDetn139RdrDetnAmbigState ReSideRdrLeDetn139RdrDetnAssoTrkID ReSideRdrLeDetn139RdrDetnAzi ReSideRdrLeDetn139RdrDetnChks ReSideRdrLeDetn139RdrDetnCntr ReSideRdrLeDetn139RdrDetnConf ReSideRdrLeDetn139RdrDetnElevn ReSideRdrLeDetn139RdrDetnPwr ReSideRdrLeDetn139RdrDetnRng ReSideRdrLeDetn139RdrDetnRngV ReSideRdrLeDetn139RdrDetnSameRV ReSideRdrLeDetn139RdrDetnSts;
SIG_GROUP_ 116 ReSideRdrLeDetn140 1 : ReSideRdrLeDetn140RdrDetnAmbigState ReSideRdrLeDetn140RdrDetnAssoTrkID ReSideRdrLeDetn140RdrDetnAzi ReSideRdrLeDetn140RdrDetnChks ReSideRdrLeDetn140RdrDetnCntr ReSideRdrLeDetn140RdrDetnConf ReSideRdrLeDetn140RdrDetnElevn ReSideRdrLeDetn140RdrDetnPwr ReSideRdrLeDetn140RdrDetnRng ReSideRdrLeDetn140RdrDetnRngV ReSideRdrLeDetn140RdrDetnSameRV ReSideRdrLeDetn140RdrDetnSts;
SIG_GROUP_ 116 ReSideRdrLeDetn141 1 : ReSideRdrLeDetn141RdrDetnAmbigState ReSideRdrLeDetn141RdrDetnAssoTrkID ReSideRdrLeDetn141RdrDetnAzi ReSideRdrLeDetn141RdrDetnChks ReSideRdrLeDetn141RdrDetnCntr ReSideRdrLeDetn141RdrDetnConf ReSideRdrLeDetn141RdrDetnElevn ReSideRdrLeDetn141RdrDetnPwr ReSideRdrLeDetn141RdrDetnRng ReSideRdrLeDetn141RdrDetnRngV ReSideRdrLeDetn141RdrDetnSameRV ReSideRdrLeDetn141RdrDetnSts;
SIG_GROUP_ 116 ReSideRdrLeDetn142 1 : ReSideRdrLeDetn142RdrDetnAmbigState ReSideRdrLeDetn142RdrDetnAssoTrkID ReSideRdrLeDetn142RdrDetnAzi ReSideRdrLeDetn142RdrDetnChks ReSideRdrLeDetn142RdrDetnCntr ReSideRdrLeDetn142RdrDetnConf ReSideRdrLeDetn142RdrDetnElevn ReSideRdrLeDetn142RdrDetnPwr ReSideRdrLeDetn142RdrDetnRng ReSideRdrLeDetn142RdrDetnRngV ReSideRdrLeDetn142RdrDetnSameRV ReSideRdrLeDetn142RdrDetnSts;
SIG_GROUP_ 116 ReSideRdrLeDetn143 1 : ReSideRdrLeDetn143RdrDetnAmbigState ReSideRdrLeDetn143RdrDetnAssoTrkID ReSideRdrLeDetn143RdrDetnAzi ReSideRdrLeDetn143RdrDetnChks ReSideRdrLeDetn143RdrDetnCntr ReSideRdrLeDetn143RdrDetnConf ReSideRdrLeDetn143RdrDetnElevn ReSideRdrLeDetn143RdrDetnPwr ReSideRdrLeDetn143RdrDetnRng ReSideRdrLeDetn143RdrDetnRngV ReSideRdrLeDetn143RdrDetnSameRV ReSideRdrLeDetn143RdrDetnSts;
SIG_GROUP_ 116 ReSideRdrLeDetn144 1 : ReSideRdrLeDetn144RdrDetnAmbigState ReSideRdrLeDetn144RdrDetnAssoTrkID ReSideRdrLeDetn144RdrDetnAzi ReSideRdrLeDetn144RdrDetnChks ReSideRdrLeDetn144RdrDetnCntr ReSideRdrLeDetn144RdrDetnConf ReSideRdrLeDetn144RdrDetnElevn ReSideRdrLeDetn144RdrDetnPwr ReSideRdrLeDetn144RdrDetnRng ReSideRdrLeDetn144RdrDetnRngV ReSideRdrLeDetn144RdrDetnSameRV ReSideRdrLeDetn144RdrDetnSts;
SIG_GROUP_ 117 ReSideRdrLeDetn145 1 : ReSideRdrLeDetn145RdrDetnAmbigState ReSideRdrLeDetn145RdrDetnAssoTrkID ReSideRdrLeDetn145RdrDetnAzi ReSideRdrLeDetn145RdrDetnChks ReSideRdrLeDetn145RdrDetnCntr ReSideRdrLeDetn145RdrDetnConf ReSideRdrLeDetn145RdrDetnElevn ReSideRdrLeDetn145RdrDetnPwr ReSideRdrLeDetn145RdrDetnRng ReSideRdrLeDetn145RdrDetnRngV ReSideRdrLeDetn145RdrDetnSameRV ReSideRdrLeDetn145RdrDetnSts;
SIG_GROUP_ 117 ReSideRdrLeDetn146 1 : ReSideRdrLeDetn146RdrDetnAmbigState ReSideRdrLeDetn146RdrDetnAssoTrkID ReSideRdrLeDetn146RdrDetnAzi ReSideRdrLeDetn146RdrDetnChks ReSideRdrLeDetn146RdrDetnCntr ReSideRdrLeDetn146RdrDetnConf ReSideRdrLeDetn146RdrDetnElevn ReSideRdrLeDetn146RdrDetnPwr ReSideRdrLeDetn146RdrDetnRng ReSideRdrLeDetn146RdrDetnRngV ReSideRdrLeDetn146RdrDetnSameRV ReSideRdrLeDetn146RdrDetnSts;
SIG_GROUP_ 117 ReSideRdrLeDetn147 1 : ReSideRdrLeDetn147RdrDetnAmbigState ReSideRdrLeDetn147RdrDetnAssoTrkID ReSideRdrLeDetn147RdrDetnAzi ReSideRdrLeDetn147RdrDetnChks ReSideRdrLeDetn147RdrDetnCntr ReSideRdrLeDetn147RdrDetnConf ReSideRdrLeDetn147RdrDetnElevn ReSideRdrLeDetn147RdrDetnPwr ReSideRdrLeDetn147RdrDetnRng ReSideRdrLeDetn147RdrDetnRngV ReSideRdrLeDetn147RdrDetnSameRV ReSideRdrLeDetn147RdrDetnSts;
SIG_GROUP_ 117 ReSideRdrLeDetn148 1 : ReSideRdrLeDetn148RdrDetnAmbigState ReSideRdrLeDetn148RdrDetnAssoTrkID ReSideRdrLeDetn148RdrDetnAzi ReSideRdrLeDetn148RdrDetnChks ReSideRdrLeDetn148RdrDetnCntr ReSideRdrLeDetn148RdrDetnConf ReSideRdrLeDetn148RdrDetnElevn ReSideRdrLeDetn148RdrDetnPwr ReSideRdrLeDetn148RdrDetnRng ReSideRdrLeDetn148RdrDetnRngV ReSideRdrLeDetn148RdrDetnSameRV ReSideRdrLeDetn148RdrDetnSts;
SIG_GROUP_ 117 ReSideRdrLeDetn149 1 : ReSideRdrLeDetn149RdrDetnAmbigState ReSideRdrLeDetn149RdrDetnAssoTrkID ReSideRdrLeDetn149RdrDetnAzi ReSideRdrLeDetn149RdrDetnChks ReSideRdrLeDetn149RdrDetnCntr ReSideRdrLeDetn149RdrDetnConf ReSideRdrLeDetn149RdrDetnElevn ReSideRdrLeDetn149RdrDetnPwr ReSideRdrLeDetn149RdrDetnRng ReSideRdrLeDetn149RdrDetnRngV ReSideRdrLeDetn149RdrDetnSameRV ReSideRdrLeDetn149RdrDetnSts;
SIG_GROUP_ 117 ReSideRdrLeDetn150 1 : ReSideRdrLeDetn150RdrDetnAmbigState ReSideRdrLeDetn150RdrDetnAssoTrkID ReSideRdrLeDetn150RdrDetnAzi ReSideRdrLeDetn150RdrDetnChks ReSideRdrLeDetn150RdrDetnCntr ReSideRdrLeDetn150RdrDetnConf ReSideRdrLeDetn150RdrDetnElevn ReSideRdrLeDetn150RdrDetnPwr ReSideRdrLeDetn150RdrDetnRng ReSideRdrLeDetn150RdrDetnRngV ReSideRdrLeDetn150RdrDetnSameRV ReSideRdrLeDetn150RdrDetnSts;
SIG_GROUP_ 118 ReSideRdrLeDetn151 1 : ReSideRdrLeDetn151RdrDetnAmbigState ReSideRdrLeDetn151RdrDetnAssoTrkID ReSideRdrLeDetn151RdrDetnAzi ReSideRdrLeDetn151RdrDetnChks ReSideRdrLeDetn151RdrDetnCntr ReSideRdrLeDetn151RdrDetnConf ReSideRdrLeDetn151RdrDetnElevn ReSideRdrLeDetn151RdrDetnPwr ReSideRdrLeDetn151RdrDetnRng ReSideRdrLeDetn151RdrDetnRngV ReSideRdrLeDetn151RdrDetnSameRV ReSideRdrLeDetn151RdrDetnSts;
SIG_GROUP_ 118 ReSideRdrLeDetn152 1 : ReSideRdrLeDetn152RdrDetnAmbigState ReSideRdrLeDetn152RdrDetnAssoTrkID ReSideRdrLeDetn152RdrDetnAzi ReSideRdrLeDetn152RdrDetnChks ReSideRdrLeDetn152RdrDetnCntr ReSideRdrLeDetn152RdrDetnConf ReSideRdrLeDetn152RdrDetnElevn ReSideRdrLeDetn152RdrDetnPwr ReSideRdrLeDetn152RdrDetnRng ReSideRdrLeDetn152RdrDetnRngV ReSideRdrLeDetn152RdrDetnSameRV ReSideRdrLeDetn152RdrDetnSts;
SIG_GROUP_ 118 ReSideRdrLeDetn153 1 : ReSideRdrLeDetn153RdrDetnAmbigState ReSideRdrLeDetn153RdrDetnAssoTrkID ReSideRdrLeDetn153RdrDetnAzi ReSideRdrLeDetn153RdrDetnChks ReSideRdrLeDetn153RdrDetnCntr ReSideRdrLeDetn153RdrDetnConf ReSideRdrLeDetn153RdrDetnElevn ReSideRdrLeDetn153RdrDetnPwr ReSideRdrLeDetn153RdrDetnRng ReSideRdrLeDetn153RdrDetnRngV ReSideRdrLeDetn153RdrDetnSameRV ReSideRdrLeDetn153RdrDetnSts;
SIG_GROUP_ 118 ReSideRdrLeDetn154 1 : ReSideRdrLeDetn154RdrDetnAmbigState ReSideRdrLeDetn154RdrDetnAssoTrkID ReSideRdrLeDetn154RdrDetnAzi ReSideRdrLeDetn154RdrDetnChks ReSideRdrLeDetn154RdrDetnCntr ReSideRdrLeDetn154RdrDetnConf ReSideRdrLeDetn154RdrDetnElevn ReSideRdrLeDetn154RdrDetnPwr ReSideRdrLeDetn154RdrDetnRng ReSideRdrLeDetn154RdrDetnRngV ReSideRdrLeDetn154RdrDetnSameRV ReSideRdrLeDetn154RdrDetnSts;
SIG_GROUP_ 118 ReSideRdrLeDetn155 1 : ReSideRdrLeDetn155RdrDetnAmbigState ReSideRdrLeDetn155RdrDetnAssoTrkID ReSideRdrLeDetn155RdrDetnAzi ReSideRdrLeDetn155RdrDetnChks ReSideRdrLeDetn155RdrDetnCntr ReSideRdrLeDetn155RdrDetnConf ReSideRdrLeDetn155RdrDetnElevn ReSideRdrLeDetn155RdrDetnPwr ReSideRdrLeDetn155RdrDetnRng ReSideRdrLeDetn155RdrDetnRngV ReSideRdrLeDetn155RdrDetnSameRV ReSideRdrLeDetn155RdrDetnSts;
SIG_GROUP_ 118 ReSideRdrLeDetn156 1 : ReSideRdrLeDetn156RdrDetnAmbigState ReSideRdrLeDetn156RdrDetnAssoTrkID ReSideRdrLeDetn156RdrDetnAzi ReSideRdrLeDetn156RdrDetnChks ReSideRdrLeDetn156RdrDetnCntr ReSideRdrLeDetn156RdrDetnConf ReSideRdrLeDetn156RdrDetnElevn ReSideRdrLeDetn156RdrDetnPwr ReSideRdrLeDetn156RdrDetnRng ReSideRdrLeDetn156RdrDetnRngV ReSideRdrLeDetn156RdrDetnSameRV ReSideRdrLeDetn156RdrDetnSts;
