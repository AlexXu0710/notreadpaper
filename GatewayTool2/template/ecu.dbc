// *************************************************************************** *
// *                                                                           *
// * Description:         CANDB File                                           *
// * Generated at:        2023-03-30 16:08                                     *
// * System:              ZSDB123101                                           *
// * Variant:             CS1E                                                 *
// * Network:             Private_CANFD5                                       *
// *                                                                           *
// *************************************************************************** *
VERSION "Private_CANFD5"

NS_ :

BS_ :

BU_ :  ASDM SODL

BO_ 325 AdcuPrivateCanFD5Fr01 : 64 ASDM
 SG_ AsySftyEnaDecelAckd : 89|1@0+ (1,0) [0|1] "" SODL
 SG_ AsySftyEnaDecelAckd_UB : 88|1@0+ (1,0) [0|1] "" SODL
 SG_ RainfallAmnt : 103|4@0+ (1,0) [0|15] "" SODL
 SG_ RainfallAmnt_UB : 99|1@0+ (1,0) [0|1] "" SODL
 SG_ StandStillMgrStsForHld_UB : 7|1@0+ (1,0) [0|1] "" SODL
 SG_ StandStillMgrStsForHld1 : 6|3@0+ (1,0) [0|7] "" SODL
 SG_ StandStillMgrStsForHldChks : 15|8@0+ (1.0,0.0) [0.0|255.0] "Unitless" SODL
 SG_ StandStillMgrStsForHldCntr : 3|4@0+ (1.0,0.0) [0.0|15.0] "Unitless" SODL
 SG_ SteerWhlSnsr_UB : 23|1@0+ (1,0) [0|1] "" SODL
 SG_ SteerWhlSnsrAg : 22|15@0- (0.0009765625,0.0) [-14.5|14.5] "rad" SODL
 SG_ SteerWhlSnsrAgSpd : 37|14@0- (0.0078125,0.0) [-50.0|50.0] "rad/s" SODL
 SG_ SteerWhlSnsrChks : 55|8@0+ (1.0,0.0) [0.0|255.0] "Unitless" SODL
 SG_ SteerWhlSnsrCntr : 63|4@0+ (1.0,0.0) [0.0|15.0] "Unitless" SODL
 SG_ SteerWhlSnsrQf : 39|2@0+ (1,0) [0|3] "" SODL
 SG_ TiAndDateIndcn_UB : 128|1@0+ (1,0) [0|1] "" SODL
 SG_ TiAndDateIndcnDataValid : 129|1@0+ (1,0) [0|1] "" SODL
 SG_ TiAndDateIndcnDay : 127|5@0+ (1.0,0.0) [1.0|31.0] "Days" SODL
 SG_ TiAndDateIndcnHr1 : 122|5@0+ (1.0,0.0) [0.0|23.0] "hours" SODL
 SG_ TiAndDateIndcnMins1 : 107|6@0+ (1.0,0.0) [0.0|59.0] "Mins" SODL
 SG_ TiAndDateIndcnMth1 : 133|4@0+ (1.0,0.0) [1.0|12.0] "Month" SODL
 SG_ TiAndDateIndcnSec1 : 117|6@0+ (1.0,0.0) [0.0|59.0] "s" SODL
 SG_ TiAndDateIndcnYr1 : 98|7@0+ (1.0,0.0) [0.0|99.0] "Year" SODL
 SG_ VehSpdLgt_UB : 71|1@0+ (1,0) [0|1] "" SODL
 SG_ VehSpdLgtA : 70|15@0+ (0.00391,0.0) [0.0|125.0027] "m/s" SODL
 SG_ VehSpdLgtChks : 87|8@0+ (1.0,0.0) [0.0|255.0] "Unitless" SODL
 SG_ VehSpdLgtCntr : 95|4@0+ (1.0,0.0) [0.0|15.0] "Unitless" SODL
 SG_ VehSpdLgtQf : 91|2@0+ (1,0) [0|3] "" SODL

BO_ 337 AdcuPrivateCanFD5Fr02 : 64 ASDM
 SG_ BrkPedlTrvl_UB : 42|1@0+ (1,0) [0|1] "" SODL
 SG_ BrkPedlTrvlAct : 39|13@0+ (0.01,-5.0) [-5.0|47.0] "mm" SODL
 SG_ BrkPedlTrvlChks : 7|8@0+ (1.0,0.0) [0.0|255.0] "Unitless" SODL
 SG_ BrkPedlTrvlCntr : 15|4@0+ (1.0,0.0) [0.0|15.0] "Unitless" SODL
 SG_ BrkPedlTrvlQf : 11|2@0+ (1,0) [0|3] "" SODL
 SG_ BrkPedlTrvlSt : 26|1@0+ (1,0) [0|1] "" SODL
 SG_ BrkPedlTrvlStQf : 9|2@0+ (1,0) [0|3] "" SODL
 SG_ BrkPedlTrvlTar : 23|13@0+ (0.01,-5.0) [-5.0|47.0] "mm" SODL
 SG_ BrkTracCtrlActv : 167|1@0+ (1,0) [0|1] "" SODL
 SG_ BrkTracCtrlActv_UB : 166|1@0+ (1,0) [0|1] "" SODL
 SG_ WhlDirRotlFrntForBkp_UB : 164|1@0+ (1,0) [0|1] "" SODL
 SG_ WhlDirRotlFrntForBkpChks : 175|8@0+ (1.0,0.0) [0.0|255.0] "Unitless" SODL
 SG_ WhlDirRotlFrntForBkpCntr : 183|4@0+ (1.0,0.0) [0.0|15.0] "Unitless" SODL
 SG_ WhlDirRotlFrntForBkpLe : 179|2@0+ (1,0) [0|3] "" SODL
 SG_ WhlDirRotlFrntForBkpRi : 177|2@0+ (1,0) [0|3] "" SODL
 SG_ WhlDirRotlReForBkp_UB : 165|1@0+ (1,0) [0|1] "" SODL
 SG_ WhlDirRotlReForBkpChks : 159|8@0+ (1.0,0.0) [0.0|255.0] "Unitless" SODL
 SG_ WhlDirRotlReForBkpCntr : 147|4@0+ (1.0,0.0) [0.0|15.0] "Unitless" SODL
 SG_ WhlDirRotlReForBkpLe : 149|2@0+ (1,0) [0|3] "" SODL
 SG_ WhlDirRotlReForBkpRi : 151|2@0+ (1,0) [0|3] "" SODL
 SG_ WhlSpdCircumlFrntForBkp_UB : 88|1@0+ (1,0) [0|1] "" SODL
 SG_ WhlSpdCircumlFrntForBkpWhlSpdCircumlFrntChks : 55|8@0+ (1.0,0.0) [0.0|255.0] "Unitless" SODL
 SG_ WhlSpdCircumlFrntForBkpWhlSpdCircumlFrntCntr : 63|4@0+ (1.0,0.0) [0.0|15.0] "Unitless" SODL
 SG_ WhlSpdCircumlFrntForBkpWhlSpdCircumlFrntLe : 71|15@0+ (0.00391,0.0) [0.0|125.0027] "m/s" SODL
 SG_ WhlSpdCircumlFrntForBkpWhlSpdCircumlFrntLeQf : 59|2@0+ (1,0) [0|3] "" SODL
 SG_ WhlSpdCircumlFrntForBkpWhlSpdCircumlFrntRiQf : 57|2@0+ (1,0) [0|3] "" SODL
 SG_ WhlSpdCircumlFrntForBkpWhlSpdCircumlFrntWhlSpdCircumlFrntRi : 87|15@0+ (0.00391,0.0) [0.0|125.0027] "m/s" SODL
 SG_ WhlSpdCircumlReForBkp_UB : 136|1@0+ (1,0) [0|1] "" SODL
 SG_ WhlSpdCircumlReForBkpWhlSpdCircumlReChks : 103|8@0+ (1.0,0.0) [0.0|255.0] "Unitless" SODL
 SG_ WhlSpdCircumlReForBkpWhlSpdCircumlReCntr : 111|4@0+ (1.0,0.0) [0.0|15.0] "Unitless" SODL
 SG_ WhlSpdCircumlReForBkpWhlSpdCircumlReLe : 119|15@0+ (0.00391,0.0) [0.0|125.0027] "m/s" SODL
 SG_ WhlSpdCircumlReForBkpWhlSpdCircumlReLeQf : 107|2@0+ (1,0) [0|3] "" SODL
 SG_ WhlSpdCircumlReForBkpWhlSpdCircumlReRi : 135|15@0+ (0.00391,0.0) [0.0|125.0027] "m/s" SODL
 SG_ WhlSpdCircumlReForBkpWhlSpdCircumlReRiQf : 105|2@0+ (1,0) [0|3] "" SODL

BO_ 357 AdcuPrivateCanFD5Fr03 : 64 ASDM
 SG_ AbsCtrlActv_UB : 10|1@0+ (1,0) [0|1] "" SODL
 SG_ AbsCtrlActvChks : 7|8@0+ (1.0,0.0) [0.0|255.0] "Unitless" SODL
 SG_ AbsCtrlActvCntr : 15|4@0+ (1.0,0.0) [0.0|15.0] "Unitless" SODL
 SG_ AbsCtrlActvCtrlSts1 : 11|1@0+ (1,0) [0|1] "" SODL
 SG_ ALgtStdFromWhlSpd_UB : 22|1@0+ (1,0) [0|1] "" SODL
 SG_ ALgtStdFromWhlSpdALgtStdFromWhlSpd : 39|16@0- (0.0009765625,0.0) [-18.0|18.0] "m/s^2" SODL
 SG_ ALgtStdFromWhlSpdChks : 31|8@0+ (1.0,0.0) [0.0|255.0] "Unitless" SODL
 SG_ ALgtStdFromWhlSpdCntr : 19|4@0+ (1.0,0.0) [0.0|15.0] "Unitless" SODL
 SG_ ALgtStdFromWhlSpdQf : 21|2@0+ (1,0) [0|3] "" SODL
 SG_ AsyDataWithCmpSafe_UB : 168|1@0+ (1,0) [0|1] "" SODL
 SG_ AsyDataWithCmpSafeALat1Qf : 153|2@0+ (1,0) [0|3] "" SODL
 SG_ AsyDataWithCmpSafeALatWithCmp : 167|15@0- (0.0085,0.0) [-138.99200000000002|139.00050000000002] "m/s^2" SODL
 SG_ AsyDataWithCmpSafeALgt1Qf : 155|2@0+ (1,0) [0|3] "" SODL
 SG_ AsyDataWithCmpSafeChks : 135|8@0+ (1.0,0.0) [0.0|255.0] "Unitless" SODL
 SG_ AsyDataWithCmpSafeCntr : 159|4@0+ (1.0,0.0) [0.0|15.0] "Unitless" SODL
 SG_ AsyDataWithCmpSafeGrdtOfALgt : 143|14@0- (0.00390625,0.0) [-30.0|30.0] "m/s^3" SODL
 SG_ AsyDataWithCmpSafeYawRateQf : 145|2@0+ (1,0) [0|3] "" SODL
 SG_ AsyDataWithCmpSafeYawRateWithCmp : 119|16@0- (0.000244140625,0.0) [-6.0|6.0] "rad/s" SODL
 SG_ BrkSysCylPMst_UB : 54|1@0+ (1,0) [0|1] "" SODL
 SG_ BrkSysCylPMstAct : 71|10@0+ (0.3,-30.0) [-30.0|276.59999999999997] "bar" SODL
 SG_ BrkSysCylPMstActQf : 53|2@0+ (1,0) [0|3] "" SODL
 SG_ BrkSysCylPMstChks : 63|8@0+ (1.0,0.0) [0.0|255.0] "Unitless" SODL
 SG_ BrkSysCylPMstCntr : 51|4@0+ (1.0,0.0) [0.0|15.0] "Unitless" SODL
 SG_ BrkSysCylPMstTar : 77|10@0+ (0.25,0.0) [0.0|250.0] "bar" SODL
 SG_ BrkSysCylPMstVirt : 83|10@0+ (0.25,0.0) [0.0|250.0] "bar" SODL
 SG_ BrkSysCylPMstVirtQf : 89|2@0+ (1,0) [0|3] "" SODL
 SG_ EpbSts_UB : 55|1@0+ (1,0) [0|1] "" SODL
 SG_ EpbStsChks : 103|8@0+ (1.0,0.0) [0.0|255.0] "Unitless" SODL
 SG_ EpbStsCntr : 107|4@0+ (1.0,0.0) [0.0|15.0] "Unitless" SODL
 SG_ EpbStsEpbSts : 111|4@0+ (1,0) [0|15] "" SODL
 SG_ EscCtrlIndcn : 9|2@0+ (1,0) [0|3] "" SODL
 SG_ EscCtrlIndcn_UB : 233|1@0+ (1,0) [0|1] "" SODL
 SG_ EscSt_UB : 247|1@0+ (1,0) [0|1] "" SODL
 SG_ EscStChks : 255|8@0+ (1.0,0.0) [0.0|255.0] "Unitless" SODL
 SG_ EscStCntr : 243|4@0+ (1.0,0.0) [0.0|15.0] "Unitless" SODL
 SG_ EscStEscSt : 246|3@0+ (1,0) [0|7] "" SODL
 SG_ PinionSteerAgGroup_UB : 23|1@0+ (1,0) [0|1] "" SODL
 SG_ PinionSteerAgGroupChks : 183|8@0+ (1.0,0.0) [0.0|255.0] "Unitless" SODL
 SG_ PinionSteerAgGroupCntr : 239|4@0+ (1.0,0.0) [0.0|15.0] "Unitless" SODL
 SG_ PinionSteerAgGroupPinionSteerAg1 : 222|15@0- (0.0009765625,0.0) [-14.5|14.5] "rad" SODL
 SG_ PinionSteerAgGroupPinionSteerAg1Qf : 191|2@0+ (1,0) [0|3] "" SODL
 SG_ PinionSteerAgGroupPinionSteerAgSpd1 : 189|14@0- (0.0078125,0.0) [-50.0|50.0] "rad/s" SODL
 SG_ PinionSteerAgGroupPinionSteerAgSpd1Qf : 207|2@0+ (1,0) [0|3] "" SODL
 SG_ PinionSteerAgGroupSteerWhlTq : 205|14@0- (0.00390625,0.0) [-30.0|30.0] "NewtonMeter" SODL
 SG_ PinionSteerAgGroupSteerWhlTqQf : 235|2@0+ (1,0) [0|3] "" SODL
 SG_ VehModMngtGlbSafe1_UB : 456|1@0+ (1,0) [0|1] "" SODL
 SG_ VehModMngtGlbSafe1CarModSts1 : 463|3@0+ (1,0) [0|7] "" SODL
 SG_ VehModMngtGlbSafe1CarModSubtypWdCarModSubtyp : 460|3@0+ (1.0,0.0) [0.0|7.0] "Unitless" SODL
 SG_ VehModMngtGlbSafe1Chks : 431|8@0+ (1.0,0.0) [0.0|255.0] "Unitless" SODL
 SG_ VehModMngtGlbSafe1Cntr : 439|4@0+ (1.0,0.0) [0.0|15.0] "Unitless" SODL
 SG_ VehModMngtGlbSafe1EgyLvlElecMai : 435|4@0+ (1.0,0.0) [0.0|15.0] "Unitless" SODL
 SG_ VehModMngtGlbSafe1EgyLvlElecSubtyp : 447|4@0+ (1.0,0.0) [0.0|15.0] "Unitless" SODL
 SG_ VehModMngtGlbSafe1FltEgyCnsWdSts : 457|1@0+ (1,0) [0|1] "" SODL
 SG_ VehModMngtGlbSafe1PwrLvlElecMai : 443|4@0+ (1.0,0.0) [0.0|15.0] "Unitless" SODL
 SG_ VehModMngtGlbSafe1PwrLvlElecSubtyp : 455|4@0+ (1.0,0.0) [0.0|15.0] "Unitless" SODL
 SG_ VehModMngtGlbSafe1UsgModSts : 451|4@0+ (1,0) [0|15] "" SODL
 SG_ VehMtnSt_UB : 287|1@0+ (1,0) [0|1] "" SODL
 SG_ VehMtnStChks : 295|8@0+ (1.0,0.0) [0.0|255.0] "Unitless" SODL
 SG_ VehMtnStCntr : 286|4@0+ (1.0,0.0) [0.0|15.0] "Unitless" SODL
 SG_ VehMtnStVehMtnSt : 282|3@0+ (1,0) [0|7] "" SODL
 SG_ WhlDirRotlFrnt_UB : 384|1@0+ (1,0) [0|1] "" SODL
 SG_ WhlDirRotlFrntChks : 399|8@0+ (1.0,0.0) [0.0|255.0] "Unitless" SODL
 SG_ WhlDirRotlFrntCntr : 407|4@0+ (1.0,0.0) [0.0|15.0] "Unitless" SODL
 SG_ WhlDirRotlFrntLe : 403|2@0+ (1,0) [0|3] "" SODL
 SG_ WhlDirRotlFrntRi : 401|2@0+ (1,0) [0|3] "" SODL
 SG_ WhlDirRotlRe_UB : 336|1@0+ (1,0) [0|1] "" SODL
 SG_ WhlDirRotlReChks : 415|8@0+ (1.0,0.0) [0.0|255.0] "Unitless" SODL
 SG_ WhlDirRotlReCntr : 419|4@0+ (1.0,0.0) [0.0|15.0] "Unitless" SODL
 SG_ WhlDirRotlReLe : 423|2@0+ (1,0) [0|3] "" SODL
 SG_ WhlDirRotlReRi : 421|2@0+ (1,0) [0|3] "" SODL
 SG_ WhlSpdCircumlFrnt_UB : 303|1@0+ (1,0) [0|1] "" SODL
 SG_ WhlSpdCircumlFrntChks : 319|8@0+ (1.0,0.0) [0.0|255.0] "Unitless" SODL
 SG_ WhlSpdCircumlFrntCntr : 327|4@0+ (1.0,0.0) [0.0|15.0] "Unitless" SODL
 SG_ WhlSpdCircumlFrntLe : 302|15@0+ (0.00391,0.0) [0.0|125.0027] "m/s" SODL
 SG_ WhlSpdCircumlFrntLeQf : 323|2@0+ (1,0) [0|3] "" SODL
 SG_ WhlSpdCircumlFrntRiQf : 321|2@0+ (1,0) [0|3] "" SODL
 SG_ WhlSpdCircumlFrntWhlSpdCircumlFrntRi : 335|15@0+ (0.00391,0.0) [0.0|125.0027] "m/s" SODL
 SG_ WhlSpdCircumlRe_UB : 351|1@0+ (1,0) [0|1] "" SODL
 SG_ WhlSpdCircumlReChks : 367|8@0+ (1.0,0.0) [0.0|255.0] "Unitless" SODL
 SG_ WhlSpdCircumlReCntr : 375|4@0+ (1.0,0.0) [0.0|15.0] "Unitless" SODL
 SG_ WhlSpdCircumlReLe : 350|15@0+ (0.00391,0.0) [0.0|125.0027] "m/s" SODL
 SG_ WhlSpdCircumlReLeQf : 371|2@0+ (1,0) [0|3] "" SODL
 SG_ WhlSpdCircumlReRi : 383|15@0+ (0.00391,0.0) [0.0|125.0027] "m/s" SODL
 SG_ WhlSpdCircumlReRiQf : 369|2@0+ (1,0) [0|3] "" SODL

BO_ 401 AdcuPrivateCanFD5Fr04 : 64 ASDM
 SG_ ADataRawSafe_UB : 69|1@0+ (1,0) [0|1] "" SODL
 SG_ ADataRawSafeALat : 23|15@0- (0.0085,0.0) [-138.99200000000002|139.00050000000002] "m/s^2" SODL
 SG_ ADataRawSafeALat1Qf : 11|2@0+ (1,0) [0|3] "" SODL
 SG_ ADataRawSafeALgt : 38|15@0- (0.0085,0.0) [-138.99200000000002|139.00050000000002] "m/s^2" SODL
 SG_ ADataRawSafeALgt1Qf : 9|2@0+ (1,0) [0|3] "" SODL
 SG_ ADataRawSafeAVert : 55|15@0- (0.0085,0.0) [-138.99200000000002|139.00050000000002] "m/s^2" SODL
 SG_ ADataRawSafeAVertQf : 71|2@0+ (1,0) [0|3] "" SODL
 SG_ ADataRawSafeChks : 7|8@0+ (1.0,0.0) [0.0|255.0] "Unitless" SODL
 SG_ ADataRawSafeCntr : 15|4@0+ (1.0,0.0) [0.0|15.0] "Unitless" SODL
 SG_ AgDataRawSafe_UB : 68|1@0+ (1,0) [0|1] "" SODL
 SG_ AgDataRawSafeChks : 111|8@0+ (1.0,0.0) [0.0|255.0] "Unitless" SODL
 SG_ AgDataRawSafeCntr : 119|4@0+ (1.0,0.0) [0.0|15.0] "Unitless" SODL
 SG_ AgDataRawSafeRollRate : 79|16@0- (0.000244140625,0.0) [-6.0|6.0] "rad/s" SODL
 SG_ AgDataRawSafeRollRateQf : 115|2@0+ (1,0) [0|3] "" SODL
 SG_ AgDataRawSafeYawRate : 95|16@0- (0.000244140625,0.0) [-6.0|6.0] "rad/s" SODL
 SG_ AgDataRawSafeYawRateQf : 113|2@0+ (1,0) [0|3] "" SODL
 SG_ BltLockStAtDrvr_UB : 125|1@0+ (1,0) [0|1] "" SODL
 SG_ BltLockStAtDrvrBltLockSt1 : 127|1@0+ (1,0) [0|1] "" SODL
 SG_ BltLockStAtDrvrBltLockSts : 126|1@0+ (1,0) [0|1] "" SODL
 SG_ GearLvrIndcn : 66|3@0+ (1,0) [0|7] "" SODL
 SG_ GearLvrIndcn_UB : 67|1@0+ (1,0) [0|1] "" SODL

BO_ 327 AdcuPrivateCanFD5Fr05 : 64 ASDM
 SG_ ExtrLtgSts_UB : 4|1@0+ (1,0) [0|1] "" SODL
 SG_ ExtrLtgStsAFS : 23|2@0+ (1,0) [0|3] "" SODL
 SG_ ExtrLtgStsAHBC : 21|2@0+ (1,0) [0|3] "" SODL
 SG_ ExtrLtgStsAHL : 19|2@0+ (1,0) [0|3] "" SODL
 SG_ ExtrLtgStsAllWL : 17|2@0+ (1,0) [0|3] "" SODL
 SG_ ExtrLtgStsApproach : 31|2@0+ (1,0) [0|3] "" SODL
 SG_ ExtrLtgStsChks : 15|8@0+ (1.0,0.0) [0.0|255.0] "Unitless" SODL
 SG_ ExtrLtgStsCntr : 3|4@0+ (1.0,0.0) [0.0|15.0] "Unitless" SODL
 SG_ ExtrLtgStsCornrgLi : 29|2@0+ (1,0) [0|3] "" SODL
 SG_ ExtrLtgStsDBL : 27|2@0+ (1,0) [0|3] "" SODL
 SG_ ExtrLtgStsDRL : 25|2@0+ (1,0) [0|3] "" SODL
 SG_ ExtrLtgStsFlash : 39|2@0+ (1,0) [0|3] "" SODL
 SG_ ExtrLtgStsFrntFog : 37|2@0+ (1,0) [0|3] "" SODL
 SG_ ExtrLtgStsGoodbye : 35|2@0+ (1,0) [0|3] "" SODL
 SG_ ExtrLtgStsHiBeam : 33|2@0+ (1,0) [0|3] "" SODL
 SG_ ExtrLtgStsHomeSafe : 47|2@0+ (1,0) [0|3] "" SODL
 SG_ ExtrLtgStsHWL : 45|2@0+ (1,0) [0|3] "" SODL
 SG_ ExtrLtgStsLoBeam : 43|2@0+ (1,0) [0|3] "" SODL
 SG_ ExtrLtgStsLtgShow : 41|2@0+ (1,0) [0|3] "" SODL
 SG_ ExtrLtgStsPosLiFrnt : 55|2@0+ (1,0) [0|3] "" SODL
 SG_ ExtrLtgStsPosLiRe : 53|2@0+ (1,0) [0|3] "" SODL
 SG_ ExtrLtgStsReFog : 51|2@0+ (1,0) [0|3] "" SODL
 SG_ ExtrLtgStsReverseLi : 49|2@0+ (1,0) [0|3] "" SODL
 SG_ ExtrLtgStsStopLi : 63|2@0+ (1,0) [0|3] "" SODL
 SG_ ExtrLtgStsTurnIndrLe : 61|2@0+ (1,0) [0|3] "" SODL
 SG_ ExtrLtgStsTurnIndrRi : 59|2@0+ (1,0) [0|3] "" SODL
 SG_ ExtrLtgStsWelcome : 57|2@0+ (1,0) [0|3] "" SODL
 SG_ VehTiAndData_UB : 71|1@0+ (1,0) [0|1] "" SODL
 SG_ VehTiAndDataDataValid : 70|1@0+ (1,0) [0|1] "" SODL
 SG_ VehTiAndDataDay : 92|5@0+ (1.0,0.0) [1.0|31.0] "Days" SODL
 SG_ VehTiAndDataHr1 : 84|5@0+ (1.0,0.0) [0.0|23.0] "hours" SODL
 SG_ VehTiAndDataMins1 : 77|6@0+ (1.0,0.0) [0.0|59.0] "Mins" SODL
 SG_ VehTiAndDataMth1 : 99|4@0+ (1.0,0.0) [1.0|12.0] "Month" SODL
 SG_ VehTiAndDataSec1 : 69|6@0+ (1.0,0.0) [0.0|59.0] "s" SODL
 SG_ VehTiAndDataYr1 : 110|7@0+ (1.0,0.0) [0.0|99.0] "Year" SODL

BO_ 897 AdcuPrivateCanFD5Fr07 : 64 ASDM
 SG_ AmbTRaw_UB : 7|1@0+ (1,0) [0|1] "" SODL
 SG_ AmbTRawAmbTVal : 2|11@0+ (0.1,-70.0) [-70.0|134.70000000000002] "degC" SODL
 SG_ AmbTRawQly : 4|2@0+ (1,0) [0|3] "" SODL
 SG_ BkpOfDstTrvld : 23|21@0+ (1.0,0.0) [0.0|2000000.0] "km" SODL
 SG_ BkpOfDstTrvld_UB : 6|1@0+ (1,0) [0|1] "" SODL
 SG_ CarTiGlb : 63|32@0+ (0.1,0.0) [0.0|429496729.5] "s" SODL
 SG_ CarTiGlb_UB : 5|1@0+ (1,0) [0|1] "" SODL
 SG_ DrvModReq : 95|4@0+ (1,0) [0|15] "" SODL
 SG_ DrvModReq_UB : 55|1@0+ (1,0) [0|1] "" SODL
 SG_ IndcrDisp : 91|2@0+ (1,0) [0|3] "" SODL
 SG_ IndcrDisp_UB : 89|1@0+ (1,0) [0|1] "" SODL
 SG_ LvlgDirMovmtIndcr : 103|2@0+ (1,0) [0|3] "" SODL
 SG_ LvlgDirMovmtIndcr_UB : 199|1@0+ (1,0) [0|1] "" SODL
 SG_ SuspPosnVertLe1WithE2E_UB : 185|1@0+ (1,0) [0|1] "" SODL
 SG_ SuspPosnVertLe1WithE2EChks : 135|8@0+ (1.0,0.0) [0.0|255.0] "Unitless" SODL
 SG_ SuspPosnVertLe1WithE2ECntr : 143|4@0+ (1.0,0.0) [0.0|15.0] "Unitless" SODL
 SG_ SuspPosnVertLe1WithE2EFrnt : 101|15@0- (0.000062,0.0) [-0.999998|1.00006] "m" SODL
 SG_ SuspPosnVertLe1WithE2EFrntQf : 139|2@0+ (1,0) [0|3] "" SODL
 SG_ SuspPosnVertLe1WithE2ERe : 118|15@0- (0.000062,0.0) [-0.999998|1.00006] "m" SODL
 SG_ SuspPosnVertLe1WithE2EReQf : 137|2@0+ (1,0) [0|3] "" SODL
 SG_ SuspPosnVertRi1WithE2E_UB : 184|1@0+ (1,0) [0|1] "" SODL
 SG_ SuspPosnVertRi1WithE2EChks : 169|8@0+ (1.0,0.0) [0.0|255.0] "Unitless" SODL
 SG_ SuspPosnVertRi1WithE2ECntr : 177|4@0+ (1.0,0.0) [0.0|15.0] "Unitless" SODL
 SG_ SuspPosnVertRi1WithE2EFrnt : 151|15@0- (0.000062,0.0) [-0.999998|1.00006] "m" SODL
 SG_ SuspPosnVertRi1WithE2EFrntQf : 189|2@0+ (1,0) [0|3] "" SODL
 SG_ SuspPosnVertRi1WithE2ERe : 152|15@0- (0.000062,0.0) [-0.999998|1.00006] "m" SODL
 SG_ SuspPosnVertRi1WithE2EReQf : 187|2@0+ (1,0) [0|3] "" SODL
 SG_ VehBattU_UB : 34|1@0+ (1,0) [0|1] "" SODL
 SG_ VehBattUSysU : 47|8@0+ (0.1,0.0) [0.0|25.0] "Volt" SODL
 SG_ VehBattUSysUQf : 33|2@0+ (1,0) [0|3] "" SODL
 SG_ WipgInfo_UB : 54|1@0+ (1,0) [0|1] "" SODL
 SG_ WipgInfoWipgSpdInfo : 50|3@0+ (1,0) [0|7] "" SODL
 SG_ WipgInfoWiprActv : 51|1@0+ (1,0) [0|1] "" SODL
 SG_ WipgInfoWiprInWipgAr : 52|1@0+ (1,0) [0|1] "" SODL

BO_ 1007 AdcuPrivateCanFD5Fr08 : 64 ASDM
 SG_ ReSideRdrLeVehPrm_UB : 148|1@0+ (1,0) [0|1] "" SODL
 SG_ ReSideRdrLeVehPrmRdrVehPrmChks : 99|8@0+ (1.0,0.0) [0.0|255.0] "Unitless" SODL
 SG_ ReSideRdrLeVehPrmRdrVehPrmCntr : 131|4@0+ (1.0,0.0) [0.0|15.0] "Unitless" SODL
 SG_ ReSideRdrLeVehPrmRdrVehPrmRdrDynCalPrmForAgOffs : 107|8@0+ (0.1,-12.8) [-12.8|12.7] "Deg" SODL
 SG_ ReSideRdrLeVehPrmRdrVehPrmRdrDynCalPrmForAxleDstReToVehFrnt : 85|9@0+ (0.01,1.0) [1.0|6.0] "m" SODL
 SG_ ReSideRdrLeVehPrmRdrVehPrmRdrDynCalPrmForPinoinAgRat : 115|8@0+ (0.05,8.0) [8.0|20.75] "Unitless" SODL
 SG_ ReSideRdrLeVehPrmRdrVehPrmRdrDynCalPrmForRollAgGain : 7|14@0+ (0.0001,0.0) [0.0|1.0] "Unitless" SODL
 SG_ ReSideRdrLeVehPrmRdrVehPrmRdrDynCalPrmForSnsrDir : 151|1@0+ (1,0) [0|1] "" SODL
 SG_ ReSideRdrLeVehPrmRdrVehPrmRdrDynCalPrmForSnsrOrntn : 150|1@0+ (1,0) [0|1] "" SODL
 SG_ ReSideRdrLeVehPrmRdrVehPrmRdrDynCalPrmForSnsrPosnLat : 27|12@0+ (0.001,-2.0) [-2.0|2.0] "m" SODL
 SG_ ReSideRdrLeVehPrmRdrVehPrmRdrDynCalPrmForSnsrPosnLgt : 9|14@0+ (0.001,-5.0) [-5.0|5.0] "m" SODL
 SG_ ReSideRdrLeVehPrmRdrVehPrmRdrDynCalPrmForSnsrPosnVert : 47|11@0+ (0.001,0.0) [0.0|2.0] "m" SODL
 SG_ ReSideRdrLeVehPrmRdrVehPrmRdrDynCalPrmForSnsrRot1 : 52|11@0+ (0.1,-90.0) [-90.0|90.0] "Deg" SODL
 SG_ ReSideRdrLeVehPrmRdrVehPrmRdrDynCalPrmForVehLen : 57|10@0+ (0.01,0.0) [0.0|10.0] "m" SODL
 SG_ ReSideRdrLeVehPrmRdrVehPrmRdrDynCalPrmForVehTyp : 123|8@0+ (1.0,0.0) [0.0|255.0] "Unitless" SODL
 SG_ ReSideRdrLeVehPrmRdrVehPrmRdrDynCalPrmForVehWidth : 92|9@0+ (0.01,0.0) [0.0|5.0] "m" SODL
 SG_ ReSideRdrLeVehPrmRdrVehPrmRdrDynCalPrmForVersMajor : 143|4@0+ (1.0,0.0) [0.0|15.0] "Unitless" SODL
 SG_ ReSideRdrLeVehPrmRdrVehPrmRdrDynCalPrmForVersMinor : 139|4@0+ (1.0,0.0) [0.0|15.0] "Unitless" SODL
 SG_ ReSideRdrLeVehPrmRdrVehPrmRdrDynCalPrmForWhlBas : 79|10@0+ (0.01,0.0) [0.0|10.0] "m" SODL
 SG_ ReSideRdrLeVehPrmRdrVehPrmVld : 149|1@0+ (1,0) [0|1] "" SODL

BO_ 2 AdcuPrivateCanFD5Fr10 : 64 ASDM
 SG_ Vin_UB : 71|1@0+ (1,0) [0|1] "" SODL
 SG_ VinBlockNr : 7|8@0+ (1.0,0.0) [0.0|255.0] "Unitless" SODL
 SG_ VinVINSignalPos1 : 15|8@0+ (1.0,0.0) [0.0|255.0] "Unitless" SODL
 SG_ VinVINSignalPos2 : 23|8@0+ (1.0,0.0) [0.0|255.0] "Unitless" SODL
 SG_ VinVINSignalPos3 : 31|8@0+ (1.0,0.0) [0.0|255.0] "Unitless" SODL
 SG_ VinVINSignalPos4 : 39|8@0+ (1.0,0.0) [0.0|255.0] "Unitless" SODL
 SG_ VinVINSignalPos5 : 47|8@0+ (1.0,0.0) [0.0|255.0] "Unitless" SODL
 SG_ VinVINSignalPos6 : 55|8@0+ (1.0,0.0) [0.0|255.0] "Unitless" SODL
 SG_ VinVINSignalPos7 : 63|8@0+ (1.0,0.0) [0.0|255.0] "Unitless" SODL

BO_ 1281 AdcuPrivateCanFD5NmFr01 : 8 ASDM

BO_ 153 ADCUPrivateCanFD5TimeSyncFr : 8 ASDM

BO_ 2047 AdcuToAllFuncPrivateCanFD5DiagReqFr : 8 ASDM
 SG_ AsdmToAllFuncSafetyCanFD5DiagReqNpdu : 7|64@0+ (1,0) [0|0] "" SODL

BO_ 1921 AdcuToSodlPrivateCanFD5DiagReqFr : 64 ASDM
 SG_ AdcuToSodlPrivateCanFD5DiagReqNpdu : 7|512@0+ (1,0) [0|0] "" SODL

BO_ 1025 SODLPrivateCANFD5Fr01 : 64 SODL
 SG_ ReSideRdrLe20Obj1_UB : 298|1@0+ (1,0) [0|1] "" ASDM
 SG_ ReSideRdrLe20Obj1Heading : 39|12@0+ (0.1,-180.0) [-180.0|180.0] "Deg" ASDM
 SG_ ReSideRdrLe20Obj1ObjBoxCenterLat : 111|9@0+ (0.1,-25.0) [-25.0|25.0] "m" ASDM
 SG_ ReSideRdrLe20Obj1ObjBoxCenterLgt : 23|9@0+ (0.1,-25.0) [-25.0|25.0] "m" ASDM
 SG_ ReSideRdrLe20Obj1ObservationHist : 79|32@0+ (1.0,0.0) [0.0|4294967295.0] "Unitless" ASDM
 SG_ ReSideRdrLe20Obj1QualityBits : 127|18@0+ (1.0,0.0) [0.0|262143.0] "Unitless" ASDM
 SG_ ReSideRdrLe20Obj1RdrObjAx : 55|8@0- (0.1,0.0) [-12.8|12.700000000000001] "m/s^2" ASDM
 SG_ ReSideRdrLe20Obj1RdrObjAy : 63|8@0- (0.1,0.0) [-12.8|12.700000000000001] "m/s^2" ASDM
 SG_ ReSideRdrLe20Obj1RdrObjBoxLength : 151|9@0+ (0.1,0.0) [0.0|50.0] "m" ASDM
 SG_ ReSideRdrLe20Obj1RdrObjBoxWidth : 279|9@0+ (0.1,0.0) [0.0|50.0] "m" ASDM
 SG_ ReSideRdrLe20Obj1RdrObjChks : 7|8@0+ (1.0,0.0) [0.0|255.0] "Unitless" ASDM
 SG_ ReSideRdrLe20Obj1RdrObjCntr : 15|4@0+ (1.0,0.0) [0.0|15.0] "Unitless" ASDM
 SG_ ReSideRdrLe20Obj1RdrObjCoastCnt : 158|5@0+ (1.0,0.0) [0.0|31.0] "Unitless" ASDM
 SG_ ReSideRdrLe20Obj1RdrObjConf : 11|4@0+ (7.0,0.0) [0.0|105.0] "%" ASDM
 SG_ ReSideRdrLe20Obj1RdrObjDx : 207|13@0+ (0.05,-200.0) [-200.0|200.0] "m" ASDM
 SG_ ReSideRdrLe20Obj1RdrObjDxStdDe : 71|8@0+ (0.05,0.0) [0.0|12.700000000000001] "m" ASDM
 SG_ ReSideRdrLe20Obj1RdrObjDy : 295|13@0+ (0.05,-200.0) [-200.0|200.0] "m" ASDM
 SG_ ReSideRdrLe20Obj1RdrObjDyStdDe : 167|8@0+ (0.05,0.0) [0.0|12.700000000000001] "m" ASDM
 SG_ ReSideRdrLe20Obj1RdrObjElevnConf : 43|4@0+ (7.0,0.0) [0.0|105.0] "%" ASDM
 SG_ ReSideRdrLe20Obj1RdrObjElevnSts : 153|2@0+ (1,0) [0|3] "" ASDM
 SG_ ReSideRdrLe20Obj1RdrObjID : 223|8@0+ (1.0,0.0) [0.0|255.0] "Unitless" ASDM
 SG_ ReSideRdrLe20Obj1RdrObjIsInFreeSpace : 280|1@0+ (1,0) [0|1] "" ASDM
 SG_ ReSideRdrLe20Obj1RdrObjMirrProblty : 263|4@0+ (7.0,0.0) [0.0|105.0] "%" ASDM
 SG_ ReSideRdrLe20Obj1RdrObjMtnPat : 210|3@0+ (1,0) [0|7] "" ASDM
 SG_ ReSideRdrLe20Obj1RdrObjNotRealProblty : 259|4@0+ (7.0,0.0) [0.0|105.0] "%" ASDM
 SG_ ReSideRdrLe20Obj1RdrObjStatyCnt : 30|7@0+ (1.0,0.0) [0.0|127.0] "Unitless" ASDM
 SG_ ReSideRdrLe20Obj1RdrObjTiAlv : 118|7@0+ (1.0,0.0) [0.0|127.0] "Unitless" ASDM
 SG_ ReSideRdrLe20Obj1RdrObjTrackSts : 177|2@0+ (1,0) [0|3] "" ASDM
 SG_ ReSideRdrLe20Obj1RdrObjTyp : 235|4@0+ (1,0) [0|15] "" ASDM
 SG_ ReSideRdrLe20Obj1RdrObjTypConfBike : 251|4@0+ (7.0,0.0) [0.0|105.0] "%" ASDM
 SG_ ReSideRdrLe20Obj1RdrObjTypConfPed : 271|4@0+ (7.0,0.0) [0.0|105.0] "%" ASDM
 SG_ ReSideRdrLe20Obj1RdrObjTypConfVeh : 267|4@0+ (7.0,0.0) [0.0|105.0] "%" ASDM
 SG_ ReSideRdrLe20Obj1RdrObjUsedTracker : 193|2@0+ (1,0) [0|3] "" ASDM
 SG_ ReSideRdrLe20Obj1RdrObjVx : 175|14@0+ (0.02,-128.0) [-128.0|128.0] "m/s" ASDM
 SG_ ReSideRdrLe20Obj1RdrObjVxStdDe : 141|6@0+ (0.05,0.0) [0.0|2.0] "m/s" ASDM
 SG_ ReSideRdrLe20Obj1RdrObjVy : 191|14@0+ (0.02,-128.0) [-128.0|128.0] "m/s" ASDM
 SG_ ReSideRdrLe20Obj1RdrObjVyStdDe : 286|6@0+ (0.05,0.0) [0.0|2.0] "m/s" ASDM
 SG_ ReSideRdrLe20Obj1RelVx : 231|12@0+ (0.02,-35.6) [-35.6|35.6] "m/s" ASDM
 SG_ ReSideRdrLe20Obj1RelVy : 247|12@0+ (0.02,-35.6) [-35.6|35.6] "m/s" ASDM

BO_ 1026 SODLPrivateCANFD5Fr02 : 64 SODL
 SG_ ReSideRdrLe20Obj2_UB : 298|1@0+ (1,0) [0|1] "" ASDM
 SG_ ReSideRdrLe20Obj2Heading : 39|12@0+ (0.1,-180.0) [-180.0|180.0] "Deg" ASDM
 SG_ ReSideRdrLe20Obj2ObjBoxCenterLat : 111|9@0+ (0.1,-25.0) [-25.0|25.0] "m" ASDM
 SG_ ReSideRdrLe20Obj2ObjBoxCenterLgt : 23|9@0+ (0.1,-25.0) [-25.0|25.0] "m" ASDM
 SG_ ReSideRdrLe20Obj2ObservationHist : 79|32@0+ (1.0,0.0) [0.0|4294967295.0] "Unitless" ASDM
 SG_ ReSideRdrLe20Obj2QualityBits : 127|18@0+ (1.0,0.0) [0.0|262143.0] "Unitless" ASDM
 SG_ ReSideRdrLe20Obj2RdrObjAx : 55|8@0- (0.1,0.0) [-12.8|12.700000000000001] "m/s^2" ASDM
 SG_ ReSideRdrLe20Obj2RdrObjAy : 63|8@0- (0.1,0.0) [-12.8|12.700000000000001] "m/s^2" ASDM
 SG_ ReSideRdrLe20Obj2RdrObjBoxLength : 151|9@0+ (0.1,0.0) [0.0|50.0] "m" ASDM
 SG_ ReSideRdrLe20Obj2RdrObjBoxWidth : 279|9@0+ (0.1,0.0) [0.0|50.0] "m" ASDM
 SG_ ReSideRdrLe20Obj2RdrObjChks : 7|8@0+ (1.0,0.0) [0.0|255.0] "Unitless" ASDM
 SG_ ReSideRdrLe20Obj2RdrObjCntr : 15|4@0+ (1.0,0.0) [0.0|15.0] "Unitless" ASDM
 SG_ ReSideRdrLe20Obj2RdrObjCoastCnt : 158|5@0+ (1.0,0.0) [0.0|31.0] "Unitless" ASDM
 SG_ ReSideRdrLe20Obj2RdrObjConf : 11|4@0+ (7.0,0.0) [0.0|105.0] "%" ASDM
 SG_ ReSideRdrLe20Obj2RdrObjDx : 207|13@0+ (0.05,-200.0) [-200.0|200.0] "m" ASDM
 SG_ ReSideRdrLe20Obj2RdrObjDxStdDe : 71|8@0+ (0.05,0.0) [0.0|12.700000000000001] "m" ASDM
 SG_ ReSideRdrLe20Obj2RdrObjDy : 295|13@0+ (0.05,-200.0) [-200.0|200.0] "m" ASDM
 SG_ ReSideRdrLe20Obj2RdrObjDyStdDe : 167|8@0+ (0.05,0.0) [0.0|12.700000000000001] "m" ASDM
 SG_ ReSideRdrLe20Obj2RdrObjElevnConf : 43|4@0+ (7.0,0.0) [0.0|105.0] "%" ASDM
 SG_ ReSideRdrLe20Obj2RdrObjElevnSts : 153|2@0+ (1,0) [0|3] "" ASDM
 SG_ ReSideRdrLe20Obj2RdrObjID : 223|8@0+ (1.0,0.0) [0.0|255.0] "Unitless" ASDM
 SG_ ReSideRdrLe20Obj2RdrObjIsInFreeSpace : 280|1@0+ (1,0) [0|1] "" ASDM
 SG_ ReSideRdrLe20Obj2RdrObjMirrProblty : 263|4@0+ (7.0,0.0) [0.0|105.0] "%" ASDM
 SG_ ReSideRdrLe20Obj2RdrObjMtnPat : 210|3@0+ (1,0) [0|7] "" ASDM
 SG_ ReSideRdrLe20Obj2RdrObjNotRealProblty : 259|4@0+ (7.0,0.0) [0.0|105.0] "%" ASDM
 SG_ ReSideRdrLe20Obj2RdrObjStatyCnt : 30|7@0+ (1.0,0.0) [0.0|127.0] "Unitless" ASDM
 SG_ ReSideRdrLe20Obj2RdrObjTiAlv : 118|7@0+ (1.0,0.0) [0.0|127.0] "Unitless" ASDM
 SG_ ReSideRdrLe20Obj2RdrObjTrackSts : 177|2@0+ (1,0) [0|3] "" ASDM
 SG_ ReSideRdrLe20Obj2RdrObjTyp : 235|4@0+ (1,0) [0|15] "" ASDM
 SG_ ReSideRdrLe20Obj2RdrObjTypConfBike : 251|4@0+ (7.0,0.0) [0.0|105.0] "%" ASDM
 SG_ ReSideRdrLe20Obj2RdrObjTypConfPed : 271|4@0+ (7.0,0.0) [0.0|105.0] "%" ASDM
 SG_ ReSideRdrLe20Obj2RdrObjTypConfVeh : 267|4@0+ (7.0,0.0) [0.0|105.0] "%" ASDM
 SG_ ReSideRdrLe20Obj2RdrObjUsedTracker : 193|2@0+ (1,0) [0|3] "" ASDM
 SG_ ReSideRdrLe20Obj2RdrObjVx : 175|14@0+ (0.02,-128.0) [-128.0|128.0] "m/s" ASDM
 SG_ ReSideRdrLe20Obj2RdrObjVxStdDe : 141|6@0+ (0.05,0.0) [0.0|2.0] "m/s" ASDM
 SG_ ReSideRdrLe20Obj2RdrObjVy : 191|14@0+ (0.02,-128.0) [-128.0|128.0] "m/s" ASDM
 SG_ ReSideRdrLe20Obj2RdrObjVyStdDe : 286|6@0+ (0.05,0.0) [0.0|2.0] "m/s" ASDM
 SG_ ReSideRdrLe20Obj2RelVx : 231|12@0+ (0.02,-35.6) [-35.6|35.6] "m/s" ASDM
 SG_ ReSideRdrLe20Obj2RelVy : 247|12@0+ (0.02,-35.6) [-35.6|35.6] "m/s" ASDM

BO_ 1027 SODLPrivateCANFD5Fr03 : 64 SODL
 SG_ ReSideRdrLe20Obj3_UB : 298|1@0+ (1,0) [0|1] "" ASDM
 SG_ ReSideRdrLe20Obj3Heading : 39|12@0+ (0.1,-180.0) [-180.0|180.0] "Deg" ASDM
 SG_ ReSideRdrLe20Obj3ObjBoxCenterLat : 111|9@0+ (0.1,-25.0) [-25.0|25.0] "m" ASDM
 SG_ ReSideRdrLe20Obj3ObjBoxCenterLgt : 23|9@0+ (0.1,-25.0) [-25.0|25.0] "m" ASDM
 SG_ ReSideRdrLe20Obj3ObservationHist : 79|32@0+ (1.0,0.0) [0.0|4294967295.0] "Unitless" ASDM
 SG_ ReSideRdrLe20Obj3QualityBits : 127|18@0+ (1.0,0.0) [0.0|262143.0] "Unitless" ASDM
 SG_ ReSideRdrLe20Obj3RdrObjAx : 55|8@0- (0.1,0.0) [-12.8|12.700000000000001] "m/s^2" ASDM
 SG_ ReSideRdrLe20Obj3RdrObjAy : 63|8@0- (0.1,0.0) [-12.8|12.700000000000001] "m/s^2" ASDM
 SG_ ReSideRdrLe20Obj3RdrObjBoxLength : 151|9@0+ (0.1,0.0) [0.0|50.0] "m" ASDM
 SG_ ReSideRdrLe20Obj3RdrObjBoxWidth : 279|9@0+ (0.1,0.0) [0.0|50.0] "m" ASDM
 SG_ ReSideRdrLe20Obj3RdrObjChks : 7|8@0+ (1.0,0.0) [0.0|255.0] "Unitless" ASDM
 SG_ ReSideRdrLe20Obj3RdrObjCntr : 15|4@0+ (1.0,0.0) [0.0|15.0] "Unitless" ASDM
 SG_ ReSideRdrLe20Obj3RdrObjCoastCnt : 158|5@0+ (1.0,0.0) [0.0|31.0] "Unitless" ASDM
 SG_ ReSideRdrLe20Obj3RdrObjConf : 11|4@0+ (7.0,0.0) [0.0|105.0] "%" ASDM
 SG_ ReSideRdrLe20Obj3RdrObjDx : 207|13@0+ (0.05,-200.0) [-200.0|200.0] "m" ASDM
 SG_ ReSideRdrLe20Obj3RdrObjDxStdDe : 71|8@0+ (0.05,0.0) [0.0|12.700000000000001] "m" ASDM
 SG_ ReSideRdrLe20Obj3RdrObjDy : 295|13@0+ (0.05,-200.0) [-200.0|200.0] "m" ASDM
 SG_ ReSideRdrLe20Obj3RdrObjDyStdDe : 167|8@0+ (0.05,0.0) [0.0|12.700000000000001] "m" ASDM
 SG_ ReSideRdrLe20Obj3RdrObjElevnConf : 43|4@0+ (7.0,0.0) [0.0|105.0] "%" ASDM
 SG_ ReSideRdrLe20Obj3RdrObjElevnSts : 153|2@0+ (1,0) [0|3] "" ASDM
 SG_ ReSideRdrLe20Obj3RdrObjID : 223|8@0+ (1.0,0.0) [0.0|255.0] "Unitless" ASDM
 SG_ ReSideRdrLe20Obj3RdrObjIsInFreeSpace : 280|1@0+ (1,0) [0|1] "" ASDM
 SG_ ReSideRdrLe20Obj3RdrObjMirrProblty : 263|4@0+ (7.0,0.0) [0.0|105.0] "%" ASDM
 SG_ ReSideRdrLe20Obj3RdrObjMtnPat : 210|3@0+ (1,0) [0|7] "" ASDM
 SG_ ReSideRdrLe20Obj3RdrObjNotRealProblty : 259|4@0+ (7.0,0.0) [0.0|105.0] "%" ASDM
 SG_ ReSideRdrLe20Obj3RdrObjStatyCnt : 30|7@0+ (1.0,0.0) [0.0|127.0] "Unitless" ASDM
 SG_ ReSideRdrLe20Obj3RdrObjTiAlv : 118|7@0+ (1.0,0.0) [0.0|127.0] "Unitless" ASDM
 SG_ ReSideRdrLe20Obj3RdrObjTrackSts : 177|2@0+ (1,0) [0|3] "" ASDM
 SG_ ReSideRdrLe20Obj3RdrObjTyp : 235|4@0+ (1,0) [0|15] "" ASDM
 SG_ ReSideRdrLe20Obj3RdrObjTypConfBike : 251|4@0+ (7.0,0.0) [0.0|105.0] "%" ASDM
 SG_ ReSideRdrLe20Obj3RdrObjTypConfPed : 271|4@0+ (7.0,0.0) [0.0|105.0] "%" ASDM
 SG_ ReSideRdrLe20Obj3RdrObjTypConfVeh : 267|4@0+ (7.0,0.0) [0.0|105.0] "%" ASDM
 SG_ ReSideRdrLe20Obj3RdrObjUsedTracker : 193|2@0+ (1,0) [0|3] "" ASDM
 SG_ ReSideRdrLe20Obj3RdrObjVx : 175|14@0+ (0.02,-128.0) [-128.0|128.0] "m/s" ASDM
 SG_ ReSideRdrLe20Obj3RdrObjVxStdDe : 141|6@0+ (0.05,0.0) [0.0|2.0] "m/s" ASDM
 SG_ ReSideRdrLe20Obj3RdrObjVy : 191|14@0+ (0.02,-128.0) [-128.0|128.0] "m/s" ASDM
 SG_ ReSideRdrLe20Obj3RdrObjVyStdDe : 286|6@0+ (0.05,0.0) [0.0|2.0] "m/s" ASDM
 SG_ ReSideRdrLe20Obj3RelVx : 231|12@0+ (0.02,-35.6) [-35.6|35.6] "m/s" ASDM
 SG_ ReSideRdrLe20Obj3RelVy : 247|12@0+ (0.02,-35.6) [-35.6|35.6] "m/s" ASDM

BO_ 1028 SODLPrivateCANFD5Fr04 : 64 SODL
 SG_ ReSideRdrLe20Obj4_UB : 298|1@0+ (1,0) [0|1] "" ASDM
 SG_ ReSideRdrLe20Obj4Heading : 39|12@0+ (0.1,-180.0) [-180.0|180.0] "Deg" ASDM
 SG_ ReSideRdrLe20Obj4ObjBoxCenterLat : 111|9@0+ (0.1,-25.0) [-25.0|25.0] "m" ASDM
 SG_ ReSideRdrLe20Obj4ObjBoxCenterLgt : 23|9@0+ (0.1,-25.0) [-25.0|25.0] "m" ASDM
 SG_ ReSideRdrLe20Obj4ObservationHist : 79|32@0+ (1.0,0.0) [0.0|4294967295.0] "Unitless" ASDM
 SG_ ReSideRdrLe20Obj4QualityBits : 127|18@0+ (1.0,0.0) [0.0|262143.0] "Unitless" ASDM
 SG_ ReSideRdrLe20Obj4RdrObjAx : 55|8@0- (0.1,0.0) [-12.8|12.700000000000001] "m/s^2" ASDM
 SG_ ReSideRdrLe20Obj4RdrObjAy : 63|8@0- (0.1,0.0) [-12.8|12.700000000000001] "m/s^2" ASDM
 SG_ ReSideRdrLe20Obj4RdrObjBoxLength : 151|9@0+ (0.1,0.0) [0.0|50.0] "m" ASDM
 SG_ ReSideRdrLe20Obj4RdrObjBoxWidth : 279|9@0+ (0.1,0.0) [0.0|50.0] "m" ASDM
 SG_ ReSideRdrLe20Obj4RdrObjChks : 7|8@0+ (1.0,0.0) [0.0|255.0] "Unitless" ASDM
 SG_ ReSideRdrLe20Obj4RdrObjCntr : 15|4@0+ (1.0,0.0) [0.0|15.0] "Unitless" ASDM
 SG_ ReSideRdrLe20Obj4RdrObjCoastCnt : 158|5@0+ (1.0,0.0) [0.0|31.0] "Unitless" ASDM
 SG_ ReSideRdrLe20Obj4RdrObjConf : 11|4@0+ (7.0,0.0) [0.0|105.0] "%" ASDM
 SG_ ReSideRdrLe20Obj4RdrObjDx : 207|13@0+ (0.05,-200.0) [-200.0|200.0] "m" ASDM
 SG_ ReSideRdrLe20Obj4RdrObjDxStdDe : 71|8@0+ (0.05,0.0) [0.0|12.700000000000001] "m" ASDM
 SG_ ReSideRdrLe20Obj4RdrObjDy : 295|13@0+ (0.05,-200.0) [-200.0|200.0] "m" ASDM
 SG_ ReSideRdrLe20Obj4RdrObjDyStdDe : 167|8@0+ (0.05,0.0) [0.0|12.700000000000001] "m" ASDM
 SG_ ReSideRdrLe20Obj4RdrObjElevnConf : 43|4@0+ (7.0,0.0) [0.0|105.0] "%" ASDM
 SG_ ReSideRdrLe20Obj4RdrObjElevnSts : 153|2@0+ (1,0) [0|3] "" ASDM
 SG_ ReSideRdrLe20Obj4RdrObjID : 223|8@0+ (1.0,0.0) [0.0|255.0] "Unitless" ASDM
 SG_ ReSideRdrLe20Obj4RdrObjIsInFreeSpace : 280|1@0+ (1,0) [0|1] "" ASDM
 SG_ ReSideRdrLe20Obj4RdrObjMirrProblty : 263|4@0+ (7.0,0.0) [0.0|105.0] "%" ASDM
 SG_ ReSideRdrLe20Obj4RdrObjMtnPat : 210|3@0+ (1,0) [0|7] "" ASDM
 SG_ ReSideRdrLe20Obj4RdrObjNotRealProblty : 259|4@0+ (7.0,0.0) [0.0|105.0] "%" ASDM
 SG_ ReSideRdrLe20Obj4RdrObjStatyCnt : 30|7@0+ (1.0,0.0) [0.0|127.0] "Unitless" ASDM
 SG_ ReSideRdrLe20Obj4RdrObjTiAlv : 118|7@0+ (1.0,0.0) [0.0|127.0] "Unitless" ASDM
 SG_ ReSideRdrLe20Obj4RdrObjTrackSts : 177|2@0+ (1,0) [0|3] "" ASDM
 SG_ ReSideRdrLe20Obj4RdrObjTyp : 235|4@0+ (1,0) [0|15] "" ASDM
 SG_ ReSideRdrLe20Obj4RdrObjTypConfBike : 251|4@0+ (7.0,0.0) [0.0|105.0] "%" ASDM
 SG_ ReSideRdrLe20Obj4RdrObjTypConfPed : 271|4@0+ (7.0,0.0) [0.0|105.0] "%" ASDM
 SG_ ReSideRdrLe20Obj4RdrObjTypConfVeh : 267|4@0+ (7.0,0.0) [0.0|105.0] "%" ASDM
 SG_ ReSideRdrLe20Obj4RdrObjUsedTracker : 193|2@0+ (1,0) [0|3] "" ASDM
 SG_ ReSideRdrLe20Obj4RdrObjVx : 175|14@0+ (0.02,-128.0) [-128.0|128.0] "m/s" ASDM
 SG_ ReSideRdrLe20Obj4RdrObjVxStdDe : 141|6@0+ (0.05,0.0) [0.0|2.0] "m/s" ASDM
 SG_ ReSideRdrLe20Obj4RdrObjVy : 191|14@0+ (0.02,-128.0) [-128.0|128.0] "m/s" ASDM
 SG_ ReSideRdrLe20Obj4RdrObjVyStdDe : 286|6@0+ (0.05,0.0) [0.0|2.0] "m/s" ASDM
 SG_ ReSideRdrLe20Obj4RelVx : 231|12@0+ (0.02,-35.6) [-35.6|35.6] "m/s" ASDM
 SG_ ReSideRdrLe20Obj4RelVy : 247|12@0+ (0.02,-35.6) [-35.6|35.6] "m/s" ASDM

BO_ 1029 SODLPrivateCANFD5Fr05 : 64 SODL
 SG_ ReSideRdrLe20Obj5_UB : 298|1@0+ (1,0) [0|1] "" ASDM
 SG_ ReSideRdrLe20Obj5Heading : 39|12@0+ (0.1,-180.0) [-180.0|180.0] "Deg" ASDM
 SG_ ReSideRdrLe20Obj5ObjBoxCenterLat : 111|9@0+ (0.1,-25.0) [-25.0|25.0] "m" ASDM
 SG_ ReSideRdrLe20Obj5ObjBoxCenterLgt : 23|9@0+ (0.1,-25.0) [-25.0|25.0] "m" ASDM
 SG_ ReSideRdrLe20Obj5ObservationHist : 79|32@0+ (1.0,0.0) [0.0|4294967295.0] "Unitless" ASDM
 SG_ ReSideRdrLe20Obj5QualityBits : 127|18@0+ (1.0,0.0) [0.0|262143.0] "Unitless" ASDM
 SG_ ReSideRdrLe20Obj5RdrObjAx : 55|8@0- (0.1,0.0) [-12.8|12.700000000000001] "m/s^2" ASDM
 SG_ ReSideRdrLe20Obj5RdrObjAy : 63|8@0- (0.1,0.0) [-12.8|12.700000000000001] "m/s^2" ASDM
 SG_ ReSideRdrLe20Obj5RdrObjBoxLength : 151|9@0+ (0.1,0.0) [0.0|50.0] "m" ASDM
 SG_ ReSideRdrLe20Obj5RdrObjBoxWidth : 279|9@0+ (0.1,0.0) [0.0|50.0] "m" ASDM
 SG_ ReSideRdrLe20Obj5RdrObjChks : 7|8@0+ (1.0,0.0) [0.0|255.0] "Unitless" ASDM
 SG_ ReSideRdrLe20Obj5RdrObjCntr : 15|4@0+ (1.0,0.0) [0.0|15.0] "Unitless" ASDM
 SG_ ReSideRdrLe20Obj5RdrObjCoastCnt : 158|5@0+ (1.0,0.0) [0.0|31.0] "Unitless" ASDM
 SG_ ReSideRdrLe20Obj5RdrObjConf : 11|4@0+ (7.0,0.0) [0.0|105.0] "%" ASDM
 SG_ ReSideRdrLe20Obj5RdrObjDx : 207|13@0+ (0.05,-200.0) [-200.0|200.0] "m" ASDM
 SG_ ReSideRdrLe20Obj5RdrObjDxStdDe : 71|8@0+ (0.05,0.0) [0.0|12.700000000000001] "m" ASDM
 SG_ ReSideRdrLe20Obj5RdrObjDy : 295|13@0+ (0.05,-200.0) [-200.0|200.0] "m" ASDM
 SG_ ReSideRdrLe20Obj5RdrObjDyStdDe : 167|8@0+ (0.05,0.0) [0.0|12.700000000000001] "m" ASDM
 SG_ ReSideRdrLe20Obj5RdrObjElevnConf : 43|4@0+ (7.0,0.0) [0.0|105.0] "%" ASDM
 SG_ ReSideRdrLe20Obj5RdrObjElevnSts : 153|2@0+ (1,0) [0|3] "" ASDM
 SG_ ReSideRdrLe20Obj5RdrObjID : 223|8@0+ (1.0,0.0) [0.0|255.0] "Unitless" ASDM
 SG_ ReSideRdrLe20Obj5RdrObjIsInFreeSpace : 280|1@0+ (1,0) [0|1] "" ASDM
 SG_ ReSideRdrLe20Obj5RdrObjMirrProblty : 263|4@0+ (7.0,0.0) [0.0|105.0] "%" ASDM
 SG_ ReSideRdrLe20Obj5RdrObjMtnPat : 210|3@0+ (1,0) [0|7] "" ASDM
 SG_ ReSideRdrLe20Obj5RdrObjNotRealProblty : 259|4@0+ (7.0,0.0) [0.0|105.0] "%" ASDM
 SG_ ReSideRdrLe20Obj5RdrObjStatyCnt : 30|7@0+ (1.0,0.0) [0.0|127.0] "Unitless" ASDM
 SG_ ReSideRdrLe20Obj5RdrObjTiAlv : 118|7@0+ (1.0,0.0) [0.0|127.0] "Unitless" ASDM
 SG_ ReSideRdrLe20Obj5RdrObjTrackSts : 177|2@0+ (1,0) [0|3] "" ASDM
 SG_ ReSideRdrLe20Obj5RdrObjTyp : 235|4@0+ (1,0) [0|15] "" ASDM
 SG_ ReSideRdrLe20Obj5RdrObjTypConfBike : 251|4@0+ (7.0,0.0) [0.0|105.0] "%" ASDM
 SG_ ReSideRdrLe20Obj5RdrObjTypConfPed : 271|4@0+ (7.0,0.0) [0.0|105.0] "%" ASDM
 SG_ ReSideRdrLe20Obj5RdrObjTypConfVeh : 267|4@0+ (7.0,0.0) [0.0|105.0] "%" ASDM
 SG_ ReSideRdrLe20Obj5RdrObjUsedTracker : 193|2@0+ (1,0) [0|3] "" ASDM
 SG_ ReSideRdrLe20Obj5RdrObjVx : 175|14@0+ (0.02,-128.0) [-128.0|128.0] "m/s" ASDM
 SG_ ReSideRdrLe20Obj5RdrObjVxStdDe : 141|6@0+ (0.05,0.0) [0.0|2.0] "m/s" ASDM
 SG_ ReSideRdrLe20Obj5RdrObjVy : 191|14@0+ (0.02,-128.0) [-128.0|128.0] "m/s" ASDM
 SG_ ReSideRdrLe20Obj5RdrObjVyStdDe : 286|6@0+ (0.05,0.0) [0.0|2.0] "m/s" ASDM
 SG_ ReSideRdrLe20Obj5RelVx : 231|12@0+ (0.02,-35.6) [-35.6|35.6] "m/s" ASDM
 SG_ ReSideRdrLe20Obj5RelVy : 247|12@0+ (0.02,-35.6) [-35.6|35.6] "m/s" ASDM

BO_ 1030 SODLPrivateCANFD5Fr06 : 64 SODL
 SG_ ReSideRdrLe20Obj6_UB : 298|1@0+ (1,0) [0|1] "" ASDM
 SG_ ReSideRdrLe20Obj6Heading : 39|12@0+ (0.1,-180.0) [-180.0|180.0] "Deg" ASDM
 SG_ ReSideRdrLe20Obj6ObjBoxCenterLat : 111|9@0+ (0.1,-25.0) [-25.0|25.0] "m" ASDM
 SG_ ReSideRdrLe20Obj6ObjBoxCenterLgt : 23|9@0+ (0.1,-25.0) [-25.0|25.0] "m" ASDM
 SG_ ReSideRdrLe20Obj6ObservationHist : 79|32@0+ (1.0,0.0) [0.0|4294967295.0] "Unitless" ASDM
 SG_ ReSideRdrLe20Obj6QualityBits : 127|18@0+ (1.0,0.0) [0.0|262143.0] "Unitless" ASDM
 SG_ ReSideRdrLe20Obj6RdrObjAx : 55|8@0- (0.1,0.0) [-12.8|12.700000000000001] "m/s^2" ASDM
 SG_ ReSideRdrLe20Obj6RdrObjAy : 63|8@0- (0.1,0.0) [-12.8|12.700000000000001] "m/s^2" ASDM
 SG_ ReSideRdrLe20Obj6RdrObjBoxLength : 151|9@0+ (0.1,0.0) [0.0|50.0] "m" ASDM
 SG_ ReSideRdrLe20Obj6RdrObjBoxWidth : 279|9@0+ (0.1,0.0) [0.0|50.0] "m" ASDM
 SG_ ReSideRdrLe20Obj6RdrObjChks : 7|8@0+ (1.0,0.0) [0.0|255.0] "Unitless" ASDM
 SG_ ReSideRdrLe20Obj6RdrObjCntr : 15|4@0+ (1.0,0.0) [0.0|15.0] "Unitless" ASDM
 SG_ ReSideRdrLe20Obj6RdrObjCoastCnt : 158|5@0+ (1.0,0.0) [0.0|31.0] "Unitless" ASDM
 SG_ ReSideRdrLe20Obj6RdrObjConf : 11|4@0+ (7.0,0.0) [0.0|105.0] "%" ASDM
 SG_ ReSideRdrLe20Obj6RdrObjDx : 207|13@0+ (0.05,-200.0) [-200.0|200.0] "m" ASDM
 SG_ ReSideRdrLe20Obj6RdrObjDxStdDe : 71|8@0+ (0.05,0.0) [0.0|12.700000000000001] "m" ASDM
 SG_ ReSideRdrLe20Obj6RdrObjDy : 295|13@0+ (0.05,-200.0) [-200.0|200.0] "m" ASDM
 SG_ ReSideRdrLe20Obj6RdrObjDyStdDe : 167|8@0+ (0.05,0.0) [0.0|12.700000000000001] "m" ASDM
 SG_ ReSideRdrLe20Obj6RdrObjElevnConf : 43|4@0+ (7.0,0.0) [0.0|105.0] "%" ASDM
 SG_ ReSideRdrLe20Obj6RdrObjElevnSts : 153|2@0+ (1,0) [0|3] "" ASDM
 SG_ ReSideRdrLe20Obj6RdrObjID : 223|8@0+ (1.0,0.0) [0.0|255.0] "Unitless" ASDM
 SG_ ReSideRdrLe20Obj6RdrObjIsInFreeSpace : 280|1@0+ (1,0) [0|1] "" ASDM
 SG_ ReSideRdrLe20Obj6RdrObjMirrProblty : 263|4@0+ (7.0,0.0) [0.0|105.0] "%" ASDM
 SG_ ReSideRdrLe20Obj6RdrObjMtnPat : 210|3@0+ (1,0) [0|7] "" ASDM
 SG_ ReSideRdrLe20Obj6RdrObjNotRealProblty : 259|4@0+ (7.0,0.0) [0.0|105.0] "%" ASDM
 SG_ ReSideRdrLe20Obj6RdrObjStatyCnt : 30|7@0+ (1.0,0.0) [0.0|127.0] "Unitless" ASDM
 SG_ ReSideRdrLe20Obj6RdrObjTiAlv : 118|7@0+ (1.0,0.0) [0.0|127.0] "Unitless" ASDM
 SG_ ReSideRdrLe20Obj6RdrObjTrackSts : 177|2@0+ (1,0) [0|3] "" ASDM
 SG_ ReSideRdrLe20Obj6RdrObjTyp : 235|4@0+ (1,0) [0|15] "" ASDM
 SG_ ReSideRdrLe20Obj6RdrObjTypConfBike : 251|4@0+ (7.0,0.0) [0.0|105.0] "%" ASDM
 SG_ ReSideRdrLe20Obj6RdrObjTypConfPed : 271|4@0+ (7.0,0.0) [0.0|105.0] "%" ASDM
 SG_ ReSideRdrLe20Obj6RdrObjTypConfVeh : 267|4@0+ (7.0,0.0) [0.0|105.0] "%" ASDM
 SG_ ReSideRdrLe20Obj6RdrObjUsedTracker : 193|2@0+ (1,0) [0|3] "" ASDM
 SG_ ReSideRdrLe20Obj6RdrObjVx : 175|14@0+ (0.02,-128.0) [-128.0|128.0] "m/s" ASDM
 SG_ ReSideRdrLe20Obj6RdrObjVxStdDe : 141|6@0+ (0.05,0.0) [0.0|2.0] "m/s" ASDM
 SG_ ReSideRdrLe20Obj6RdrObjVy : 191|14@0+ (0.02,-128.0) [-128.0|128.0] "m/s" ASDM
 SG_ ReSideRdrLe20Obj6RdrObjVyStdDe : 286|6@0+ (0.05,0.0) [0.0|2.0] "m/s" ASDM
 SG_ ReSideRdrLe20Obj6RelVx : 231|12@0+ (0.02,-35.6) [-35.6|35.6] "m/s" ASDM
 SG_ ReSideRdrLe20Obj6RelVy : 247|12@0+ (0.02,-35.6) [-35.6|35.6] "m/s" ASDM

BO_ 1031 SODLPrivateCANFD5Fr07 : 64 SODL
 SG_ ReSideRdrLe20Obj7_UB : 298|1@0+ (1,0) [0|1] "" ASDM
 SG_ ReSideRdrLe20Obj7Heading : 39|12@0+ (0.1,-180.0) [-180.0|180.0] "Deg" ASDM
 SG_ ReSideRdrLe20Obj7ObjBoxCenterLat : 111|9@0+ (0.1,-25.0) [-25.0|25.0] "m" ASDM
 SG_ ReSideRdrLe20Obj7ObjBoxCenterLgt : 23|9@0+ (0.1,-25.0) [-25.0|25.0] "m" ASDM
 SG_ ReSideRdrLe20Obj7ObservationHist : 79|32@0+ (1.0,0.0) [0.0|4294967295.0] "Unitless" ASDM
 SG_ ReSideRdrLe20Obj7QualityBits : 127|18@0+ (1.0,0.0) [0.0|262143.0] "Unitless" ASDM
 SG_ ReSideRdrLe20Obj7RdrObjAx : 55|8@0- (0.1,0.0) [-12.8|12.700000000000001] "m/s^2" ASDM
 SG_ ReSideRdrLe20Obj7RdrObjAy : 63|8@0- (0.1,0.0) [-12.8|12.700000000000001] "m/s^2" ASDM
 SG_ ReSideRdrLe20Obj7RdrObjBoxLength : 151|9@0+ (0.1,0.0) [0.0|50.0] "m" ASDM
 SG_ ReSideRdrLe20Obj7RdrObjBoxWidth : 279|9@0+ (0.1,0.0) [0.0|50.0] "m" ASDM
 SG_ ReSideRdrLe20Obj7RdrObjChks : 7|8@0+ (1.0,0.0) [0.0|255.0] "Unitless" ASDM
 SG_ ReSideRdrLe20Obj7RdrObjCntr : 15|4@0+ (1.0,0.0) [0.0|15.0] "Unitless" ASDM
 SG_ ReSideRdrLe20Obj7RdrObjCoastCnt : 158|5@0+ (1.0,0.0) [0.0|31.0] "Unitless" ASDM
 SG_ ReSideRdrLe20Obj7RdrObjConf : 11|4@0+ (7.0,0.0) [0.0|105.0] "%" ASDM
 SG_ ReSideRdrLe20Obj7RdrObjDx : 207|13@0+ (0.05,-200.0) [-200.0|200.0] "m" ASDM
 SG_ ReSideRdrLe20Obj7RdrObjDxStdDe : 71|8@0+ (0.05,0.0) [0.0|12.700000000000001] "m" ASDM
 SG_ ReSideRdrLe20Obj7RdrObjDy : 295|13@0+ (0.05,-200.0) [-200.0|200.0] "m" ASDM
 SG_ ReSideRdrLe20Obj7RdrObjDyStdDe : 167|8@0+ (0.05,0.0) [0.0|12.700000000000001] "m" ASDM
 SG_ ReSideRdrLe20Obj7RdrObjElevnConf : 43|4@0+ (7.0,0.0) [0.0|105.0] "%" ASDM
 SG_ ReSideRdrLe20Obj7RdrObjElevnSts : 153|2@0+ (1,0) [0|3] "" ASDM
 SG_ ReSideRdrLe20Obj7RdrObjID : 223|8@0+ (1.0,0.0) [0.0|255.0] "Unitless" ASDM
 SG_ ReSideRdrLe20Obj7RdrObjIsInFreeSpace : 280|1@0+ (1,0) [0|1] "" ASDM
 SG_ ReSideRdrLe20Obj7RdrObjMirrProblty : 263|4@0+ (7.0,0.0) [0.0|105.0] "%" ASDM
 SG_ ReSideRdrLe20Obj7RdrObjMtnPat : 210|3@0+ (1,0) [0|7] "" ASDM
 SG_ ReSideRdrLe20Obj7RdrObjNotRealProblty : 259|4@0+ (7.0,0.0) [0.0|105.0] "%" ASDM
 SG_ ReSideRdrLe20Obj7RdrObjStatyCnt : 30|7@0+ (1.0,0.0) [0.0|127.0] "Unitless" ASDM
 SG_ ReSideRdrLe20Obj7RdrObjTiAlv : 118|7@0+ (1.0,0.0) [0.0|127.0] "Unitless" ASDM
 SG_ ReSideRdrLe20Obj7RdrObjTrackSts : 177|2@0+ (1,0) [0|3] "" ASDM
 SG_ ReSideRdrLe20Obj7RdrObjTyp : 235|4@0+ (1,0) [0|15] "" ASDM
 SG_ ReSideRdrLe20Obj7RdrObjTypConfBike : 251|4@0+ (7.0,0.0) [0.0|105.0] "%" ASDM
 SG_ ReSideRdrLe20Obj7RdrObjTypConfPed : 271|4@0+ (7.0,0.0) [0.0|105.0] "%" ASDM
 SG_ ReSideRdrLe20Obj7RdrObjTypConfVeh : 267|4@0+ (7.0,0.0) [0.0|105.0] "%" ASDM
 SG_ ReSideRdrLe20Obj7RdrObjUsedTracker : 193|2@0+ (1,0) [0|3] "" ASDM
 SG_ ReSideRdrLe20Obj7RdrObjVx : 175|14@0+ (0.02,-128.0) [-128.0|128.0] "m/s" ASDM
 SG_ ReSideRdrLe20Obj7RdrObjVxStdDe : 141|6@0+ (0.05,0.0) [0.0|2.0] "m/s" ASDM
 SG_ ReSideRdrLe20Obj7RdrObjVy : 191|14@0+ (0.02,-128.0) [-128.0|128.0] "m/s" ASDM
 SG_ ReSideRdrLe20Obj7RdrObjVyStdDe : 286|6@0+ (0.05,0.0) [0.0|2.0] "m/s" ASDM
 SG_ ReSideRdrLe20Obj7RelVx : 231|12@0+ (0.02,-35.6) [-35.6|35.6] "m/s" ASDM
 SG_ ReSideRdrLe20Obj7RelVy : 247|12@0+ (0.02,-35.6) [-35.6|35.6] "m/s" ASDM

// Signal Comments
CM_ SG_ 325 AsySftyEnaDecelAckd "Acknowledged signal from receiver for Brake gain enable signal. Acknowledged signal from receiver for enable signal for deceleration in safety critical situation.";
CM_ SG_ 325 RainfallAmnt "The signal describe the amount of rain falling";
CM_ SG_ 325 StandStillMgrStsForHld1 "Brake systen hold status";
CM_ SG_ 325 StandStillMgrStsForHldChks "chks";
CM_ SG_ 325 StandStillMgrStsForHldCntr "cntr";
CM_ SG_ 325 SteerWhlSnsrAg "Actual steering wheel angle from the actual centre position of the steering wheel. ";
CM_ SG_ 325 SteerWhlSnsrAgSpd "Actual steering wheel angle from the actual centre position of the steering wheel. Steering angle speed with steering wheel rotation direction.  ";
CM_ SG_ 325 SteerWhlSnsrChks "Checksum for steering wheel sensor data.";
CM_ SG_ 325 SteerWhlSnsrCntr "Counter value for steering wheel sensor data.";
CM_ SG_ 325 SteerWhlSnsrQf "Qf for steering wheel sensor information";
CM_ SG_ 325 TiAndDateIndcnDataValid "Current time (Hr, Min and Sec) and date (Year, Months and days) data for indication. See requirement for more information about the signals. Signal qualifier, No means values should be ignored.";
CM_ SG_ 325 TiAndDateIndcnDay "Current time (Hr, Min and Sec) and date (Year, Months and days) data for indication. See requirement for more information about the signals. Day";
CM_ SG_ 325 TiAndDateIndcnHr1 "Current time (Hr, Min and Sec) and date (Year, Months and days) data for indication. See requirement for more information about the signals. Hour";
CM_ SG_ 325 TiAndDateIndcnMins1 "Current time (Hr, Min and Sec) and date (Year, Months and days) data for indication. See requirement for more information about the signals. Minutes";
CM_ SG_ 325 TiAndDateIndcnMth1 "Current time (Hr, Min and Sec) and date (Year, Months and days) data for indication. See requirement for more information about the signals. Month, 1-12";
CM_ SG_ 325 TiAndDateIndcnSec1 "Current time (Hr, Min and Sec) and date (Year, Months and days) data for indication. See requirement for more information about the signals. Seconds";
CM_ SG_ 325 TiAndDateIndcnYr1 "Current time (Hr, Min and Sec) and date (Year, Months and days) data for indication. See requirement for more information about the signals. Year, 0-99";
CM_ SG_ 325 VehSpdLgtA "Vehicle speed longitudinal based on wheel speed sensors and longitudinal acceleration.";
CM_ SG_ 325 VehSpdLgtChks "Checksum";
CM_ SG_ 325 VehSpdLgtCntr "Counter";
CM_ SG_ 325 VehSpdLgtQf "Quality factor for vehicle speed as measured by wheel speed sensors and longitudinal acceleration.";
CM_ SG_ 337 BrkPedlTrvlAct "Information about driver brake request derived from the travel sensor in the brake booster. Actual value for the output rod";
CM_ SG_ 337 BrkPedlTrvlChks "Information about driver brake request derived from the travel sensor in the brake booster. Checksum";
CM_ SG_ 337 BrkPedlTrvlCntr "Information about driver brake request derived from the travel sensor in the brake booster. Counter";
CM_ SG_ 337 BrkPedlTrvlQf "Information about driver brake request derived from the travel sensor in the brake booster. Travel sensor quality factor";
CM_ SG_ 337 BrkPedlTrvlSt "Information about driver brake request derived from the travel sensor in the brake booster. Brake pedal applied information";
CM_ SG_ 337 BrkPedlTrvlStQf "Information about driver brake request derived from the travel sensor in the brake booster. Brake pedal applied information quality factor";
CM_ SG_ 337 BrkPedlTrvlTar "Information about driver brake request derived from the travel sensor in the brake booster. Target value for the output rod";
CM_ SG_ 337 BrkTracCtrlActv "Indicates InCtrl if brake traction control (TC) is active on at least one wheel.";
CM_ SG_ 337 WhlDirRotlFrntForBkpChks "check sum";
CM_ SG_ 337 WhlDirRotlFrntForBkpCntr "counter";
CM_ SG_ 337 WhlDirRotlFrntForBkpLe "Rotational direction for the front individual wheels. Wheel rotation direction of front left wheel.";
CM_ SG_ 337 WhlDirRotlFrntForBkpRi "Rotational direction for the front individual wheels. Wheel rotation direction of front right wheel.";
CM_ SG_ 337 WhlDirRotlReForBkpChks "checksum";
CM_ SG_ 337 WhlDirRotlReForBkpCntr "counter";
CM_ SG_ 337 WhlDirRotlReForBkpLe "Rotational direction for the rear individual wheels. Wheel rotation direction of rear left wheel.";
CM_ SG_ 337 WhlDirRotlReForBkpRi "Rotational direction for the rear individual wheels. Wheel rotation direction of rear right wheel.";
CM_ SG_ 337 WhlSpdCircumlFrntForBkpWhlSpdCircumlFrntChks "Individual wheel speed from front wheel speed sensors. Checksum";
CM_ SG_ 337 WhlSpdCircumlFrntForBkpWhlSpdCircumlFrntCntr "Individual wheel speed from front wheel speed sensors. Counter";
CM_ SG_ 337 WhlSpdCircumlFrntForBkpWhlSpdCircumlFrntLe "Individual wheel speed from front wheel speed sensors. Wheel speed from front left wheel speed sensor using nominal value of wheel radius.";
CM_ SG_ 337 WhlSpdCircumlFrntForBkpWhlSpdCircumlFrntLeQf "Individual wheel speed from front wheel speed sensors. Qf for wheel speed sensor";
CM_ SG_ 337 WhlSpdCircumlFrntForBkpWhlSpdCircumlFrntRiQf "Individual wheel speed from front wheel speed sensors. Qf for wheel speed sensor";
CM_ SG_ 337 WhlSpdCircumlFrntForBkpWhlSpdCircumlFrntWhlSpdCircumlFrntRi "Individual wheel speed from front wheel speed sensors. Wheel speed from front right wheel speed sensor using nominal value of wheel radius
";
CM_ SG_ 337 WhlSpdCircumlReForBkpWhlSpdCircumlReChks "Individual wheel speed from rear wheel speed sensors. Checksum";
CM_ SG_ 337 WhlSpdCircumlReForBkpWhlSpdCircumlReCntr "Individual wheel speed from rear wheel speed sensors. Counter";
CM_ SG_ 337 WhlSpdCircumlReForBkpWhlSpdCircumlReLe "Individual wheel speed from rear wheel speed sensors. Wheel speed from rear left wheel speed sensor using nominal value of wheel radius.";
CM_ SG_ 337 WhlSpdCircumlReForBkpWhlSpdCircumlReLeQf "Individual wheel speed from rear wheel speed sensors. Qf for wheel speed sensor";
CM_ SG_ 337 WhlSpdCircumlReForBkpWhlSpdCircumlReRi "Individual wheel speed from rear wheel speed sensors. Wheel speed from rear right wheel speed sensor using nominal value of wheel radius.";
CM_ SG_ 337 WhlSpdCircumlReForBkpWhlSpdCircumlReRiQf "Individual wheel speed from rear wheel speed sensors. Qf for wheel speed sensor";
CM_ SG_ 357 AbsCtrlActvChks "checksum";
CM_ SG_ 357 AbsCtrlActvCntr "counter";
CM_ SG_ 357 AbsCtrlActvCtrlSts1 "Anti Blocking Systems (ABS) control is active (at least one wheel)
0 = No wheel is in Anti Blocking Systems (ABS) control
1 = At least one wheel is in Anti Blocking Systems (ABS) control";
CM_ SG_ 357 ALgtStdFromWhlSpdALgtStdFromWhlSpd "Longitudinal acceleration over ground.
end2endprotection=profile1A dataid= 12345 Longitudinal acceleration over ground";
CM_ SG_ 357 ALgtStdFromWhlSpdChks "Longitudinal acceleration over ground.
end2endprotection=profile1A dataid=12345 Checksum for longitudinal acceleration over ground";
CM_ SG_ 357 ALgtStdFromWhlSpdCntr "Longitudinal acceleration over ground.
end2endprotection=profile1A dataid=12345 Counter for longitudinal acceleration over ground";
CM_ SG_ 357 ALgtStdFromWhlSpdQf "Longitudinal acceleration over ground.
end2endprotection=profile1A dataid=12345 Qf for longitudinal acceleration over ground";
CM_ SG_ 357 AsyDataWithCmpSafeALat1Qf "IMU processed special data. Quality factor for Lateral acceleration signal";
CM_ SG_ 357 AsyDataWithCmpSafeALatWithCmp "IMU processed special data.  Compensated Lateral acceleration";
CM_ SG_ 357 AsyDataWithCmpSafeALgt1Qf "IMU processed special data. Quality factor for Longitudinal acceleration";
CM_ SG_ 357 AsyDataWithCmpSafeChks "IMU processed special data. Check sum";
CM_ SG_ 357 AsyDataWithCmpSafeCntr "IMU processed special data. Counter";
CM_ SG_ 357 AsyDataWithCmpSafeGrdtOfALgt "IMU processed special data. Derivative of Longitudinal acceleration";
CM_ SG_ 357 AsyDataWithCmpSafeYawRateQf "IMU processed special data. Quality Factor for Yaw Rate";
CM_ SG_ 357 AsyDataWithCmpSafeYawRateWithCmp "IMU processed special data. Compensated Yaw rate";
CM_ SG_ 357 BrkSysCylPMstAct "Brake system master cylinder pressure information Actual pressure, raw value";
CM_ SG_ 357 BrkSysCylPMstActQf "Brake system master cylinder pressure information Actual pressure quality factor";
CM_ SG_ 357 BrkSysCylPMstChks "Brake system master cylinder pressure information Checksum";
CM_ SG_ 357 BrkSysCylPMstCntr "Brake system master cylinder pressure information Counter";
CM_ SG_ 357 BrkSysCylPMstTar "Brake system master cylinder pressure information Target pressure";
CM_ SG_ 357 BrkSysCylPMstVirt "Brake system master cylinder pressure information Virtual pressure";
CM_ SG_ 357 BrkSysCylPMstVirtQf "Brake system master cylinder pressure information Virtual pressure quality factor";
CM_ SG_ 357 EpbStsChks "Electrical Park Brake system status information Status for the rear wheel park actuator";
CM_ SG_ 357 EpbStsCntr "Electrical Park Brake system status information Counter for EPB status";
CM_ SG_ 357 EpbStsEpbSts "Electrical Park Brake system status information Status for the rear wheel park actuator";
CM_ SG_ 357 EscCtrlIndcn "Indicates that an Electronic stability control (ESC) controller is active";
CM_ SG_ 357 EscStChks "Information on activation/ deactivation of Electronic Stability Control (ESC) Checksum for Esc state";
CM_ SG_ 357 EscStCntr "Information on activation/ deactivation of Electronic Stability Control (ESC) Counter for Esc state";
CM_ SG_ 357 EscStEscSt "Information on activation/ deactivation of Electronic Stability Control (ESC) Esc state information for Esc ON, Esc OFF or Esc Sport";
CM_ SG_ 357 PinionSteerAgGroupChks "Checksum for PinionSteerAgGroup";
CM_ SG_ 357 PinionSteerAgGroupCntr "Counter for PinionSteerAgGroup";
CM_ SG_ 357 PinionSteerAgGroupPinionSteerAg1 "Calculated pinion steer angle at the front steering device";
CM_ SG_ 357 PinionSteerAgGroupPinionSteerAg1Qf "Quality factor for PinionSteerAg1";
CM_ SG_ 357 PinionSteerAgGroupPinionSteerAgSpd1 "Calculated pinion steer angle speed at the front steering device ";
CM_ SG_ 357 PinionSteerAgGroupPinionSteerAgSpd1Qf "Quality factor for PinionSteerAgSpd1";
CM_ SG_ 357 PinionSteerAgGroupSteerWhlTq "Torque on steering wheel";
CM_ SG_ 357 PinionSteerAgGroupSteerWhlTqQf "Quality factor for SteerWhlTq";
CM_ SG_ 357 VehModMngtGlbSafe1CarModSts1 "CarMode Status";
CM_ SG_ 357 VehModMngtGlbSafe1CarModSubtypWdCarModSubtyp "CarMode substate status";
CM_ SG_ 357 VehModMngtGlbSafe1Chks "Checksum";
CM_ SG_ 357 VehModMngtGlbSafe1Cntr "Counter";
CM_ SG_ 357 VehModMngtGlbSafe1EgyLvlElecMai "Main energy level in the vehicle.";
CM_ SG_ 357 VehModMngtGlbSafe1EgyLvlElecSubtyp "Substate of the energy level in the vehicle.";
CM_ SG_ 357 VehModMngtGlbSafe1FltEgyCnsWdSts "High quiescent current detected by CEM via BMS.";
CM_ SG_ 357 VehModMngtGlbSafe1PwrLvlElecMai "Main Power level in the vehicle.";
CM_ SG_ 357 VehModMngtGlbSafe1PwrLvlElecSubtyp "Substate of the power level in the vehicle.";
CM_ SG_ 357 VehModMngtGlbSafe1UsgModSts "UsageMode Status";
CM_ SG_ 357 VehMtnStChks "Vehicle motion state information based on wheel speed sensors. Provides information about vehicle stand still and vehicle rolling direction. Checksum for vehicle motion state";
CM_ SG_ 357 VehMtnStCntr "Vehicle motion state information based on wheel speed sensors. Provides information about vehicle stand still and vehicle rolling direction. Counter for vehicle motion state";
CM_ SG_ 357 VehMtnStVehMtnSt "Vehicle motion state information based on wheel speed sensors. Provides information about vehicle stand still and vehicle rolling direction. Vehicle motion state";
CM_ SG_ 357 WhlDirRotlFrntChks "check sum";
CM_ SG_ 357 WhlDirRotlFrntCntr "counter";
CM_ SG_ 357 WhlDirRotlFrntLe "Rotational direction for the front individual wheels. Wheel rotation direction of front left wheel.";
CM_ SG_ 357 WhlDirRotlFrntRi "Rotational direction for the front individual wheels. Wheel rotation direction of front right wheel.";
CM_ SG_ 357 WhlDirRotlReChks "checksum";
CM_ SG_ 357 WhlDirRotlReCntr "counter";
CM_ SG_ 357 WhlDirRotlReLe "Rotational direction for the rear individual wheels. Wheel rotation direction of rear left wheel.";
CM_ SG_ 357 WhlDirRotlReRi "Rotational direction for the rear individual wheels. Wheel rotation direction of rear right wheel.";
CM_ SG_ 357 WhlSpdCircumlFrntChks "Individual wheel speed from front wheel speed sensors. Checksum";
CM_ SG_ 357 WhlSpdCircumlFrntCntr "Individual wheel speed from front wheel speed sensors. Counter";
CM_ SG_ 357 WhlSpdCircumlFrntLe "Individual wheel speed from front wheel speed sensors. Wheel speed from front left wheel speed sensor using nominal value of wheel radius.";
CM_ SG_ 357 WhlSpdCircumlFrntLeQf "Individual wheel speed from front wheel speed sensors. Qf for wheel speed sensor";
CM_ SG_ 357 WhlSpdCircumlFrntRiQf "Individual wheel speed from front wheel speed sensors. Qf for wheel speed sensor";
CM_ SG_ 357 WhlSpdCircumlFrntWhlSpdCircumlFrntRi "Individual wheel speed from front wheel speed sensors. Wheel speed from front right wheel speed sensor using nominal value of wheel radius";
CM_ SG_ 357 WhlSpdCircumlReChks "Individual wheel speed from rear wheel speed sensors. Checksum";
CM_ SG_ 357 WhlSpdCircumlReCntr "Individual wheel speed from rear wheel speed sensors. Counter";
CM_ SG_ 357 WhlSpdCircumlReLe "Individual wheel speed from rear wheel speed sensors. Wheel speed from rear left wheel speed sensor using nominal value of wheel radius.";
CM_ SG_ 357 WhlSpdCircumlReLeQf "Individual wheel speed from rear wheel speed sensors. Qf for wheel speed sensor";
CM_ SG_ 357 WhlSpdCircumlReRi "Individual wheel speed from rear wheel speed sensors. Wheel speed from rear right wheel speed sensor using nominal value of wheel radius.";
CM_ SG_ 357 WhlSpdCircumlReRiQf "Individual wheel speed from rear wheel speed sensors. Qf for wheel speed sensor";
CM_ SG_ 401 ADataRawSafeALat "IMU acceleration data Lateral acceleration";
CM_ SG_ 401 ADataRawSafeALat1Qf "IMU acceleration data Quality factor for Lateral acceleration signal";
CM_ SG_ 401 ADataRawSafeALgt "IMU acceleration data Longitudinal acceleration";
CM_ SG_ 401 ADataRawSafeALgt1Qf "IMU acceleration data Quality factor for Longitudinal acceleration";
CM_ SG_ 401 ADataRawSafeAVert "IMU acceleration data Vertical acceleration";
CM_ SG_ 401 ADataRawSafeAVertQf "IMU acceleration data Quality factor for Vertical acceleration";
CM_ SG_ 401 ADataRawSafeChks "IMU acceleration data Check sum";
CM_ SG_ 401 ADataRawSafeCntr "IMU acceleration data Counter";
CM_ SG_ 401 AgDataRawSafeChks "IMU angular rate data. Check summa";
CM_ SG_ 401 AgDataRawSafeCntr "IMU angular rate data. Counter";
CM_ SG_ 401 AgDataRawSafeRollRate "IMU angular rate data. Roll Rate";
CM_ SG_ 401 AgDataRawSafeRollRateQf "IMU angular rate data. Quality factor for Roll Rate";
CM_ SG_ 401 AgDataRawSafeYawRate "IMU angular rate data. Yaw Rate";
CM_ SG_ 401 AgDataRawSafeYawRateQf "IMU angular rate data. Quality Factor for Yaw Rate";
CM_ SG_ 401 BltLockStAtDrvrBltLockSt1 "State of belt lock at driver seating position Belt lock state, locked/unlocked";
CM_ SG_ 401 BltLockStAtDrvrBltLockSts "State of belt lock at driver seating position Belt lock status, OK/NOK";
CM_ SG_ 401 GearLvrIndcn "Gear lever indication (drivetrain position) to the driver. If drivetrain position is not possible to decide signal is set to undefined. Valid for automatic vehicles.
";
CM_ SG_ 327 ExtrLtgStsAFS "AFS status";
CM_ SG_ 327 ExtrLtgStsAHBC "AHBC Status";
CM_ SG_ 327 ExtrLtgStsAHL "AHL Status";
CM_ SG_ 327 ExtrLtgStsAllWL "All Weather Light Status";
CM_ SG_ 327 ExtrLtgStsApproach "Approach Light Status";
CM_ SG_ 327 ExtrLtgStsChks "Checksum";
CM_ SG_ 327 ExtrLtgStsCntr "Counter";
CM_ SG_ 327 ExtrLtgStsCornrgLi "Cornering Light Status";
CM_ SG_ 327 ExtrLtgStsDBL "DBL Stataus";
CM_ SG_ 327 ExtrLtgStsDRL "DRL Status";
CM_ SG_ 327 ExtrLtgStsFlash "Flash Light Status";
CM_ SG_ 327 ExtrLtgStsFrntFog "Front Fog Light Status";
CM_ SG_ 327 ExtrLtgStsGoodbye "Good Bye Light Status";
CM_ SG_ 327 ExtrLtgStsHiBeam "Hi Beam Status";
CM_ SG_ 327 ExtrLtgStsHomeSafe "Home Safe Light Status";
CM_ SG_ 327 ExtrLtgStsHWL "HWL Status";
CM_ SG_ 327 ExtrLtgStsLoBeam "Low Beam Status";
CM_ SG_ 327 ExtrLtgStsLtgShow "Light Show Status";
CM_ SG_ 327 ExtrLtgStsPosLiFrnt "Position Light Front Status";
CM_ SG_ 327 ExtrLtgStsPosLiRe "Position Light Rear Status";
CM_ SG_ 327 ExtrLtgStsReFog "Rear Fog Light Status";
CM_ SG_ 327 ExtrLtgStsReverseLi "Reverse Light Status";
CM_ SG_ 327 ExtrLtgStsStopLi "Stop Light Status";
CM_ SG_ 327 ExtrLtgStsTurnIndrLe "Turn Indicator Left Status";
CM_ SG_ 327 ExtrLtgStsTurnIndrRi "Turn Indicator Right Status
";
CM_ SG_ 327 ExtrLtgStsWelcome "Welcome Light Status";
CM_ SG_ 327 VehTiAndDataDataValid "Vehicle time (Hr, Min and Sec) and date (Year, Months and days) data for indication. See requirement for more information about the signals. Signal qualifier, No means values should be ignored.";
CM_ SG_ 327 VehTiAndDataDay "Vehicle time (Hr, Min and Sec) and date (Year, Months and days) data for indication. See requirement for more information about the signals. Day";
CM_ SG_ 327 VehTiAndDataHr1 "Vehicle time (Hr, Min and Sec) and date (Year, Months and days) data for indication. See requirement for more information about the signals. Hour";
CM_ SG_ 327 VehTiAndDataMins1 "Vehicle time (Hr, Min and Sec) and date (Year, Months and days) data for indication. See requirement for more information about the signals. Minutes";
CM_ SG_ 327 VehTiAndDataMth1 "Vehicle time (Hr, Min and Sec) and date (Year, Months and days) data for indication. See requirement for more information about the signals. Month, 1-12";
CM_ SG_ 327 VehTiAndDataSec1 "Vehicle time (Hr, Min and Sec) and date (Year, Months and days) data for indication. See requirement for more information about the signals. Seconds";
CM_ SG_ 327 VehTiAndDataYr1 "Vehicle time (Hr, Min and Sec) and date (Year, Months and days) data for indication. See requirement for more information about the signals. Year, 0-99";
CM_ SG_ 897 AmbTRawAmbTVal "Unfiltered ambient temp raw data in deg C. Ambient temp value";
CM_ SG_ 897 AmbTRawQly "Unfiltered ambient temp raw data in deg C. Quality Factor of the ambient temp";
CM_ SG_ 897 BkpOfDstTrvld "total traveled distance.";
CM_ SG_ 897 CarTiGlb "Presents a tiime value that shall be used by all ECUs to time-stamp diagnsotic trouble codes (DTC) according to the requirements for Global DTC snapshot data.";
CM_ SG_ 897 DrvModReq "drive mode";
CM_ SG_ 897 IndcrDisp "Controls the Direction Indicator tell-tales and sound to the driver.

Signal will be event driven and holds every flank on and off of the telltales/sound.

This signal will not be used for the Hazard Warning Light Button in instrument panel.";
CM_ SG_ 897 LvlgDirMovmtIndcr "This signal is used for indicating the movement direction in the air suspension during its change.";
CM_ SG_ 897 SuspPosnVertLe1WithE2EChks "External CAN signal to inform the right body height (include both front and rear) with ASIL-B leve(A CRC is added)l. Checksum on height information and QF for front and rear.";
CM_ SG_ 897 SuspPosnVertLe1WithE2ECntr "External CAN signal to inform the right body height (include both front and rear) with ASIL-B leve(A CRC is added)l. Rollingcounter on height information and QF for front and rear.";
CM_ SG_ 897 SuspPosnVertLe1WithE2EFrnt "External CAN signal to inform the left body height (include both front and rear) with ASIL-B leve(A CRC is added)l. QF on height information from left front.";
CM_ SG_ 897 SuspPosnVertLe1WithE2EFrntQf "External CAN signal to inform the left body height (include both front and rear) with ASIL-B leve(A CRC is added)l. QF on height information from left front.";
CM_ SG_ 897 SuspPosnVertLe1WithE2ERe "External CAN signal to inform the left body height (include both front and rear) with ASIL-B leve(A CRC is added)l. QF on height information from left rear";
CM_ SG_ 897 SuspPosnVertLe1WithE2EReQf "External CAN signal to inform the left body height (include both front and rear) with ASIL-B leve(A CRC is added)l. QF on height information from left rear";
CM_ SG_ 897 SuspPosnVertRi1WithE2EChks "External CAN signal to inform the right body height (include both front and rear) with ASIL-B leve(A CRC is added)l. Checksum on height information and QF for front and rear.";
CM_ SG_ 897 SuspPosnVertRi1WithE2ECntr "External CAN signal to inform the right body height (include both front and rear) with ASIL-B leve(A CRC is added)l. Rollingcounter on height information and QF for front and rear.";
CM_ SG_ 897 SuspPosnVertRi1WithE2EFrnt "External CAN signal to inform the right body height (include both front and rear) with ASIL-B leve(A CRC is added)l. Height information from right front";
CM_ SG_ 897 SuspPosnVertRi1WithE2EFrntQf "External CAN signal to inform the right body height (include both front and rear) with ASIL-B leve(A CRC is added)l. QF on height information from right front";
CM_ SG_ 897 SuspPosnVertRi1WithE2ERe "External CAN signal to inform the right body height (include both front and rear) with ASIL-B leve(A CRC is added)l. Height information from right rear";
CM_ SG_ 897 SuspPosnVertRi1WithE2EReQf "External CAN signal to inform the right body height (include both front and rear) with ASIL-B leve(A CRC is added)l. QF on height information from right rear";
CM_ SG_ 897 VehBattUSysU "Vehicle System Voltage At 12V side";
CM_ SG_ 897 VehBattUSysUQf "Present vehicle voltage measured by CEM with QF";
CM_ SG_ 897 WipgInfoWipgSpdInfo "Information regarding how the wipers are run";
CM_ SG_ 897 WipgInfoWiprActv " 0 No wiping, 1 Wiping";
CM_ SG_ 897 WipgInfoWiprInWipgAr " 0 Wiper in lower reversing area or parked, 1 Wiper in wiping area";
CM_ SG_ 1007 ReSideRdrLeVehPrmRdrVehPrmChks "CRC";
CM_ SG_ 1007 ReSideRdrLeVehPrmRdrVehPrmCntr "Counter";
CM_ SG_ 1007 ReSideRdrLeVehPrmRdrVehPrmRdrDynCalPrmForAgOffs "Angle offset due to facia effects";
CM_ SG_ 1007 ReSideRdrLeVehPrmRdrVehPrmRdrDynCalPrmForAxleDstReToVehFrnt "Distance from rear axel to vehicle front";
CM_ SG_ 1007 ReSideRdrLeVehPrmRdrVehPrmRdrDynCalPrmForPinoinAgRat "Ration between pinion angle and wheel angle";
CM_ SG_ 1007 ReSideRdrLeVehPrmRdrVehPrmRdrDynCalPrmForRollAgGain "the compliance of the rear corner suspension";
CM_ SG_ 1007 ReSideRdrLeVehPrmRdrVehPrmRdrDynCalPrmForSnsrDir "Sensor direction in relation to the vehicle driving direction";
CM_ SG_ 1007 ReSideRdrLeVehPrmRdrVehPrmRdrDynCalPrmForSnsrOrntn "Direction of Sensor connector point.";
CM_ SG_ 1007 ReSideRdrLeVehPrmRdrVehPrmRdrDynCalPrmForSnsrPosnLat "Sensor lateral position in relation to the vehicle reference point";
CM_ SG_ 1007 ReSideRdrLeVehPrmRdrVehPrmRdrDynCalPrmForSnsrPosnLgt "Sensor longitudinal position in relation to the vehicle reference point";
CM_ SG_ 1007 ReSideRdrLeVehPrmRdrVehPrmRdrDynCalPrmForSnsrPosnVert "Sensor vertical position in relation to ground";
CM_ SG_ 1007 ReSideRdrLeVehPrmRdrVehPrmRdrDynCalPrmForSnsrRot1 "Sensor rotation";
CM_ SG_ 1007 ReSideRdrLeVehPrmRdrVehPrmRdrDynCalPrmForVehLen "Vehicle length";
CM_ SG_ 1007 ReSideRdrLeVehPrmRdrVehPrmRdrDynCalPrmForVehTyp "Vehicle type";
CM_ SG_ 1007 ReSideRdrLeVehPrmRdrVehPrmRdrDynCalPrmForVehWidth "Vehicle width";
CM_ SG_ 1007 ReSideRdrLeVehPrmRdrVehPrmRdrDynCalPrmForVersMajor "Major version for dynamic calibration parameters.";
CM_ SG_ 1007 ReSideRdrLeVehPrmRdrVehPrmRdrDynCalPrmForVersMinor "Minor version for dynamic calibration parameters";
CM_ SG_ 1007 ReSideRdrLeVehPrmRdrVehPrmRdrDynCalPrmForWhlBas "Vehicle wheel base";
CM_ SG_ 1007 ReSideRdrLeVehPrmRdrVehPrmVld "Validity of data, if it is not valid, then set to 0";
CM_ SG_ 2 VinBlockNr "VIN number block counter. ";
CM_ SG_ 2 VinVINSignalPos1 "VIN byte 1. Used for character 1, 8 and 15.";
CM_ SG_ 2 VinVINSignalPos2 "VIN byte 2. Used for character 2, 9 and 16.";
CM_ SG_ 2 VinVINSignalPos3 "VIN byte 3. Used for character 3, 10 and 17.";
CM_ SG_ 2 VinVINSignalPos4 "VIN byte 4. Used for character 4 and 11.";
CM_ SG_ 2 VinVINSignalPos5 "VIN byte 5. Used for character 5 and 12.";
CM_ SG_ 2 VinVINSignalPos6 "VIN byte 6. Used for character 6 and 13.";
CM_ SG_ 2 VinVINSignalPos7 "VIN byte 7. Used for character 7 and 14.";
CM_ SG_ 1025 ReSideRdrLe20Obj1Heading "Refer to the data element description in FrntSideRdrLeObj1 with the same data element name.";
CM_ SG_ 1025 ReSideRdrLe20Obj1ObjBoxCenterLat "Refer to the data element description in FrntSideRdrLeObj1 with the same data element name.";
CM_ SG_ 1025 ReSideRdrLe20Obj1ObjBoxCenterLgt "Refer to the data element description in FrntSideRdrLeObj1 with the same data element name.";
CM_ SG_ 1025 ReSideRdrLe20Obj1ObservationHist "Refer to the data element description in FrntSideRdrLeObj1 with the same data element name.";
CM_ SG_ 1025 ReSideRdrLe20Obj1QualityBits "Refer to the data element description in FrntSideRdrLeObj1 with the same data element name.";
CM_ SG_ 1025 ReSideRdrLe20Obj1RdrObjAx "Refer to the data element description in FrntSideRdrLeObj1 with the same data element name.";
CM_ SG_ 1025 ReSideRdrLe20Obj1RdrObjAy "Refer to the data element description in FrntSideRdrLeObj1 with the same data element name.";
CM_ SG_ 1025 ReSideRdrLe20Obj1RdrObjBoxLength "Refer to the data element description in FrntSideRdrLeObj1 with the same data element name.";
CM_ SG_ 1025 ReSideRdrLe20Obj1RdrObjBoxWidth "Refer to the data element description in FrntSideRdrLeObj1 with the same data element name.";
CM_ SG_ 1025 ReSideRdrLe20Obj1RdrObjChks "Refer to the data element description in FrntSideRdrLeObj1 with the same data element name.";
CM_ SG_ 1025 ReSideRdrLe20Obj1RdrObjCntr "Refer to the data element description in FrntSideRdrLeObj1 with the same data element name.";
CM_ SG_ 1025 ReSideRdrLe20Obj1RdrObjCoastCnt "Refer to the data element description in FrntSideRdrLeObj1 with the same data element name.";
CM_ SG_ 1025 ReSideRdrLe20Obj1RdrObjConf "Refer to the data element description in FrntSideRdrLeObj1 with the same data element name.";
CM_ SG_ 1025 ReSideRdrLe20Obj1RdrObjDx "Refer to the data element description in FrntSideRdrLeObj1 with the same data element name.";
CM_ SG_ 1025 ReSideRdrLe20Obj1RdrObjDxStdDe "Refer to the data element description in FrntSideRdrLeObj1 with the same data element name.";
CM_ SG_ 1025 ReSideRdrLe20Obj1RdrObjDy "Refer to the data element description in FrntSideRdrLeObj1 with the same data element name.";
CM_ SG_ 1025 ReSideRdrLe20Obj1RdrObjDyStdDe "Refer to the data element description in FrntSideRdrLeObj1 with the same data element name.";
CM_ SG_ 1025 ReSideRdrLe20Obj1RdrObjElevnConf "Refer to the data element description in FrntSideRdrLeObj1 with the same data element name.";
CM_ SG_ 1025 ReSideRdrLe20Obj1RdrObjElevnSts "Refer to the data element description in FrntSideRdrLeObj1 with the same data element name.";
CM_ SG_ 1025 ReSideRdrLe20Obj1RdrObjID "Refer to the data element description in FrntSideRdrLeObj1 with the same data element name.";
CM_ SG_ 1025 ReSideRdrLe20Obj1RdrObjIsInFreeSpace "Refer to the data element description in FrntSideRdrLeObj1 with the same data element name.";
CM_ SG_ 1025 ReSideRdrLe20Obj1RdrObjMirrProblty "Refer to the data element description in FrntSideRdrLeObj1 with the same data element name.";
CM_ SG_ 1025 ReSideRdrLe20Obj1RdrObjMtnPat "Refer to the data element description in FrntSideRdrLeObj1 with the same data element name.";
CM_ SG_ 1025 ReSideRdrLe20Obj1RdrObjNotRealProblty "Refer to the data element description in FrntSideRdrLeObj1 with the same data element name.";
CM_ SG_ 1025 ReSideRdrLe20Obj1RdrObjStatyCnt "Refer to the data element description in FrntSideRdrLeObj1 with the same data element name.";
CM_ SG_ 1025 ReSideRdrLe20Obj1RdrObjTiAlv "Refer to the data element description in FrntSideRdrLeObj1 with the same data element name.";
CM_ SG_ 1025 ReSideRdrLe20Obj1RdrObjTrackSts "Refer to the data element description in FrntSideRdrLeObj1 with the same data element name.";
CM_ SG_ 1025 ReSideRdrLe20Obj1RdrObjTyp "Refer to the data element description in FrntSideRdrLeObj1 with the same data element name.";
CM_ SG_ 1025 ReSideRdrLe20Obj1RdrObjTypConfBike "Refer to the data element description in FrntSideRdrLeObj1 with the same data element name.";
CM_ SG_ 1025 ReSideRdrLe20Obj1RdrObjTypConfPed "Refer to the data element description in FrntSideRdrLeObj1 with the same data element name.";
CM_ SG_ 1025 ReSideRdrLe20Obj1RdrObjTypConfVeh "Refer to the data element description in FrntSideRdrLeObj1 with the same data element name.";
CM_ SG_ 1025 ReSideRdrLe20Obj1RdrObjUsedTracker "Refer to the data element description in FrntSideRdrLeObj1 with the same data element name.";
CM_ SG_ 1025 ReSideRdrLe20Obj1RdrObjVx "Refer to the data element description in FrntSideRdrLeObj1 with the same data element name.";
CM_ SG_ 1025 ReSideRdrLe20Obj1RdrObjVxStdDe "Refer to the data element description in FrntSideRdrLeObj1 with the same data element name.";
CM_ SG_ 1025 ReSideRdrLe20Obj1RdrObjVy "Refer to the data element description in FrntSideRdrLeObj1 with the same data element name.";
CM_ SG_ 1025 ReSideRdrLe20Obj1RdrObjVyStdDe "Refer to the data element description in FrntSideRdrLeObj1 with the same data element name.";
CM_ SG_ 1025 ReSideRdrLe20Obj1RelVx "Refer to the data element description in FrntSideRdrLeObj1 with the same data element name.";
CM_ SG_ 1025 ReSideRdrLe20Obj1RelVy "Refer to the data element description in FrntSideRdrLeObj1 with the same data element name.";
CM_ SG_ 1026 ReSideRdrLe20Obj2Heading "Refer to the data element description in FrntSideRdrLeObj1 with the same data element name.";
CM_ SG_ 1026 ReSideRdrLe20Obj2ObjBoxCenterLat "Refer to the data element description in FrntSideRdrLeObj1 with the same data element name.";
CM_ SG_ 1026 ReSideRdrLe20Obj2ObjBoxCenterLgt "Refer to the data element description in FrntSideRdrLeObj1 with the same data element name.";
CM_ SG_ 1026 ReSideRdrLe20Obj2ObservationHist "Refer to the data element description in FrntSideRdrLeObj1 with the same data element name.";
CM_ SG_ 1026 ReSideRdrLe20Obj2QualityBits "Refer to the data element description in FrntSideRdrLeObj1 with the same data element name.";
CM_ SG_ 1026 ReSideRdrLe20Obj2RdrObjAx "Refer to the data element description in FrntSideRdrLeObj1 with the same data element name.";
CM_ SG_ 1026 ReSideRdrLe20Obj2RdrObjAy "Refer to the data element description in FrntSideRdrLeObj1 with the same data element name.";
CM_ SG_ 1026 ReSideRdrLe20Obj2RdrObjBoxLength "Refer to the data element description in FrntSideRdrLeObj1 with the same data element name.";
CM_ SG_ 1026 ReSideRdrLe20Obj2RdrObjBoxWidth "Refer to the data element description in FrntSideRdrLeObj1 with the same data element name.";
CM_ SG_ 1026 ReSideRdrLe20Obj2RdrObjChks "Refer to the data element description in FrntSideRdrLeObj1 with the same data element name.";
CM_ SG_ 1026 ReSideRdrLe20Obj2RdrObjCntr "Refer to the data element description in FrntSideRdrLeObj1 with the same data element name.";
CM_ SG_ 1026 ReSideRdrLe20Obj2RdrObjCoastCnt "Refer to the data element description in FrntSideRdrLeObj1 with the same data element name.";
CM_ SG_ 1026 ReSideRdrLe20Obj2RdrObjConf "Refer to the data element description in FrntSideRdrLeObj1 with the same data element name.";
CM_ SG_ 1026 ReSideRdrLe20Obj2RdrObjDx "Refer to the data element description in FrntSideRdrLeObj1 with the same data element name.";
CM_ SG_ 1026 ReSideRdrLe20Obj2RdrObjDxStdDe "Refer to the data element description in FrntSideRdrLeObj1 with the same data element name.";
CM_ SG_ 1026 ReSideRdrLe20Obj2RdrObjDy "Refer to the data element description in FrntSideRdrLeObj1 with the same data element name.";
CM_ SG_ 1026 ReSideRdrLe20Obj2RdrObjDyStdDe "Refer to the data element description in FrntSideRdrLeObj1 with the same data element name.";
CM_ SG_ 1026 ReSideRdrLe20Obj2RdrObjElevnConf "Refer to the data element description in FrntSideRdrLeObj1 with the same data element name.";
CM_ SG_ 1026 ReSideRdrLe20Obj2RdrObjElevnSts "Refer to the data element description in FrntSideRdrLeObj1 with the same data element name.";
CM_ SG_ 1026 ReSideRdrLe20Obj2RdrObjID "Refer to the data element description in FrntSideRdrLeObj1 with the same data element name.";
CM_ SG_ 1026 ReSideRdrLe20Obj2RdrObjIsInFreeSpace "Refer to the data element description in FrntSideRdrLeObj1 with the same data element name.";
CM_ SG_ 1026 ReSideRdrLe20Obj2RdrObjMirrProblty "Refer to the data element description in FrntSideRdrLeObj1 with the same data element name.";
CM_ SG_ 1026 ReSideRdrLe20Obj2RdrObjMtnPat "Refer to the data element description in FrntSideRdrLeObj1 with the same data element name.";
CM_ SG_ 1026 ReSideRdrLe20Obj2RdrObjNotRealProblty "Refer to the data element description in FrntSideRdrLeObj1 with the same data element name.";
CM_ SG_ 1026 ReSideRdrLe20Obj2RdrObjStatyCnt "Refer to the data element description in FrntSideRdrLeObj1 with the same data element name.";
CM_ SG_ 1026 ReSideRdrLe20Obj2RdrObjTiAlv "Refer to the data element description in FrntSideRdrLeObj1 with the same data element name.";
CM_ SG_ 1026 ReSideRdrLe20Obj2RdrObjTrackSts "Refer to the data element description in FrntSideRdrLeObj1 with the same data element name.";
CM_ SG_ 1026 ReSideRdrLe20Obj2RdrObjTyp "Refer to the data element description in FrntSideRdrLeObj1 with the same data element name.";
CM_ SG_ 1026 ReSideRdrLe20Obj2RdrObjTypConfBike "Refer to the data element description in FrntSideRdrLeObj1 with the same data element name.";
CM_ SG_ 1026 ReSideRdrLe20Obj2RdrObjTypConfPed "Refer to the data element description in FrntSideRdrLeObj1 with the same data element name.";
CM_ SG_ 1026 ReSideRdrLe20Obj2RdrObjTypConfVeh "Refer to the data element description in FrntSideRdrLeObj1 with the same data element name.";
CM_ SG_ 1026 ReSideRdrLe20Obj2RdrObjUsedTracker "Refer to the data element description in FrntSideRdrLeObj1 with the same data element name.";
CM_ SG_ 1026 ReSideRdrLe20Obj2RdrObjVx "Refer to the data element description in FrntSideRdrLeObj1 with the same data element name.";
CM_ SG_ 1026 ReSideRdrLe20Obj2RdrObjVxStdDe "Refer to the data element description in FrntSideRdrLeObj1 with the same data element name.";
CM_ SG_ 1026 ReSideRdrLe20Obj2RdrObjVy "Refer to the data element description in FrntSideRdrLeObj1 with the same data element name.";
CM_ SG_ 1026 ReSideRdrLe20Obj2RdrObjVyStdDe "Refer to the data element description in FrntSideRdrLeObj1 with the same data element name.";
CM_ SG_ 1026 ReSideRdrLe20Obj2RelVx "Refer to the data element description in FrntSideRdrLeObj1 with the same data element name.";
CM_ SG_ 1026 ReSideRdrLe20Obj2RelVy "Refer to the data element description in FrntSideRdrLeObj1 with the same data element name.";
CM_ SG_ 1027 ReSideRdrLe20Obj3Heading "Refer to the data element description in FrntSideRdrLeObj1 with the same data element name.";
CM_ SG_ 1027 ReSideRdrLe20Obj3ObjBoxCenterLat "Refer to the data element description in FrntSideRdrLeObj1 with the same data element name.";
CM_ SG_ 1027 ReSideRdrLe20Obj3ObjBoxCenterLgt "Refer to the data element description in FrntSideRdrLeObj1 with the same data element name.";
CM_ SG_ 1027 ReSideRdrLe20Obj3ObservationHist "Refer to the data element description in FrntSideRdrLeObj1 with the same data element name.";
CM_ SG_ 1027 ReSideRdrLe20Obj3QualityBits "Refer to the data element description in FrntSideRdrLeObj1 with the same data element name.";
CM_ SG_ 1027 ReSideRdrLe20Obj3RdrObjAx "Refer to the data element description in FrntSideRdrLeObj1 with the same data element name.";
CM_ SG_ 1027 ReSideRdrLe20Obj3RdrObjAy "Refer to the data element description in FrntSideRdrLeObj1 with the same data element name.";
CM_ SG_ 1027 ReSideRdrLe20Obj3RdrObjBoxLength "Refer to the data element description in FrntSideRdrLeObj1 with the same data element name.";
CM_ SG_ 1027 ReSideRdrLe20Obj3RdrObjBoxWidth "Refer to the data element description in FrntSideRdrLeObj1 with the same data element name.";
CM_ SG_ 1027 ReSideRdrLe20Obj3RdrObjChks "Refer to the data element description in FrntSideRdrLeObj1 with the same data element name.";
CM_ SG_ 1027 ReSideRdrLe20Obj3RdrObjCntr "Refer to the data element description in FrntSideRdrLeObj1 with the same data element name.";
CM_ SG_ 1027 ReSideRdrLe20Obj3RdrObjCoastCnt "Refer to the data element description in FrntSideRdrLeObj1 with the same data element name.";
CM_ SG_ 1027 ReSideRdrLe20Obj3RdrObjConf "Refer to the data element description in FrntSideRdrLeObj1 with the same data element name.";
CM_ SG_ 1027 ReSideRdrLe20Obj3RdrObjDx "Refer to the data element description in FrntSideRdrLeObj1 with the same data element name.";
CM_ SG_ 1027 ReSideRdrLe20Obj3RdrObjDxStdDe "Refer to the data element description in FrntSideRdrLeObj1 with the same data element name.";
CM_ SG_ 1027 ReSideRdrLe20Obj3RdrObjDy "Refer to the data element description in FrntSideRdrLeObj1 with the same data element name.";
CM_ SG_ 1027 ReSideRdrLe20Obj3RdrObjDyStdDe "Refer to the data element description in FrntSideRdrLeObj1 with the same data element name.";
CM_ SG_ 1027 ReSideRdrLe20Obj3RdrObjElevnConf "Refer to the data element description in FrntSideRdrLeObj1 with the same data element name.";
CM_ SG_ 1027 ReSideRdrLe20Obj3RdrObjElevnSts "Refer to the data element description in FrntSideRdrLeObj1 with the same data element name.";
CM_ SG_ 1027 ReSideRdrLe20Obj3RdrObjID "Refer to the data element description in FrntSideRdrLeObj1 with the same data element name.";
CM_ SG_ 1027 ReSideRdrLe20Obj3RdrObjIsInFreeSpace "Refer to the data element description in FrntSideRdrLeObj1 with the same data element name.";
CM_ SG_ 1027 ReSideRdrLe20Obj3RdrObjMirrProblty "Refer to the data element description in FrntSideRdrLeObj1 with the same data element name.";
CM_ SG_ 1027 ReSideRdrLe20Obj3RdrObjMtnPat "Refer to the data element description in FrntSideRdrLeObj1 with the same data element name.";
CM_ SG_ 1027 ReSideRdrLe20Obj3RdrObjNotRealProblty "Refer to the data element description in FrntSideRdrLeObj1 with the same data element name.";
CM_ SG_ 1027 ReSideRdrLe20Obj3RdrObjStatyCnt "Refer to the data element description in FrntSideRdrLeObj1 with the same data element name.";
CM_ SG_ 1027 ReSideRdrLe20Obj3RdrObjTiAlv "Refer to the data element description in FrntSideRdrLeObj1 with the same data element name.";
CM_ SG_ 1027 ReSideRdrLe20Obj3RdrObjTrackSts "Refer to the data element description in FrntSideRdrLeObj1 with the same data element name.";
CM_ SG_ 1027 ReSideRdrLe20Obj3RdrObjTyp "Refer to the data element description in FrntSideRdrLeObj1 with the same data element name.";
CM_ SG_ 1027 ReSideRdrLe20Obj3RdrObjTypConfBike "Refer to the data element description in FrntSideRdrLeObj1 with the same data element name.";
CM_ SG_ 1027 ReSideRdrLe20Obj3RdrObjTypConfPed "Refer to the data element description in FrntSideRdrLeObj1 with the same data element name.";
CM_ SG_ 1027 ReSideRdrLe20Obj3RdrObjTypConfVeh "Refer to the data element description in FrntSideRdrLeObj1 with the same data element name.";
CM_ SG_ 1027 ReSideRdrLe20Obj3RdrObjUsedTracker "Refer to the data element description in FrntSideRdrLeObj1 with the same data element name.";
CM_ SG_ 1027 ReSideRdrLe20Obj3RdrObjVx "Refer to the data element description in FrntSideRdrLeObj1 with the same data element name.";
CM_ SG_ 1027 ReSideRdrLe20Obj3RdrObjVxStdDe "Refer to the data element description in FrntSideRdrLeObj1 with the same data element name.";
CM_ SG_ 1027 ReSideRdrLe20Obj3RdrObjVy "Refer to the data element description in FrntSideRdrLeObj1 with the same data element name.";
CM_ SG_ 1027 ReSideRdrLe20Obj3RdrObjVyStdDe "Refer to the data element description in FrntSideRdrLeObj1 with the same data element name.";
CM_ SG_ 1027 ReSideRdrLe20Obj3RelVx "Refer to the data element description in FrntSideRdrLeObj1 with the same data element name.";
CM_ SG_ 1027 ReSideRdrLe20Obj3RelVy "Refer to the data element description in FrntSideRdrLeObj1 with the same data element name.";
CM_ SG_ 1028 ReSideRdrLe20Obj4Heading "Refer to the data element description in FrntSideRdrLeObj1 with the same data element name.";
CM_ SG_ 1028 ReSideRdrLe20Obj4ObjBoxCenterLat "Refer to the data element description in FrntSideRdrLeObj1 with the same data element name.";
CM_ SG_ 1028 ReSideRdrLe20Obj4ObjBoxCenterLgt "Refer to the data element description in FrntSideRdrLeObj1 with the same data element name.";
CM_ SG_ 1028 ReSideRdrLe20Obj4ObservationHist "Refer to the data element description in FrntSideRdrLeObj1 with the same data element name.";
CM_ SG_ 1028 ReSideRdrLe20Obj4QualityBits "Refer to the data element description in FrntSideRdrLeObj1 with the same data element name.";
CM_ SG_ 1028 ReSideRdrLe20Obj4RdrObjAx "Refer to the data element description in FrntSideRdrLeObj1 with the same data element name.";
CM_ SG_ 1028 ReSideRdrLe20Obj4RdrObjAy "Refer to the data element description in FrntSideRdrLeObj1 with the same data element name.";
CM_ SG_ 1028 ReSideRdrLe20Obj4RdrObjBoxLength "Refer to the data element description in FrntSideRdrLeObj1 with the same data element name.";
CM_ SG_ 1028 ReSideRdrLe20Obj4RdrObjBoxWidth "Refer to the data element description in FrntSideRdrLeObj1 with the same data element name.";
CM_ SG_ 1028 ReSideRdrLe20Obj4RdrObjChks "Refer to the data element description in FrntSideRdrLeObj1 with the same data element name.";
CM_ SG_ 1028 ReSideRdrLe20Obj4RdrObjCntr "Refer to the data element description in FrntSideRdrLeObj1 with the same data element name.";
CM_ SG_ 1028 ReSideRdrLe20Obj4RdrObjCoastCnt "Refer to the data element description in FrntSideRdrLeObj1 with the same data element name.";
CM_ SG_ 1028 ReSideRdrLe20Obj4RdrObjConf "Refer to the data element description in FrntSideRdrLeObj1 with the same data element name.";
CM_ SG_ 1028 ReSideRdrLe20Obj4RdrObjDx "Refer to the data element description in FrntSideRdrLeObj1 with the same data element name.";
CM_ SG_ 1028 ReSideRdrLe20Obj4RdrObjDxStdDe "Refer to the data element description in FrntSideRdrLeObj1 with the same data element name.";
CM_ SG_ 1028 ReSideRdrLe20Obj4RdrObjDy "Refer to the data element description in FrntSideRdrLeObj1 with the same data element name.";
CM_ SG_ 1028 ReSideRdrLe20Obj4RdrObjDyStdDe "Refer to the data element description in FrntSideRdrLeObj1 with the same data element name.";
CM_ SG_ 1028 ReSideRdrLe20Obj4RdrObjElevnConf "Refer to the data element description in FrntSideRdrLeObj1 with the same data element name.";
CM_ SG_ 1028 ReSideRdrLe20Obj4RdrObjElevnSts "Refer to the data element description in FrntSideRdrLeObj1 with the same data element name.";
CM_ SG_ 1028 ReSideRdrLe20Obj4RdrObjID "Refer to the data element description in FrntSideRdrLeObj1 with the same data element name.";
CM_ SG_ 1028 ReSideRdrLe20Obj4RdrObjIsInFreeSpace "Refer to the data element description in FrntSideRdrLeObj1 with the same data element name.";
CM_ SG_ 1028 ReSideRdrLe20Obj4RdrObjMirrProblty "Refer to the data element description in FrntSideRdrLeObj1 with the same data element name.";
CM_ SG_ 1028 ReSideRdrLe20Obj4RdrObjMtnPat "Refer to the data element description in FrntSideRdrLeObj1 with the same data element name.";
CM_ SG_ 1028 ReSideRdrLe20Obj4RdrObjNotRealProblty "Refer to the data element description in FrntSideRdrLeObj1 with the same data element name.";
CM_ SG_ 1028 ReSideRdrLe20Obj4RdrObjStatyCnt "Refer to the data element description in FrntSideRdrLeObj1 with the same data element name.";
CM_ SG_ 1028 ReSideRdrLe20Obj4RdrObjTiAlv "Refer to the data element description in FrntSideRdrLeObj1 with the same data element name.";
CM_ SG_ 1028 ReSideRdrLe20Obj4RdrObjTrackSts "Refer to the data element description in FrntSideRdrLeObj1 with the same data element name.";
CM_ SG_ 1028 ReSideRdrLe20Obj4RdrObjTyp "Refer to the data element description in FrntSideRdrLeObj1 with the same data element name.";
CM_ SG_ 1028 ReSideRdrLe20Obj4RdrObjTypConfBike "Refer to the data element description in FrntSideRdrLeObj1 with the same data element name.";
CM_ SG_ 1028 ReSideRdrLe20Obj4RdrObjTypConfPed "Refer to the data element description in FrntSideRdrLeObj1 with the same data element name.";
CM_ SG_ 1028 ReSideRdrLe20Obj4RdrObjTypConfVeh "Refer to the data element description in FrntSideRdrLeObj1 with the same data element name.";
CM_ SG_ 1028 ReSideRdrLe20Obj4RdrObjUsedTracker "Refer to the data element description in FrntSideRdrLeObj1 with the same data element name.";
CM_ SG_ 1028 ReSideRdrLe20Obj4RdrObjVx "Refer to the data element description in FrntSideRdrLeObj1 with the same data element name.";
CM_ SG_ 1028 ReSideRdrLe20Obj4RdrObjVxStdDe "Refer to the data element description in FrntSideRdrLeObj1 with the same data element name.";
CM_ SG_ 1028 ReSideRdrLe20Obj4RdrObjVy "Refer to the data element description in FrntSideRdrLeObj1 with the same data element name.";
CM_ SG_ 1028 ReSideRdrLe20Obj4RdrObjVyStdDe "Refer to the data element description in FrntSideRdrLeObj1 with the same data element name.";
CM_ SG_ 1028 ReSideRdrLe20Obj4RelVx "Refer to the data element description in FrntSideRdrLeObj1 with the same data element name.";
CM_ SG_ 1028 ReSideRdrLe20Obj4RelVy "Refer to the data element description in FrntSideRdrLeObj1 with the same data element name.";
CM_ SG_ 1029 ReSideRdrLe20Obj5Heading "Refer to the data element description in FrntSideRdrLeObj1 with the same data element name.";
CM_ SG_ 1029 ReSideRdrLe20Obj5ObjBoxCenterLat "Refer to the data element description in FrntSideRdrLeObj1 with the same data element name.";
CM_ SG_ 1029 ReSideRdrLe20Obj5ObjBoxCenterLgt "Refer to the data element description in FrntSideRdrLeObj1 with the same data element name.";
CM_ SG_ 1029 ReSideRdrLe20Obj5ObservationHist "Refer to the data element description in FrntSideRdrLeObj1 with the same data element name.";
CM_ SG_ 1029 ReSideRdrLe20Obj5QualityBits "Refer to the data element description in FrntSideRdrLeObj1 with the same data element name.";
CM_ SG_ 1029 ReSideRdrLe20Obj5RdrObjAx "Refer to the data element description in FrntSideRdrLeObj1 with the same data element name.";
CM_ SG_ 1029 ReSideRdrLe20Obj5RdrObjAy "Refer to the data element description in FrntSideRdrLeObj1 with the same data element name.";
CM_ SG_ 1029 ReSideRdrLe20Obj5RdrObjBoxLength "Refer to the data element description in FrntSideRdrLeObj1 with the same data element name.";
CM_ SG_ 1029 ReSideRdrLe20Obj5RdrObjBoxWidth "Refer to the data element description in FrntSideRdrLeObj1 with the same data element name.";
CM_ SG_ 1029 ReSideRdrLe20Obj5RdrObjChks "Refer to the data element description in FrntSideRdrLeObj1 with the same data element name.";
CM_ SG_ 1029 ReSideRdrLe20Obj5RdrObjCntr "Refer to the data element description in FrntSideRdrLeObj1 with the same data element name.";
CM_ SG_ 1029 ReSideRdrLe20Obj5RdrObjCoastCnt "Refer to the data element description in FrntSideRdrLeObj1 with the same data element name.";
CM_ SG_ 1029 ReSideRdrLe20Obj5RdrObjConf "Refer to the data element description in FrntSideRdrLeObj1 with the same data element name.";
CM_ SG_ 1029 ReSideRdrLe20Obj5RdrObjDx "Refer to the data element description in FrntSideRdrLeObj1 with the same data element name.";
CM_ SG_ 1029 ReSideRdrLe20Obj5RdrObjDxStdDe "Refer to the data element description in FrntSideRdrLeObj1 with the same data element name.";
CM_ SG_ 1029 ReSideRdrLe20Obj5RdrObjDy "Refer to the data element description in FrntSideRdrLeObj1 with the same data element name.";
CM_ SG_ 1029 ReSideRdrLe20Obj5RdrObjDyStdDe "Refer to the data element description in FrntSideRdrLeObj1 with the same data element name.";
CM_ SG_ 1029 ReSideRdrLe20Obj5RdrObjElevnConf "Refer to the data element description in FrntSideRdrLeObj1 with the same data element name.";
CM_ SG_ 1029 ReSideRdrLe20Obj5RdrObjElevnSts "Refer to the data element description in FrntSideRdrLeObj1 with the same data element name.";
CM_ SG_ 1029 ReSideRdrLe20Obj5RdrObjID "Refer to the data element description in FrntSideRdrLeObj1 with the same data element name.";
CM_ SG_ 1029 ReSideRdrLe20Obj5RdrObjIsInFreeSpace "Refer to the data element description in FrntSideRdrLeObj1 with the same data element name.";
CM_ SG_ 1029 ReSideRdrLe20Obj5RdrObjMirrProblty "Refer to the data element description in FrntSideRdrLeObj1 with the same data element name.";
CM_ SG_ 1029 ReSideRdrLe20Obj5RdrObjMtnPat "Refer to the data element description in FrntSideRdrLeObj1 with the same data element name.";
CM_ SG_ 1029 ReSideRdrLe20Obj5RdrObjNotRealProblty "Refer to the data element description in FrntSideRdrLeObj1 with the same data element name.";
CM_ SG_ 1029 ReSideRdrLe20Obj5RdrObjStatyCnt "Refer to the data element description in FrntSideRdrLeObj1 with the same data element name.";
CM_ SG_ 1029 ReSideRdrLe20Obj5RdrObjTiAlv "Refer to the data element description in FrntSideRdrLeObj1 with the same data element name.";
CM_ SG_ 1029 ReSideRdrLe20Obj5RdrObjTrackSts "Refer to the data element description in FrntSideRdrLeObj1 with the same data element name.";
CM_ SG_ 1029 ReSideRdrLe20Obj5RdrObjTyp "Refer to the data element description in FrntSideRdrLeObj1 with the same data element name.";
CM_ SG_ 1029 ReSideRdrLe20Obj5RdrObjTypConfBike "Refer to the data element description in FrntSideRdrLeObj1 with the same data element name.";
CM_ SG_ 1029 ReSideRdrLe20Obj5RdrObjTypConfPed "Refer to the data element description in FrntSideRdrLeObj1 with the same data element name.";
CM_ SG_ 1029 ReSideRdrLe20Obj5RdrObjTypConfVeh "Refer to the data element description in FrntSideRdrLeObj1 with the same data element name.";
CM_ SG_ 1029 ReSideRdrLe20Obj5RdrObjUsedTracker "Refer to the data element description in FrntSideRdrLeObj1 with the same data element name.";
CM_ SG_ 1029 ReSideRdrLe20Obj5RdrObjVx "Refer to the data element description in FrntSideRdrLeObj1 with the same data element name.";
CM_ SG_ 1029 ReSideRdrLe20Obj5RdrObjVxStdDe "Refer to the data element description in FrntSideRdrLeObj1 with the same data element name.";
CM_ SG_ 1029 ReSideRdrLe20Obj5RdrObjVy "Refer to the data element description in FrntSideRdrLeObj1 with the same data element name.";
CM_ SG_ 1029 ReSideRdrLe20Obj5RdrObjVyStdDe "Refer to the data element description in FrntSideRdrLeObj1 with the same data element name.";
CM_ SG_ 1029 ReSideRdrLe20Obj5RelVx "Refer to the data element description in FrntSideRdrLeObj1 with the same data element name.";
CM_ SG_ 1029 ReSideRdrLe20Obj5RelVy "Refer to the data element description in FrntSideRdrLeObj1 with the same data element name.";
CM_ SG_ 1030 ReSideRdrLe20Obj6Heading "Refer to the data element description in FrntSideRdrLeObj1 with the same data element name.";
CM_ SG_ 1030 ReSideRdrLe20Obj6ObjBoxCenterLat "Refer to the data element description in FrntSideRdrLeObj1 with the same data element name.";
CM_ SG_ 1030 ReSideRdrLe20Obj6ObjBoxCenterLgt "Refer to the data element description in FrntSideRdrLeObj1 with the same data element name.";
CM_ SG_ 1030 ReSideRdrLe20Obj6ObservationHist "Refer to the data element description in FrntSideRdrLeObj1 with the same data element name.";
CM_ SG_ 1030 ReSideRdrLe20Obj6QualityBits "Refer to the data element description in FrntSideRdrLeObj1 with the same data element name.";
CM_ SG_ 1030 ReSideRdrLe20Obj6RdrObjAx "Refer to the data element description in FrntSideRdrLeObj1 with the same data element name.";
CM_ SG_ 1030 ReSideRdrLe20Obj6RdrObjAy "Refer to the data element description in FrntSideRdrLeObj1 with the same data element name.";
CM_ SG_ 1030 ReSideRdrLe20Obj6RdrObjBoxLength "Refer to the data element description in FrntSideRdrLeObj1 with the same data element name.";
CM_ SG_ 1030 ReSideRdrLe20Obj6RdrObjBoxWidth "Refer to the data element description in FrntSideRdrLeObj1 with the same data element name.";
CM_ SG_ 1030 ReSideRdrLe20Obj6RdrObjChks "Refer to the data element description in FrntSideRdrLeObj1 with the same data element name.";
CM_ SG_ 1030 ReSideRdrLe20Obj6RdrObjCntr "Refer to the data element description in FrntSideRdrLeObj1 with the same data element name.";
CM_ SG_ 1030 ReSideRdrLe20Obj6RdrObjCoastCnt "Refer to the data element description in FrntSideRdrLeObj1 with the same data element name.";
CM_ SG_ 1030 ReSideRdrLe20Obj6RdrObjConf "Refer to the data element description in FrntSideRdrLeObj1 with the same data element name.";
CM_ SG_ 1030 ReSideRdrLe20Obj6RdrObjDx "Refer to the data element description in FrntSideRdrLeObj1 with the same data element name.";
CM_ SG_ 1030 ReSideRdrLe20Obj6RdrObjDxStdDe "Refer to the data element description in FrntSideRdrLeObj1 with the same data element name.";
CM_ SG_ 1030 ReSideRdrLe20Obj6RdrObjDy "Refer to the data element description in FrntSideRdrLeObj1 with the same data element name.";
CM_ SG_ 1030 ReSideRdrLe20Obj6RdrObjDyStdDe "Refer to the data element description in FrntSideRdrLeObj1 with the same data element name.";
CM_ SG_ 1030 ReSideRdrLe20Obj6RdrObjElevnConf "Refer to the data element description in FrntSideRdrLeObj1 with the same data element name.";
CM_ SG_ 1030 ReSideRdrLe20Obj6RdrObjElevnSts "Refer to the data element description in FrntSideRdrLeObj1 with the same data element name.";
CM_ SG_ 1030 ReSideRdrLe20Obj6RdrObjID "Refer to the data element description in FrntSideRdrLeObj1 with the same data element name.";
CM_ SG_ 1030 ReSideRdrLe20Obj6RdrObjIsInFreeSpace "Refer to the data element description in FrntSideRdrLeObj1 with the same data element name.";
CM_ SG_ 1030 ReSideRdrLe20Obj6RdrObjMirrProblty "Refer to the data element description in FrntSideRdrLeObj1 with the same data element name.";
CM_ SG_ 1030 ReSideRdrLe20Obj6RdrObjMtnPat "Refer to the data element description in FrntSideRdrLeObj1 with the same data element name.";
CM_ SG_ 1030 ReSideRdrLe20Obj6RdrObjNotRealProblty "Refer to the data element description in FrntSideRdrLeObj1 with the same data element name.";
CM_ SG_ 1030 ReSideRdrLe20Obj6RdrObjStatyCnt "Refer to the data element description in FrntSideRdrLeObj1 with the same data element name.";
CM_ SG_ 1030 ReSideRdrLe20Obj6RdrObjTiAlv "Refer to the data element description in FrntSideRdrLeObj1 with the same data element name.";
CM_ SG_ 1030 ReSideRdrLe20Obj6RdrObjTrackSts "Refer to the data element description in FrntSideRdrLeObj1 with the same data element name.";
CM_ SG_ 1030 ReSideRdrLe20Obj6RdrObjTyp "Refer to the data element description in FrntSideRdrLeObj1 with the same data element name.";
CM_ SG_ 1030 ReSideRdrLe20Obj6RdrObjTypConfBike "Refer to the data element description in FrntSideRdrLeObj1 with the same data element name.";
CM_ SG_ 1030 ReSideRdrLe20Obj6RdrObjTypConfPed "Refer to the data element description in FrntSideRdrLeObj1 with the same data element name.";
CM_ SG_ 1030 ReSideRdrLe20Obj6RdrObjTypConfVeh "Refer to the data element description in FrntSideRdrLeObj1 with the same data element name.";
CM_ SG_ 1030 ReSideRdrLe20Obj6RdrObjUsedTracker "Refer to the data element description in FrntSideRdrLeObj1 with the same data element name.";
CM_ SG_ 1030 ReSideRdrLe20Obj6RdrObjVx "Refer to the data element description in FrntSideRdrLeObj1 with the same data element name.";
CM_ SG_ 1030 ReSideRdrLe20Obj6RdrObjVxStdDe "Refer to the data element description in FrntSideRdrLeObj1 with the same data element name.";
CM_ SG_ 1030 ReSideRdrLe20Obj6RdrObjVy "Refer to the data element description in FrntSideRdrLeObj1 with the same data element name.";
CM_ SG_ 1030 ReSideRdrLe20Obj6RdrObjVyStdDe "Refer to the data element description in FrntSideRdrLeObj1 with the same data element name.";
CM_ SG_ 1030 ReSideRdrLe20Obj6RelVx "Refer to the data element description in FrntSideRdrLeObj1 with the same data element name.";
CM_ SG_ 1030 ReSideRdrLe20Obj6RelVy "Refer to the data element description in FrntSideRdrLeObj1 with the same data element name.";
CM_ SG_ 1031 ReSideRdrLe20Obj7Heading "Refer to the data element description in FrntSideRdrLeObj1 with the same data element name.";
CM_ SG_ 1031 ReSideRdrLe20Obj7ObjBoxCenterLat "Refer to the data element description in FrntSideRdrLeObj1 with the same data element name.";
CM_ SG_ 1031 ReSideRdrLe20Obj7ObjBoxCenterLgt "Refer to the data element description in FrntSideRdrLeObj1 with the same data element name.";
CM_ SG_ 1031 ReSideRdrLe20Obj7ObservationHist "Refer to the data element description in FrntSideRdrLeObj1 with the same data element name.";
CM_ SG_ 1031 ReSideRdrLe20Obj7QualityBits "Refer to the data element description in FrntSideRdrLeObj1 with the same data element name.";
CM_ SG_ 1031 ReSideRdrLe20Obj7RdrObjAx "Refer to the data element description in FrntSideRdrLeObj1 with the same data element name.";
CM_ SG_ 1031 ReSideRdrLe20Obj7RdrObjAy "Refer to the data element description in FrntSideRdrLeObj1 with the same data element name.";
CM_ SG_ 1031 ReSideRdrLe20Obj7RdrObjBoxLength "Refer to the data element description in FrntSideRdrLeObj1 with the same data element name.";
CM_ SG_ 1031 ReSideRdrLe20Obj7RdrObjBoxWidth "Refer to the data element description in FrntSideRdrLeObj1 with the same data element name.";
CM_ SG_ 1031 ReSideRdrLe20Obj7RdrObjChks "Refer to the data element description in FrntSideRdrLeObj1 with the same data element name.";
CM_ SG_ 1031 ReSideRdrLe20Obj7RdrObjCntr "Refer to the data element description in FrntSideRdrLeObj1 with the same data element name.";
CM_ SG_ 1031 ReSideRdrLe20Obj7RdrObjCoastCnt "Refer to the data element description in FrntSideRdrLeObj1 with the same data element name.";
CM_ SG_ 1031 ReSideRdrLe20Obj7RdrObjConf "Refer to the data element description in FrntSideRdrLeObj1 with the same data element name.";
CM_ SG_ 1031 ReSideRdrLe20Obj7RdrObjDx "Refer to the data element description in FrntSideRdrLeObj1 with the same data element name.";
CM_ SG_ 1031 ReSideRdrLe20Obj7RdrObjDxStdDe "Refer to the data element description in FrntSideRdrLeObj1 with the same data element name.";
CM_ SG_ 1031 ReSideRdrLe20Obj7RdrObjDy "Refer to the data element description in FrntSideRdrLeObj1 with the same data element name.";
CM_ SG_ 1031 ReSideRdrLe20Obj7RdrObjDyStdDe "Refer to the data element description in FrntSideRdrLeObj1 with the same data element name.";
CM_ SG_ 1031 ReSideRdrLe20Obj7RdrObjElevnConf "Refer to the data element description in FrntSideRdrLeObj1 with the same data element name.";
CM_ SG_ 1031 ReSideRdrLe20Obj7RdrObjElevnSts "Refer to the data element description in FrntSideRdrLeObj1 with the same data element name.";
CM_ SG_ 1031 ReSideRdrLe20Obj7RdrObjID "Refer to the data element description in FrntSideRdrLeObj1 with the same data element name.";
CM_ SG_ 1031 ReSideRdrLe20Obj7RdrObjIsInFreeSpace "Refer to the data element description in FrntSideRdrLeObj1 with the same data element name.";
CM_ SG_ 1031 ReSideRdrLe20Obj7RdrObjMirrProblty "Refer to the data element description in FrntSideRdrLeObj1 with the same data element name.";
CM_ SG_ 1031 ReSideRdrLe20Obj7RdrObjMtnPat "Refer to the data element description in FrntSideRdrLeObj1 with the same data element name.";
CM_ SG_ 1031 ReSideRdrLe20Obj7RdrObjNotRealProblty "Refer to the data element description in FrntSideRdrLeObj1 with the same data element name.";
CM_ SG_ 1031 ReSideRdrLe20Obj7RdrObjStatyCnt "Refer to the data element description in FrntSideRdrLeObj1 with the same data element name.";
CM_ SG_ 1031 ReSideRdrLe20Obj7RdrObjTiAlv "Refer to the data element description in FrntSideRdrLeObj1 with the same data element name.";
CM_ SG_ 1031 ReSideRdrLe20Obj7RdrObjTrackSts "Refer to the data element description in FrntSideRdrLeObj1 with the same data element name.";
CM_ SG_ 1031 ReSideRdrLe20Obj7RdrObjTyp "Refer to the data element description in FrntSideRdrLeObj1 with the same data element name.";
CM_ SG_ 1031 ReSideRdrLe20Obj7RdrObjTypConfBike "Refer to the data element description in FrntSideRdrLeObj1 with the same data element name.";
CM_ SG_ 1031 ReSideRdrLe20Obj7RdrObjTypConfPed "Refer to the data element description in FrntSideRdrLeObj1 with the same data element name.";
CM_ SG_ 1031 ReSideRdrLe20Obj7RdrObjTypConfVeh "Refer to the data element description in FrntSideRdrLeObj1 with the same data element name.";
CM_ SG_ 1031 ReSideRdrLe20Obj7RdrObjUsedTracker "Refer to the data element description in FrntSideRdrLeObj1 with the same data element name.";
CM_ SG_ 1031 ReSideRdrLe20Obj7RdrObjVx "Refer to the data element description in FrntSideRdrLeObj1 with the same data element name.";
CM_ SG_ 1031 ReSideRdrLe20Obj7RdrObjVxStdDe "Refer to the data element description in FrntSideRdrLeObj1 with the same data element name.";
CM_ SG_ 1031 ReSideRdrLe20Obj7RdrObjVy "Refer to the data element description in FrntSideRdrLeObj1 with the same data element name.";
CM_ SG_ 1031 ReSideRdrLe20Obj7RdrObjVyStdDe "Refer to the data element description in FrntSideRdrLeObj1 with the same data element name.";
CM_ SG_ 1031 ReSideRdrLe20Obj7RelVx "Refer to the data element description in FrntSideRdrLeObj1 with the same data element name.";
CM_ SG_ 1031 ReSideRdrLe20Obj7RelVy "Refer to the data element description in FrntSideRdrLeObj1 with the same data element name.";

// Attribute definitions
BA_DEF_  "BaudRateCANFD" FLOAT 1000 10000000; // [bps]
BA_DEF_  "Baudrate" INT 1000 1000000; // [bps]
BA_DEF_  "BusType" STRING;
BA_DEF_  "DBName" STRING;
BA_DEF_  "ProtocolType" STRING;
BA_DEF_ BU_ "NmAsrNode" ENUM "No","Yes";
BA_DEF_ BU_ "NmAsrNodeIdentifier" INT 0 255;
BA_DEF_ BO_ "CANFD_BRS" ENUM "0","1";
BA_DEF_ BO_ "GenMsgCycleTime" INT 0 65536; // [ms]
BA_DEF_ BO_ "GenMsgDelayTime" INT 0 65536; // [ms]
BA_DEF_ BO_ "GenMsgSendType" ENUM "cyclic", "spontaneous", "not-used", "not-used", "not-used", "cyclicAndSpontaneous", "not-used", "cyclicIfActive", "NoMsgSendType"; // [us]
BA_DEF_ BO_ "GenMsgStartDelayTime" INT 0 65536; // [ms]
BA_DEF_ BO_ "VFrameFormat" ENUM "StandardCAN","ExtendedCAN","reserved","J1939PG","reserved","reserved","reserved","reserved","reserved","reserved","reserved","reserved","reserved","reserved","StandardCAN_FD","ExtendedCAN_FD";
BA_DEF_ SG_ "GenSigSendType" ENUM "Cyclic","OnWrite","OnWriteWithRepetition","OnChange","OnChangeWithRepetition","IfActive","IfActiveWithRepetition","NoSigSendType";
BA_DEF_ SG_ "GenSigStartValue" HEX 0 80000000;
BA_DEF_ BO_ "GenMsgILSupport" ENUM "No","Yes";
BA_DEF_ BO_ "NmAsrMessage" ENUM "No","Yes";
BA_DEF_  "NmAsrBaseAddress" HEX 0 536870911;
BA_DEF_  "NmAsrMessageCount" INT 0 255;
BA_DEF_ BU_ "NodeLayerModules" STRING;
BA_DEF_ BU_ "ILused" ENUM "No","Yes";
BA_DEF_ SG_ "GenSigFuncType" ENUM "NoFunction","n/a","n/a","n/a","n/a","n/a","n/a","n/a","n/a","n/a","n/a","n/a","n/a","n/a","n/a","CHK","CNTR","n/a","n/a","n/a","CNTR_AR_01","CRC_AR_01_BOTH","CRC_AR_01_ALT","CRC_AR_01_LOW","CRC_AR_01_NIBBLE","CNTR_AR_04","CRC_AR_04A","CNTR_AR_05","CRC_AR_05";
BA_DEF_ SG_ "GenSigDataID" STRING;

BA_DEF_DEF_ "BusType" "";
BA_DEF_DEF_ "DBName" "";
BA_DEF_DEF_ "ProtocolType" "";
BA_DEF_DEF_ "NmAsrNode" "No";
BA_DEF_DEF_ "NmAsrNodeIdentifier" 0;
BA_DEF_DEF_ "CANFD_BRS" "1";
BA_DEF_DEF_ "GenSigStartValue" 0;
BA_DEF_DEF_ "VFrameFormat" "J1939PG";
BA_DEF_DEF_ "GenSigSendType" "NoSigSendType";
BA_DEF_DEF_ "GenMsgCycleTime" 0;
BA_DEF_DEF_ "GenMsgDelayTime" 0;
BA_DEF_DEF_ "GenMsgStartDelayTime" 0;
BA_DEF_DEF_ "GenMsgSendType" "NoMsgSendType";
BA_DEF_DEF_ "GenMsgILSupport" "Yes";
BA_DEF_DEF_ "NmAsrMessage" "No";
BA_DEF_DEF_ "NmAsrBaseAddress" 1280;
BA_DEF_DEF_ "NmAsrMessageCount" 64;
BA_DEF_DEF_ "NodeLayerModules" "CANoeILNLSPA.dll";
BA_DEF_DEF_ "ILused" "Yes";
BA_DEF_DEF_ "GenSigFuncType" "NoFunction";
BA_DEF_DEF_ "GenSigDataID" "";

BA_ "BaudRateCANFD" 2000000;
BA_ "Baudrate" 500000;
BA_ "BusType" "CAN FD";
BA_ "DBName" "Private_CANFD5";
BA_ "ProtocolType" "CAN";
// ECU: ASDM
// ECU: SODL
BA_ "NmAsrNode" BU_ SODL 1;
BA_ "NmAsrNodeIdentifier" BU_ SODL 2;
BA_ "NodeLayerModules" BU_ SODL "CANoeILNLSPA.dll,AsrNM33.dll";
// Frame: ADCUPrivateCanFD5TimeSyncFr
BA_ "GenMsgDelayTime" BO_ 153 50;
BA_ "GenMsgSendType" BO_ 153 1;
BA_ "VFrameFormat" BO_ 153 14;
// Frame: AdcuPrivateCanFD5Fr01
BA_ "GenMsgCycleTime" BO_ 325 20;
BA_ "GenMsgSendType" BO_ 325 0;
BA_ "VFrameFormat" BO_ 325 14;
// Frame: AdcuPrivateCanFD5Fr02
BA_ "GenMsgCycleTime" BO_ 337 10;
BA_ "GenMsgSendType" BO_ 337 0;
BA_ "VFrameFormat" BO_ 337 14;
// Frame: AdcuPrivateCanFD5Fr03
BA_ "GenMsgCycleTime" BO_ 357 20;
BA_ "GenMsgSendType" BO_ 357 0;
BA_ "VFrameFormat" BO_ 357 14;
// Frame: AdcuPrivateCanFD5Fr04
BA_ "GenMsgCycleTime" BO_ 401 20;
BA_ "GenMsgSendType" BO_ 401 0;
BA_ "VFrameFormat" BO_ 401 14;
// Frame: AdcuPrivateCanFD5Fr05
BA_ "GenMsgCycleTime" BO_ 327 30;
BA_ "GenMsgSendType" BO_ 327 0;
BA_ "VFrameFormat" BO_ 327 14;
// Frame: AdcuPrivateCanFD5Fr07
BA_ "GenMsgCycleTime" BO_ 897 450 ;
BA_ "GenMsgSendType" BO_ 897 0;
BA_ "VFrameFormat" BO_ 897 14;
// Frame: AdcuPrivateCanFD5Fr08
BA_ "GenMsgCycleTime" BO_ 1007 500 ;
BA_ "GenMsgSendType" BO_ 1007 0;
BA_ "VFrameFormat" BO_ 1007 14;
// Frame: AdcuPrivateCanFD5Fr10
BA_ "GenMsgDelayTime" BO_ 2 20 ;
BA_ "GenMsgSendType" BO_ 2 1;
BA_ "VFrameFormat" BO_ 2 14;
// Frame: AdcuPrivateCanFD5NmFr01
BA_ "GenMsgDelayTime" BO_ 1281 20 ;
BA_ "GenMsgSendType" BO_ 1281 1;
BA_ "VFrameFormat" BO_ 1281 0;
// Frame: AdcuToAllFuncPrivateCanFD5DiagReqFr
BA_ "GenMsgDelayTime" BO_ 2047 5 ;
BA_ "GenMsgSendType" BO_ 2047 1;
BA_ "VFrameFormat" BO_ 2047 14;
// Frame: AdcuToSodlPrivateCanFD5DiagReqFr
BA_ "GenMsgDelayTime" BO_ 1921 5 ;
BA_ "GenMsgSendType" BO_ 1921 1;
BA_ "VFrameFormat" BO_ 1921 14;
// Frame: SODLPrivateCANFD5Fr01
BA_ "GenMsgCycleTime" BO_ 1025 50 ;
BA_ "GenMsgSendType" BO_ 1025 0;
BA_ "VFrameFormat" BO_ 1025 14;
// Frame: SODLPrivateCANFD5Fr02
BA_ "GenMsgCycleTime" BO_ 1026 50 ;
BA_ "GenMsgSendType" BO_ 1026 0;
BA_ "VFrameFormat" BO_ 1026 14;
// Frame: SODLPrivateCANFD5Fr03
BA_ "GenMsgCycleTime" BO_ 1027 50 ;
BA_ "GenMsgSendType" BO_ 1027 0;
BA_ "VFrameFormat" BO_ 1027 14;
// Frame: SODLPrivateCANFD5Fr04
BA_ "GenMsgCycleTime" BO_ 1028 50 ;
BA_ "GenMsgSendType" BO_ 1028 0;
BA_ "VFrameFormat" BO_ 1028 14;
// Frame: SODLPrivateCANFD5Fr05
BA_ "GenMsgCycleTime" BO_ 1029 50 ;
BA_ "GenMsgSendType" BO_ 1029 0;
BA_ "VFrameFormat" BO_ 1029 14;
// Frame: SODLPrivateCANFD5Fr06
BA_ "GenMsgCycleTime" BO_ 1030 50 ;
BA_ "GenMsgSendType" BO_ 1030 0;
BA_ "VFrameFormat" BO_ 1030 14;
// Frame: SODLPrivateCANFD5Fr07
BA_ "GenMsgCycleTime" BO_ 1031 50 ;
BA_ "GenMsgSendType" BO_ 1031 0;
BA_ "VFrameFormat" BO_ 1031 14;
BA_ "GenSigSendType" SG_ 401 ADataRawSafeALat 0;
BA_ "GenSigSendType" SG_ 401 ADataRawSafeALat1Qf 0;
BA_ "GenSigStartValue" SG_ 401 ADataRawSafeALat1Qf 1;
BA_ "GenSigSendType" SG_ 401 ADataRawSafeALgt 0;
BA_ "GenSigSendType" SG_ 401 ADataRawSafeALgt1Qf 0;
BA_ "GenSigStartValue" SG_ 401 ADataRawSafeALgt1Qf 1;
BA_ "GenSigSendType" SG_ 401 ADataRawSafeAVert 0;
BA_ "GenSigStartValue" SG_ 401 ADataRawSafeAVert 1155;
BA_ "GenSigSendType" SG_ 401 ADataRawSafeAVertQf 0;
BA_ "GenSigStartValue" SG_ 401 ADataRawSafeAVertQf 1;
BA_ "GenSigDataID" SG_ 401 ADataRawSafeChks "0x22";
BA_ "GenSigFuncType" SG_ 401 ADataRawSafeChks 15;
BA_ "GenSigSendType" SG_ 401 ADataRawSafeChks 0;
BA_ "GenSigStartValue" SG_ 401 ADataRawSafeChks 255;
BA_ "GenSigFuncType" SG_ 401 ADataRawSafeCntr 16;
BA_ "GenSigSendType" SG_ 401 ADataRawSafeCntr 0;
BA_ "GenSigSendType" SG_ 357 ALgtStdFromWhlSpdALgtStdFromWhlSpd 0;
BA_ "GenSigDataID" SG_ 357 ALgtStdFromWhlSpdChks "0x34";
BA_ "GenSigFuncType" SG_ 357 ALgtStdFromWhlSpdChks 15;
BA_ "GenSigSendType" SG_ 357 ALgtStdFromWhlSpdChks 0;
BA_ "GenSigFuncType" SG_ 357 ALgtStdFromWhlSpdCntr 16;
BA_ "GenSigSendType" SG_ 357 ALgtStdFromWhlSpdCntr 0;
BA_ "GenSigSendType" SG_ 357 ALgtStdFromWhlSpdQf 0;
BA_ "GenSigStartValue" SG_ 357 ALgtStdFromWhlSpdQf 1;
BA_ "GenSigDataID" SG_ 357 AbsCtrlActvChks "0xD06";
BA_ "GenSigFuncType" SG_ 357 AbsCtrlActvChks 15;
BA_ "GenSigSendType" SG_ 357 AbsCtrlActvChks 0;
BA_ "GenSigFuncType" SG_ 357 AbsCtrlActvCntr 16;
BA_ "GenSigSendType" SG_ 357 AbsCtrlActvCntr 0;
BA_ "GenSigSendType" SG_ 357 AbsCtrlActvCtrlSts1 0;
BA_ "GenSigDataID" SG_ 401 AgDataRawSafeChks "0x23";
BA_ "GenSigFuncType" SG_ 401 AgDataRawSafeChks 15;
BA_ "GenSigSendType" SG_ 401 AgDataRawSafeChks 0;
BA_ "GenSigStartValue" SG_ 401 AgDataRawSafeChks 255;
BA_ "GenSigFuncType" SG_ 401 AgDataRawSafeCntr 16;
BA_ "GenSigSendType" SG_ 401 AgDataRawSafeCntr 0;
BA_ "GenSigSendType" SG_ 401 AgDataRawSafeRollRate 0;
BA_ "GenSigSendType" SG_ 401 AgDataRawSafeRollRateQf 0;
BA_ "GenSigStartValue" SG_ 401 AgDataRawSafeRollRateQf 1;
BA_ "GenSigSendType" SG_ 401 AgDataRawSafeYawRate 0;
BA_ "GenSigSendType" SG_ 401 AgDataRawSafeYawRateQf 0;
BA_ "GenSigStartValue" SG_ 401 AgDataRawSafeYawRateQf 1;
BA_ "GenSigSendType" SG_ 897 AmbTRawAmbTVal 0;
BA_ "GenSigStartValue" SG_ 897 AmbTRawAmbTVal 700;
BA_ "GenSigSendType" SG_ 897 AmbTRawQly 0;
BA_ "GenSigSendType" SG_ 357 AsyDataWithCmpSafeALat1Qf 0;
BA_ "GenSigStartValue" SG_ 357 AsyDataWithCmpSafeALat1Qf 1;
BA_ "GenSigSendType" SG_ 357 AsyDataWithCmpSafeALatWithCmp 0;
BA_ "GenSigSendType" SG_ 357 AsyDataWithCmpSafeALgt1Qf 0;
BA_ "GenSigStartValue" SG_ 357 AsyDataWithCmpSafeALgt1Qf 1;
BA_ "GenSigDataID" SG_ 357 AsyDataWithCmpSafeChks "0x24";
BA_ "GenSigFuncType" SG_ 357 AsyDataWithCmpSafeChks 15;
BA_ "GenSigSendType" SG_ 357 AsyDataWithCmpSafeChks 0;
BA_ "GenSigStartValue" SG_ 357 AsyDataWithCmpSafeChks 255;
BA_ "GenSigFuncType" SG_ 357 AsyDataWithCmpSafeCntr 16;
BA_ "GenSigSendType" SG_ 357 AsyDataWithCmpSafeCntr 0;
BA_ "GenSigSendType" SG_ 357 AsyDataWithCmpSafeGrdtOfALgt 0;
BA_ "GenSigSendType" SG_ 357 AsyDataWithCmpSafeYawRateQf 0;
BA_ "GenSigStartValue" SG_ 357 AsyDataWithCmpSafeYawRateQf 1;
BA_ "GenSigSendType" SG_ 357 AsyDataWithCmpSafeYawRateWithCmp 0;
BA_ "GenSigSendType" SG_ 325 AsySftyEnaDecelAckd 0;
BA_ "GenSigSendType" SG_ 897 BkpOfDstTrvld 0;
BA_ "GenSigSendType" SG_ 401 BltLockStAtDrvrBltLockSt1 0;
BA_ "GenSigStartValue" SG_ 401 BltLockStAtDrvrBltLockSt1 1;
BA_ "GenSigSendType" SG_ 401 BltLockStAtDrvrBltLockSts 0;
BA_ "GenSigSendType" SG_ 337 BrkPedlTrvlAct 0;
BA_ "GenSigStartValue" SG_ 337 BrkPedlTrvlAct 500;
BA_ "GenSigDataID" SG_ 337 BrkPedlTrvlChks "0xB3";
BA_ "GenSigFuncType" SG_ 337 BrkPedlTrvlChks 15;
BA_ "GenSigSendType" SG_ 337 BrkPedlTrvlChks 0;
BA_ "GenSigStartValue" SG_ 337 BrkPedlTrvlChks 255;
BA_ "GenSigFuncType" SG_ 337 BrkPedlTrvlCntr 16;
BA_ "GenSigSendType" SG_ 337 BrkPedlTrvlCntr 0;
BA_ "GenSigSendType" SG_ 337 BrkPedlTrvlQf 0;
BA_ "GenSigStartValue" SG_ 337 BrkPedlTrvlQf 1;
BA_ "GenSigSendType" SG_ 337 BrkPedlTrvlSt 0;
BA_ "GenSigSendType" SG_ 337 BrkPedlTrvlStQf 0;
BA_ "GenSigStartValue" SG_ 337 BrkPedlTrvlStQf 1;
BA_ "GenSigSendType" SG_ 337 BrkPedlTrvlTar 0;
BA_ "GenSigStartValue" SG_ 337 BrkPedlTrvlTar 500;
BA_ "GenSigSendType" SG_ 357 BrkSysCylPMstAct 0;
BA_ "GenSigStartValue" SG_ 357 BrkSysCylPMstAct 100;
BA_ "GenSigSendType" SG_ 357 BrkSysCylPMstActQf 0;
BA_ "GenSigStartValue" SG_ 357 BrkSysCylPMstActQf 1;
BA_ "GenSigDataID" SG_ 357 BrkSysCylPMstChks "0xB7";
BA_ "GenSigFuncType" SG_ 357 BrkSysCylPMstChks 15;
BA_ "GenSigSendType" SG_ 357 BrkSysCylPMstChks 0;
BA_ "GenSigFuncType" SG_ 357 BrkSysCylPMstCntr 16;
BA_ "GenSigSendType" SG_ 357 BrkSysCylPMstCntr 0;
BA_ "GenSigSendType" SG_ 357 BrkSysCylPMstTar 0;
BA_ "GenSigSendType" SG_ 357 BrkSysCylPMstVirt 0;
BA_ "GenSigSendType" SG_ 357 BrkSysCylPMstVirtQf 0;
BA_ "GenSigStartValue" SG_ 357 BrkSysCylPMstVirtQf 1;
BA_ "GenSigSendType" SG_ 337 BrkTracCtrlActv 0;
BA_ "GenSigSendType" SG_ 897 CarTiGlb 0;
BA_ "GenSigSendType" SG_ 897 DrvModReq 0;
BA_ "GenSigDataID" SG_ 357 EpbStsChks "0x84";
BA_ "GenSigFuncType" SG_ 357 EpbStsChks 15;
BA_ "GenSigSendType" SG_ 357 EpbStsChks 0;
BA_ "GenSigFuncType" SG_ 357 EpbStsCntr 16;
BA_ "GenSigSendType" SG_ 357 EpbStsCntr 0;
BA_ "GenSigSendType" SG_ 357 EpbStsEpbSts 0;
BA_ "GenSigSendType" SG_ 357 EscCtrlIndcn 0;
BA_ "GenSigStartValue" SG_ 357 EscCtrlIndcn 1;
BA_ "GenSigDataID" SG_ 357 EscStChks "0x7F";
BA_ "GenSigFuncType" SG_ 357 EscStChks 15;
BA_ "GenSigSendType" SG_ 357 EscStChks 0;
BA_ "GenSigFuncType" SG_ 357 EscStCntr 16;
BA_ "GenSigSendType" SG_ 357 EscStCntr 0;
BA_ "GenSigSendType" SG_ 357 EscStEscSt 0;
BA_ "GenSigStartValue" SG_ 357 EscStEscSt 1;
BA_ "GenSigSendType" SG_ 327 ExtrLtgStsAFS 0;
BA_ "GenSigSendType" SG_ 327 ExtrLtgStsAHBC 0;
BA_ "GenSigSendType" SG_ 327 ExtrLtgStsAHL 0;
BA_ "GenSigSendType" SG_ 327 ExtrLtgStsAllWL 0;
BA_ "GenSigSendType" SG_ 327 ExtrLtgStsApproach 0;
BA_ "GenSigDataID" SG_ 327 ExtrLtgStsChks "0x44C";
BA_ "GenSigFuncType" SG_ 327 ExtrLtgStsChks 15;
BA_ "GenSigSendType" SG_ 327 ExtrLtgStsChks 0;
BA_ "GenSigFuncType" SG_ 327 ExtrLtgStsCntr 16;
BA_ "GenSigSendType" SG_ 327 ExtrLtgStsCntr 0;
BA_ "GenSigSendType" SG_ 327 ExtrLtgStsCornrgLi 0;
BA_ "GenSigSendType" SG_ 327 ExtrLtgStsDBL 0;
BA_ "GenSigSendType" SG_ 327 ExtrLtgStsDRL 0;
BA_ "GenSigSendType" SG_ 327 ExtrLtgStsFlash 0;
BA_ "GenSigSendType" SG_ 327 ExtrLtgStsFrntFog 0;
BA_ "GenSigSendType" SG_ 327 ExtrLtgStsGoodbye 0;
BA_ "GenSigSendType" SG_ 327 ExtrLtgStsHWL 0;
BA_ "GenSigSendType" SG_ 327 ExtrLtgStsHiBeam 0;
BA_ "GenSigSendType" SG_ 327 ExtrLtgStsHomeSafe 0;
BA_ "GenSigSendType" SG_ 327 ExtrLtgStsLoBeam 0;
BA_ "GenSigSendType" SG_ 327 ExtrLtgStsLtgShow 0;
BA_ "GenSigSendType" SG_ 327 ExtrLtgStsPosLiFrnt 0;
BA_ "GenSigSendType" SG_ 327 ExtrLtgStsPosLiRe 0;
BA_ "GenSigSendType" SG_ 327 ExtrLtgStsReFog 0;
BA_ "GenSigSendType" SG_ 327 ExtrLtgStsReverseLi 0;
BA_ "GenSigSendType" SG_ 327 ExtrLtgStsStopLi 0;
BA_ "GenSigSendType" SG_ 327 ExtrLtgStsTurnIndrLe 0;
BA_ "GenSigSendType" SG_ 327 ExtrLtgStsTurnIndrRi 0;
BA_ "GenSigSendType" SG_ 327 ExtrLtgStsWelcome 0;
BA_ "GenSigSendType" SG_ 401 GearLvrIndcn 0;
BA_ "GenSigStartValue" SG_ 401 GearLvrIndcn 7;
BA_ "GenSigSendType" SG_ 897 IndcrDisp 0;
BA_ "GenSigStartValue" SG_ 897 LvlgDirMovmtIndcr 1;
BA_ "GenSigDataID" SG_ 357 PinionSteerAgGroupChks "0x40D";
BA_ "GenSigFuncType" SG_ 357 PinionSteerAgGroupChks 15;
BA_ "GenSigSendType" SG_ 357 PinionSteerAgGroupChks 0;
BA_ "GenSigFuncType" SG_ 357 PinionSteerAgGroupCntr 16;
BA_ "GenSigSendType" SG_ 357 PinionSteerAgGroupCntr 0;
BA_ "GenSigSendType" SG_ 357 PinionSteerAgGroupPinionSteerAg1 0;
BA_ "GenSigSendType" SG_ 357 PinionSteerAgGroupPinionSteerAg1Qf 0;
BA_ "GenSigStartValue" SG_ 357 PinionSteerAgGroupPinionSteerAg1Qf 1;
BA_ "GenSigSendType" SG_ 357 PinionSteerAgGroupPinionSteerAgSpd1 0;
BA_ "GenSigSendType" SG_ 357 PinionSteerAgGroupPinionSteerAgSpd1Qf 0;
BA_ "GenSigStartValue" SG_ 357 PinionSteerAgGroupPinionSteerAgSpd1Qf 1;
BA_ "GenSigSendType" SG_ 357 PinionSteerAgGroupSteerWhlTq 0;
BA_ "GenSigSendType" SG_ 357 PinionSteerAgGroupSteerWhlTqQf 0;
BA_ "GenSigStartValue" SG_ 357 PinionSteerAgGroupSteerWhlTqQf 1;
BA_ "GenSigSendType" SG_ 325 RainfallAmnt 0;
BA_ "GenSigStartValue" SG_ 325 RainfallAmnt 14;
BA_ "GenSigSendType" SG_ 1025 ReSideRdrLe20Obj1Heading 0;
BA_ "GenSigStartValue" SG_ 1025 ReSideRdrLe20Obj1Heading 1800;
BA_ "GenSigSendType" SG_ 1025 ReSideRdrLe20Obj1ObjBoxCenterLat 0;
BA_ "GenSigStartValue" SG_ 1025 ReSideRdrLe20Obj1ObjBoxCenterLat 250;
BA_ "GenSigSendType" SG_ 1025 ReSideRdrLe20Obj1ObjBoxCenterLgt 0;
BA_ "GenSigStartValue" SG_ 1025 ReSideRdrLe20Obj1ObjBoxCenterLgt 250;
BA_ "GenSigSendType" SG_ 1025 ReSideRdrLe20Obj1ObservationHist 0;
BA_ "GenSigSendType" SG_ 1025 ReSideRdrLe20Obj1QualityBits 0;
BA_ "GenSigSendType" SG_ 1025 ReSideRdrLe20Obj1RdrObjAx 0;
BA_ "GenSigSendType" SG_ 1025 ReSideRdrLe20Obj1RdrObjAy 0;
BA_ "GenSigSendType" SG_ 1025 ReSideRdrLe20Obj1RdrObjBoxLength 0;
BA_ "GenSigSendType" SG_ 1025 ReSideRdrLe20Obj1RdrObjBoxWidth 0;
BA_ "GenSigDataID" SG_ 1025 ReSideRdrLe20Obj1RdrObjChks "0x1294";
BA_ "GenSigFuncType" SG_ 1025 ReSideRdrLe20Obj1RdrObjChks 15;
BA_ "GenSigSendType" SG_ 1025 ReSideRdrLe20Obj1RdrObjChks 0;
BA_ "GenSigFuncType" SG_ 1025 ReSideRdrLe20Obj1RdrObjCntr 16;
BA_ "GenSigSendType" SG_ 1025 ReSideRdrLe20Obj1RdrObjCntr 0;
BA_ "GenSigSendType" SG_ 1025 ReSideRdrLe20Obj1RdrObjCoastCnt 0;
BA_ "GenSigStartValue" SG_ 1025 ReSideRdrLe20Obj1RdrObjCoastCnt 31;
BA_ "GenSigSendType" SG_ 1025 ReSideRdrLe20Obj1RdrObjConf 0;
BA_ "GenSigSendType" SG_ 1025 ReSideRdrLe20Obj1RdrObjDx 0;
BA_ "GenSigSendType" SG_ 1025 ReSideRdrLe20Obj1RdrObjDxStdDe 0;
BA_ "GenSigSendType" SG_ 1025 ReSideRdrLe20Obj1RdrObjDy 0;
BA_ "GenSigStartValue" SG_ 1025 ReSideRdrLe20Obj1RdrObjDy 4000;
BA_ "GenSigSendType" SG_ 1025 ReSideRdrLe20Obj1RdrObjDyStdDe 0;
BA_ "GenSigSendType" SG_ 1025 ReSideRdrLe20Obj1RdrObjElevnConf 0;
BA_ "GenSigSendType" SG_ 1025 ReSideRdrLe20Obj1RdrObjElevnSts 0;
BA_ "GenSigSendType" SG_ 1025 ReSideRdrLe20Obj1RdrObjID 0;
BA_ "GenSigSendType" SG_ 1025 ReSideRdrLe20Obj1RdrObjIsInFreeSpace 0;
BA_ "GenSigStartValue" SG_ 1025 ReSideRdrLe20Obj1RdrObjIsInFreeSpace 1;
BA_ "GenSigSendType" SG_ 1025 ReSideRdrLe20Obj1RdrObjMirrProblty 0;
BA_ "GenSigSendType" SG_ 1025 ReSideRdrLe20Obj1RdrObjMtnPat 0;
BA_ "GenSigStartValue" SG_ 1025 ReSideRdrLe20Obj1RdrObjMtnPat 3;
BA_ "GenSigSendType" SG_ 1025 ReSideRdrLe20Obj1RdrObjNotRealProblty 0;
BA_ "GenSigSendType" SG_ 1025 ReSideRdrLe20Obj1RdrObjStatyCnt 0;
BA_ "GenSigSendType" SG_ 1025 ReSideRdrLe20Obj1RdrObjTiAlv 0;
BA_ "GenSigSendType" SG_ 1025 ReSideRdrLe20Obj1RdrObjTrackSts 0;
BA_ "GenSigSendType" SG_ 1025 ReSideRdrLe20Obj1RdrObjTyp 0;
BA_ "GenSigSendType" SG_ 1025 ReSideRdrLe20Obj1RdrObjTypConfBike 0;
BA_ "GenSigSendType" SG_ 1025 ReSideRdrLe20Obj1RdrObjTypConfPed 0;
BA_ "GenSigSendType" SG_ 1025 ReSideRdrLe20Obj1RdrObjTypConfVeh 0;
BA_ "GenSigSendType" SG_ 1025 ReSideRdrLe20Obj1RdrObjUsedTracker 0;
BA_ "GenSigStartValue" SG_ 1025 ReSideRdrLe20Obj1RdrObjUsedTracker 3;
BA_ "GenSigSendType" SG_ 1025 ReSideRdrLe20Obj1RdrObjVx 0;
BA_ "GenSigStartValue" SG_ 1025 ReSideRdrLe20Obj1RdrObjVx 6400;
BA_ "GenSigSendType" SG_ 1025 ReSideRdrLe20Obj1RdrObjVxStdDe 0;
BA_ "GenSigSendType" SG_ 1025 ReSideRdrLe20Obj1RdrObjVy 0;
BA_ "GenSigStartValue" SG_ 1025 ReSideRdrLe20Obj1RdrObjVy 6400;
BA_ "GenSigSendType" SG_ 1025 ReSideRdrLe20Obj1RdrObjVyStdDe 0;
BA_ "GenSigSendType" SG_ 1025 ReSideRdrLe20Obj1RelVx 0;
BA_ "GenSigStartValue" SG_ 1025 ReSideRdrLe20Obj1RelVx 1780;
BA_ "GenSigSendType" SG_ 1025 ReSideRdrLe20Obj1RelVy 0;
BA_ "GenSigStartValue" SG_ 1025 ReSideRdrLe20Obj1RelVy 1780;
BA_ "GenSigSendType" SG_ 1026 ReSideRdrLe20Obj2Heading 0;
BA_ "GenSigStartValue" SG_ 1026 ReSideRdrLe20Obj2Heading 1800;
BA_ "GenSigSendType" SG_ 1026 ReSideRdrLe20Obj2ObjBoxCenterLat 0;
BA_ "GenSigStartValue" SG_ 1026 ReSideRdrLe20Obj2ObjBoxCenterLat 250;
BA_ "GenSigSendType" SG_ 1026 ReSideRdrLe20Obj2ObjBoxCenterLgt 0;
BA_ "GenSigStartValue" SG_ 1026 ReSideRdrLe20Obj2ObjBoxCenterLgt 250;
BA_ "GenSigSendType" SG_ 1026 ReSideRdrLe20Obj2ObservationHist 0;
BA_ "GenSigSendType" SG_ 1026 ReSideRdrLe20Obj2QualityBits 0;
BA_ "GenSigSendType" SG_ 1026 ReSideRdrLe20Obj2RdrObjAx 0;
BA_ "GenSigSendType" SG_ 1026 ReSideRdrLe20Obj2RdrObjAy 0;
BA_ "GenSigSendType" SG_ 1026 ReSideRdrLe20Obj2RdrObjBoxLength 0;
BA_ "GenSigSendType" SG_ 1026 ReSideRdrLe20Obj2RdrObjBoxWidth 0;
BA_ "GenSigDataID" SG_ 1026 ReSideRdrLe20Obj2RdrObjChks "0x1295";
BA_ "GenSigFuncType" SG_ 1026 ReSideRdrLe20Obj2RdrObjChks 15;
BA_ "GenSigSendType" SG_ 1026 ReSideRdrLe20Obj2RdrObjChks 0;
BA_ "GenSigFuncType" SG_ 1026 ReSideRdrLe20Obj2RdrObjCntr 16;
BA_ "GenSigSendType" SG_ 1026 ReSideRdrLe20Obj2RdrObjCntr 0;
BA_ "GenSigSendType" SG_ 1026 ReSideRdrLe20Obj2RdrObjCoastCnt 0;
BA_ "GenSigStartValue" SG_ 1026 ReSideRdrLe20Obj2RdrObjCoastCnt 31;
BA_ "GenSigSendType" SG_ 1026 ReSideRdrLe20Obj2RdrObjConf 0;
BA_ "GenSigSendType" SG_ 1026 ReSideRdrLe20Obj2RdrObjDx 0;
BA_ "GenSigSendType" SG_ 1026 ReSideRdrLe20Obj2RdrObjDxStdDe 0;
BA_ "GenSigSendType" SG_ 1026 ReSideRdrLe20Obj2RdrObjDy 0;
BA_ "GenSigStartValue" SG_ 1026 ReSideRdrLe20Obj2RdrObjDy 4000;
BA_ "GenSigSendType" SG_ 1026 ReSideRdrLe20Obj2RdrObjDyStdDe 0;
BA_ "GenSigSendType" SG_ 1026 ReSideRdrLe20Obj2RdrObjElevnConf 0;
BA_ "GenSigSendType" SG_ 1026 ReSideRdrLe20Obj2RdrObjElevnSts 0;
BA_ "GenSigSendType" SG_ 1026 ReSideRdrLe20Obj2RdrObjID 0;
BA_ "GenSigSendType" SG_ 1026 ReSideRdrLe20Obj2RdrObjIsInFreeSpace 0;
BA_ "GenSigStartValue" SG_ 1026 ReSideRdrLe20Obj2RdrObjIsInFreeSpace 1;
BA_ "GenSigSendType" SG_ 1026 ReSideRdrLe20Obj2RdrObjMirrProblty 0;
BA_ "GenSigSendType" SG_ 1026 ReSideRdrLe20Obj2RdrObjMtnPat 0;
BA_ "GenSigStartValue" SG_ 1026 ReSideRdrLe20Obj2RdrObjMtnPat 3;
BA_ "GenSigSendType" SG_ 1026 ReSideRdrLe20Obj2RdrObjNotRealProblty 0;
BA_ "GenSigSendType" SG_ 1026 ReSideRdrLe20Obj2RdrObjStatyCnt 0;
BA_ "GenSigSendType" SG_ 1026 ReSideRdrLe20Obj2RdrObjTiAlv 0;
BA_ "GenSigSendType" SG_ 1026 ReSideRdrLe20Obj2RdrObjTrackSts 0;
BA_ "GenSigSendType" SG_ 1026 ReSideRdrLe20Obj2RdrObjTyp 0;
BA_ "GenSigSendType" SG_ 1026 ReSideRdrLe20Obj2RdrObjTypConfBike 0;
BA_ "GenSigSendType" SG_ 1026 ReSideRdrLe20Obj2RdrObjTypConfPed 0;
BA_ "GenSigSendType" SG_ 1026 ReSideRdrLe20Obj2RdrObjTypConfVeh 0;
BA_ "GenSigSendType" SG_ 1026 ReSideRdrLe20Obj2RdrObjUsedTracker 0;
BA_ "GenSigStartValue" SG_ 1026 ReSideRdrLe20Obj2RdrObjUsedTracker 3;
BA_ "GenSigSendType" SG_ 1026 ReSideRdrLe20Obj2RdrObjVx 0;
BA_ "GenSigStartValue" SG_ 1026 ReSideRdrLe20Obj2RdrObjVx 6400;
BA_ "GenSigSendType" SG_ 1026 ReSideRdrLe20Obj2RdrObjVxStdDe 0;
BA_ "GenSigSendType" SG_ 1026 ReSideRdrLe20Obj2RdrObjVy 0;
BA_ "GenSigStartValue" SG_ 1026 ReSideRdrLe20Obj2RdrObjVy 6400;
BA_ "GenSigSendType" SG_ 1026 ReSideRdrLe20Obj2RdrObjVyStdDe 0;
BA_ "GenSigSendType" SG_ 1026 ReSideRdrLe20Obj2RelVx 0;
BA_ "GenSigStartValue" SG_ 1026 ReSideRdrLe20Obj2RelVx 1780;
BA_ "GenSigSendType" SG_ 1026 ReSideRdrLe20Obj2RelVy 0;
BA_ "GenSigStartValue" SG_ 1026 ReSideRdrLe20Obj2RelVy 1780;
BA_ "GenSigSendType" SG_ 1027 ReSideRdrLe20Obj3Heading 0;
BA_ "GenSigStartValue" SG_ 1027 ReSideRdrLe20Obj3Heading 1800;
BA_ "GenSigSendType" SG_ 1027 ReSideRdrLe20Obj3ObjBoxCenterLat 0;
BA_ "GenSigStartValue" SG_ 1027 ReSideRdrLe20Obj3ObjBoxCenterLat 250;
BA_ "GenSigSendType" SG_ 1027 ReSideRdrLe20Obj3ObjBoxCenterLgt 0;
BA_ "GenSigStartValue" SG_ 1027 ReSideRdrLe20Obj3ObjBoxCenterLgt 250;
BA_ "GenSigSendType" SG_ 1027 ReSideRdrLe20Obj3ObservationHist 0;
BA_ "GenSigSendType" SG_ 1027 ReSideRdrLe20Obj3QualityBits 0;
BA_ "GenSigSendType" SG_ 1027 ReSideRdrLe20Obj3RdrObjAx 0;
BA_ "GenSigSendType" SG_ 1027 ReSideRdrLe20Obj3RdrObjAy 0;
BA_ "GenSigSendType" SG_ 1027 ReSideRdrLe20Obj3RdrObjBoxLength 0;
BA_ "GenSigSendType" SG_ 1027 ReSideRdrLe20Obj3RdrObjBoxWidth 0;
BA_ "GenSigDataID" SG_ 1027 ReSideRdrLe20Obj3RdrObjChks "0x1296";
BA_ "GenSigFuncType" SG_ 1027 ReSideRdrLe20Obj3RdrObjChks 15;
BA_ "GenSigSendType" SG_ 1027 ReSideRdrLe20Obj3RdrObjChks 0;
BA_ "GenSigFuncType" SG_ 1027 ReSideRdrLe20Obj3RdrObjCntr 16;
BA_ "GenSigSendType" SG_ 1027 ReSideRdrLe20Obj3RdrObjCntr 0;
BA_ "GenSigSendType" SG_ 1027 ReSideRdrLe20Obj3RdrObjCoastCnt 0;
BA_ "GenSigStartValue" SG_ 1027 ReSideRdrLe20Obj3RdrObjCoastCnt 31;
BA_ "GenSigSendType" SG_ 1027 ReSideRdrLe20Obj3RdrObjConf 0;
BA_ "GenSigSendType" SG_ 1027 ReSideRdrLe20Obj3RdrObjDx 0;
BA_ "GenSigSendType" SG_ 1027 ReSideRdrLe20Obj3RdrObjDxStdDe 0;
BA_ "GenSigSendType" SG_ 1027 ReSideRdrLe20Obj3RdrObjDy 0;
BA_ "GenSigStartValue" SG_ 1027 ReSideRdrLe20Obj3RdrObjDy 4000;
BA_ "GenSigSendType" SG_ 1027 ReSideRdrLe20Obj3RdrObjDyStdDe 0;
BA_ "GenSigSendType" SG_ 1027 ReSideRdrLe20Obj3RdrObjElevnConf 0;
BA_ "GenSigSendType" SG_ 1027 ReSideRdrLe20Obj3RdrObjElevnSts 0;
BA_ "GenSigSendType" SG_ 1027 ReSideRdrLe20Obj3RdrObjID 0;
BA_ "GenSigSendType" SG_ 1027 ReSideRdrLe20Obj3RdrObjIsInFreeSpace 0;
BA_ "GenSigStartValue" SG_ 1027 ReSideRdrLe20Obj3RdrObjIsInFreeSpace 1;
BA_ "GenSigSendType" SG_ 1027 ReSideRdrLe20Obj3RdrObjMirrProblty 0;
BA_ "GenSigSendType" SG_ 1027 ReSideRdrLe20Obj3RdrObjMtnPat 0;
BA_ "GenSigStartValue" SG_ 1027 ReSideRdrLe20Obj3RdrObjMtnPat 3;
BA_ "GenSigSendType" SG_ 1027 ReSideRdrLe20Obj3RdrObjNotRealProblty 0;
BA_ "GenSigSendType" SG_ 1027 ReSideRdrLe20Obj3RdrObjStatyCnt 0;
BA_ "GenSigSendType" SG_ 1027 ReSideRdrLe20Obj3RdrObjTiAlv 0;
BA_ "GenSigSendType" SG_ 1027 ReSideRdrLe20Obj3RdrObjTrackSts 0;
BA_ "GenSigSendType" SG_ 1027 ReSideRdrLe20Obj3RdrObjTyp 0;
BA_ "GenSigSendType" SG_ 1027 ReSideRdrLe20Obj3RdrObjTypConfBike 0;
BA_ "GenSigSendType" SG_ 1027 ReSideRdrLe20Obj3RdrObjTypConfPed 0;
BA_ "GenSigSendType" SG_ 1027 ReSideRdrLe20Obj3RdrObjTypConfVeh 0;
BA_ "GenSigSendType" SG_ 1027 ReSideRdrLe20Obj3RdrObjUsedTracker 0;
BA_ "GenSigStartValue" SG_ 1027 ReSideRdrLe20Obj3RdrObjUsedTracker 3;
BA_ "GenSigSendType" SG_ 1027 ReSideRdrLe20Obj3RdrObjVx 0;
BA_ "GenSigStartValue" SG_ 1027 ReSideRdrLe20Obj3RdrObjVx 6400;
BA_ "GenSigSendType" SG_ 1027 ReSideRdrLe20Obj3RdrObjVxStdDe 0;
BA_ "GenSigSendType" SG_ 1027 ReSideRdrLe20Obj3RdrObjVy 0;
BA_ "GenSigStartValue" SG_ 1027 ReSideRdrLe20Obj3RdrObjVy 6400;
BA_ "GenSigSendType" SG_ 1027 ReSideRdrLe20Obj3RdrObjVyStdDe 0;
BA_ "GenSigSendType" SG_ 1027 ReSideRdrLe20Obj3RelVx 0;
BA_ "GenSigStartValue" SG_ 1027 ReSideRdrLe20Obj3RelVx 1780;
BA_ "GenSigSendType" SG_ 1027 ReSideRdrLe20Obj3RelVy 0;
BA_ "GenSigStartValue" SG_ 1027 ReSideRdrLe20Obj3RelVy 1780;
BA_ "GenSigSendType" SG_ 1028 ReSideRdrLe20Obj4Heading 0;
BA_ "GenSigStartValue" SG_ 1028 ReSideRdrLe20Obj4Heading 1800;
BA_ "GenSigSendType" SG_ 1028 ReSideRdrLe20Obj4ObjBoxCenterLat 0;
BA_ "GenSigStartValue" SG_ 1028 ReSideRdrLe20Obj4ObjBoxCenterLat 250;
BA_ "GenSigSendType" SG_ 1028 ReSideRdrLe20Obj4ObjBoxCenterLgt 0;
BA_ "GenSigStartValue" SG_ 1028 ReSideRdrLe20Obj4ObjBoxCenterLgt 250;
BA_ "GenSigSendType" SG_ 1028 ReSideRdrLe20Obj4ObservationHist 0;
BA_ "GenSigSendType" SG_ 1028 ReSideRdrLe20Obj4QualityBits 0;
BA_ "GenSigSendType" SG_ 1028 ReSideRdrLe20Obj4RdrObjAx 0;
BA_ "GenSigSendType" SG_ 1028 ReSideRdrLe20Obj4RdrObjAy 0;
BA_ "GenSigSendType" SG_ 1028 ReSideRdrLe20Obj4RdrObjBoxLength 0;
BA_ "GenSigSendType" SG_ 1028 ReSideRdrLe20Obj4RdrObjBoxWidth 0;
BA_ "GenSigDataID" SG_ 1028 ReSideRdrLe20Obj4RdrObjChks "0x1297";
BA_ "GenSigFuncType" SG_ 1028 ReSideRdrLe20Obj4RdrObjChks 15;
BA_ "GenSigSendType" SG_ 1028 ReSideRdrLe20Obj4RdrObjChks 0;
BA_ "GenSigFuncType" SG_ 1028 ReSideRdrLe20Obj4RdrObjCntr 16;
BA_ "GenSigSendType" SG_ 1028 ReSideRdrLe20Obj4RdrObjCntr 0;
BA_ "GenSigSendType" SG_ 1028 ReSideRdrLe20Obj4RdrObjCoastCnt 0;
BA_ "GenSigStartValue" SG_ 1028 ReSideRdrLe20Obj4RdrObjCoastCnt 31;
BA_ "GenSigSendType" SG_ 1028 ReSideRdrLe20Obj4RdrObjConf 0;
BA_ "GenSigSendType" SG_ 1028 ReSideRdrLe20Obj4RdrObjDx 0;
BA_ "GenSigSendType" SG_ 1028 ReSideRdrLe20Obj4RdrObjDxStdDe 0;
BA_ "GenSigSendType" SG_ 1028 ReSideRdrLe20Obj4RdrObjDy 0;
BA_ "GenSigStartValue" SG_ 1028 ReSideRdrLe20Obj4RdrObjDy 4000;
BA_ "GenSigSendType" SG_ 1028 ReSideRdrLe20Obj4RdrObjDyStdDe 0;
BA_ "GenSigSendType" SG_ 1028 ReSideRdrLe20Obj4RdrObjElevnConf 0;
BA_ "GenSigSendType" SG_ 1028 ReSideRdrLe20Obj4RdrObjElevnSts 0;
BA_ "GenSigSendType" SG_ 1028 ReSideRdrLe20Obj4RdrObjID 0;
BA_ "GenSigSendType" SG_ 1028 ReSideRdrLe20Obj4RdrObjIsInFreeSpace 0;
BA_ "GenSigStartValue" SG_ 1028 ReSideRdrLe20Obj4RdrObjIsInFreeSpace 1;
BA_ "GenSigSendType" SG_ 1028 ReSideRdrLe20Obj4RdrObjMirrProblty 0;
BA_ "GenSigSendType" SG_ 1028 ReSideRdrLe20Obj4RdrObjMtnPat 0;
BA_ "GenSigStartValue" SG_ 1028 ReSideRdrLe20Obj4RdrObjMtnPat 3;
BA_ "GenSigSendType" SG_ 1028 ReSideRdrLe20Obj4RdrObjNotRealProblty 0;
BA_ "GenSigSendType" SG_ 1028 ReSideRdrLe20Obj4RdrObjStatyCnt 0;
BA_ "GenSigSendType" SG_ 1028 ReSideRdrLe20Obj4RdrObjTiAlv 0;
BA_ "GenSigSendType" SG_ 1028 ReSideRdrLe20Obj4RdrObjTrackSts 0;
BA_ "GenSigSendType" SG_ 1028 ReSideRdrLe20Obj4RdrObjTyp 0;
BA_ "GenSigSendType" SG_ 1028 ReSideRdrLe20Obj4RdrObjTypConfBike 0;
BA_ "GenSigSendType" SG_ 1028 ReSideRdrLe20Obj4RdrObjTypConfPed 0;
BA_ "GenSigSendType" SG_ 1028 ReSideRdrLe20Obj4RdrObjTypConfVeh 0;
BA_ "GenSigSendType" SG_ 1028 ReSideRdrLe20Obj4RdrObjUsedTracker 0;
BA_ "GenSigStartValue" SG_ 1028 ReSideRdrLe20Obj4RdrObjUsedTracker 3;
BA_ "GenSigSendType" SG_ 1028 ReSideRdrLe20Obj4RdrObjVx 0;
BA_ "GenSigStartValue" SG_ 1028 ReSideRdrLe20Obj4RdrObjVx 6400;
BA_ "GenSigSendType" SG_ 1028 ReSideRdrLe20Obj4RdrObjVxStdDe 0;
BA_ "GenSigSendType" SG_ 1028 ReSideRdrLe20Obj4RdrObjVy 0;
BA_ "GenSigStartValue" SG_ 1028 ReSideRdrLe20Obj4RdrObjVy 6400;
BA_ "GenSigSendType" SG_ 1028 ReSideRdrLe20Obj4RdrObjVyStdDe 0;
BA_ "GenSigSendType" SG_ 1028 ReSideRdrLe20Obj4RelVx 0;
BA_ "GenSigStartValue" SG_ 1028 ReSideRdrLe20Obj4RelVx 1780;
BA_ "GenSigSendType" SG_ 1028 ReSideRdrLe20Obj4RelVy 0;
BA_ "GenSigStartValue" SG_ 1028 ReSideRdrLe20Obj4RelVy 1780;
BA_ "GenSigSendType" SG_ 1029 ReSideRdrLe20Obj5Heading 0;
BA_ "GenSigStartValue" SG_ 1029 ReSideRdrLe20Obj5Heading 1800;
BA_ "GenSigSendType" SG_ 1029 ReSideRdrLe20Obj5ObjBoxCenterLat 0;
BA_ "GenSigStartValue" SG_ 1029 ReSideRdrLe20Obj5ObjBoxCenterLat 250;
BA_ "GenSigSendType" SG_ 1029 ReSideRdrLe20Obj5ObjBoxCenterLgt 0;
BA_ "GenSigStartValue" SG_ 1029 ReSideRdrLe20Obj5ObjBoxCenterLgt 250;
BA_ "GenSigSendType" SG_ 1029 ReSideRdrLe20Obj5ObservationHist 0;
BA_ "GenSigSendType" SG_ 1029 ReSideRdrLe20Obj5QualityBits 0;
BA_ "GenSigSendType" SG_ 1029 ReSideRdrLe20Obj5RdrObjAx 0;
BA_ "GenSigSendType" SG_ 1029 ReSideRdrLe20Obj5RdrObjAy 0;
BA_ "GenSigSendType" SG_ 1029 ReSideRdrLe20Obj5RdrObjBoxLength 0;
BA_ "GenSigSendType" SG_ 1029 ReSideRdrLe20Obj5RdrObjBoxWidth 0;
BA_ "GenSigDataID" SG_ 1029 ReSideRdrLe20Obj5RdrObjChks "0x1298";
BA_ "GenSigFuncType" SG_ 1029 ReSideRdrLe20Obj5RdrObjChks 15;
BA_ "GenSigSendType" SG_ 1029 ReSideRdrLe20Obj5RdrObjChks 0;
BA_ "GenSigFuncType" SG_ 1029 ReSideRdrLe20Obj5RdrObjCntr 16;
BA_ "GenSigSendType" SG_ 1029 ReSideRdrLe20Obj5RdrObjCntr 0;
BA_ "GenSigSendType" SG_ 1029 ReSideRdrLe20Obj5RdrObjCoastCnt 0;
BA_ "GenSigStartValue" SG_ 1029 ReSideRdrLe20Obj5RdrObjCoastCnt 31;
BA_ "GenSigSendType" SG_ 1029 ReSideRdrLe20Obj5RdrObjConf 0;
BA_ "GenSigSendType" SG_ 1029 ReSideRdrLe20Obj5RdrObjDx 0;
BA_ "GenSigSendType" SG_ 1029 ReSideRdrLe20Obj5RdrObjDxStdDe 0;
BA_ "GenSigSendType" SG_ 1029 ReSideRdrLe20Obj5RdrObjDy 0;
BA_ "GenSigStartValue" SG_ 1029 ReSideRdrLe20Obj5RdrObjDy 4000;
BA_ "GenSigSendType" SG_ 1029 ReSideRdrLe20Obj5RdrObjDyStdDe 0;
BA_ "GenSigSendType" SG_ 1029 ReSideRdrLe20Obj5RdrObjElevnConf 0;
BA_ "GenSigSendType" SG_ 1029 ReSideRdrLe20Obj5RdrObjElevnSts 0;
BA_ "GenSigSendType" SG_ 1029 ReSideRdrLe20Obj5RdrObjID 0;
BA_ "GenSigSendType" SG_ 1029 ReSideRdrLe20Obj5RdrObjIsInFreeSpace 0;
BA_ "GenSigStartValue" SG_ 1029 ReSideRdrLe20Obj5RdrObjIsInFreeSpace 1;
BA_ "GenSigSendType" SG_ 1029 ReSideRdrLe20Obj5RdrObjMirrProblty 0;
BA_ "GenSigSendType" SG_ 1029 ReSideRdrLe20Obj5RdrObjMtnPat 0;
BA_ "GenSigStartValue" SG_ 1029 ReSideRdrLe20Obj5RdrObjMtnPat 3;
BA_ "GenSigSendType" SG_ 1029 ReSideRdrLe20Obj5RdrObjNotRealProblty 0;
BA_ "GenSigSendType" SG_ 1029 ReSideRdrLe20Obj5RdrObjStatyCnt 0;
BA_ "GenSigSendType" SG_ 1029 ReSideRdrLe20Obj5RdrObjTiAlv 0;
BA_ "GenSigSendType" SG_ 1029 ReSideRdrLe20Obj5RdrObjTrackSts 0;
BA_ "GenSigSendType" SG_ 1029 ReSideRdrLe20Obj5RdrObjTyp 0;
BA_ "GenSigSendType" SG_ 1029 ReSideRdrLe20Obj5RdrObjTypConfBike 0;
BA_ "GenSigSendType" SG_ 1029 ReSideRdrLe20Obj5RdrObjTypConfPed 0;
BA_ "GenSigSendType" SG_ 1029 ReSideRdrLe20Obj5RdrObjTypConfVeh 0;
BA_ "GenSigSendType" SG_ 1029 ReSideRdrLe20Obj5RdrObjUsedTracker 0;
BA_ "GenSigStartValue" SG_ 1029 ReSideRdrLe20Obj5RdrObjUsedTracker 3;
BA_ "GenSigSendType" SG_ 1029 ReSideRdrLe20Obj5RdrObjVx 0;
BA_ "GenSigStartValue" SG_ 1029 ReSideRdrLe20Obj5RdrObjVx 6400;
BA_ "GenSigSendType" SG_ 1029 ReSideRdrLe20Obj5RdrObjVxStdDe 0;
BA_ "GenSigSendType" SG_ 1029 ReSideRdrLe20Obj5RdrObjVy 0;
BA_ "GenSigStartValue" SG_ 1029 ReSideRdrLe20Obj5RdrObjVy 6400;
BA_ "GenSigSendType" SG_ 1029 ReSideRdrLe20Obj5RdrObjVyStdDe 0;
BA_ "GenSigSendType" SG_ 1029 ReSideRdrLe20Obj5RelVx 0;
BA_ "GenSigStartValue" SG_ 1029 ReSideRdrLe20Obj5RelVx 1780;
BA_ "GenSigSendType" SG_ 1029 ReSideRdrLe20Obj5RelVy 0;
BA_ "GenSigStartValue" SG_ 1029 ReSideRdrLe20Obj5RelVy 1780;
BA_ "GenSigSendType" SG_ 1030 ReSideRdrLe20Obj6Heading 0;
BA_ "GenSigStartValue" SG_ 1030 ReSideRdrLe20Obj6Heading 1800;
BA_ "GenSigSendType" SG_ 1030 ReSideRdrLe20Obj6ObjBoxCenterLat 0;
BA_ "GenSigStartValue" SG_ 1030 ReSideRdrLe20Obj6ObjBoxCenterLat 250;
BA_ "GenSigSendType" SG_ 1030 ReSideRdrLe20Obj6ObjBoxCenterLgt 0;
BA_ "GenSigStartValue" SG_ 1030 ReSideRdrLe20Obj6ObjBoxCenterLgt 250;
BA_ "GenSigSendType" SG_ 1030 ReSideRdrLe20Obj6ObservationHist 0;
BA_ "GenSigSendType" SG_ 1030 ReSideRdrLe20Obj6QualityBits 0;
BA_ "GenSigSendType" SG_ 1030 ReSideRdrLe20Obj6RdrObjAx 0;
BA_ "GenSigSendType" SG_ 1030 ReSideRdrLe20Obj6RdrObjAy 0;
BA_ "GenSigSendType" SG_ 1030 ReSideRdrLe20Obj6RdrObjBoxLength 0;
BA_ "GenSigSendType" SG_ 1030 ReSideRdrLe20Obj6RdrObjBoxWidth 0;
BA_ "GenSigDataID" SG_ 1030 ReSideRdrLe20Obj6RdrObjChks "0x1299";
BA_ "GenSigFuncType" SG_ 1030 ReSideRdrLe20Obj6RdrObjChks 15;
BA_ "GenSigSendType" SG_ 1030 ReSideRdrLe20Obj6RdrObjChks 0;
BA_ "GenSigFuncType" SG_ 1030 ReSideRdrLe20Obj6RdrObjCntr 16;
BA_ "GenSigSendType" SG_ 1030 ReSideRdrLe20Obj6RdrObjCntr 0;
BA_ "GenSigSendType" SG_ 1030 ReSideRdrLe20Obj6RdrObjCoastCnt 0;
BA_ "GenSigStartValue" SG_ 1030 ReSideRdrLe20Obj6RdrObjCoastCnt 31;
BA_ "GenSigSendType" SG_ 1030 ReSideRdrLe20Obj6RdrObjConf 0;
BA_ "GenSigSendType" SG_ 1030 ReSideRdrLe20Obj6RdrObjDx 0;
BA_ "GenSigSendType" SG_ 1030 ReSideRdrLe20Obj6RdrObjDxStdDe 0;
BA_ "GenSigSendType" SG_ 1030 ReSideRdrLe20Obj6RdrObjDy 0;
BA_ "GenSigStartValue" SG_ 1030 ReSideRdrLe20Obj6RdrObjDy 4000;
BA_ "GenSigSendType" SG_ 1030 ReSideRdrLe20Obj6RdrObjDyStdDe 0;
BA_ "GenSigSendType" SG_ 1030 ReSideRdrLe20Obj6RdrObjElevnConf 0;
BA_ "GenSigSendType" SG_ 1030 ReSideRdrLe20Obj6RdrObjElevnSts 0;
BA_ "GenSigSendType" SG_ 1030 ReSideRdrLe20Obj6RdrObjID 0;
BA_ "GenSigSendType" SG_ 1030 ReSideRdrLe20Obj6RdrObjIsInFreeSpace 0;
BA_ "GenSigStartValue" SG_ 1030 ReSideRdrLe20Obj6RdrObjIsInFreeSpace 1;
BA_ "GenSigSendType" SG_ 1030 ReSideRdrLe20Obj6RdrObjMirrProblty 0;
BA_ "GenSigSendType" SG_ 1030 ReSideRdrLe20Obj6RdrObjMtnPat 0;
BA_ "GenSigStartValue" SG_ 1030 ReSideRdrLe20Obj6RdrObjMtnPat 3;
BA_ "GenSigSendType" SG_ 1030 ReSideRdrLe20Obj6RdrObjNotRealProblty 0;
BA_ "GenSigSendType" SG_ 1030 ReSideRdrLe20Obj6RdrObjStatyCnt 0;
BA_ "GenSigSendType" SG_ 1030 ReSideRdrLe20Obj6RdrObjTiAlv 0;
BA_ "GenSigSendType" SG_ 1030 ReSideRdrLe20Obj6RdrObjTrackSts 0;
BA_ "GenSigSendType" SG_ 1030 ReSideRdrLe20Obj6RdrObjTyp 0;
BA_ "GenSigSendType" SG_ 1030 ReSideRdrLe20Obj6RdrObjTypConfBike 0;
BA_ "GenSigSendType" SG_ 1030 ReSideRdrLe20Obj6RdrObjTypConfPed 0;
BA_ "GenSigSendType" SG_ 1030 ReSideRdrLe20Obj6RdrObjTypConfVeh 0;
BA_ "GenSigSendType" SG_ 1030 ReSideRdrLe20Obj6RdrObjUsedTracker 0;
BA_ "GenSigStartValue" SG_ 1030 ReSideRdrLe20Obj6RdrObjUsedTracker 3;
BA_ "GenSigSendType" SG_ 1030 ReSideRdrLe20Obj6RdrObjVx 0;
BA_ "GenSigStartValue" SG_ 1030 ReSideRdrLe20Obj6RdrObjVx 6400;
BA_ "GenSigSendType" SG_ 1030 ReSideRdrLe20Obj6RdrObjVxStdDe 0;
BA_ "GenSigSendType" SG_ 1030 ReSideRdrLe20Obj6RdrObjVy 0;
BA_ "GenSigStartValue" SG_ 1030 ReSideRdrLe20Obj6RdrObjVy 6400;
BA_ "GenSigSendType" SG_ 1030 ReSideRdrLe20Obj6RdrObjVyStdDe 0;
BA_ "GenSigSendType" SG_ 1030 ReSideRdrLe20Obj6RelVx 0;
BA_ "GenSigStartValue" SG_ 1030 ReSideRdrLe20Obj6RelVx 1780;
BA_ "GenSigSendType" SG_ 1030 ReSideRdrLe20Obj6RelVy 0;
BA_ "GenSigStartValue" SG_ 1030 ReSideRdrLe20Obj6RelVy 1780;
BA_ "GenSigSendType" SG_ 1031 ReSideRdrLe20Obj7Heading 0;
BA_ "GenSigStartValue" SG_ 1031 ReSideRdrLe20Obj7Heading 1800;
BA_ "GenSigSendType" SG_ 1031 ReSideRdrLe20Obj7ObjBoxCenterLat 0;
BA_ "GenSigStartValue" SG_ 1031 ReSideRdrLe20Obj7ObjBoxCenterLat 250;
BA_ "GenSigSendType" SG_ 1031 ReSideRdrLe20Obj7ObjBoxCenterLgt 0;
BA_ "GenSigStartValue" SG_ 1031 ReSideRdrLe20Obj7ObjBoxCenterLgt 250;
BA_ "GenSigSendType" SG_ 1031 ReSideRdrLe20Obj7ObservationHist 0;
BA_ "GenSigSendType" SG_ 1031 ReSideRdrLe20Obj7QualityBits 0;
BA_ "GenSigSendType" SG_ 1031 ReSideRdrLe20Obj7RdrObjAx 0;
BA_ "GenSigSendType" SG_ 1031 ReSideRdrLe20Obj7RdrObjAy 0;
BA_ "GenSigSendType" SG_ 1031 ReSideRdrLe20Obj7RdrObjBoxLength 0;
BA_ "GenSigSendType" SG_ 1031 ReSideRdrLe20Obj7RdrObjBoxWidth 0;
BA_ "GenSigDataID" SG_ 1031 ReSideRdrLe20Obj7RdrObjChks "0x129A";
BA_ "GenSigFuncType" SG_ 1031 ReSideRdrLe20Obj7RdrObjChks 15;
BA_ "GenSigSendType" SG_ 1031 ReSideRdrLe20Obj7RdrObjChks 0;
BA_ "GenSigFuncType" SG_ 1031 ReSideRdrLe20Obj7RdrObjCntr 16;
BA_ "GenSigSendType" SG_ 1031 ReSideRdrLe20Obj7RdrObjCntr 0;
BA_ "GenSigSendType" SG_ 1031 ReSideRdrLe20Obj7RdrObjCoastCnt 0;
BA_ "GenSigStartValue" SG_ 1031 ReSideRdrLe20Obj7RdrObjCoastCnt 31;
BA_ "GenSigSendType" SG_ 1031 ReSideRdrLe20Obj7RdrObjConf 0;
BA_ "GenSigSendType" SG_ 1031 ReSideRdrLe20Obj7RdrObjDx 0;
BA_ "GenSigSendType" SG_ 1031 ReSideRdrLe20Obj7RdrObjDxStdDe 0;
BA_ "GenSigSendType" SG_ 1031 ReSideRdrLe20Obj7RdrObjDy 0;
BA_ "GenSigStartValue" SG_ 1031 ReSideRdrLe20Obj7RdrObjDy 4000;
BA_ "GenSigSendType" SG_ 1031 ReSideRdrLe20Obj7RdrObjDyStdDe 0;
BA_ "GenSigSendType" SG_ 1031 ReSideRdrLe20Obj7RdrObjElevnConf 0;
BA_ "GenSigSendType" SG_ 1031 ReSideRdrLe20Obj7RdrObjElevnSts 0;
BA_ "GenSigSendType" SG_ 1031 ReSideRdrLe20Obj7RdrObjID 0;
BA_ "GenSigSendType" SG_ 1031 ReSideRdrLe20Obj7RdrObjIsInFreeSpace 0;
BA_ "GenSigStartValue" SG_ 1031 ReSideRdrLe20Obj7RdrObjIsInFreeSpace 1;
BA_ "GenSigSendType" SG_ 1031 ReSideRdrLe20Obj7RdrObjMirrProblty 0;
BA_ "GenSigSendType" SG_ 1031 ReSideRdrLe20Obj7RdrObjMtnPat 0;
BA_ "GenSigStartValue" SG_ 1031 ReSideRdrLe20Obj7RdrObjMtnPat 3;
BA_ "GenSigSendType" SG_ 1031 ReSideRdrLe20Obj7RdrObjNotRealProblty 0;
BA_ "GenSigSendType" SG_ 1031 ReSideRdrLe20Obj7RdrObjStatyCnt 0;
BA_ "GenSigSendType" SG_ 1031 ReSideRdrLe20Obj7RdrObjTiAlv 0;
BA_ "GenSigSendType" SG_ 1031 ReSideRdrLe20Obj7RdrObjTrackSts 0;
BA_ "GenSigSendType" SG_ 1031 ReSideRdrLe20Obj7RdrObjTyp 0;
BA_ "GenSigSendType" SG_ 1031 ReSideRdrLe20Obj7RdrObjTypConfBike 0;
BA_ "GenSigSendType" SG_ 1031 ReSideRdrLe20Obj7RdrObjTypConfPed 0;
BA_ "GenSigSendType" SG_ 1031 ReSideRdrLe20Obj7RdrObjTypConfVeh 0;
BA_ "GenSigSendType" SG_ 1031 ReSideRdrLe20Obj7RdrObjUsedTracker 0;
BA_ "GenSigStartValue" SG_ 1031 ReSideRdrLe20Obj7RdrObjUsedTracker 3;
BA_ "GenSigSendType" SG_ 1031 ReSideRdrLe20Obj7RdrObjVx 0;
BA_ "GenSigStartValue" SG_ 1031 ReSideRdrLe20Obj7RdrObjVx 6400;
BA_ "GenSigSendType" SG_ 1031 ReSideRdrLe20Obj7RdrObjVxStdDe 0;
BA_ "GenSigSendType" SG_ 1031 ReSideRdrLe20Obj7RdrObjVy 0;
BA_ "GenSigStartValue" SG_ 1031 ReSideRdrLe20Obj7RdrObjVy 6400;
BA_ "GenSigSendType" SG_ 1031 ReSideRdrLe20Obj7RdrObjVyStdDe 0;
BA_ "GenSigSendType" SG_ 1031 ReSideRdrLe20Obj7RelVx 0;
BA_ "GenSigStartValue" SG_ 1031 ReSideRdrLe20Obj7RelVx 1780;
BA_ "GenSigSendType" SG_ 1031 ReSideRdrLe20Obj7RelVy 0;
BA_ "GenSigStartValue" SG_ 1031 ReSideRdrLe20Obj7RelVy 1780;
BA_ "GenSigDataID" SG_ 1007 ReSideRdrLeVehPrmRdrVehPrmChks "0x811";
BA_ "GenSigFuncType" SG_ 1007 ReSideRdrLeVehPrmRdrVehPrmChks 15;
BA_ "GenSigSendType" SG_ 1007 ReSideRdrLeVehPrmRdrVehPrmChks 0;
BA_ "GenSigFuncType" SG_ 1007 ReSideRdrLeVehPrmRdrVehPrmCntr 16;
BA_ "GenSigSendType" SG_ 1007 ReSideRdrLeVehPrmRdrVehPrmCntr 0;
BA_ "GenSigSendType" SG_ 1007 ReSideRdrLeVehPrmRdrVehPrmRdrDynCalPrmForAgOffs 0;
BA_ "GenSigStartValue" SG_ 1007 ReSideRdrLeVehPrmRdrVehPrmRdrDynCalPrmForAgOffs 128;
BA_ "GenSigSendType" SG_ 1007 ReSideRdrLeVehPrmRdrVehPrmRdrDynCalPrmForAxleDstReToVehFrnt 0;
BA_ "GenSigStartValue" SG_ 1007 ReSideRdrLeVehPrmRdrVehPrmRdrDynCalPrmForAxleDstReToVehFrnt 250;
BA_ "GenSigSendType" SG_ 1007 ReSideRdrLeVehPrmRdrVehPrmRdrDynCalPrmForPinoinAgRat 0;
BA_ "GenSigStartValue" SG_ 1007 ReSideRdrLeVehPrmRdrVehPrmRdrDynCalPrmForPinoinAgRat 140;
BA_ "GenSigSendType" SG_ 1007 ReSideRdrLeVehPrmRdrVehPrmRdrDynCalPrmForRollAgGain 0;
BA_ "GenSigStartValue" SG_ 1007 ReSideRdrLeVehPrmRdrVehPrmRdrDynCalPrmForRollAgGain 50;
BA_ "GenSigSendType" SG_ 1007 ReSideRdrLeVehPrmRdrVehPrmRdrDynCalPrmForSnsrDir 0;
BA_ "GenSigSendType" SG_ 1007 ReSideRdrLeVehPrmRdrVehPrmRdrDynCalPrmForSnsrOrntn 0;
BA_ "GenSigSendType" SG_ 1007 ReSideRdrLeVehPrmRdrVehPrmRdrDynCalPrmForSnsrPosnLat 0;
BA_ "GenSigStartValue" SG_ 1007 ReSideRdrLeVehPrmRdrVehPrmRdrDynCalPrmForSnsrPosnLat 2000;
BA_ "GenSigSendType" SG_ 1007 ReSideRdrLeVehPrmRdrVehPrmRdrDynCalPrmForSnsrPosnLgt 0;
BA_ "GenSigStartValue" SG_ 1007 ReSideRdrLeVehPrmRdrVehPrmRdrDynCalPrmForSnsrPosnLgt 5000;
BA_ "GenSigSendType" SG_ 1007 ReSideRdrLeVehPrmRdrVehPrmRdrDynCalPrmForSnsrPosnVert 0;
BA_ "GenSigSendType" SG_ 1007 ReSideRdrLeVehPrmRdrVehPrmRdrDynCalPrmForSnsrRot1 0;
BA_ "GenSigStartValue" SG_ 1007 ReSideRdrLeVehPrmRdrVehPrmRdrDynCalPrmForSnsrRot1 900;
BA_ "GenSigSendType" SG_ 1007 ReSideRdrLeVehPrmRdrVehPrmRdrDynCalPrmForVehLen 0;
BA_ "GenSigStartValue" SG_ 1007 ReSideRdrLeVehPrmRdrVehPrmRdrDynCalPrmForVehLen 500;
BA_ "GenSigSendType" SG_ 1007 ReSideRdrLeVehPrmRdrVehPrmRdrDynCalPrmForVehTyp 0;
BA_ "GenSigSendType" SG_ 1007 ReSideRdrLeVehPrmRdrVehPrmRdrDynCalPrmForVehWidth 0;
BA_ "GenSigStartValue" SG_ 1007 ReSideRdrLeVehPrmRdrVehPrmRdrDynCalPrmForVehWidth 200;
BA_ "GenSigSendType" SG_ 1007 ReSideRdrLeVehPrmRdrVehPrmRdrDynCalPrmForVersMajor 0;
BA_ "GenSigSendType" SG_ 1007 ReSideRdrLeVehPrmRdrVehPrmRdrDynCalPrmForVersMinor 0;
BA_ "GenSigSendType" SG_ 1007 ReSideRdrLeVehPrmRdrVehPrmRdrDynCalPrmForWhlBas 0;
BA_ "GenSigSendType" SG_ 1007 ReSideRdrLeVehPrmRdrVehPrmVld 0;
BA_ "GenSigSendType" SG_ 325 StandStillMgrStsForHld1 0;
BA_ "GenSigDataID" SG_ 325 StandStillMgrStsForHldChks "0x448";
BA_ "GenSigFuncType" SG_ 325 StandStillMgrStsForHldChks 15;
BA_ "GenSigSendType" SG_ 325 StandStillMgrStsForHldChks 0;
BA_ "GenSigFuncType" SG_ 325 StandStillMgrStsForHldCntr 16;
BA_ "GenSigSendType" SG_ 325 StandStillMgrStsForHldCntr 0;
BA_ "GenSigSendType" SG_ 325 SteerWhlSnsrAg 0;
BA_ "GenSigSendType" SG_ 325 SteerWhlSnsrAgSpd 0;
BA_ "GenSigDataID" SG_ 325 SteerWhlSnsrChks "0x33";
BA_ "GenSigFuncType" SG_ 325 SteerWhlSnsrChks 15;
BA_ "GenSigSendType" SG_ 325 SteerWhlSnsrChks 0;
BA_ "GenSigFuncType" SG_ 325 SteerWhlSnsrCntr 16;
BA_ "GenSigSendType" SG_ 325 SteerWhlSnsrCntr 0;
BA_ "GenSigSendType" SG_ 325 SteerWhlSnsrQf 0;
BA_ "GenSigStartValue" SG_ 325 SteerWhlSnsrQf 1;
BA_ "GenSigStartValue" SG_ 897 SuspPosnVertLe1WithE2EFrntQf 1;
BA_ "GenSigStartValue" SG_ 897 SuspPosnVertLe1WithE2EReQf 1;
BA_ "GenSigStartValue" SG_ 897 SuspPosnVertRi1WithE2EFrntQf 1;
BA_ "GenSigStartValue" SG_ 897 SuspPosnVertRi1WithE2EReQf 1;
BA_ "GenSigSendType" SG_ 325 TiAndDateIndcnDataValid 0;
BA_ "GenSigSendType" SG_ 325 TiAndDateIndcnDay 0;
BA_ "GenSigStartValue" SG_ 325 TiAndDateIndcnDay 1;
BA_ "GenSigSendType" SG_ 325 TiAndDateIndcnHr1 0;
BA_ "GenSigSendType" SG_ 325 TiAndDateIndcnMins1 0;
BA_ "GenSigSendType" SG_ 325 TiAndDateIndcnMth1 0;
BA_ "GenSigStartValue" SG_ 325 TiAndDateIndcnMth1 1;
BA_ "GenSigSendType" SG_ 325 TiAndDateIndcnSec1 0;
BA_ "GenSigSendType" SG_ 325 TiAndDateIndcnYr1 0;
BA_ "GenSigSendType" SG_ 897 VehBattUSysU 0;
BA_ "GenSigSendType" SG_ 897 VehBattUSysUQf 0;
BA_ "GenSigStartValue" SG_ 897 VehBattUSysUQf 1;
BA_ "GenSigSendType" SG_ 357 VehModMngtGlbSafe1CarModSts1 0;
BA_ "GenSigSendType" SG_ 357 VehModMngtGlbSafe1CarModSubtypWdCarModSubtyp 0;
BA_ "GenSigDataID" SG_ 357 VehModMngtGlbSafe1Chks "0x74";
BA_ "GenSigFuncType" SG_ 357 VehModMngtGlbSafe1Chks 15;
BA_ "GenSigSendType" SG_ 357 VehModMngtGlbSafe1Chks 0;
BA_ "GenSigFuncType" SG_ 357 VehModMngtGlbSafe1Cntr 16;
BA_ "GenSigSendType" SG_ 357 VehModMngtGlbSafe1Cntr 0;
BA_ "GenSigSendType" SG_ 357 VehModMngtGlbSafe1EgyLvlElecMai 0;
BA_ "GenSigSendType" SG_ 357 VehModMngtGlbSafe1EgyLvlElecSubtyp 0;
BA_ "GenSigSendType" SG_ 357 VehModMngtGlbSafe1FltEgyCnsWdSts 0;
BA_ "GenSigSendType" SG_ 357 VehModMngtGlbSafe1PwrLvlElecMai 0;
BA_ "GenSigSendType" SG_ 357 VehModMngtGlbSafe1PwrLvlElecSubtyp 0;
BA_ "GenSigSendType" SG_ 357 VehModMngtGlbSafe1UsgModSts 0;
BA_ "GenSigStartValue" SG_ 357 VehModMngtGlbSafe1UsgModSts 1;
BA_ "GenSigDataID" SG_ 357 VehMtnStChks "0x36";
BA_ "GenSigFuncType" SG_ 357 VehMtnStChks 15;
BA_ "GenSigSendType" SG_ 357 VehMtnStChks 0;
BA_ "GenSigFuncType" SG_ 357 VehMtnStCntr 16;
BA_ "GenSigSendType" SG_ 357 VehMtnStCntr 0;
BA_ "GenSigSendType" SG_ 357 VehMtnStVehMtnSt 0;
BA_ "GenSigSendType" SG_ 325 VehSpdLgtA 0;
BA_ "GenSigDataID" SG_ 325 VehSpdLgtChks "0x37";
BA_ "GenSigFuncType" SG_ 325 VehSpdLgtChks 15;
BA_ "GenSigSendType" SG_ 325 VehSpdLgtChks 0;
BA_ "GenSigFuncType" SG_ 325 VehSpdLgtCntr 16;
BA_ "GenSigSendType" SG_ 325 VehSpdLgtCntr 0;
BA_ "GenSigSendType" SG_ 325 VehSpdLgtQf 0;
BA_ "GenSigStartValue" SG_ 325 VehSpdLgtQf 1;
BA_ "GenSigSendType" SG_ 327 VehTiAndDataDataValid 0;
BA_ "GenSigSendType" SG_ 327 VehTiAndDataDay 0;
BA_ "GenSigStartValue" SG_ 327 VehTiAndDataDay 1;
BA_ "GenSigSendType" SG_ 327 VehTiAndDataHr1 0;
BA_ "GenSigSendType" SG_ 327 VehTiAndDataMins1 0;
BA_ "GenSigSendType" SG_ 327 VehTiAndDataMth1 0;
BA_ "GenSigStartValue" SG_ 327 VehTiAndDataMth1 1;
BA_ "GenSigSendType" SG_ 327 VehTiAndDataSec1 0;
BA_ "GenSigSendType" SG_ 327 VehTiAndDataYr1 0;
BA_ "GenSigSendType" SG_ 2 VinBlockNr 1;
BA_ "GenSigSendType" SG_ 2 VinVINSignalPos1 1;
BA_ "GenSigSendType" SG_ 2 VinVINSignalPos2 1;
BA_ "GenSigSendType" SG_ 2 VinVINSignalPos3 1;
BA_ "GenSigSendType" SG_ 2 VinVINSignalPos4 1;
BA_ "GenSigSendType" SG_ 2 VinVINSignalPos5 1;
BA_ "GenSigSendType" SG_ 2 VinVINSignalPos6 1;
BA_ "GenSigSendType" SG_ 2 VinVINSignalPos7 1;
BA_ "GenSigDataID" SG_ 357 WhlDirRotlFrntChks "0x228";
BA_ "GenSigFuncType" SG_ 357 WhlDirRotlFrntChks 15;
BA_ "GenSigSendType" SG_ 357 WhlDirRotlFrntChks 0;
BA_ "GenSigFuncType" SG_ 357 WhlDirRotlFrntCntr 16;
BA_ "GenSigSendType" SG_ 357 WhlDirRotlFrntCntr 0;
BA_ "GenSigDataID" SG_ 337 WhlDirRotlFrntForBkpChks "0x196A";
BA_ "GenSigFuncType" SG_ 337 WhlDirRotlFrntForBkpChks 15;
BA_ "GenSigSendType" SG_ 337 WhlDirRotlFrntForBkpChks 0;
BA_ "GenSigFuncType" SG_ 337 WhlDirRotlFrntForBkpCntr 16;
BA_ "GenSigSendType" SG_ 337 WhlDirRotlFrntForBkpCntr 0;
BA_ "GenSigSendType" SG_ 337 WhlDirRotlFrntForBkpLe 0;
BA_ "GenSigSendType" SG_ 337 WhlDirRotlFrntForBkpRi 0;
BA_ "GenSigSendType" SG_ 357 WhlDirRotlFrntLe 0;
BA_ "GenSigSendType" SG_ 357 WhlDirRotlFrntRi 0;
BA_ "GenSigDataID" SG_ 357 WhlDirRotlReChks "0x227";
BA_ "GenSigFuncType" SG_ 357 WhlDirRotlReChks 15;
BA_ "GenSigSendType" SG_ 357 WhlDirRotlReChks 0;
BA_ "GenSigFuncType" SG_ 357 WhlDirRotlReCntr 16;
BA_ "GenSigSendType" SG_ 357 WhlDirRotlReCntr 0;
BA_ "GenSigDataID" SG_ 337 WhlDirRotlReForBkpChks "0x196B";
BA_ "GenSigFuncType" SG_ 337 WhlDirRotlReForBkpChks 15;
BA_ "GenSigSendType" SG_ 337 WhlDirRotlReForBkpChks 0;
BA_ "GenSigFuncType" SG_ 337 WhlDirRotlReForBkpCntr 16;
BA_ "GenSigSendType" SG_ 337 WhlDirRotlReForBkpCntr 0;
BA_ "GenSigSendType" SG_ 337 WhlDirRotlReForBkpLe 0;
BA_ "GenSigSendType" SG_ 337 WhlDirRotlReForBkpRi 0;
BA_ "GenSigSendType" SG_ 357 WhlDirRotlReLe 0;
BA_ "GenSigSendType" SG_ 357 WhlDirRotlReRi 0;
BA_ "GenSigDataID" SG_ 357 WhlSpdCircumlFrntChks "0x6F";
BA_ "GenSigFuncType" SG_ 357 WhlSpdCircumlFrntChks 15;
BA_ "GenSigSendType" SG_ 357 WhlSpdCircumlFrntChks 0;
BA_ "GenSigFuncType" SG_ 357 WhlSpdCircumlFrntCntr 16;
BA_ "GenSigSendType" SG_ 357 WhlSpdCircumlFrntCntr 0;
BA_ "GenSigDataID" SG_ 337 WhlSpdCircumlFrntForBkpWhlSpdCircumlFrntChks "0x19AD";
BA_ "GenSigFuncType" SG_ 337 WhlSpdCircumlFrntForBkpWhlSpdCircumlFrntChks 15;
BA_ "GenSigSendType" SG_ 337 WhlSpdCircumlFrntForBkpWhlSpdCircumlFrntChks 0;
BA_ "GenSigFuncType" SG_ 337 WhlSpdCircumlFrntForBkpWhlSpdCircumlFrntCntr 16;
BA_ "GenSigSendType" SG_ 337 WhlSpdCircumlFrntForBkpWhlSpdCircumlFrntCntr 0;
BA_ "GenSigSendType" SG_ 337 WhlSpdCircumlFrntForBkpWhlSpdCircumlFrntLe 0;
BA_ "GenSigSendType" SG_ 337 WhlSpdCircumlFrntForBkpWhlSpdCircumlFrntLeQf 0;
BA_ "GenSigSendType" SG_ 337 WhlSpdCircumlFrntForBkpWhlSpdCircumlFrntRiQf 0;
BA_ "GenSigSendType" SG_ 337 WhlSpdCircumlFrntForBkpWhlSpdCircumlFrntWhlSpdCircumlFrntRi 0;
BA_ "GenSigSendType" SG_ 357 WhlSpdCircumlFrntLe 0;
BA_ "GenSigSendType" SG_ 357 WhlSpdCircumlFrntLeQf 0;
BA_ "GenSigStartValue" SG_ 357 WhlSpdCircumlFrntLeQf 1;
BA_ "GenSigSendType" SG_ 357 WhlSpdCircumlFrntRiQf 0;
BA_ "GenSigStartValue" SG_ 357 WhlSpdCircumlFrntRiQf 1;
BA_ "GenSigSendType" SG_ 357 WhlSpdCircumlFrntWhlSpdCircumlFrntRi 0;
BA_ "GenSigDataID" SG_ 357 WhlSpdCircumlReChks "0x7C";
BA_ "GenSigFuncType" SG_ 357 WhlSpdCircumlReChks 15;
BA_ "GenSigSendType" SG_ 357 WhlSpdCircumlReChks 0;
BA_ "GenSigFuncType" SG_ 357 WhlSpdCircumlReCntr 16;
BA_ "GenSigSendType" SG_ 357 WhlSpdCircumlReCntr 0;
BA_ "GenSigDataID" SG_ 337 WhlSpdCircumlReForBkpWhlSpdCircumlReChks "0x19AE";
BA_ "GenSigFuncType" SG_ 337 WhlSpdCircumlReForBkpWhlSpdCircumlReChks 15;
BA_ "GenSigSendType" SG_ 337 WhlSpdCircumlReForBkpWhlSpdCircumlReChks 0;
BA_ "GenSigFuncType" SG_ 337 WhlSpdCircumlReForBkpWhlSpdCircumlReCntr 16;
BA_ "GenSigSendType" SG_ 337 WhlSpdCircumlReForBkpWhlSpdCircumlReCntr 0;
BA_ "GenSigSendType" SG_ 337 WhlSpdCircumlReForBkpWhlSpdCircumlReLe 0;
BA_ "GenSigSendType" SG_ 337 WhlSpdCircumlReForBkpWhlSpdCircumlReLeQf 0;
BA_ "GenSigSendType" SG_ 337 WhlSpdCircumlReForBkpWhlSpdCircumlReRi 0;
BA_ "GenSigSendType" SG_ 337 WhlSpdCircumlReForBkpWhlSpdCircumlReRiQf 0;
BA_ "GenSigSendType" SG_ 357 WhlSpdCircumlReLe 0;
BA_ "GenSigSendType" SG_ 357 WhlSpdCircumlReLeQf 0;
BA_ "GenSigStartValue" SG_ 357 WhlSpdCircumlReLeQf 1;
BA_ "GenSigSendType" SG_ 357 WhlSpdCircumlReRi 0;
BA_ "GenSigSendType" SG_ 357 WhlSpdCircumlReRiQf 0;
BA_ "GenSigStartValue" SG_ 357 WhlSpdCircumlReRiQf 1;
BA_ "GenSigSendType" SG_ 897 WipgInfoWipgSpdInfo 0;
BA_ "GenSigSendType" SG_ 897 WipgInfoWiprActv 0;
BA_ "GenSigSendType" SG_ 897 WipgInfoWiprInWipgAr 0;

VAL_ 325 AsySftyEnaDecelAckd 0 "OnOff1_Off" 1 "OnOff1_On";
VAL_ 325 RainfallAmnt 0 "AmntSnsr_Amnt" 14 "AmntSnsr_InitValue" 15 "AmntSnsr_Error";
VAL_ 325 StandStillMgrStsForHld1 0 "StandStillMgrStsForHld1_StandStillMgrStsForHldVal0" 1 "StandStillMgrStsForHld1_StandStillMgrStsForHldVal1" 2 "StandStillMgrStsForHld1_StandStillMgrStsForHldVal2" 3 "StandStillMgrStsForHld1_StandStillMgrStsForHldVal3" 4 "StandStillMgrStsForHld1_StandStillMgrStsForHldVal4" 5 "StandStillMgrStsForHld1_StandStillMgrStsForHldVal5" 6 "StandStillMgrStsForHld1_StandStillMgrStsForHldVal6" 7 "StandStillMgrStsForHld1_StandStillMgrStsForHldVal7";
VAL_ 325 SteerWhlSnsrQf 0 "GenQf1_UndefindDataAccur" 1 "GenQf1_TmpUndefdData" 2 "GenQf1_DataAccurNotWithinSpcn" 3 "GenQf1_AccurData";
VAL_ 325 TiAndDateIndcnDataValid 0 "NoYes1_No" 1 "NoYes1_Yes";
VAL_ 325 VehSpdLgtQf 0 "GenQf1_UndefindDataAccur" 1 "GenQf1_TmpUndefdData" 2 "GenQf1_DataAccurNotWithinSpcn" 3 "GenQf1_AccurData";
VAL_ 337 BrkPedlTrvlQf 0 "GenQf1_UndefindDataAccur" 1 "GenQf1_TmpUndefdData" 2 "GenQf1_DataAccurNotWithinSpcn" 3 "GenQf1_AccurData";
VAL_ 337 BrkPedlTrvlSt 0 "PsdNotPsd_NotPsd" 1 "PsdNotPsd_Psd";
VAL_ 337 BrkPedlTrvlStQf 0 "GenQf1_UndefindDataAccur" 1 "GenQf1_TmpUndefdData" 2 "GenQf1_DataAccurNotWithinSpcn" 3 "GenQf1_AccurData";
VAL_ 337 BrkTracCtrlActv 0 "CtrlSts1_NoCtrl" 1 "CtrlSts1_InCtrl";
VAL_ 337 WhlDirRotlFrntForBkpLe 0 "WhlRotlDirStd1_Undefd" 1 "WhlRotlDirStd1_StandStill" 2 "WhlRotlDirStd1_Fwd" 3 "WhlRotlDirStd1_Backw";
VAL_ 337 WhlDirRotlFrntForBkpRi 0 "WhlRotlDirStd1_Undefd" 1 "WhlRotlDirStd1_StandStill" 2 "WhlRotlDirStd1_Fwd" 3 "WhlRotlDirStd1_Backw";
VAL_ 337 WhlDirRotlReForBkpLe 0 "WhlRotlDirStd1_Undefd" 1 "WhlRotlDirStd1_StandStill" 2 "WhlRotlDirStd1_Fwd" 3 "WhlRotlDirStd1_Backw";
VAL_ 337 WhlDirRotlReForBkpRi 0 "WhlRotlDirStd1_Undefd" 1 "WhlRotlDirStd1_StandStill" 2 "WhlRotlDirStd1_Fwd" 3 "WhlRotlDirStd1_Backw";
VAL_ 337 WhlSpdCircumlFrntForBkpWhlSpdCircumlFrntLeQf 0 "GenQf1_UndefindDataAccur" 1 "GenQf1_TmpUndefdData" 2 "GenQf1_DataAccurNotWithinSpcn" 3 "GenQf1_AccurData";
VAL_ 337 WhlSpdCircumlFrntForBkpWhlSpdCircumlFrntRiQf 0 "GenQf1_UndefindDataAccur" 1 "GenQf1_TmpUndefdData" 2 "GenQf1_DataAccurNotWithinSpcn" 3 "GenQf1_AccurData";
VAL_ 337 WhlSpdCircumlReForBkpWhlSpdCircumlReLeQf 0 "GenQf1_UndefindDataAccur" 1 "GenQf1_TmpUndefdData" 2 "GenQf1_DataAccurNotWithinSpcn" 3 "GenQf1_AccurData";
VAL_ 337 WhlSpdCircumlReForBkpWhlSpdCircumlReRiQf 0 "GenQf1_UndefindDataAccur" 1 "GenQf1_TmpUndefdData" 2 "GenQf1_DataAccurNotWithinSpcn" 3 "GenQf1_AccurData";
VAL_ 357 AbsCtrlActvCtrlSts1 0 "CtrlSts1_NoCtrl" 1 "CtrlSts1_InCtrl";
VAL_ 357 ALgtStdFromWhlSpdQf 0 "GenQf1_UndefindDataAccur" 1 "GenQf1_TmpUndefdData" 2 "GenQf1_DataAccurNotWithinSpcn" 3 "GenQf1_AccurData";
VAL_ 357 AsyDataWithCmpSafeALat1Qf 0 "Qf1_DevOfDataUndefd" 1 "Qf1_DataTmpUndefdAndEvlnInProgs" 2 "Qf1_DevOfDataNotWithinRngAllwd" 3 "Qf1_DataCalcdWithDevDefd";
VAL_ 357 AsyDataWithCmpSafeALgt1Qf 0 "Qf1_DevOfDataUndefd" 1 "Qf1_DataTmpUndefdAndEvlnInProgs" 2 "Qf1_DevOfDataNotWithinRngAllwd" 3 "Qf1_DataCalcdWithDevDefd";
VAL_ 357 AsyDataWithCmpSafeYawRateQf 0 "Qf1_DevOfDataUndefd" 1 "Qf1_DataTmpUndefdAndEvlnInProgs" 2 "Qf1_DevOfDataNotWithinRngAllwd" 3 "Qf1_DataCalcdWithDevDefd";
VAL_ 357 BrkSysCylPMstActQf 0 "GenQf1_UndefindDataAccur" 1 "GenQf1_TmpUndefdData" 2 "GenQf1_DataAccurNotWithinSpcn" 3 "GenQf1_AccurData";
VAL_ 357 BrkSysCylPMstVirtQf 0 "GenQf1_UndefindDataAccur" 1 "GenQf1_TmpUndefdData" 2 "GenQf1_DataAccurNotWithinSpcn" 3 "GenQf1_AccurData";
VAL_ 357 EpbStsEpbSts 0 "EpbSts_Resd0" 1 "EpbSts_Resd1" 2 "EpbSts_Resd2" 3 "EpbSts_AllAppld" 4 "EpbSts_Resd4" 5 "EpbSts_AllInTran" 6 "EpbSts_BrkgDynByActr" 7 "EpbSts_Resd7" 8 "EpbSts_Resd8" 9 "EpbSts_ActrAllReld" 10 "EpbSts_BrkgDynDegraded" 11 "EpbSts_Resd11" 12 "EpbSts_BrkgDyn" 13 "EpbSts_Resd13" 14 "EpbSts_Resd14" 15 "EpbSts_Err";
VAL_ 357 EscCtrlIndcn 0 "DevSts1_On" 1 "DevSts1_Off" 2 "DevSts1_Flt";
VAL_ 357 EscStEscSt 0 "EscSt1_Inin" 1 "EscSt1_Ok" 2 "EscSt1_TmpErr" 3 "EscSt1_PrmntErr" 4 "EscSt1_UsrOff";
VAL_ 357 PinionSteerAgGroupPinionSteerAg1Qf 0 "GenQf1_UndefindDataAccur" 1 "GenQf1_TmpUndefdData" 2 "GenQf1_DataAccurNotWithinSpcn" 3 "GenQf1_AccurData";
VAL_ 357 PinionSteerAgGroupPinionSteerAgSpd1Qf 0 "GenQf1_UndefindDataAccur" 1 "GenQf1_TmpUndefdData" 2 "GenQf1_DataAccurNotWithinSpcn" 3 "GenQf1_AccurData";
VAL_ 357 PinionSteerAgGroupSteerWhlTqQf 0 "GenQf1_UndefindDataAccur" 1 "GenQf1_TmpUndefdData" 2 "GenQf1_DataAccurNotWithinSpcn" 3 "GenQf1_AccurData";
VAL_ 357 VehModMngtGlbSafe1CarModSts1 0 "CarModSts1_CarModNorm" 1 "CarModSts1_CarModTrnsp" 2 "CarModSts1_CarModFcy" 3 "CarModSts1_CarModCrash" 5 "CarModSts1_CarModDyno";
VAL_ 357 VehModMngtGlbSafe1FltEgyCnsWdSts 0 "FltEgyCns1_NoFlt" 1 "FltEgyCns1_Flt";
VAL_ 357 VehModMngtGlbSafe1UsgModSts 0 "UsgModSts1_UsgModAbdnd" 1 "UsgModSts1_UsgModInActv" 2 "UsgModSts1_UsgModCnvinc" 11 "UsgModSts1_UsgModActv" 13 "UsgModSts1_UsgModDrvg";
VAL_ 357 VehMtnStVehMtnSt 0 "VehMtnSt2_Ukwn" 1 "VehMtnSt2_StandStillVal1" 2 "VehMtnSt2_StandStillVal2" 3 "VehMtnSt2_StandStillVal3" 4 "VehMtnSt2_RollgFwdVal1" 5 "VehMtnSt2_RollgFwdVal2" 6 "VehMtnSt2_RollgBackwVal1" 7 "VehMtnSt2_RollgBackwVal2";
VAL_ 357 WhlDirRotlFrntLe 0 "WhlRotlDirStd1_Undefd" 1 "WhlRotlDirStd1_StandStill" 2 "WhlRotlDirStd1_Fwd" 3 "WhlRotlDirStd1_Backw";
VAL_ 357 WhlDirRotlFrntRi 0 "WhlRotlDirStd1_Undefd" 1 "WhlRotlDirStd1_StandStill" 2 "WhlRotlDirStd1_Fwd" 3 "WhlRotlDirStd1_Backw";
VAL_ 357 WhlDirRotlReLe 0 "WhlRotlDirStd1_Undefd" 1 "WhlRotlDirStd1_StandStill" 2 "WhlRotlDirStd1_Fwd" 3 "WhlRotlDirStd1_Backw";
VAL_ 357 WhlDirRotlReRi 0 "WhlRotlDirStd1_Undefd" 1 "WhlRotlDirStd1_StandStill" 2 "WhlRotlDirStd1_Fwd" 3 "WhlRotlDirStd1_Backw";
VAL_ 357 WhlSpdCircumlFrntLeQf 0 "GenQf1_UndefindDataAccur" 1 "GenQf1_TmpUndefdData" 2 "GenQf1_DataAccurNotWithinSpcn" 3 "GenQf1_AccurData";
VAL_ 357 WhlSpdCircumlFrntRiQf 0 "GenQf1_UndefindDataAccur" 1 "GenQf1_TmpUndefdData" 2 "GenQf1_DataAccurNotWithinSpcn" 3 "GenQf1_AccurData";
VAL_ 357 WhlSpdCircumlReLeQf 0 "GenQf1_UndefindDataAccur" 1 "GenQf1_TmpUndefdData" 2 "GenQf1_DataAccurNotWithinSpcn" 3 "GenQf1_AccurData";
VAL_ 357 WhlSpdCircumlReRiQf 0 "GenQf1_UndefindDataAccur" 1 "GenQf1_TmpUndefdData" 2 "GenQf1_DataAccurNotWithinSpcn" 3 "GenQf1_AccurData";
VAL_ 401 ADataRawSafeALat1Qf 0 "Qf1_DevOfDataUndefd" 1 "Qf1_DataTmpUndefdAndEvlnInProgs" 2 "Qf1_DevOfDataNotWithinRngAllwd" 3 "Qf1_DataCalcdWithDevDefd";
VAL_ 401 ADataRawSafeALgt1Qf 0 "Qf1_DevOfDataUndefd" 1 "Qf1_DataTmpUndefdAndEvlnInProgs" 2 "Qf1_DevOfDataNotWithinRngAllwd" 3 "Qf1_DataCalcdWithDevDefd";
VAL_ 401 ADataRawSafeAVertQf 0 "Qf1_DevOfDataUndefd" 1 "Qf1_DataTmpUndefdAndEvlnInProgs" 2 "Qf1_DevOfDataNotWithinRngAllwd" 3 "Qf1_DataCalcdWithDevDefd";
VAL_ 401 AgDataRawSafeRollRateQf 0 "Qf1_DevOfDataUndefd" 1 "Qf1_DataTmpUndefdAndEvlnInProgs" 2 "Qf1_DevOfDataNotWithinRngAllwd" 3 "Qf1_DataCalcdWithDevDefd";
VAL_ 401 AgDataRawSafeYawRateQf 0 "Qf1_DevOfDataUndefd" 1 "Qf1_DataTmpUndefdAndEvlnInProgs" 2 "Qf1_DevOfDataNotWithinRngAllwd" 3 "Qf1_DataCalcdWithDevDefd";
VAL_ 401 BltLockStAtDrvrBltLockSt1 0 "BltLockSt1_Unlock" 1 "BltLockSt1_Lock";
VAL_ 401 BltLockStAtDrvrBltLockSts 0 "DevErrSts2_NoFlt" 1 "DevErrSts2_Flt";
VAL_ 401 GearLvrIndcn 0 "GearLvrIndcn2_ParkIndcn" 1 "GearLvrIndcn2_RvsIndcn" 2 "GearLvrIndcn2_NeutIndcn" 3 "GearLvrIndcn2_DrvIndcn" 4 "GearLvrIndcn2_ManModeIndcn" 5 "GearLvrIndcn2_Resd1" 6 "GearLvrIndcn2_Resd2" 7 "GearLvrIndcn2_Undefd";
VAL_ 327 ExtrLtgStsAFS 0 "DevSts4_Off" 1 "DevSts4_On" 2 "DevSts4_Err" 3 "DevSts4_Resd";
VAL_ 327 ExtrLtgStsAHBC 0 "DevSts4_Off" 1 "DevSts4_On" 2 "DevSts4_Err" 3 "DevSts4_Resd";
VAL_ 327 ExtrLtgStsAHL 0 "DevSts4_Off" 1 "DevSts4_On" 2 "DevSts4_Err" 3 "DevSts4_Resd";
VAL_ 327 ExtrLtgStsAllWL 0 "DevSts4_Off" 1 "DevSts4_On" 2 "DevSts4_Err" 3 "DevSts4_Resd";
VAL_ 327 ExtrLtgStsApproach 0 "DevSts4_Off" 1 "DevSts4_On" 2 "DevSts4_Err" 3 "DevSts4_Resd";
VAL_ 327 ExtrLtgStsCornrgLi 0 "DevSts4_Off" 1 "DevSts4_On" 2 "DevSts4_Err" 3 "DevSts4_Resd";
VAL_ 327 ExtrLtgStsDBL 0 "DevSts4_Off" 1 "DevSts4_On" 2 "DevSts4_Err" 3 "DevSts4_Resd";
VAL_ 327 ExtrLtgStsDRL 0 "DevSts4_Off" 1 "DevSts4_On" 2 "DevSts4_Err" 3 "DevSts4_Resd";
VAL_ 327 ExtrLtgStsFlash 0 "DevSts4_Off" 1 "DevSts4_On" 2 "DevSts4_Err" 3 "DevSts4_Resd";
VAL_ 327 ExtrLtgStsFrntFog 0 "DevSts4_Off" 1 "DevSts4_On" 2 "DevSts4_Err" 3 "DevSts4_Resd";
VAL_ 327 ExtrLtgStsGoodbye 0 "DevSts4_Off" 1 "DevSts4_On" 2 "DevSts4_Err" 3 "DevSts4_Resd";
VAL_ 327 ExtrLtgStsHiBeam 0 "DevSts4_Off" 1 "DevSts4_On" 2 "DevSts4_Err" 3 "DevSts4_Resd";
VAL_ 327 ExtrLtgStsHomeSafe 0 "DevSts4_Off" 1 "DevSts4_On" 2 "DevSts4_Err" 3 "DevSts4_Resd";
VAL_ 327 ExtrLtgStsHWL 0 "DevSts4_Off" 1 "DevSts4_On" 2 "DevSts4_Err" 3 "DevSts4_Resd";
VAL_ 327 ExtrLtgStsLoBeam 0 "DevSts4_Off" 1 "DevSts4_On" 2 "DevSts4_Err" 3 "DevSts4_Resd";
VAL_ 327 ExtrLtgStsLtgShow 0 "DevSts4_Off" 1 "DevSts4_On" 2 "DevSts4_Err" 3 "DevSts4_Resd";
VAL_ 327 ExtrLtgStsPosLiFrnt 0 "DevSts4_Off" 1 "DevSts4_On" 2 "DevSts4_Err" 3 "DevSts4_Resd";
VAL_ 327 ExtrLtgStsPosLiRe 0 "DevSts4_Off" 1 "DevSts4_On" 2 "DevSts4_Err" 3 "DevSts4_Resd";
VAL_ 327 ExtrLtgStsReFog 0 "DevSts4_Off" 1 "DevSts4_On" 2 "DevSts4_Err" 3 "DevSts4_Resd";
VAL_ 327 ExtrLtgStsReverseLi 0 "DevSts4_Off" 1 "DevSts4_On" 2 "DevSts4_Err" 3 "DevSts4_Resd";
VAL_ 327 ExtrLtgStsStopLi 0 "DevSts4_Off" 1 "DevSts4_On" 2 "DevSts4_Err" 3 "DevSts4_Resd";
VAL_ 327 ExtrLtgStsTurnIndrLe 0 "DevSts4_Off" 1 "DevSts4_On" 2 "DevSts4_Err" 3 "DevSts4_Resd";
VAL_ 327 ExtrLtgStsTurnIndrRi 0 "DevSts4_Off" 1 "DevSts4_On" 2 "DevSts4_Err" 3 "DevSts4_Resd";
VAL_ 327 ExtrLtgStsWelcome 0 "DevSts4_Off" 1 "DevSts4_On" 2 "DevSts4_Err" 3 "DevSts4_Resd";
VAL_ 327 VehTiAndDataDataValid 0 "NoYes1_No" 1 "NoYes1_Yes";
VAL_ 897 AmbTRawQly 0 "GenQf1_UndefindDataAccur" 1 "GenQf1_TmpUndefdData" 2 "GenQf1_DataAccurNotWithinSpcn" 3 "GenQf1_AccurData";
VAL_ 897 DrvModReq 0 "DrvModReqType1_Undefd" 1 "DrvModReqType1_ECO" 2 "DrvModReqType1_Comfort_Normal" 3 "DrvModReqType1_Dynamic_Sport" 4 "DrvModReqType1_Individual" 5 "DrvModReqType1_Offroad_CrossTerrain" 6 "DrvModReqType1_Adaptive" 7 "DrvModReqType1_Race" 8 "DrvModReqType1_Pure_EV" 9 "DrvModReqType1_Hybrid" 10 "DrvModReqType1_Power" 11 "DrvModReqType1_Snow" 12 "DrvModReqType1_Sand" 13 "DrvModReqType1_Mud" 14 "DrvModReqType1_Rock" 15 "DrvModReqType1_Err";
VAL_ 897 IndcrDisp 0 "IndcrSts1_Off" 1 "IndcrSts1_LeOn" 2 "IndcrSts1_RiOn" 3 "IndcrSts1_LeAndRiOn";
VAL_ 897 LvlgDirMovmtIndcr 0 "TriSt1_NegSt" 1 "TriSt1_StabSt" 2 "TriSt1_PosSt" 3 "TriSt1_NotUsed";
VAL_ 897 SuspPosnVertLe1WithE2EFrntQf 0 "GenQf1_UndefindDataAccur" 1 "GenQf1_TmpUndefdData" 2 "GenQf1_DataAccurNotWithinSpcn" 3 "GenQf1_AccurData";
VAL_ 897 SuspPosnVertLe1WithE2EReQf 0 "GenQf1_UndefindDataAccur" 1 "GenQf1_TmpUndefdData" 2 "GenQf1_DataAccurNotWithinSpcn" 3 "GenQf1_AccurData";
VAL_ 897 SuspPosnVertRi1WithE2EFrntQf 0 "GenQf1_UndefindDataAccur" 1 "GenQf1_TmpUndefdData" 2 "GenQf1_DataAccurNotWithinSpcn" 3 "GenQf1_AccurData";
VAL_ 897 SuspPosnVertRi1WithE2EReQf 0 "GenQf1_UndefindDataAccur" 1 "GenQf1_TmpUndefdData" 2 "GenQf1_DataAccurNotWithinSpcn" 3 "GenQf1_AccurData";
VAL_ 897 VehBattUSysUQf 0 "GenQf1_UndefindDataAccur" 1 "GenQf1_TmpUndefdData" 2 "GenQf1_DataAccurNotWithinSpcn" 3 "GenQf1_AccurData";
VAL_ 897 WipgInfoWipgSpdInfo 0 "WipgSpdInfo_Off" 1 "WipgSpdInfo_IntlLo" 2 "WipgSpdInfo_IntlHi" 3 "WipgSpdInfo_WipgSpd4045" 4 "WipgSpdInfo_WipgSpd4650" 5 "WipgSpdInfo_WipgSpd5155" 6 "WipgSpdInfo_WipgSpd5660" 7 "WipgSpdInfo_WiprErr";
VAL_ 897 WipgInfoWiprActv 0 "OnOff1_Off" 1 "OnOff1_On";
VAL_ 897 WipgInfoWiprInWipgAr 0 "OnOff1_Off" 1 "OnOff1_On";
VAL_ 1007 ReSideRdrLeVehPrmRdrVehPrmRdrDynCalPrmForSnsrDir 0 "YesNo2_No" 1 "YesNo2_Yes";
VAL_ 1007 ReSideRdrLeVehPrmRdrVehPrmRdrDynCalPrmForSnsrOrntn 0 "YesNo2_No" 1 "YesNo2_Yes";
VAL_ 1007 ReSideRdrLeVehPrmRdrVehPrmVld 0 "YesNo2_No" 1 "YesNo2_Yes";
VAL_ 1025 ReSideRdrLe20Obj1RdrObjElevnSts 0 "RdrObjElevnSts_Unknown" 1 "RdrObjElevnSts_OverRidable" 2 "RdrObjElevnSts_Rlv" 3 "RdrObjElevnSts_UnderRidable";
VAL_ 1025 ReSideRdrLe20Obj1RdrObjIsInFreeSpace 0 "YesNo2_No" 1 "YesNo2_Yes";
VAL_ 1025 ReSideRdrLe20Obj1RdrObjMtnPat 0 "RdrObjMtnPat_Ukwn" 1 "RdrObjMtnPat_Staty" 2 "RdrObjMtnPat_StatyFromMovg" 3 "RdrObjMtnPat_Movg" 4 "RdrObjMtnPat_Receding" 5 "RdrObjMtnPat_Oncoming" 6 "RdrObjMtnPat_CrossingFromLe" 7 "RdrObjMtnPat_CrossingFromRi";
VAL_ 1025 ReSideRdrLe20Obj1RdrObjTrackSts 0 "RdrObjTrackSts_Invld" 1 "RdrObjTrackSts_Updated" 2 "RdrObjTrackSts_New" 3 "RdrObjTrackSts_Coasted";
VAL_ 1025 ReSideRdrLe20Obj1RdrObjTyp 0 "RdrObjTyp_Ukwn" 1 "RdrObjTyp_Car" 2 "RdrObjTyp_MotorCycle" 3 "RdrObjTyp_Truck" 4 "RdrObjTyp_Ped" 5 "RdrObjTyp_ObstdVert1" 6 "RdrObjTyp_ObstdVert2" 7 "RdrObjTyp_Anim" 8 "RdrObjTyp_ObjGen" 9 "RdrObjTyp_Bicycle" 10 "RdrObjTyp_VehofUkwnClass" 11 "RdrObjTyp_Reserved";
VAL_ 1025 ReSideRdrLe20Obj1RdrObjUsedTracker 0 "RdrObjUsedTracker_Stationary" 1 "RdrObjUsedTracker_MovingCVModel" 2 "RdrObjUsedTracker_MovingCTModel" 3 "RdrObjUsedTracker_Undefined";
VAL_ 1026 ReSideRdrLe20Obj2RdrObjElevnSts 0 "RdrObjElevnSts_Unknown" 1 "RdrObjElevnSts_OverRidable" 2 "RdrObjElevnSts_Rlv" 3 "RdrObjElevnSts_UnderRidable";
VAL_ 1026 ReSideRdrLe20Obj2RdrObjIsInFreeSpace 0 "YesNo2_No" 1 "YesNo2_Yes";
VAL_ 1026 ReSideRdrLe20Obj2RdrObjMtnPat 0 "RdrObjMtnPat_Ukwn" 1 "RdrObjMtnPat_Staty" 2 "RdrObjMtnPat_StatyFromMovg" 3 "RdrObjMtnPat_Movg" 4 "RdrObjMtnPat_Receding" 5 "RdrObjMtnPat_Oncoming" 6 "RdrObjMtnPat_CrossingFromLe" 7 "RdrObjMtnPat_CrossingFromRi";
VAL_ 1026 ReSideRdrLe20Obj2RdrObjTrackSts 0 "RdrObjTrackSts_Invld" 1 "RdrObjTrackSts_Updated" 2 "RdrObjTrackSts_New" 3 "RdrObjTrackSts_Coasted";
VAL_ 1026 ReSideRdrLe20Obj2RdrObjTyp 0 "RdrObjTyp_Ukwn" 1 "RdrObjTyp_Car" 2 "RdrObjTyp_MotorCycle" 3 "RdrObjTyp_Truck" 4 "RdrObjTyp_Ped" 5 "RdrObjTyp_ObstdVert1" 6 "RdrObjTyp_ObstdVert2" 7 "RdrObjTyp_Anim" 8 "RdrObjTyp_ObjGen" 9 "RdrObjTyp_Bicycle" 10 "RdrObjTyp_VehofUkwnClass" 11 "RdrObjTyp_Reserved";
VAL_ 1026 ReSideRdrLe20Obj2RdrObjUsedTracker 0 "RdrObjUsedTracker_Stationary" 1 "RdrObjUsedTracker_MovingCVModel" 2 "RdrObjUsedTracker_MovingCTModel" 3 "RdrObjUsedTracker_Undefined";
VAL_ 1027 ReSideRdrLe20Obj3RdrObjElevnSts 0 "RdrObjElevnSts_Unknown" 1 "RdrObjElevnSts_OverRidable" 2 "RdrObjElevnSts_Rlv" 3 "RdrObjElevnSts_UnderRidable";
VAL_ 1027 ReSideRdrLe20Obj3RdrObjIsInFreeSpace 0 "YesNo2_No" 1 "YesNo2_Yes";
VAL_ 1027 ReSideRdrLe20Obj3RdrObjMtnPat 0 "RdrObjMtnPat_Ukwn" 1 "RdrObjMtnPat_Staty" 2 "RdrObjMtnPat_StatyFromMovg" 3 "RdrObjMtnPat_Movg" 4 "RdrObjMtnPat_Receding" 5 "RdrObjMtnPat_Oncoming" 6 "RdrObjMtnPat_CrossingFromLe" 7 "RdrObjMtnPat_CrossingFromRi";
VAL_ 1027 ReSideRdrLe20Obj3RdrObjTrackSts 0 "RdrObjTrackSts_Invld" 1 "RdrObjTrackSts_Updated" 2 "RdrObjTrackSts_New" 3 "RdrObjTrackSts_Coasted";
VAL_ 1027 ReSideRdrLe20Obj3RdrObjTyp 0 "RdrObjTyp_Ukwn" 1 "RdrObjTyp_Car" 2 "RdrObjTyp_MotorCycle" 3 "RdrObjTyp_Truck" 4 "RdrObjTyp_Ped" 5 "RdrObjTyp_ObstdVert1" 6 "RdrObjTyp_ObstdVert2" 7 "RdrObjTyp_Anim" 8 "RdrObjTyp_ObjGen" 9 "RdrObjTyp_Bicycle" 10 "RdrObjTyp_VehofUkwnClass" 11 "RdrObjTyp_Reserved";
VAL_ 1027 ReSideRdrLe20Obj3RdrObjUsedTracker 0 "RdrObjUsedTracker_Stationary" 1 "RdrObjUsedTracker_MovingCVModel" 2 "RdrObjUsedTracker_MovingCTModel" 3 "RdrObjUsedTracker_Undefined";
VAL_ 1028 ReSideRdrLe20Obj4RdrObjElevnSts 0 "RdrObjElevnSts_Unknown" 1 "RdrObjElevnSts_OverRidable" 2 "RdrObjElevnSts_Rlv" 3 "RdrObjElevnSts_UnderRidable";
VAL_ 1028 ReSideRdrLe20Obj4RdrObjIsInFreeSpace 0 "YesNo2_No" 1 "YesNo2_Yes";
VAL_ 1028 ReSideRdrLe20Obj4RdrObjMtnPat 0 "RdrObjMtnPat_Ukwn" 1 "RdrObjMtnPat_Staty" 2 "RdrObjMtnPat_StatyFromMovg" 3 "RdrObjMtnPat_Movg" 4 "RdrObjMtnPat_Receding" 5 "RdrObjMtnPat_Oncoming" 6 "RdrObjMtnPat_CrossingFromLe" 7 "RdrObjMtnPat_CrossingFromRi";
VAL_ 1028 ReSideRdrLe20Obj4RdrObjTrackSts 0 "RdrObjTrackSts_Invld" 1 "RdrObjTrackSts_Updated" 2 "RdrObjTrackSts_New" 3 "RdrObjTrackSts_Coasted";
VAL_ 1028 ReSideRdrLe20Obj4RdrObjTyp 0 "RdrObjTyp_Ukwn" 1 "RdrObjTyp_Car" 2 "RdrObjTyp_MotorCycle" 3 "RdrObjTyp_Truck" 4 "RdrObjTyp_Ped" 5 "RdrObjTyp_ObstdVert1" 6 "RdrObjTyp_ObstdVert2" 7 "RdrObjTyp_Anim" 8 "RdrObjTyp_ObjGen" 9 "RdrObjTyp_Bicycle" 10 "RdrObjTyp_VehofUkwnClass" 11 "RdrObjTyp_Reserved";
VAL_ 1028 ReSideRdrLe20Obj4RdrObjUsedTracker 0 "RdrObjUsedTracker_Stationary" 1 "RdrObjUsedTracker_MovingCVModel" 2 "RdrObjUsedTracker_MovingCTModel" 3 "RdrObjUsedTracker_Undefined";
VAL_ 1029 ReSideRdrLe20Obj5RdrObjElevnSts 0 "RdrObjElevnSts_Unknown" 1 "RdrObjElevnSts_OverRidable" 2 "RdrObjElevnSts_Rlv" 3 "RdrObjElevnSts_UnderRidable";
VAL_ 1029 ReSideRdrLe20Obj5RdrObjIsInFreeSpace 0 "YesNo2_No" 1 "YesNo2_Yes";
VAL_ 1029 ReSideRdrLe20Obj5RdrObjMtnPat 0 "RdrObjMtnPat_Ukwn" 1 "RdrObjMtnPat_Staty" 2 "RdrObjMtnPat_StatyFromMovg" 3 "RdrObjMtnPat_Movg" 4 "RdrObjMtnPat_Receding" 5 "RdrObjMtnPat_Oncoming" 6 "RdrObjMtnPat_CrossingFromLe" 7 "RdrObjMtnPat_CrossingFromRi";
VAL_ 1029 ReSideRdrLe20Obj5RdrObjTrackSts 0 "RdrObjTrackSts_Invld" 1 "RdrObjTrackSts_Updated" 2 "RdrObjTrackSts_New" 3 "RdrObjTrackSts_Coasted";
VAL_ 1029 ReSideRdrLe20Obj5RdrObjTyp 0 "RdrObjTyp_Ukwn" 1 "RdrObjTyp_Car" 2 "RdrObjTyp_MotorCycle" 3 "RdrObjTyp_Truck" 4 "RdrObjTyp_Ped" 5 "RdrObjTyp_ObstdVert1" 6 "RdrObjTyp_ObstdVert2" 7 "RdrObjTyp_Anim" 8 "RdrObjTyp_ObjGen" 9 "RdrObjTyp_Bicycle" 10 "RdrObjTyp_VehofUkwnClass" 11 "RdrObjTyp_Reserved";
VAL_ 1029 ReSideRdrLe20Obj5RdrObjUsedTracker 0 "RdrObjUsedTracker_Stationary" 1 "RdrObjUsedTracker_MovingCVModel" 2 "RdrObjUsedTracker_MovingCTModel" 3 "RdrObjUsedTracker_Undefined";
VAL_ 1030 ReSideRdrLe20Obj6RdrObjElevnSts 0 "RdrObjElevnSts_Unknown" 1 "RdrObjElevnSts_OverRidable" 2 "RdrObjElevnSts_Rlv" 3 "RdrObjElevnSts_UnderRidable";
VAL_ 1030 ReSideRdrLe20Obj6RdrObjIsInFreeSpace 0 "YesNo2_No" 1 "YesNo2_Yes";
VAL_ 1030 ReSideRdrLe20Obj6RdrObjMtnPat 0 "RdrObjMtnPat_Ukwn" 1 "RdrObjMtnPat_Staty" 2 "RdrObjMtnPat_StatyFromMovg" 3 "RdrObjMtnPat_Movg" 4 "RdrObjMtnPat_Receding" 5 "RdrObjMtnPat_Oncoming" 6 "RdrObjMtnPat_CrossingFromLe" 7 "RdrObjMtnPat_CrossingFromRi";
VAL_ 1030 ReSideRdrLe20Obj6RdrObjTrackSts 0 "RdrObjTrackSts_Invld" 1 "RdrObjTrackSts_Updated" 2 "RdrObjTrackSts_New" 3 "RdrObjTrackSts_Coasted";
VAL_ 1030 ReSideRdrLe20Obj6RdrObjTyp 0 "RdrObjTyp_Ukwn" 1 "RdrObjTyp_Car" 2 "RdrObjTyp_MotorCycle" 3 "RdrObjTyp_Truck" 4 "RdrObjTyp_Ped" 5 "RdrObjTyp_ObstdVert1" 6 "RdrObjTyp_ObstdVert2" 7 "RdrObjTyp_Anim" 8 "RdrObjTyp_ObjGen" 9 "RdrObjTyp_Bicycle" 10 "RdrObjTyp_VehofUkwnClass" 11 "RdrObjTyp_Reserved";
VAL_ 1030 ReSideRdrLe20Obj6RdrObjUsedTracker 0 "RdrObjUsedTracker_Stationary" 1 "RdrObjUsedTracker_MovingCVModel" 2 "RdrObjUsedTracker_MovingCTModel" 3 "RdrObjUsedTracker_Undefined";
VAL_ 1031 ReSideRdrLe20Obj7RdrObjElevnSts 0 "RdrObjElevnSts_Unknown" 1 "RdrObjElevnSts_OverRidable" 2 "RdrObjElevnSts_Rlv" 3 "RdrObjElevnSts_UnderRidable";
VAL_ 1031 ReSideRdrLe20Obj7RdrObjIsInFreeSpace 0 "YesNo2_No" 1 "YesNo2_Yes";
VAL_ 1031 ReSideRdrLe20Obj7RdrObjMtnPat 0 "RdrObjMtnPat_Ukwn" 1 "RdrObjMtnPat_Staty" 2 "RdrObjMtnPat_StatyFromMovg" 3 "RdrObjMtnPat_Movg" 4 "RdrObjMtnPat_Receding" 5 "RdrObjMtnPat_Oncoming" 6 "RdrObjMtnPat_CrossingFromLe" 7 "RdrObjMtnPat_CrossingFromRi";
VAL_ 1031 ReSideRdrLe20Obj7RdrObjTrackSts 0 "RdrObjTrackSts_Invld" 1 "RdrObjTrackSts_Updated" 2 "RdrObjTrackSts_New" 3 "RdrObjTrackSts_Coasted";
VAL_ 1031 ReSideRdrLe20Obj7RdrObjTyp 0 "RdrObjTyp_Ukwn" 1 "RdrObjTyp_Car" 2 "RdrObjTyp_MotorCycle" 3 "RdrObjTyp_Truck" 4 "RdrObjTyp_Ped" 5 "RdrObjTyp_ObstdVert1" 6 "RdrObjTyp_ObstdVert2" 7 "RdrObjTyp_Anim" 8 "RdrObjTyp_ObjGen" 9 "RdrObjTyp_Bicycle" 10 "RdrObjTyp_VehofUkwnClass" 11 "RdrObjTyp_Reserved";
VAL_ 1031 ReSideRdrLe20Obj7RdrObjUsedTracker 0 "RdrObjUsedTracker_Stationary" 1 "RdrObjUsedTracker_MovingCVModel" 2 "RdrObjUsedTracker_MovingCTModel" 3 "RdrObjUsedTracker_Undefined";
SIG_GROUP_ 357 AbsCtrlActv 1 : AbsCtrlActvChks AbsCtrlActvCntr AbsCtrlActvCtrlSts1;
SIG_GROUP_ 401 ADataRawSafe 1 : ADataRawSafeALat ADataRawSafeALat1Qf ADataRawSafeALgt ADataRawSafeALgt1Qf ADataRawSafeAVert ADataRawSafeAVertQf ADataRawSafeChks ADataRawSafeCntr;
SIG_GROUP_ 401 AgDataRawSafe 1 : AgDataRawSafeChks AgDataRawSafeCntr AgDataRawSafeRollRate AgDataRawSafeRollRateQf AgDataRawSafeYawRate AgDataRawSafeYawRateQf;
SIG_GROUP_ 357 ALgtStdFromWhlSpd 1 : ALgtStdFromWhlSpdALgtStdFromWhlSpd ALgtStdFromWhlSpdChks ALgtStdFromWhlSpdCntr ALgtStdFromWhlSpdQf;
SIG_GROUP_ 897 AmbTRaw 1 : AmbTRawAmbTVal AmbTRawQly;
SIG_GROUP_ 357 AsyDataWithCmpSafe 1 : AsyDataWithCmpSafeALat1Qf AsyDataWithCmpSafeALatWithCmp AsyDataWithCmpSafeALgt1Qf AsyDataWithCmpSafeChks AsyDataWithCmpSafeCntr AsyDataWithCmpSafeGrdtOfALgt AsyDataWithCmpSafeYawRateQf AsyDataWithCmpSafeYawRateWithCmp;
SIG_GROUP_ 401 BltLockStAtDrvr 1 : BltLockStAtDrvrBltLockSt1 BltLockStAtDrvrBltLockSts;
SIG_GROUP_ 337 BrkPedlTrvl 1 : BrkPedlTrvlAct BrkPedlTrvlChks BrkPedlTrvlCntr BrkPedlTrvlQf BrkPedlTrvlSt BrkPedlTrvlStQf BrkPedlTrvlTar;
SIG_GROUP_ 357 BrkSysCylPMst 1 : BrkSysCylPMstAct BrkSysCylPMstActQf BrkSysCylPMstChks BrkSysCylPMstCntr BrkSysCylPMstTar BrkSysCylPMstVirt BrkSysCylPMstVirtQf;
SIG_GROUP_ 357 EpbSts 1 : EpbStsChks EpbStsCntr EpbStsEpbSts;
SIG_GROUP_ 357 EscSt 1 : EscStChks EscStCntr EscStEscSt;
SIG_GROUP_ 327 ExtrLtgSts 1 : ExtrLtgStsAFS ExtrLtgStsAHBC ExtrLtgStsAHL ExtrLtgStsAllWL ExtrLtgStsApproach ExtrLtgStsChks ExtrLtgStsCntr ExtrLtgStsCornrgLi ExtrLtgStsDBL ExtrLtgStsDRL ExtrLtgStsFlash ExtrLtgStsFrntFog ExtrLtgStsGoodbye ExtrLtgStsHiBeam ExtrLtgStsHomeSafe ExtrLtgStsHWL ExtrLtgStsLoBeam ExtrLtgStsLtgShow ExtrLtgStsPosLiFrnt ExtrLtgStsPosLiRe ExtrLtgStsReFog ExtrLtgStsReverseLi ExtrLtgStsStopLi ExtrLtgStsTurnIndrLe ExtrLtgStsTurnIndrRi ExtrLtgStsWelcome;
SIG_GROUP_ 357 PinionSteerAgGroup 1 : PinionSteerAgGroupChks PinionSteerAgGroupCntr PinionSteerAgGroupPinionSteerAg1 PinionSteerAgGroupPinionSteerAg1Qf PinionSteerAgGroupPinionSteerAgSpd1 PinionSteerAgGroupPinionSteerAgSpd1Qf PinionSteerAgGroupSteerWhlTq PinionSteerAgGroupSteerWhlTqQf;
SIG_GROUP_ 1025 ReSideRdrLe20Obj1 1 : ReSideRdrLe20Obj1Heading ReSideRdrLe20Obj1ObjBoxCenterLat ReSideRdrLe20Obj1ObjBoxCenterLgt ReSideRdrLe20Obj1ObservationHist ReSideRdrLe20Obj1QualityBits ReSideRdrLe20Obj1RdrObjAx ReSideRdrLe20Obj1RdrObjAy ReSideRdrLe20Obj1RdrObjBoxLength ReSideRdrLe20Obj1RdrObjBoxWidth ReSideRdrLe20Obj1RdrObjChks ReSideRdrLe20Obj1RdrObjCntr ReSideRdrLe20Obj1RdrObjCoastCnt ReSideRdrLe20Obj1RdrObjConf ReSideRdrLe20Obj1RdrObjDx ReSideRdrLe20Obj1RdrObjDxStdDe ReSideRdrLe20Obj1RdrObjDy ReSideRdrLe20Obj1RdrObjDyStdDe ReSideRdrLe20Obj1RdrObjElevnConf ReSideRdrLe20Obj1RdrObjElevnSts ReSideRdrLe20Obj1RdrObjID ReSideRdrLe20Obj1RdrObjIsInFreeSpace ReSideRdrLe20Obj1RdrObjMirrProblty ReSideRdrLe20Obj1RdrObjMtnPat ReSideRdrLe20Obj1RdrObjNotRealProblty ReSideRdrLe20Obj1RdrObjStatyCnt ReSideRdrLe20Obj1RdrObjTiAlv ReSideRdrLe20Obj1RdrObjTrackSts ReSideRdrLe20Obj1RdrObjTyp ReSideRdrLe20Obj1RdrObjTypConfBike ReSideRdrLe20Obj1RdrObjTypConfPed ReSideRdrLe20Obj1RdrObjTypConfVeh ReSideRdrLe20Obj1RdrObjUsedTracker ReSideRdrLe20Obj1RdrObjVx ReSideRdrLe20Obj1RdrObjVxStdDe ReSideRdrLe20Obj1RdrObjVy ReSideRdrLe20Obj1RdrObjVyStdDe ReSideRdrLe20Obj1RelVx ReSideRdrLe20Obj1RelVy;
SIG_GROUP_ 1026 ReSideRdrLe20Obj2 1 : ReSideRdrLe20Obj2Heading ReSideRdrLe20Obj2ObjBoxCenterLat ReSideRdrLe20Obj2ObjBoxCenterLgt ReSideRdrLe20Obj2ObservationHist ReSideRdrLe20Obj2QualityBits ReSideRdrLe20Obj2RdrObjAx ReSideRdrLe20Obj2RdrObjAy ReSideRdrLe20Obj2RdrObjBoxLength ReSideRdrLe20Obj2RdrObjBoxWidth ReSideRdrLe20Obj2RdrObjChks ReSideRdrLe20Obj2RdrObjCntr ReSideRdrLe20Obj2RdrObjCoastCnt ReSideRdrLe20Obj2RdrObjConf ReSideRdrLe20Obj2RdrObjDx ReSideRdrLe20Obj2RdrObjDxStdDe ReSideRdrLe20Obj2RdrObjDy ReSideRdrLe20Obj2RdrObjDyStdDe ReSideRdrLe20Obj2RdrObjElevnConf ReSideRdrLe20Obj2RdrObjElevnSts ReSideRdrLe20Obj2RdrObjID ReSideRdrLe20Obj2RdrObjIsInFreeSpace ReSideRdrLe20Obj2RdrObjMirrProblty ReSideRdrLe20Obj2RdrObjMtnPat ReSideRdrLe20Obj2RdrObjNotRealProblty ReSideRdrLe20Obj2RdrObjStatyCnt ReSideRdrLe20Obj2RdrObjTiAlv ReSideRdrLe20Obj2RdrObjTrackSts ReSideRdrLe20Obj2RdrObjTyp ReSideRdrLe20Obj2RdrObjTypConfBike ReSideRdrLe20Obj2RdrObjTypConfPed ReSideRdrLe20Obj2RdrObjTypConfVeh ReSideRdrLe20Obj2RdrObjUsedTracker ReSideRdrLe20Obj2RdrObjVx ReSideRdrLe20Obj2RdrObjVxStdDe ReSideRdrLe20Obj2RdrObjVy ReSideRdrLe20Obj2RdrObjVyStdDe ReSideRdrLe20Obj2RelVx ReSideRdrLe20Obj2RelVy;
SIG_GROUP_ 1027 ReSideRdrLe20Obj3 1 : ReSideRdrLe20Obj3Heading ReSideRdrLe20Obj3ObjBoxCenterLat ReSideRdrLe20Obj3ObjBoxCenterLgt ReSideRdrLe20Obj3ObservationHist ReSideRdrLe20Obj3QualityBits ReSideRdrLe20Obj3RdrObjAx ReSideRdrLe20Obj3RdrObjAy ReSideRdrLe20Obj3RdrObjBoxLength ReSideRdrLe20Obj3RdrObjBoxWidth ReSideRdrLe20Obj3RdrObjChks ReSideRdrLe20Obj3RdrObjCntr ReSideRdrLe20Obj3RdrObjCoastCnt ReSideRdrLe20Obj3RdrObjConf ReSideRdrLe20Obj3RdrObjDx ReSideRdrLe20Obj3RdrObjDxStdDe ReSideRdrLe20Obj3RdrObjDy ReSideRdrLe20Obj3RdrObjDyStdDe ReSideRdrLe20Obj3RdrObjElevnConf ReSideRdrLe20Obj3RdrObjElevnSts ReSideRdrLe20Obj3RdrObjID ReSideRdrLe20Obj3RdrObjIsInFreeSpace ReSideRdrLe20Obj3RdrObjMirrProblty ReSideRdrLe20Obj3RdrObjMtnPat ReSideRdrLe20Obj3RdrObjNotRealProblty ReSideRdrLe20Obj3RdrObjStatyCnt ReSideRdrLe20Obj3RdrObjTiAlv ReSideRdrLe20Obj3RdrObjTrackSts ReSideRdrLe20Obj3RdrObjTyp ReSideRdrLe20Obj3RdrObjTypConfBike ReSideRdrLe20Obj3RdrObjTypConfPed ReSideRdrLe20Obj3RdrObjTypConfVeh ReSideRdrLe20Obj3RdrObjUsedTracker ReSideRdrLe20Obj3RdrObjVx ReSideRdrLe20Obj3RdrObjVxStdDe ReSideRdrLe20Obj3RdrObjVy ReSideRdrLe20Obj3RdrObjVyStdDe ReSideRdrLe20Obj3RelVx ReSideRdrLe20Obj3RelVy;
SIG_GROUP_ 1028 ReSideRdrLe20Obj4 1 : ReSideRdrLe20Obj4Heading ReSideRdrLe20Obj4ObjBoxCenterLat ReSideRdrLe20Obj4ObjBoxCenterLgt ReSideRdrLe20Obj4ObservationHist ReSideRdrLe20Obj4QualityBits ReSideRdrLe20Obj4RdrObjAx ReSideRdrLe20Obj4RdrObjAy ReSideRdrLe20Obj4RdrObjBoxLength ReSideRdrLe20Obj4RdrObjBoxWidth ReSideRdrLe20Obj4RdrObjChks ReSideRdrLe20Obj4RdrObjCntr ReSideRdrLe20Obj4RdrObjCoastCnt ReSideRdrLe20Obj4RdrObjConf ReSideRdrLe20Obj4RdrObjDx ReSideRdrLe20Obj4RdrObjDxStdDe ReSideRdrLe20Obj4RdrObjDy ReSideRdrLe20Obj4RdrObjDyStdDe ReSideRdrLe20Obj4RdrObjElevnConf ReSideRdrLe20Obj4RdrObjElevnSts ReSideRdrLe20Obj4RdrObjID ReSideRdrLe20Obj4RdrObjIsInFreeSpace ReSideRdrLe20Obj4RdrObjMirrProblty ReSideRdrLe20Obj4RdrObjMtnPat ReSideRdrLe20Obj4RdrObjNotRealProblty ReSideRdrLe20Obj4RdrObjStatyCnt ReSideRdrLe20Obj4RdrObjTiAlv ReSideRdrLe20Obj4RdrObjTrackSts ReSideRdrLe20Obj4RdrObjTyp ReSideRdrLe20Obj4RdrObjTypConfBike ReSideRdrLe20Obj4RdrObjTypConfPed ReSideRdrLe20Obj4RdrObjTypConfVeh ReSideRdrLe20Obj4RdrObjUsedTracker ReSideRdrLe20Obj4RdrObjVx ReSideRdrLe20Obj4RdrObjVxStdDe ReSideRdrLe20Obj4RdrObjVy ReSideRdrLe20Obj4RdrObjVyStdDe ReSideRdrLe20Obj4RelVx ReSideRdrLe20Obj4RelVy;
SIG_GROUP_ 1029 ReSideRdrLe20Obj5 1 : ReSideRdrLe20Obj5Heading ReSideRdrLe20Obj5ObjBoxCenterLat ReSideRdrLe20Obj5ObjBoxCenterLgt ReSideRdrLe20Obj5ObservationHist ReSideRdrLe20Obj5QualityBits ReSideRdrLe20Obj5RdrObjAx ReSideRdrLe20Obj5RdrObjAy ReSideRdrLe20Obj5RdrObjBoxLength ReSideRdrLe20Obj5RdrObjBoxWidth ReSideRdrLe20Obj5RdrObjChks ReSideRdrLe20Obj5RdrObjCntr ReSideRdrLe20Obj5RdrObjCoastCnt ReSideRdrLe20Obj5RdrObjConf ReSideRdrLe20Obj5RdrObjDx ReSideRdrLe20Obj5RdrObjDxStdDe ReSideRdrLe20Obj5RdrObjDy ReSideRdrLe20Obj5RdrObjDyStdDe ReSideRdrLe20Obj5RdrObjElevnConf ReSideRdrLe20Obj5RdrObjElevnSts ReSideRdrLe20Obj5RdrObjID ReSideRdrLe20Obj5RdrObjIsInFreeSpace ReSideRdrLe20Obj5RdrObjMirrProblty ReSideRdrLe20Obj5RdrObjMtnPat ReSideRdrLe20Obj5RdrObjNotRealProblty ReSideRdrLe20Obj5RdrObjStatyCnt ReSideRdrLe20Obj5RdrObjTiAlv ReSideRdrLe20Obj5RdrObjTrackSts ReSideRdrLe20Obj5RdrObjTyp ReSideRdrLe20Obj5RdrObjTypConfBike ReSideRdrLe20Obj5RdrObjTypConfPed ReSideRdrLe20Obj5RdrObjTypConfVeh ReSideRdrLe20Obj5RdrObjUsedTracker ReSideRdrLe20Obj5RdrObjVx ReSideRdrLe20Obj5RdrObjVxStdDe ReSideRdrLe20Obj5RdrObjVy ReSideRdrLe20Obj5RdrObjVyStdDe ReSideRdrLe20Obj5RelVx ReSideRdrLe20Obj5RelVy;
SIG_GROUP_ 1030 ReSideRdrLe20Obj6 1 : ReSideRdrLe20Obj6Heading ReSideRdrLe20Obj6ObjBoxCenterLat ReSideRdrLe20Obj6ObjBoxCenterLgt ReSideRdrLe20Obj6ObservationHist ReSideRdrLe20Obj6QualityBits ReSideRdrLe20Obj6RdrObjAx ReSideRdrLe20Obj6RdrObjAy ReSideRdrLe20Obj6RdrObjBoxLength ReSideRdrLe20Obj6RdrObjBoxWidth ReSideRdrLe20Obj6RdrObjChks ReSideRdrLe20Obj6RdrObjCntr ReSideRdrLe20Obj6RdrObjCoastCnt ReSideRdrLe20Obj6RdrObjConf ReSideRdrLe20Obj6RdrObjDx ReSideRdrLe20Obj6RdrObjDxStdDe ReSideRdrLe20Obj6RdrObjDy ReSideRdrLe20Obj6RdrObjDyStdDe ReSideRdrLe20Obj6RdrObjElevnConf ReSideRdrLe20Obj6RdrObjElevnSts ReSideRdrLe20Obj6RdrObjID ReSideRdrLe20Obj6RdrObjIsInFreeSpace ReSideRdrLe20Obj6RdrObjMirrProblty ReSideRdrLe20Obj6RdrObjMtnPat ReSideRdrLe20Obj6RdrObjNotRealProblty ReSideRdrLe20Obj6RdrObjStatyCnt ReSideRdrLe20Obj6RdrObjTiAlv ReSideRdrLe20Obj6RdrObjTrackSts ReSideRdrLe20Obj6RdrObjTyp ReSideRdrLe20Obj6RdrObjTypConfBike ReSideRdrLe20Obj6RdrObjTypConfPed ReSideRdrLe20Obj6RdrObjTypConfVeh ReSideRdrLe20Obj6RdrObjUsedTracker ReSideRdrLe20Obj6RdrObjVx ReSideRdrLe20Obj6RdrObjVxStdDe ReSideRdrLe20Obj6RdrObjVy ReSideRdrLe20Obj6RdrObjVyStdDe ReSideRdrLe20Obj6RelVx ReSideRdrLe20Obj6RelVy;
SIG_GROUP_ 1031 ReSideRdrLe20Obj7 1 : ReSideRdrLe20Obj7Heading ReSideRdrLe20Obj7ObjBoxCenterLat ReSideRdrLe20Obj7ObjBoxCenterLgt ReSideRdrLe20Obj7ObservationHist ReSideRdrLe20Obj7QualityBits ReSideRdrLe20Obj7RdrObjAx ReSideRdrLe20Obj7RdrObjAy ReSideRdrLe20Obj7RdrObjBoxLength ReSideRdrLe20Obj7RdrObjBoxWidth ReSideRdrLe20Obj7RdrObjChks ReSideRdrLe20Obj7RdrObjCntr ReSideRdrLe20Obj7RdrObjCoastCnt ReSideRdrLe20Obj7RdrObjConf ReSideRdrLe20Obj7RdrObjDx ReSideRdrLe20Obj7RdrObjDxStdDe ReSideRdrLe20Obj7RdrObjDy ReSideRdrLe20Obj7RdrObjDyStdDe ReSideRdrLe20Obj7RdrObjElevnConf ReSideRdrLe20Obj7RdrObjElevnSts ReSideRdrLe20Obj7RdrObjID ReSideRdrLe20Obj7RdrObjIsInFreeSpace ReSideRdrLe20Obj7RdrObjMirrProblty ReSideRdrLe20Obj7RdrObjMtnPat ReSideRdrLe20Obj7RdrObjNotRealProblty ReSideRdrLe20Obj7RdrObjStatyCnt ReSideRdrLe20Obj7RdrObjTiAlv ReSideRdrLe20Obj7RdrObjTrackSts ReSideRdrLe20Obj7RdrObjTyp ReSideRdrLe20Obj7RdrObjTypConfBike ReSideRdrLe20Obj7RdrObjTypConfPed ReSideRdrLe20Obj7RdrObjTypConfVeh ReSideRdrLe20Obj7RdrObjUsedTracker ReSideRdrLe20Obj7RdrObjVx ReSideRdrLe20Obj7RdrObjVxStdDe ReSideRdrLe20Obj7RdrObjVy ReSideRdrLe20Obj7RdrObjVyStdDe ReSideRdrLe20Obj7RelVx ReSideRdrLe20Obj7RelVy;
SIG_GROUP_ 1007 ReSideRdrLeVehPrm 1 : ReSideRdrLeVehPrmRdrVehPrmChks ReSideRdrLeVehPrmRdrVehPrmCntr ReSideRdrLeVehPrmRdrVehPrmRdrDynCalPrmForAgOffs ReSideRdrLeVehPrmRdrVehPrmRdrDynCalPrmForAxleDstReToVehFrnt ReSideRdrLeVehPrmRdrVehPrmRdrDynCalPrmForPinoinAgRat ReSideRdrLeVehPrmRdrVehPrmRdrDynCalPrmForRollAgGain ReSideRdrLeVehPrmRdrVehPrmRdrDynCalPrmForSnsrDir ReSideRdrLeVehPrmRdrVehPrmRdrDynCalPrmForSnsrOrntn ReSideRdrLeVehPrmRdrVehPrmRdrDynCalPrmForSnsrPosnLat ReSideRdrLeVehPrmRdrVehPrmRdrDynCalPrmForSnsrPosnLgt ReSideRdrLeVehPrmRdrVehPrmRdrDynCalPrmForSnsrPosnVert ReSideRdrLeVehPrmRdrVehPrmRdrDynCalPrmForSnsrRot1 ReSideRdrLeVehPrmRdrVehPrmRdrDynCalPrmForVehLen ReSideRdrLeVehPrmRdrVehPrmRdrDynCalPrmForVehTyp ReSideRdrLeVehPrmRdrVehPrmRdrDynCalPrmForVehWidth ReSideRdrLeVehPrmRdrVehPrmRdrDynCalPrmForVersMajor ReSideRdrLeVehPrmRdrVehPrmRdrDynCalPrmForVersMinor ReSideRdrLeVehPrmRdrVehPrmRdrDynCalPrmForWhlBas ReSideRdrLeVehPrmRdrVehPrmVld;
SIG_GROUP_ 325 StandStillMgrStsForHld 1 : StandStillMgrStsForHld1 StandStillMgrStsForHldChks StandStillMgrStsForHldCntr;
SIG_GROUP_ 325 SteerWhlSnsr 1 : SteerWhlSnsrAg SteerWhlSnsrAgSpd SteerWhlSnsrChks SteerWhlSnsrCntr SteerWhlSnsrQf;
SIG_GROUP_ 897 SuspPosnVertLe1WithE2E 1 : SuspPosnVertLe1WithE2EChks SuspPosnVertLe1WithE2ECntr SuspPosnVertLe1WithE2EFrnt SuspPosnVertLe1WithE2EFrntQf SuspPosnVertLe1WithE2ERe SuspPosnVertLe1WithE2EReQf;
SIG_GROUP_ 897 SuspPosnVertRi1WithE2E 1 : SuspPosnVertRi1WithE2EChks SuspPosnVertRi1WithE2ECntr SuspPosnVertRi1WithE2EFrnt SuspPosnVertRi1WithE2EFrntQf SuspPosnVertRi1WithE2ERe SuspPosnVertRi1WithE2EReQf;
SIG_GROUP_ 325 TiAndDateIndcn 1 : TiAndDateIndcnDataValid TiAndDateIndcnDay TiAndDateIndcnHr1 TiAndDateIndcnMins1 TiAndDateIndcnMth1 TiAndDateIndcnSec1 TiAndDateIndcnYr1;
SIG_GROUP_ 897 VehBattU 1 : VehBattUSysU VehBattUSysUQf;
SIG_GROUP_ 357 VehModMngtGlbSafe1 1 : VehModMngtGlbSafe1CarModSts1 VehModMngtGlbSafe1CarModSubtypWdCarModSubtyp VehModMngtGlbSafe1Chks VehModMngtGlbSafe1Cntr VehModMngtGlbSafe1EgyLvlElecMai VehModMngtGlbSafe1EgyLvlElecSubtyp VehModMngtGlbSafe1FltEgyCnsWdSts VehModMngtGlbSafe1PwrLvlElecMai VehModMngtGlbSafe1PwrLvlElecSubtyp VehModMngtGlbSafe1UsgModSts;
SIG_GROUP_ 357 VehMtnSt 1 : VehMtnStChks VehMtnStCntr VehMtnStVehMtnSt;
SIG_GROUP_ 325 VehSpdLgt 1 : VehSpdLgtA VehSpdLgtChks VehSpdLgtCntr VehSpdLgtQf;
SIG_GROUP_ 327 VehTiAndData 1 : VehTiAndDataDataValid VehTiAndDataDay VehTiAndDataHr1 VehTiAndDataMins1 VehTiAndDataMth1 VehTiAndDataSec1 VehTiAndDataYr1;
SIG_GROUP_ 2 Vin 1 : VinBlockNr VinVINSignalPos1 VinVINSignalPos2 VinVINSignalPos3 VinVINSignalPos4 VinVINSignalPos5 VinVINSignalPos6 VinVINSignalPos7;
SIG_GROUP_ 357 WhlDirRotlFrnt 1 : WhlDirRotlFrntChks WhlDirRotlFrntCntr WhlDirRotlFrntLe WhlDirRotlFrntRi;
SIG_GROUP_ 337 WhlDirRotlFrntForBkp 1 : WhlDirRotlFrntForBkpChks WhlDirRotlFrntForBkpCntr WhlDirRotlFrntForBkpLe WhlDirRotlFrntForBkpRi;
SIG_GROUP_ 357 WhlDirRotlRe 1 : WhlDirRotlReChks WhlDirRotlReCntr WhlDirRotlReLe WhlDirRotlReRi;
SIG_GROUP_ 337 WhlDirRotlReForBkp 1 : WhlDirRotlReForBkpChks WhlDirRotlReForBkpCntr WhlDirRotlReForBkpLe WhlDirRotlReForBkpRi;
SIG_GROUP_ 357 WhlSpdCircumlFrnt 1 : WhlSpdCircumlFrntChks WhlSpdCircumlFrntCntr WhlSpdCircumlFrntLe WhlSpdCircumlFrntLeQf WhlSpdCircumlFrntRiQf WhlSpdCircumlFrntWhlSpdCircumlFrntRi;
SIG_GROUP_ 337 WhlSpdCircumlFrntForBkp 1 : WhlSpdCircumlFrntForBkpWhlSpdCircumlFrntChks WhlSpdCircumlFrntForBkpWhlSpdCircumlFrntCntr WhlSpdCircumlFrntForBkpWhlSpdCircumlFrntLe WhlSpdCircumlFrntForBkpWhlSpdCircumlFrntLeQf WhlSpdCircumlFrntForBkpWhlSpdCircumlFrntRiQf WhlSpdCircumlFrntForBkpWhlSpdCircumlFrntWhlSpdCircumlFrntRi;
SIG_GROUP_ 357 WhlSpdCircumlRe 1 : WhlSpdCircumlReChks WhlSpdCircumlReCntr WhlSpdCircumlReLe WhlSpdCircumlReLeQf WhlSpdCircumlReRi WhlSpdCircumlReRiQf;
SIG_GROUP_ 337 WhlSpdCircumlReForBkp 1 : WhlSpdCircumlReForBkpWhlSpdCircumlReChks WhlSpdCircumlReForBkpWhlSpdCircumlReCntr WhlSpdCircumlReForBkpWhlSpdCircumlReLe WhlSpdCircumlReForBkpWhlSpdCircumlReLeQf WhlSpdCircumlReForBkpWhlSpdCircumlReRi WhlSpdCircumlReForBkpWhlSpdCircumlReRiQf;
SIG_GROUP_ 897 WipgInfo 1 : WipgInfoWipgSpdInfo WipgInfoWiprActv WipgInfoWiprInWipgAr;
