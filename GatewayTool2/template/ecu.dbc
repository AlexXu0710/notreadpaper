// *************************************************************************** *
// *                                                                           *
// * Description:         CANDB File                                           *
// * Generated at:        2023-03-30 16:08                                     *
// * System:              ZSDB123101                                           *
// * Variant:             CS1E                                                 *
// * Network:             Private_CANFD5                                       *
// *                                                                           *
// *************************************************************************** *
VERSION "Private_CANFD5"

NS_ :

BS_ :

BU_ :  ASDM SODL

BO_ 1056 SODLPrivateCANFD5Fr20 : 64 SODL
 SG_ ReSideRdrLe20Obj20_UB : 298|1@0+ (1,0) [0|1] "" ASDM
 SG_ ReSideRdrLe20Obj20Heading : 39|12@0+ (0.1,-180.0) [-180.0|180.0] "Deg" ASDM
 SG_ ReSideRdrLe20Obj20ObjBoxCenterLat : 111|9@0+ (0.1,-25.0) [-25.0|25.0] "m" ASDM
 SG_ ReSideRdrLe20Obj20ObjBoxCenterLgt : 23|9@0+ (0.1,-25.0) [-25.0|25.0] "m" ASDM
 SG_ ReSideRdrLe20Obj20ObservationHist : 79|32@0+ (1.0,0.0) [0.0|4294967295.0] "Unitless" ASDM
 SG_ ReSideRdrLe20Obj20QualityBits : 127|18@0+ (1.0,0.0) [0.0|262143.0] "Unitless" ASDM
 SG_ ReSideRdrLe20Obj20RdrObjAx : 55|8@0- (0.1,0.0) [-12.8|12.700000000000001] "m/s^2" ASDM
 SG_ ReSideRdrLe20Obj20RdrObjAy : 63|8@0- (0.1,0.0) [-12.8|12.700000000000001] "m/s^2" ASDM
 SG_ ReSideRdrLe20Obj20RdrObjBoxLength : 151|9@0+ (0.1,0.0) [0.0|50.0] "m" ASDM
 SG_ ReSideRdrLe20Obj20RdrObjBoxWidth : 279|9@0+ (0.1,0.0) [0.0|50.0] "m" ASDM
 SG_ ReSideRdrLe20Obj20RdrObjChks : 7|8@0+ (1.0,0.0) [0.0|255.0] "Unitless" ASDM
 SG_ ReSideRdrLe20Obj20RdrObjCntr : 15|4@0+ (1.0,0.0) [0.0|15.0] "Unitless" ASDM
 SG_ ReSideRdrLe20Obj20RdrObjCoastCnt : 158|5@0+ (1.0,0.0) [0.0|31.0] "Unitless" ASDM
 SG_ ReSideRdrLe20Obj20RdrObjConf : 11|4@0+ (7.0,0.0) [0.0|105.0] "%" ASDM
 SG_ ReSideRdrLe20Obj20RdrObjDx : 207|13@0+ (0.05,-200.0) [-200.0|200.0] "m" ASDM
 SG_ ReSideRdrLe20Obj20RdrObjDxStdDe : 71|8@0+ (0.05,0.0) [0.0|12.700000000000001] "m" ASDM
 SG_ ReSideRdrLe20Obj20RdrObjDy : 295|13@0+ (0.05,-200.0) [-200.0|200.0] "m" ASDM
 SG_ ReSideRdrLe20Obj20RdrObjDyStdDe : 167|8@0+ (0.05,0.0) [0.0|12.700000000000001] "m" ASDM
 SG_ ReSideRdrLe20Obj20RdrObjElevnConf : 43|4@0+ (7.0,0.0) [0.0|105.0] "%" ASDM
 SG_ ReSideRdrLe20Obj20RdrObjElevnSts : 153|2@0+ (1,0) [0|3] "" ASDM
 SG_ ReSideRdrLe20Obj20RdrObjID : 223|8@0+ (1.0,0.0) [0.0|255.0] "Unitless" ASDM
 SG_ ReSideRdrLe20Obj20RdrObjIsInFreeSpace : 280|1@0+ (1,0) [0|1] "" ASDM
 SG_ ReSideRdrLe20Obj20RdrObjMirrProblty : 263|4@0+ (7.0,0.0) [0.0|105.0] "%" ASDM
 SG_ ReSideRdrLe20Obj20RdrObjMtnPat : 210|3@0+ (1,0) [0|7] "" ASDM
 SG_ ReSideRdrLe20Obj20RdrObjNotRealProblty : 259|4@0+ (7.0,0.0) [0.0|105.0] "%" ASDM
 SG_ ReSideRdrLe20Obj20RdrObjStatyCnt : 30|7@0+ (1.0,0.0) [0.0|127.0] "Unitless" ASDM
 SG_ ReSideRdrLe20Obj20RdrObjTiAlv : 118|7@0+ (1.0,0.0) [0.0|127.0] "Unitless" ASDM
 SG_ ReSideRdrLe20Obj20RdrObjTrackSts : 177|2@0+ (1,0) [0|3] "" ASDM
 SG_ ReSideRdrLe20Obj20RdrObjTyp : 235|4@0+ (1,0) [0|15] "" ASDM
 SG_ ReSideRdrLe20Obj20RdrObjTypConfBike : 251|4@0+ (7.0,0.0) [0.0|105.0] "%" ASDM
 SG_ ReSideRdrLe20Obj20RdrObjTypConfPed : 271|4@0+ (7.0,0.0) [0.0|105.0] "%" ASDM
 SG_ ReSideRdrLe20Obj20RdrObjTypConfVeh : 267|4@0+ (7.0,0.0) [0.0|105.0] "%" ASDM
 SG_ ReSideRdrLe20Obj20RdrObjUsedTracker : 193|2@0+ (1,0) [0|3] "" ASDM
 SG_ ReSideRdrLe20Obj20RdrObjVx : 175|14@0+ (0.02,-128.0) [-128.0|128.0] "m/s" ASDM
 SG_ ReSideRdrLe20Obj20RdrObjVxStdDe : 141|6@0+ (0.05,0.0) [0.0|2.0] "m/s" ASDM
 SG_ ReSideRdrLe20Obj20RdrObjVy : 191|14@0+ (0.02,-128.0) [-128.0|128.0] "m/s" ASDM
 SG_ ReSideRdrLe20Obj20RdrObjVyStdDe : 286|6@0+ (0.05,0.0) [0.0|2.0] "m/s" ASDM
 SG_ ReSideRdrLe20Obj20RelVx : 231|12@0+ (0.02,-35.6) [-35.6|35.6] "m/s" ASDM
 SG_ ReSideRdrLe20Obj20RelVy : 247|12@0+ (0.02,-35.6) [-35.6|35.6] "m/s" ASDM

BO_ 1057 SODLPrivateCANFD5Fr21 : 64 SODL
 SG_ ReSideRdrLe20Obj21_UB : 298|1@0+ (1,0) [0|1] "" ASDM
 SG_ ReSideRdrLe20Obj21Heading : 39|12@0+ (0.1,-180.0) [-180.0|180.0] "Deg" ASDM
 SG_ ReSideRdrLe20Obj21ObjBoxCenterLat : 111|9@0+ (0.1,-25.0) [-25.0|25.0] "m" ASDM
 SG_ ReSideRdrLe20Obj21ObjBoxCenterLgt : 23|9@0+ (0.1,-25.0) [-25.0|25.0] "m" ASDM
 SG_ ReSideRdrLe20Obj21ObservationHist : 79|32@0+ (1.0,0.0) [0.0|4294967295.0] "Unitless" ASDM
 SG_ ReSideRdrLe20Obj21QualityBits : 127|18@0+ (1.0,0.0) [0.0|262143.0] "Unitless" ASDM
 SG_ ReSideRdrLe20Obj21RdrObjAx : 55|8@0- (0.1,0.0) [-12.8|12.700000000000001] "m/s^2" ASDM
 SG_ ReSideRdrLe20Obj21RdrObjAy : 63|8@0- (0.1,0.0) [-12.8|12.700000000000001] "m/s^2" ASDM
 SG_ ReSideRdrLe20Obj21RdrObjBoxLength : 151|9@0+ (0.1,0.0) [0.0|50.0] "m" ASDM
 SG_ ReSideRdrLe20Obj21RdrObjBoxWidth : 279|9@0+ (0.1,0.0) [0.0|50.0] "m" ASDM
 SG_ ReSideRdrLe20Obj21RdrObjChks : 7|8@0+ (1.0,0.0) [0.0|255.0] "Unitless" ASDM
 SG_ ReSideRdrLe20Obj21RdrObjCntr : 15|4@0+ (1.0,0.0) [0.0|15.0] "Unitless" ASDM
 SG_ ReSideRdrLe20Obj21RdrObjCoastCnt : 158|5@0+ (1.0,0.0) [0.0|31.0] "Unitless" ASDM
 SG_ ReSideRdrLe20Obj21RdrObjConf : 11|4@0+ (7.0,0.0) [0.0|105.0] "%" ASDM
 SG_ ReSideRdrLe20Obj21RdrObjDx : 207|13@0+ (0.05,-200.0) [-200.0|200.0] "m" ASDM
 SG_ ReSideRdrLe20Obj21RdrObjDxStdDe : 71|8@0+ (0.05,0.0) [0.0|12.700000000000001] "m" ASDM
 SG_ ReSideRdrLe20Obj21RdrObjDy : 295|13@0+ (0.05,-200.0) [-200.0|200.0] "m" ASDM
 SG_ ReSideRdrLe20Obj21RdrObjDyStdDe : 167|8@0+ (0.05,0.0) [0.0|12.700000000000001] "m" ASDM
 SG_ ReSideRdrLe20Obj21RdrObjElevnConf : 43|4@0+ (7.0,0.0) [0.0|105.0] "%" ASDM
 SG_ ReSideRdrLe20Obj21RdrObjElevnSts : 153|2@0+ (1,0) [0|3] "" ASDM
 SG_ ReSideRdrLe20Obj21RdrObjID : 223|8@0+ (1.0,0.0) [0.0|255.0] "Unitless" ASDM
 SG_ ReSideRdrLe20Obj21RdrObjIsInFreeSpace : 280|1@0+ (1,0) [0|1] "" ASDM
 SG_ ReSideRdrLe20Obj21RdrObjMirrProblty : 263|4@0+ (7.0,0.0) [0.0|105.0] "%" ASDM
 SG_ ReSideRdrLe20Obj21RdrObjMtnPat : 210|3@0+ (1,0) [0|7] "" ASDM
 SG_ ReSideRdrLe20Obj21RdrObjNotRealProblty : 259|4@0+ (7.0,0.0) [0.0|105.0] "%" ASDM
 SG_ ReSideRdrLe20Obj21RdrObjStatyCnt : 30|7@0+ (1.0,0.0) [0.0|127.0] "Unitless" ASDM
 SG_ ReSideRdrLe20Obj21RdrObjTiAlv : 118|7@0+ (1.0,0.0) [0.0|127.0] "Unitless" ASDM
 SG_ ReSideRdrLe20Obj21RdrObjTrackSts : 177|2@0+ (1,0) [0|3] "" ASDM
 SG_ ReSideRdrLe20Obj21RdrObjTyp : 235|4@0+ (1,0) [0|15] "" ASDM
 SG_ ReSideRdrLe20Obj21RdrObjTypConfBike : 251|4@0+ (7.0,0.0) [0.0|105.0] "%" ASDM
 SG_ ReSideRdrLe20Obj21RdrObjTypConfPed : 271|4@0+ (7.0,0.0) [0.0|105.0] "%" ASDM
 SG_ ReSideRdrLe20Obj21RdrObjTypConfVeh : 267|4@0+ (7.0,0.0) [0.0|105.0] "%" ASDM
 SG_ ReSideRdrLe20Obj21RdrObjUsedTracker : 193|2@0+ (1,0) [0|3] "" ASDM
 SG_ ReSideRdrLe20Obj21RdrObjVx : 175|14@0+ (0.02,-128.0) [-128.0|128.0] "m/s" ASDM
 SG_ ReSideRdrLe20Obj21RdrObjVxStdDe : 141|6@0+ (0.05,0.0) [0.0|2.0] "m/s" ASDM
 SG_ ReSideRdrLe20Obj21RdrObjVy : 191|14@0+ (0.02,-128.0) [-128.0|128.0] "m/s" ASDM
 SG_ ReSideRdrLe20Obj21RdrObjVyStdDe : 286|6@0+ (0.05,0.0) [0.0|2.0] "m/s" ASDM
 SG_ ReSideRdrLe20Obj21RelVx : 231|12@0+ (0.02,-35.6) [-35.6|35.6] "m/s" ASDM
 SG_ ReSideRdrLe20Obj21RelVy : 247|12@0+ (0.02,-35.6) [-35.6|35.6] "m/s" ASDM

BO_ 1058 SODLPrivateCANFD5Fr22 : 64 SODL
 SG_ ReSideRdrLe20Obj22_UB : 298|1@0+ (1,0) [0|1] "" ASDM
 SG_ ReSideRdrLe20Obj22Heading : 39|12@0+ (0.1,-180.0) [-180.0|180.0] "Deg" ASDM
 SG_ ReSideRdrLe20Obj22ObjBoxCenterLat : 111|9@0+ (0.1,-25.0) [-25.0|25.0] "m" ASDM
 SG_ ReSideRdrLe20Obj22ObjBoxCenterLgt : 23|9@0+ (0.1,-25.0) [-25.0|25.0] "m" ASDM
 SG_ ReSideRdrLe20Obj22ObservationHist : 79|32@0+ (1.0,0.0) [0.0|4294967295.0] "Unitless" ASDM
 SG_ ReSideRdrLe20Obj22QualityBits : 127|18@0+ (1.0,0.0) [0.0|262143.0] "Unitless" ASDM
 SG_ ReSideRdrLe20Obj22RdrObjAx : 55|8@0- (0.1,0.0) [-12.8|12.700000000000001] "m/s^2" ASDM
 SG_ ReSideRdrLe20Obj22RdrObjAy : 63|8@0- (0.1,0.0) [-12.8|12.700000000000001] "m/s^2" ASDM
 SG_ ReSideRdrLe20Obj22RdrObjBoxLength : 151|9@0+ (0.1,0.0) [0.0|50.0] "m" ASDM
 SG_ ReSideRdrLe20Obj22RdrObjBoxWidth : 279|9@0+ (0.1,0.0) [0.0|50.0] "m" ASDM
 SG_ ReSideRdrLe20Obj22RdrObjChks : 7|8@0+ (1.0,0.0) [0.0|255.0] "Unitless" ASDM
 SG_ ReSideRdrLe20Obj22RdrObjCntr : 15|4@0+ (1.0,0.0) [0.0|15.0] "Unitless" ASDM
 SG_ ReSideRdrLe20Obj22RdrObjCoastCnt : 158|5@0+ (1.0,0.0) [0.0|31.0] "Unitless" ASDM
 SG_ ReSideRdrLe20Obj22RdrObjConf : 11|4@0+ (7.0,0.0) [0.0|105.0] "%" ASDM
 SG_ ReSideRdrLe20Obj22RdrObjDx : 207|13@0+ (0.05,-200.0) [-200.0|200.0] "m" ASDM
 SG_ ReSideRdrLe20Obj22RdrObjDxStdDe : 71|8@0+ (0.05,0.0) [0.0|12.700000000000001] "m" ASDM
 SG_ ReSideRdrLe20Obj22RdrObjDy : 295|13@0+ (0.05,-200.0) [-200.0|200.0] "m" ASDM
 SG_ ReSideRdrLe20Obj22RdrObjDyStdDe : 167|8@0+ (0.05,0.0) [0.0|12.700000000000001] "m" ASDM
 SG_ ReSideRdrLe20Obj22RdrObjElevnConf : 43|4@0+ (7.0,0.0) [0.0|105.0] "%" ASDM
 SG_ ReSideRdrLe20Obj22RdrObjElevnSts : 153|2@0+ (1,0) [0|3] "" ASDM
 SG_ ReSideRdrLe20Obj22RdrObjID : 223|8@0+ (1.0,0.0) [0.0|255.0] "Unitless" ASDM
 SG_ ReSideRdrLe20Obj22RdrObjIsInFreeSpace : 280|1@0+ (1,0) [0|1] "" ASDM
 SG_ ReSideRdrLe20Obj22RdrObjMirrProblty : 263|4@0+ (7.0,0.0) [0.0|105.0] "%" ASDM
 SG_ ReSideRdrLe20Obj22RdrObjMtnPat : 210|3@0+ (1,0) [0|7] "" ASDM
 SG_ ReSideRdrLe20Obj22RdrObjNotRealProblty : 259|4@0+ (7.0,0.0) [0.0|105.0] "%" ASDM
 SG_ ReSideRdrLe20Obj22RdrObjStatyCnt : 30|7@0+ (1.0,0.0) [0.0|127.0] "Unitless" ASDM
 SG_ ReSideRdrLe20Obj22RdrObjTiAlv : 118|7@0+ (1.0,0.0) [0.0|127.0] "Unitless" ASDM
 SG_ ReSideRdrLe20Obj22RdrObjTrackSts : 177|2@0+ (1,0) [0|3] "" ASDM
 SG_ ReSideRdrLe20Obj22RdrObjTyp : 235|4@0+ (1,0) [0|15] "" ASDM
 SG_ ReSideRdrLe20Obj22RdrObjTypConfBike : 251|4@0+ (7.0,0.0) [0.0|105.0] "%" ASDM
 SG_ ReSideRdrLe20Obj22RdrObjTypConfPed : 271|4@0+ (7.0,0.0) [0.0|105.0] "%" ASDM
 SG_ ReSideRdrLe20Obj22RdrObjTypConfVeh : 267|4@0+ (7.0,0.0) [0.0|105.0] "%" ASDM
 SG_ ReSideRdrLe20Obj22RdrObjUsedTracker : 193|2@0+ (1,0) [0|3] "" ASDM
 SG_ ReSideRdrLe20Obj22RdrObjVx : 175|14@0+ (0.02,-128.0) [-128.0|128.0] "m/s" ASDM
 SG_ ReSideRdrLe20Obj22RdrObjVxStdDe : 141|6@0+ (0.05,0.0) [0.0|2.0] "m/s" ASDM
 SG_ ReSideRdrLe20Obj22RdrObjVy : 191|14@0+ (0.02,-128.0) [-128.0|128.0] "m/s" ASDM
 SG_ ReSideRdrLe20Obj22RdrObjVyStdDe : 286|6@0+ (0.05,0.0) [0.0|2.0] "m/s" ASDM
 SG_ ReSideRdrLe20Obj22RelVx : 231|12@0+ (0.02,-35.6) [-35.6|35.6] "m/s" ASDM
 SG_ ReSideRdrLe20Obj22RelVy : 247|12@0+ (0.02,-35.6) [-35.6|35.6] "m/s" ASDM

BO_ 1059 SODLPrivateCANFD5Fr23 : 64 SODL
 SG_ ReSideRdrLe20Obj23_UB : 298|1@0+ (1,0) [0|1] "" ASDM
 SG_ ReSideRdrLe20Obj23Heading : 39|12@0+ (0.1,-180.0) [-180.0|180.0] "Deg" ASDM
 SG_ ReSideRdrLe20Obj23ObjBoxCenterLat : 111|9@0+ (0.1,-25.0) [-25.0|25.0] "m" ASDM
 SG_ ReSideRdrLe20Obj23ObjBoxCenterLgt : 23|9@0+ (0.1,-25.0) [-25.0|25.0] "m" ASDM
 SG_ ReSideRdrLe20Obj23ObservationHist : 79|32@0+ (1.0,0.0) [0.0|4294967295.0] "Unitless" ASDM
 SG_ ReSideRdrLe20Obj23QualityBits : 127|18@0+ (1.0,0.0) [0.0|262143.0] "Unitless" ASDM
 SG_ ReSideRdrLe20Obj23RdrObjAx : 55|8@0- (0.1,0.0) [-12.8|12.700000000000001] "m/s^2" ASDM
 SG_ ReSideRdrLe20Obj23RdrObjAy : 63|8@0- (0.1,0.0) [-12.8|12.700000000000001] "m/s^2" ASDM
 SG_ ReSideRdrLe20Obj23RdrObjBoxLength : 151|9@0+ (0.1,0.0) [0.0|50.0] "m" ASDM
 SG_ ReSideRdrLe20Obj23RdrObjBoxWidth : 279|9@0+ (0.1,0.0) [0.0|50.0] "m" ASDM
 SG_ ReSideRdrLe20Obj23RdrObjChks : 7|8@0+ (1.0,0.0) [0.0|255.0] "Unitless" ASDM
 SG_ ReSideRdrLe20Obj23RdrObjCntr : 15|4@0+ (1.0,0.0) [0.0|15.0] "Unitless" ASDM
 SG_ ReSideRdrLe20Obj23RdrObjCoastCnt : 158|5@0+ (1.0,0.0) [0.0|31.0] "Unitless" ASDM
 SG_ ReSideRdrLe20Obj23RdrObjConf : 11|4@0+ (7.0,0.0) [0.0|105.0] "%" ASDM
 SG_ ReSideRdrLe20Obj23RdrObjDx : 207|13@0+ (0.05,-200.0) [-200.0|200.0] "m" ASDM
 SG_ ReSideRdrLe20Obj23RdrObjDxStdDe : 71|8@0+ (0.05,0.0) [0.0|12.700000000000001] "m" ASDM
 SG_ ReSideRdrLe20Obj23RdrObjDy : 295|13@0+ (0.05,-200.0) [-200.0|200.0] "m" ASDM
 SG_ ReSideRdrLe20Obj23RdrObjDyStdDe : 167|8@0+ (0.05,0.0) [0.0|12.700000000000001] "m" ASDM
 SG_ ReSideRdrLe20Obj23RdrObjElevnConf : 43|4@0+ (7.0,0.0) [0.0|105.0] "%" ASDM
 SG_ ReSideRdrLe20Obj23RdrObjElevnSts : 153|2@0+ (1,0) [0|3] "" ASDM
 SG_ ReSideRdrLe20Obj23RdrObjID : 223|8@0+ (1.0,0.0) [0.0|255.0] "Unitless" ASDM
 SG_ ReSideRdrLe20Obj23RdrObjIsInFreeSpace : 280|1@0+ (1,0) [0|1] "" ASDM
 SG_ ReSideRdrLe20Obj23RdrObjMirrProblty : 263|4@0+ (7.0,0.0) [0.0|105.0] "%" ASDM
 SG_ ReSideRdrLe20Obj23RdrObjMtnPat : 210|3@0+ (1,0) [0|7] "" ASDM
 SG_ ReSideRdrLe20Obj23RdrObjNotRealProblty : 259|4@0+ (7.0,0.0) [0.0|105.0] "%" ASDM
 SG_ ReSideRdrLe20Obj23RdrObjStatyCnt : 30|7@0+ (1.0,0.0) [0.0|127.0] "Unitless" ASDM
 SG_ ReSideRdrLe20Obj23RdrObjTiAlv : 118|7@0+ (1.0,0.0) [0.0|127.0] "Unitless" ASDM
 SG_ ReSideRdrLe20Obj23RdrObjTrackSts : 177|2@0+ (1,0) [0|3] "" ASDM
 SG_ ReSideRdrLe20Obj23RdrObjTyp : 235|4@0+ (1,0) [0|15] "" ASDM
 SG_ ReSideRdrLe20Obj23RdrObjTypConfBike : 251|4@0+ (7.0,0.0) [0.0|105.0] "%" ASDM
 SG_ ReSideRdrLe20Obj23RdrObjTypConfPed : 271|4@0+ (7.0,0.0) [0.0|105.0] "%" ASDM
 SG_ ReSideRdrLe20Obj23RdrObjTypConfVeh : 267|4@0+ (7.0,0.0) [0.0|105.0] "%" ASDM
 SG_ ReSideRdrLe20Obj23RdrObjUsedTracker : 193|2@0+ (1,0) [0|3] "" ASDM
 SG_ ReSideRdrLe20Obj23RdrObjVx : 175|14@0+ (0.02,-128.0) [-128.0|128.0] "m/s" ASDM
 SG_ ReSideRdrLe20Obj23RdrObjVxStdDe : 141|6@0+ (0.05,0.0) [0.0|2.0] "m/s" ASDM
 SG_ ReSideRdrLe20Obj23RdrObjVy : 191|14@0+ (0.02,-128.0) [-128.0|128.0] "m/s" ASDM
 SG_ ReSideRdrLe20Obj23RdrObjVyStdDe : 286|6@0+ (0.05,0.0) [0.0|2.0] "m/s" ASDM
 SG_ ReSideRdrLe20Obj23RelVx : 231|12@0+ (0.02,-35.6) [-35.6|35.6] "m/s" ASDM
 SG_ ReSideRdrLe20Obj23RelVy : 247|12@0+ (0.02,-35.6) [-35.6|35.6] "m/s" ASDM

BO_ 1060 SODLPrivateCANFD5Fr24 : 64 SODL
 SG_ ReSideRdrLe20Obj24_UB : 298|1@0+ (1,0) [0|1] "" ASDM
 SG_ ReSideRdrLe20Obj24Heading : 39|12@0+ (0.1,-180.0) [-180.0|180.0] "Deg" ASDM
 SG_ ReSideRdrLe20Obj24ObjBoxCenterLat : 111|9@0+ (0.1,-25.0) [-25.0|25.0] "m" ASDM
 SG_ ReSideRdrLe20Obj24ObjBoxCenterLgt : 23|9@0+ (0.1,-25.0) [-25.0|25.0] "m" ASDM
 SG_ ReSideRdrLe20Obj24ObservationHist : 79|32@0+ (1.0,0.0) [0.0|4294967295.0] "Unitless" ASDM
 SG_ ReSideRdrLe20Obj24QualityBits : 127|18@0+ (1.0,0.0) [0.0|262143.0] "Unitless" ASDM
 SG_ ReSideRdrLe20Obj24RdrObjAx : 55|8@0- (0.1,0.0) [-12.8|12.700000000000001] "m/s^2" ASDM
 SG_ ReSideRdrLe20Obj24RdrObjAy : 63|8@0- (0.1,0.0) [-12.8|12.700000000000001] "m/s^2" ASDM
 SG_ ReSideRdrLe20Obj24RdrObjBoxLength : 151|9@0+ (0.1,0.0) [0.0|50.0] "m" ASDM
 SG_ ReSideRdrLe20Obj24RdrObjBoxWidth : 279|9@0+ (0.1,0.0) [0.0|50.0] "m" ASDM
 SG_ ReSideRdrLe20Obj24RdrObjChks : 7|8@0+ (1.0,0.0) [0.0|255.0] "Unitless" ASDM
 SG_ ReSideRdrLe20Obj24RdrObjCntr : 15|4@0+ (1.0,0.0) [0.0|15.0] "Unitless" ASDM
 SG_ ReSideRdrLe20Obj24RdrObjCoastCnt : 158|5@0+ (1.0,0.0) [0.0|31.0] "Unitless" ASDM
 SG_ ReSideRdrLe20Obj24RdrObjConf : 11|4@0+ (7.0,0.0) [0.0|105.0] "%" ASDM
 SG_ ReSideRdrLe20Obj24RdrObjDx : 207|13@0+ (0.05,-200.0) [-200.0|200.0] "m" ASDM
 SG_ ReSideRdrLe20Obj24RdrObjDxStdDe : 71|8@0+ (0.05,0.0) [0.0|12.700000000000001] "m" ASDM
 SG_ ReSideRdrLe20Obj24RdrObjDy : 295|13@0+ (0.05,-200.0) [-200.0|200.0] "m" ASDM
 SG_ ReSideRdrLe20Obj24RdrObjDyStdDe : 167|8@0+ (0.05,0.0) [0.0|12.700000000000001] "m" ASDM
 SG_ ReSideRdrLe20Obj24RdrObjElevnConf : 43|4@0+ (7.0,0.0) [0.0|105.0] "%" ASDM
 SG_ ReSideRdrLe20Obj24RdrObjElevnSts : 153|2@0+ (1,0) [0|3] "" ASDM
 SG_ ReSideRdrLe20Obj24RdrObjID : 223|8@0+ (1.0,0.0) [0.0|255.0] "Unitless" ASDM
 SG_ ReSideRdrLe20Obj24RdrObjIsInFreeSpace : 280|1@0+ (1,0) [0|1] "" ASDM
 SG_ ReSideRdrLe20Obj24RdrObjMirrProblty : 263|4@0+ (7.0,0.0) [0.0|105.0] "%" ASDM
 SG_ ReSideRdrLe20Obj24RdrObjMtnPat : 210|3@0+ (1,0) [0|7] "" ASDM
 SG_ ReSideRdrLe20Obj24RdrObjNotRealProblty : 259|4@0+ (7.0,0.0) [0.0|105.0] "%" ASDM
 SG_ ReSideRdrLe20Obj24RdrObjStatyCnt : 30|7@0+ (1.0,0.0) [0.0|127.0] "Unitless" ASDM
 SG_ ReSideRdrLe20Obj24RdrObjTiAlv : 118|7@0+ (1.0,0.0) [0.0|127.0] "Unitless" ASDM
 SG_ ReSideRdrLe20Obj24RdrObjTrackSts : 177|2@0+ (1,0) [0|3] "" ASDM
 SG_ ReSideRdrLe20Obj24RdrObjTyp : 235|4@0+ (1,0) [0|15] "" ASDM
 SG_ ReSideRdrLe20Obj24RdrObjTypConfBike : 251|4@0+ (7.0,0.0) [0.0|105.0] "%" ASDM
 SG_ ReSideRdrLe20Obj24RdrObjTypConfPed : 271|4@0+ (7.0,0.0) [0.0|105.0] "%" ASDM
 SG_ ReSideRdrLe20Obj24RdrObjTypConfVeh : 267|4@0+ (7.0,0.0) [0.0|105.0] "%" ASDM
 SG_ ReSideRdrLe20Obj24RdrObjUsedTracker : 193|2@0+ (1,0) [0|3] "" ASDM
 SG_ ReSideRdrLe20Obj24RdrObjVx : 175|14@0+ (0.02,-128.0) [-128.0|128.0] "m/s" ASDM
 SG_ ReSideRdrLe20Obj24RdrObjVxStdDe : 141|6@0+ (0.05,0.0) [0.0|2.0] "m/s" ASDM
 SG_ ReSideRdrLe20Obj24RdrObjVy : 191|14@0+ (0.02,-128.0) [-128.0|128.0] "m/s" ASDM
 SG_ ReSideRdrLe20Obj24RdrObjVyStdDe : 286|6@0+ (0.05,0.0) [0.0|2.0] "m/s" ASDM
 SG_ ReSideRdrLe20Obj24RelVx : 231|12@0+ (0.02,-35.6) [-35.6|35.6] "m/s" ASDM
 SG_ ReSideRdrLe20Obj24RelVy : 247|12@0+ (0.02,-35.6) [-35.6|35.6] "m/s" ASDM

BO_ 1061 SODLPrivateCANFD5Fr25 : 64 SODL
 SG_ ReSideRdrLe20Obj25_UB : 298|1@0+ (1,0) [0|1] "" ASDM
 SG_ ReSideRdrLe20Obj25Heading : 39|12@0+ (0.1,-180.0) [-180.0|180.0] "Deg" ASDM
 SG_ ReSideRdrLe20Obj25ObjBoxCenterLat : 111|9@0+ (0.1,-25.0) [-25.0|25.0] "m" ASDM
 SG_ ReSideRdrLe20Obj25ObjBoxCenterLgt : 23|9@0+ (0.1,-25.0) [-25.0|25.0] "m" ASDM
 SG_ ReSideRdrLe20Obj25ObservationHist : 79|32@0+ (1.0,0.0) [0.0|4294967295.0] "Unitless" ASDM
 SG_ ReSideRdrLe20Obj25QualityBits : 127|18@0+ (1.0,0.0) [0.0|262143.0] "Unitless" ASDM
 SG_ ReSideRdrLe20Obj25RdrObjAx : 55|8@0- (0.1,0.0) [-12.8|12.700000000000001] "m/s^2" ASDM
 SG_ ReSideRdrLe20Obj25RdrObjAy : 63|8@0- (0.1,0.0) [-12.8|12.700000000000001] "m/s^2" ASDM
 SG_ ReSideRdrLe20Obj25RdrObjBoxLength : 151|9@0+ (0.1,0.0) [0.0|50.0] "m" ASDM
 SG_ ReSideRdrLe20Obj25RdrObjBoxWidth : 279|9@0+ (0.1,0.0) [0.0|50.0] "m" ASDM
 SG_ ReSideRdrLe20Obj25RdrObjChks : 7|8@0+ (1.0,0.0) [0.0|255.0] "Unitless" ASDM
 SG_ ReSideRdrLe20Obj25RdrObjCntr : 15|4@0+ (1.0,0.0) [0.0|15.0] "Unitless" ASDM
 SG_ ReSideRdrLe20Obj25RdrObjCoastCnt : 158|5@0+ (1.0,0.0) [0.0|31.0] "Unitless" ASDM
 SG_ ReSideRdrLe20Obj25RdrObjConf : 11|4@0+ (7.0,0.0) [0.0|105.0] "%" ASDM
 SG_ ReSideRdrLe20Obj25RdrObjDx : 207|13@0+ (0.05,-200.0) [-200.0|200.0] "m" ASDM
 SG_ ReSideRdrLe20Obj25RdrObjDxStdDe : 71|8@0+ (0.05,0.0) [0.0|12.700000000000001] "m" ASDM
 SG_ ReSideRdrLe20Obj25RdrObjDy : 295|13@0+ (0.05,-200.0) [-200.0|200.0] "m" ASDM
 SG_ ReSideRdrLe20Obj25RdrObjDyStdDe : 167|8@0+ (0.05,0.0) [0.0|12.700000000000001] "m" ASDM
 SG_ ReSideRdrLe20Obj25RdrObjElevnConf : 43|4@0+ (7.0,0.0) [0.0|105.0] "%" ASDM
 SG_ ReSideRdrLe20Obj25RdrObjElevnSts : 153|2@0+ (1,0) [0|3] "" ASDM
 SG_ ReSideRdrLe20Obj25RdrObjID : 223|8@0+ (1.0,0.0) [0.0|255.0] "Unitless" ASDM
 SG_ ReSideRdrLe20Obj25RdrObjIsInFreeSpace : 280|1@0+ (1,0) [0|1] "" ASDM
 SG_ ReSideRdrLe20Obj25RdrObjMirrProblty : 263|4@0+ (7.0,0.0) [0.0|105.0] "%" ASDM
 SG_ ReSideRdrLe20Obj25RdrObjMtnPat : 210|3@0+ (1,0) [0|7] "" ASDM
 SG_ ReSideRdrLe20Obj25RdrObjNotRealProblty : 259|4@0+ (7.0,0.0) [0.0|105.0] "%" ASDM
 SG_ ReSideRdrLe20Obj25RdrObjStatyCnt : 30|7@0+ (1.0,0.0) [0.0|127.0] "Unitless" ASDM
 SG_ ReSideRdrLe20Obj25RdrObjTiAlv : 118|7@0+ (1.0,0.0) [0.0|127.0] "Unitless" ASDM
 SG_ ReSideRdrLe20Obj25RdrObjTrackSts : 177|2@0+ (1,0) [0|3] "" ASDM
 SG_ ReSideRdrLe20Obj25RdrObjTyp : 235|4@0+ (1,0) [0|15] "" ASDM
 SG_ ReSideRdrLe20Obj25RdrObjTypConfBike : 251|4@0+ (7.0,0.0) [0.0|105.0] "%" ASDM
 SG_ ReSideRdrLe20Obj25RdrObjTypConfPed : 271|4@0+ (7.0,0.0) [0.0|105.0] "%" ASDM
 SG_ ReSideRdrLe20Obj25RdrObjTypConfVeh : 267|4@0+ (7.0,0.0) [0.0|105.0] "%" ASDM
 SG_ ReSideRdrLe20Obj25RdrObjUsedTracker : 193|2@0+ (1,0) [0|3] "" ASDM
 SG_ ReSideRdrLe20Obj25RdrObjVx : 175|14@0+ (0.02,-128.0) [-128.0|128.0] "m/s" ASDM
 SG_ ReSideRdrLe20Obj25RdrObjVxStdDe : 141|6@0+ (0.05,0.0) [0.0|2.0] "m/s" ASDM
 SG_ ReSideRdrLe20Obj25RdrObjVy : 191|14@0+ (0.02,-128.0) [-128.0|128.0] "m/s" ASDM
 SG_ ReSideRdrLe20Obj25RdrObjVyStdDe : 286|6@0+ (0.05,0.0) [0.0|2.0] "m/s" ASDM
 SG_ ReSideRdrLe20Obj25RelVx : 231|12@0+ (0.02,-35.6) [-35.6|35.6] "m/s" ASDM
 SG_ ReSideRdrLe20Obj25RelVy : 247|12@0+ (0.02,-35.6) [-35.6|35.6] "m/s" ASDM

BO_ 1062 SODLPrivateCANFD5Fr26 : 64 SODL
 SG_ ReSideRdrLe20Obj26_UB : 298|1@0+ (1,0) [0|1] "" ASDM
 SG_ ReSideRdrLe20Obj26Heading : 39|12@0+ (0.1,-180.0) [-180.0|180.0] "Deg" ASDM
 SG_ ReSideRdrLe20Obj26ObjBoxCenterLat : 111|9@0+ (0.1,-25.0) [-25.0|25.0] "m" ASDM
 SG_ ReSideRdrLe20Obj26ObjBoxCenterLgt : 23|9@0+ (0.1,-25.0) [-25.0|25.0] "m" ASDM
 SG_ ReSideRdrLe20Obj26ObservationHist : 79|32@0+ (1.0,0.0) [0.0|4294967295.0] "Unitless" ASDM
 SG_ ReSideRdrLe20Obj26QualityBits : 127|18@0+ (1.0,0.0) [0.0|262143.0] "Unitless" ASDM
 SG_ ReSideRdrLe20Obj26RdrObjAx : 55|8@0- (0.1,0.0) [-12.8|12.700000000000001] "m/s^2" ASDM
 SG_ ReSideRdrLe20Obj26RdrObjAy : 63|8@0- (0.1,0.0) [-12.8|12.700000000000001] "m/s^2" ASDM
 SG_ ReSideRdrLe20Obj26RdrObjBoxLength : 151|9@0+ (0.1,0.0) [0.0|50.0] "m" ASDM
 SG_ ReSideRdrLe20Obj26RdrObjBoxWidth : 279|9@0+ (0.1,0.0) [0.0|50.0] "m" ASDM
 SG_ ReSideRdrLe20Obj26RdrObjChks : 7|8@0+ (1.0,0.0) [0.0|255.0] "Unitless" ASDM
 SG_ ReSideRdrLe20Obj26RdrObjCntr : 15|4@0+ (1.0,0.0) [0.0|15.0] "Unitless" ASDM
 SG_ ReSideRdrLe20Obj26RdrObjCoastCnt : 158|5@0+ (1.0,0.0) [0.0|31.0] "Unitless" ASDM
 SG_ ReSideRdrLe20Obj26RdrObjConf : 11|4@0+ (7.0,0.0) [0.0|105.0] "%" ASDM
 SG_ ReSideRdrLe20Obj26RdrObjDx : 207|13@0+ (0.05,-200.0) [-200.0|200.0] "m" ASDM
 SG_ ReSideRdrLe20Obj26RdrObjDxStdDe : 71|8@0+ (0.05,0.0) [0.0|12.700000000000001] "m" ASDM
 SG_ ReSideRdrLe20Obj26RdrObjDy : 295|13@0+ (0.05,-200.0) [-200.0|200.0] "m" ASDM
 SG_ ReSideRdrLe20Obj26RdrObjDyStdDe : 167|8@0+ (0.05,0.0) [0.0|12.700000000000001] "m" ASDM
 SG_ ReSideRdrLe20Obj26RdrObjElevnConf : 43|4@0+ (7.0,0.0) [0.0|105.0] "%" ASDM
 SG_ ReSideRdrLe20Obj26RdrObjElevnSts : 153|2@0+ (1,0) [0|3] "" ASDM
 SG_ ReSideRdrLe20Obj26RdrObjID : 223|8@0+ (1.0,0.0) [0.0|255.0] "Unitless" ASDM
 SG_ ReSideRdrLe20Obj26RdrObjIsInFreeSpace : 280|1@0+ (1,0) [0|1] "" ASDM
 SG_ ReSideRdrLe20Obj26RdrObjMirrProblty : 263|4@0+ (7.0,0.0) [0.0|105.0] "%" ASDM
 SG_ ReSideRdrLe20Obj26RdrObjMtnPat : 210|3@0+ (1,0) [0|7] "" ASDM
 SG_ ReSideRdrLe20Obj26RdrObjNotRealProblty : 259|4@0+ (7.0,0.0) [0.0|105.0] "%" ASDM
 SG_ ReSideRdrLe20Obj26RdrObjStatyCnt : 30|7@0+ (1.0,0.0) [0.0|127.0] "Unitless" ASDM
 SG_ ReSideRdrLe20Obj26RdrObjTiAlv : 118|7@0+ (1.0,0.0) [0.0|127.0] "Unitless" ASDM
 SG_ ReSideRdrLe20Obj26RdrObjTrackSts : 177|2@0+ (1,0) [0|3] "" ASDM
 SG_ ReSideRdrLe20Obj26RdrObjTyp : 235|4@0+ (1,0) [0|15] "" ASDM
 SG_ ReSideRdrLe20Obj26RdrObjTypConfBike : 251|4@0+ (7.0,0.0) [0.0|105.0] "%" ASDM
 SG_ ReSideRdrLe20Obj26RdrObjTypConfPed : 271|4@0+ (7.0,0.0) [0.0|105.0] "%" ASDM
 SG_ ReSideRdrLe20Obj26RdrObjTypConfVeh : 267|4@0+ (7.0,0.0) [0.0|105.0] "%" ASDM
 SG_ ReSideRdrLe20Obj26RdrObjUsedTracker : 193|2@0+ (1,0) [0|3] "" ASDM
 SG_ ReSideRdrLe20Obj26RdrObjVx : 175|14@0+ (0.02,-128.0) [-128.0|128.0] "m/s" ASDM
 SG_ ReSideRdrLe20Obj26RdrObjVxStdDe : 141|6@0+ (0.05,0.0) [0.0|2.0] "m/s" ASDM
 SG_ ReSideRdrLe20Obj26RdrObjVy : 191|14@0+ (0.02,-128.0) [-128.0|128.0] "m/s" ASDM
 SG_ ReSideRdrLe20Obj26RdrObjVyStdDe : 286|6@0+ (0.05,0.0) [0.0|2.0] "m/s" ASDM
 SG_ ReSideRdrLe20Obj26RelVx : 231|12@0+ (0.02,-35.6) [-35.6|35.6] "m/s" ASDM
 SG_ ReSideRdrLe20Obj26RelVy : 247|12@0+ (0.02,-35.6) [-35.6|35.6] "m/s" ASDM

BO_ 1063 SODLPrivateCANFD5Fr27 : 64 SODL
 SG_ ReSideRdrLe20Obj27_UB : 298|1@0+ (1,0) [0|1] "" ASDM
 SG_ ReSideRdrLe20Obj27Heading : 39|12@0+ (0.1,-180.0) [-180.0|180.0] "Deg" ASDM
 SG_ ReSideRdrLe20Obj27ObjBoxCenterLat : 111|9@0+ (0.1,-25.0) [-25.0|25.0] "m" ASDM
 SG_ ReSideRdrLe20Obj27ObjBoxCenterLgt : 23|9@0+ (0.1,-25.0) [-25.0|25.0] "m" ASDM
 SG_ ReSideRdrLe20Obj27ObservationHist : 79|32@0+ (1.0,0.0) [0.0|4294967295.0] "Unitless" ASDM
 SG_ ReSideRdrLe20Obj27QualityBits : 127|18@0+ (1.0,0.0) [0.0|262143.0] "Unitless" ASDM
 SG_ ReSideRdrLe20Obj27RdrObjAx : 55|8@0- (0.1,0.0) [-12.8|12.700000000000001] "m/s^2" ASDM
 SG_ ReSideRdrLe20Obj27RdrObjAy : 63|8@0- (0.1,0.0) [-12.8|12.700000000000001] "m/s^2" ASDM
 SG_ ReSideRdrLe20Obj27RdrObjBoxLength : 151|9@0+ (0.1,0.0) [0.0|50.0] "m" ASDM
 SG_ ReSideRdrLe20Obj27RdrObjBoxWidth : 279|9@0+ (0.1,0.0) [0.0|50.0] "m" ASDM
 SG_ ReSideRdrLe20Obj27RdrObjChks : 7|8@0+ (1.0,0.0) [0.0|255.0] "Unitless" ASDM
 SG_ ReSideRdrLe20Obj27RdrObjCntr : 15|4@0+ (1.0,0.0) [0.0|15.0] "Unitless" ASDM
 SG_ ReSideRdrLe20Obj27RdrObjCoastCnt : 158|5@0+ (1.0,0.0) [0.0|31.0] "Unitless" ASDM
 SG_ ReSideRdrLe20Obj27RdrObjConf : 11|4@0+ (7.0,0.0) [0.0|105.0] "%" ASDM
 SG_ ReSideRdrLe20Obj27RdrObjDx : 207|13@0+ (0.05,-200.0) [-200.0|200.0] "m" ASDM
 SG_ ReSideRdrLe20Obj27RdrObjDxStdDe : 71|8@0+ (0.05,0.0) [0.0|12.700000000000001] "m" ASDM
 SG_ ReSideRdrLe20Obj27RdrObjDy : 295|13@0+ (0.05,-200.0) [-200.0|200.0] "m" ASDM
 SG_ ReSideRdrLe20Obj27RdrObjDyStdDe : 167|8@0+ (0.05,0.0) [0.0|12.700000000000001] "m" ASDM
 SG_ ReSideRdrLe20Obj27RdrObjElevnConf : 43|4@0+ (7.0,0.0) [0.0|105.0] "%" ASDM
 SG_ ReSideRdrLe20Obj27RdrObjElevnSts : 153|2@0+ (1,0) [0|3] "" ASDM
 SG_ ReSideRdrLe20Obj27RdrObjID : 223|8@0+ (1.0,0.0) [0.0|255.0] "Unitless" ASDM
 SG_ ReSideRdrLe20Obj27RdrObjIsInFreeSpace : 280|1@0+ (1,0) [0|1] "" ASDM
 SG_ ReSideRdrLe20Obj27RdrObjMirrProblty : 263|4@0+ (7.0,0.0) [0.0|105.0] "%" ASDM
 SG_ ReSideRdrLe20Obj27RdrObjMtnPat : 210|3@0+ (1,0) [0|7] "" ASDM
 SG_ ReSideRdrLe20Obj27RdrObjNotRealProblty : 259|4@0+ (7.0,0.0) [0.0|105.0] "%" ASDM
 SG_ ReSideRdrLe20Obj27RdrObjStatyCnt : 30|7@0+ (1.0,0.0) [0.0|127.0] "Unitless" ASDM
 SG_ ReSideRdrLe20Obj27RdrObjTiAlv : 118|7@0+ (1.0,0.0) [0.0|127.0] "Unitless" ASDM
 SG_ ReSideRdrLe20Obj27RdrObjTrackSts : 177|2@0+ (1,0) [0|3] "" ASDM
 SG_ ReSideRdrLe20Obj27RdrObjTyp : 235|4@0+ (1,0) [0|15] "" ASDM
 SG_ ReSideRdrLe20Obj27RdrObjTypConfBike : 251|4@0+ (7.0,0.0) [0.0|105.0] "%" ASDM
 SG_ ReSideRdrLe20Obj27RdrObjTypConfPed : 271|4@0+ (7.0,0.0) [0.0|105.0] "%" ASDM
 SG_ ReSideRdrLe20Obj27RdrObjTypConfVeh : 267|4@0+ (7.0,0.0) [0.0|105.0] "%" ASDM
 SG_ ReSideRdrLe20Obj27RdrObjUsedTracker : 193|2@0+ (1,0) [0|3] "" ASDM
 SG_ ReSideRdrLe20Obj27RdrObjVx : 175|14@0+ (0.02,-128.0) [-128.0|128.0] "m/s" ASDM
 SG_ ReSideRdrLe20Obj27RdrObjVxStdDe : 141|6@0+ (0.05,0.0) [0.0|2.0] "m/s" ASDM
 SG_ ReSideRdrLe20Obj27RdrObjVy : 191|14@0+ (0.02,-128.0) [-128.0|128.0] "m/s" ASDM
 SG_ ReSideRdrLe20Obj27RdrObjVyStdDe : 286|6@0+ (0.05,0.0) [0.0|2.0] "m/s" ASDM
 SG_ ReSideRdrLe20Obj27RelVx : 231|12@0+ (0.02,-35.6) [-35.6|35.6] "m/s" ASDM
 SG_ ReSideRdrLe20Obj27RelVy : 247|12@0+ (0.02,-35.6) [-35.6|35.6] "m/s" ASDM

BO_ 1064 SODLPrivateCANFD5Fr28 : 64 SODL
 SG_ ReSideRdrLe20Obj28_UB : 298|1@0+ (1,0) [0|1] "" ASDM
 SG_ ReSideRdrLe20Obj28Heading : 39|12@0+ (0.1,-180.0) [-180.0|180.0] "Deg" ASDM
 SG_ ReSideRdrLe20Obj28ObjBoxCenterLat : 111|9@0+ (0.1,-25.0) [-25.0|25.0] "m" ASDM
 SG_ ReSideRdrLe20Obj28ObjBoxCenterLgt : 23|9@0+ (0.1,-25.0) [-25.0|25.0] "m" ASDM
 SG_ ReSideRdrLe20Obj28ObservationHist : 79|32@0+ (1.0,0.0) [0.0|4294967295.0] "Unitless" ASDM
 SG_ ReSideRdrLe20Obj28QualityBits : 127|18@0+ (1.0,0.0) [0.0|262143.0] "Unitless" ASDM
 SG_ ReSideRdrLe20Obj28RdrObjAx : 55|8@0- (0.1,0.0) [-12.8|12.700000000000001] "m/s^2" ASDM
 SG_ ReSideRdrLe20Obj28RdrObjAy : 63|8@0- (0.1,0.0) [-12.8|12.700000000000001] "m/s^2" ASDM
 SG_ ReSideRdrLe20Obj28RdrObjBoxLength : 151|9@0+ (0.1,0.0) [0.0|50.0] "m" ASDM
 SG_ ReSideRdrLe20Obj28RdrObjBoxWidth : 279|9@0+ (0.1,0.0) [0.0|50.0] "m" ASDM
 SG_ ReSideRdrLe20Obj28RdrObjChks : 7|8@0+ (1.0,0.0) [0.0|255.0] "Unitless" ASDM
 SG_ ReSideRdrLe20Obj28RdrObjCntr : 15|4@0+ (1.0,0.0) [0.0|15.0] "Unitless" ASDM
 SG_ ReSideRdrLe20Obj28RdrObjCoastCnt : 158|5@0+ (1.0,0.0) [0.0|31.0] "Unitless" ASDM
 SG_ ReSideRdrLe20Obj28RdrObjConf : 11|4@0+ (7.0,0.0) [0.0|105.0] "%" ASDM
 SG_ ReSideRdrLe20Obj28RdrObjDx : 207|13@0+ (0.05,-200.0) [-200.0|200.0] "m" ASDM
 SG_ ReSideRdrLe20Obj28RdrObjDxStdDe : 71|8@0+ (0.05,0.0) [0.0|12.700000000000001] "m" ASDM
 SG_ ReSideRdrLe20Obj28RdrObjDy : 295|13@0+ (0.05,-200.0) [-200.0|200.0] "m" ASDM
 SG_ ReSideRdrLe20Obj28RdrObjDyStdDe : 167|8@0+ (0.05,0.0) [0.0|12.700000000000001] "m" ASDM
 SG_ ReSideRdrLe20Obj28RdrObjElevnConf : 43|4@0+ (7.0,0.0) [0.0|105.0] "%" ASDM
 SG_ ReSideRdrLe20Obj28RdrObjElevnSts : 153|2@0+ (1,0) [0|3] "" ASDM
 SG_ ReSideRdrLe20Obj28RdrObjID : 223|8@0+ (1.0,0.0) [0.0|255.0] "Unitless" ASDM
 SG_ ReSideRdrLe20Obj28RdrObjIsInFreeSpace : 280|1@0+ (1,0) [0|1] "" ASDM
 SG_ ReSideRdrLe20Obj28RdrObjMirrProblty : 263|4@0+ (7.0,0.0) [0.0|105.0] "%" ASDM
 SG_ ReSideRdrLe20Obj28RdrObjMtnPat : 210|3@0+ (1,0) [0|7] "" ASDM
 SG_ ReSideRdrLe20Obj28RdrObjNotRealProblty : 259|4@0+ (7.0,0.0) [0.0|105.0] "%" ASDM
 SG_ ReSideRdrLe20Obj28RdrObjStatyCnt : 30|7@0+ (1.0,0.0) [0.0|127.0] "Unitless" ASDM
 SG_ ReSideRdrLe20Obj28RdrObjTiAlv : 118|7@0+ (1.0,0.0) [0.0|127.0] "Unitless" ASDM
 SG_ ReSideRdrLe20Obj28RdrObjTrackSts : 177|2@0+ (1,0) [0|3] "" ASDM
 SG_ ReSideRdrLe20Obj28RdrObjTyp : 235|4@0+ (1,0) [0|15] "" ASDM
 SG_ ReSideRdrLe20Obj28RdrObjTypConfBike : 251|4@0+ (7.0,0.0) [0.0|105.0] "%" ASDM
 SG_ ReSideRdrLe20Obj28RdrObjTypConfPed : 271|4@0+ (7.0,0.0) [0.0|105.0] "%" ASDM
 SG_ ReSideRdrLe20Obj28RdrObjTypConfVeh : 267|4@0+ (7.0,0.0) [0.0|105.0] "%" ASDM
 SG_ ReSideRdrLe20Obj28RdrObjUsedTracker : 193|2@0+ (1,0) [0|3] "" ASDM
 SG_ ReSideRdrLe20Obj28RdrObjVx : 175|14@0+ (0.02,-128.0) [-128.0|128.0] "m/s" ASDM
 SG_ ReSideRdrLe20Obj28RdrObjVxStdDe : 141|6@0+ (0.05,0.0) [0.0|2.0] "m/s" ASDM
 SG_ ReSideRdrLe20Obj28RdrObjVy : 191|14@0+ (0.02,-128.0) [-128.0|128.0] "m/s" ASDM
 SG_ ReSideRdrLe20Obj28RdrObjVyStdDe : 286|6@0+ (0.05,0.0) [0.0|2.0] "m/s" ASDM
 SG_ ReSideRdrLe20Obj28RelVx : 231|12@0+ (0.02,-35.6) [-35.6|35.6] "m/s" ASDM
 SG_ ReSideRdrLe20Obj28RelVy : 247|12@0+ (0.02,-35.6) [-35.6|35.6] "m/s" ASDM

BO_ 1065 SODLPrivateCANFD5Fr29 : 64 SODL
 SG_ ReSideRdrLe20Obj29_UB : 298|1@0+ (1,0) [0|1] "" ASDM
 SG_ ReSideRdrLe20Obj29Heading : 39|12@0+ (0.1,-180.0) [-180.0|180.0] "Deg" ASDM
 SG_ ReSideRdrLe20Obj29ObjBoxCenterLat : 111|9@0+ (0.1,-25.0) [-25.0|25.0] "m" ASDM
 SG_ ReSideRdrLe20Obj29ObjBoxCenterLgt : 23|9@0+ (0.1,-25.0) [-25.0|25.0] "m" ASDM
 SG_ ReSideRdrLe20Obj29ObservationHist : 79|32@0+ (1.0,0.0) [0.0|4294967295.0] "Unitless" ASDM
 SG_ ReSideRdrLe20Obj29QualityBits : 127|18@0+ (1.0,0.0) [0.0|262143.0] "Unitless" ASDM
 SG_ ReSideRdrLe20Obj29RdrObjAx : 55|8@0- (0.1,0.0) [-12.8|12.700000000000001] "m/s^2" ASDM
 SG_ ReSideRdrLe20Obj29RdrObjAy : 63|8@0- (0.1,0.0) [-12.8|12.700000000000001] "m/s^2" ASDM
 SG_ ReSideRdrLe20Obj29RdrObjBoxLength : 151|9@0+ (0.1,0.0) [0.0|50.0] "m" ASDM
 SG_ ReSideRdrLe20Obj29RdrObjBoxWidth : 279|9@0+ (0.1,0.0) [0.0|50.0] "m" ASDM
 SG_ ReSideRdrLe20Obj29RdrObjChks : 7|8@0+ (1.0,0.0) [0.0|255.0] "Unitless" ASDM
 SG_ ReSideRdrLe20Obj29RdrObjCntr : 15|4@0+ (1.0,0.0) [0.0|15.0] "Unitless" ASDM
 SG_ ReSideRdrLe20Obj29RdrObjCoastCnt : 158|5@0+ (1.0,0.0) [0.0|31.0] "Unitless" ASDM
 SG_ ReSideRdrLe20Obj29RdrObjConf : 11|4@0+ (7.0,0.0) [0.0|105.0] "%" ASDM
 SG_ ReSideRdrLe20Obj29RdrObjDx : 207|13@0+ (0.05,-200.0) [-200.0|200.0] "m" ASDM
 SG_ ReSideRdrLe20Obj29RdrObjDxStdDe : 71|8@0+ (0.05,0.0) [0.0|12.700000000000001] "m" ASDM
 SG_ ReSideRdrLe20Obj29RdrObjDy : 295|13@0+ (0.05,-200.0) [-200.0|200.0] "m" ASDM
 SG_ ReSideRdrLe20Obj29RdrObjDyStdDe : 167|8@0+ (0.05,0.0) [0.0|12.700000000000001] "m" ASDM
 SG_ ReSideRdrLe20Obj29RdrObjElevnConf : 43|4@0+ (7.0,0.0) [0.0|105.0] "%" ASDM
 SG_ ReSideRdrLe20Obj29RdrObjElevnSts : 153|2@0+ (1,0) [0|3] "" ASDM
 SG_ ReSideRdrLe20Obj29RdrObjID : 223|8@0+ (1.0,0.0) [0.0|255.0] "Unitless" ASDM
 SG_ ReSideRdrLe20Obj29RdrObjIsInFreeSpace : 280|1@0+ (1,0) [0|1] "" ASDM
 SG_ ReSideRdrLe20Obj29RdrObjMirrProblty : 263|4@0+ (7.0,0.0) [0.0|105.0] "%" ASDM
 SG_ ReSideRdrLe20Obj29RdrObjMtnPat : 210|3@0+ (1,0) [0|7] "" ASDM
 SG_ ReSideRdrLe20Obj29RdrObjNotRealProblty : 259|4@0+ (7.0,0.0) [0.0|105.0] "%" ASDM
 SG_ ReSideRdrLe20Obj29RdrObjStatyCnt : 30|7@0+ (1.0,0.0) [0.0|127.0] "Unitless" ASDM
 SG_ ReSideRdrLe20Obj29RdrObjTiAlv : 118|7@0+ (1.0,0.0) [0.0|127.0] "Unitless" ASDM
 SG_ ReSideRdrLe20Obj29RdrObjTrackSts : 177|2@0+ (1,0) [0|3] "" ASDM
 SG_ ReSideRdrLe20Obj29RdrObjTyp : 235|4@0+ (1,0) [0|15] "" ASDM
 SG_ ReSideRdrLe20Obj29RdrObjTypConfBike : 251|4@0+ (7.0,0.0) [0.0|105.0] "%" ASDM
 SG_ ReSideRdrLe20Obj29RdrObjTypConfPed : 271|4@0+ (7.0,0.0) [0.0|105.0] "%" ASDM
 SG_ ReSideRdrLe20Obj29RdrObjTypConfVeh : 267|4@0+ (7.0,0.0) [0.0|105.0] "%" ASDM
 SG_ ReSideRdrLe20Obj29RdrObjUsedTracker : 193|2@0+ (1,0) [0|3] "" ASDM
 SG_ ReSideRdrLe20Obj29RdrObjVx : 175|14@0+ (0.02,-128.0) [-128.0|128.0] "m/s" ASDM
 SG_ ReSideRdrLe20Obj29RdrObjVxStdDe : 141|6@0+ (0.05,0.0) [0.0|2.0] "m/s" ASDM
 SG_ ReSideRdrLe20Obj29RdrObjVy : 191|14@0+ (0.02,-128.0) [-128.0|128.0] "m/s" ASDM
 SG_ ReSideRdrLe20Obj29RdrObjVyStdDe : 286|6@0+ (0.05,0.0) [0.0|2.0] "m/s" ASDM
 SG_ ReSideRdrLe20Obj29RelVx : 231|12@0+ (0.02,-35.6) [-35.6|35.6] "m/s" ASDM
 SG_ ReSideRdrLe20Obj29RelVy : 247|12@0+ (0.02,-35.6) [-35.6|35.6] "m/s" ASDM

BO_ 1072 SODLPrivateCANFD5Fr30 : 64 SODL
 SG_ ReSideRdrLe20Obj30_UB : 298|1@0+ (1,0) [0|1] "" ASDM
 SG_ ReSideRdrLe20Obj30Heading : 39|12@0+ (0.1,-180.0) [-180.0|180.0] "Deg" ASDM
 SG_ ReSideRdrLe20Obj30ObjBoxCenterLat : 111|9@0+ (0.1,-25.0) [-25.0|25.0] "m" ASDM
 SG_ ReSideRdrLe20Obj30ObjBoxCenterLgt : 23|9@0+ (0.1,-25.0) [-25.0|25.0] "m" ASDM
 SG_ ReSideRdrLe20Obj30ObservationHist : 79|32@0+ (1.0,0.0) [0.0|4294967295.0] "Unitless" ASDM
 SG_ ReSideRdrLe20Obj30QualityBits : 127|18@0+ (1.0,0.0) [0.0|262143.0] "Unitless" ASDM
 SG_ ReSideRdrLe20Obj30RdrObjAx : 55|8@0- (0.1,0.0) [-12.8|12.700000000000001] "m/s^2" ASDM
 SG_ ReSideRdrLe20Obj30RdrObjAy : 63|8@0- (0.1,0.0) [-12.8|12.700000000000001] "m/s^2" ASDM
 SG_ ReSideRdrLe20Obj30RdrObjBoxLength : 151|9@0+ (0.1,0.0) [0.0|50.0] "m" ASDM
 SG_ ReSideRdrLe20Obj30RdrObjBoxWidth : 279|9@0+ (0.1,0.0) [0.0|50.0] "m" ASDM
 SG_ ReSideRdrLe20Obj30RdrObjChks : 7|8@0+ (1.0,0.0) [0.0|255.0] "Unitless" ASDM
 SG_ ReSideRdrLe20Obj30RdrObjCntr : 15|4@0+ (1.0,0.0) [0.0|15.0] "Unitless" ASDM
 SG_ ReSideRdrLe20Obj30RdrObjCoastCnt : 158|5@0+ (1.0,0.0) [0.0|31.0] "Unitless" ASDM
 SG_ ReSideRdrLe20Obj30RdrObjConf : 11|4@0+ (7.0,0.0) [0.0|105.0] "%" ASDM
 SG_ ReSideRdrLe20Obj30RdrObjDx : 207|13@0+ (0.05,-200.0) [-200.0|200.0] "m" ASDM
 SG_ ReSideRdrLe20Obj30RdrObjDxStdDe : 71|8@0+ (0.05,0.0) [0.0|12.700000000000001] "m" ASDM
 SG_ ReSideRdrLe20Obj30RdrObjDy : 295|13@0+ (0.05,-200.0) [-200.0|200.0] "m" ASDM
 SG_ ReSideRdrLe20Obj30RdrObjDyStdDe : 167|8@0+ (0.05,0.0) [0.0|12.700000000000001] "m" ASDM
 SG_ ReSideRdrLe20Obj30RdrObjElevnConf : 43|4@0+ (7.0,0.0) [0.0|105.0] "%" ASDM
 SG_ ReSideRdrLe20Obj30RdrObjElevnSts : 153|2@0+ (1,0) [0|3] "" ASDM
 SG_ ReSideRdrLe20Obj30RdrObjID : 223|8@0+ (1.0,0.0) [0.0|255.0] "Unitless" ASDM
 SG_ ReSideRdrLe20Obj30RdrObjIsInFreeSpace : 280|1@0+ (1,0) [0|1] "" ASDM
 SG_ ReSideRdrLe20Obj30RdrObjMirrProblty : 263|4@0+ (7.0,0.0) [0.0|105.0] "%" ASDM
 SG_ ReSideRdrLe20Obj30RdrObjMtnPat : 210|3@0+ (1,0) [0|7] "" ASDM
 SG_ ReSideRdrLe20Obj30RdrObjNotRealProblty : 259|4@0+ (7.0,0.0) [0.0|105.0] "%" ASDM
 SG_ ReSideRdrLe20Obj30RdrObjStatyCnt : 30|7@0+ (1.0,0.0) [0.0|127.0] "Unitless" ASDM
 SG_ ReSideRdrLe20Obj30RdrObjTiAlv : 118|7@0+ (1.0,0.0) [0.0|127.0] "Unitless" ASDM
 SG_ ReSideRdrLe20Obj30RdrObjTrackSts : 177|2@0+ (1,0) [0|3] "" ASDM
 SG_ ReSideRdrLe20Obj30RdrObjTyp : 235|4@0+ (1,0) [0|15] "" ASDM
 SG_ ReSideRdrLe20Obj30RdrObjTypConfBike : 251|4@0+ (7.0,0.0) [0.0|105.0] "%" ASDM
 SG_ ReSideRdrLe20Obj30RdrObjTypConfPed : 271|4@0+ (7.0,0.0) [0.0|105.0] "%" ASDM
 SG_ ReSideRdrLe20Obj30RdrObjTypConfVeh : 267|4@0+ (7.0,0.0) [0.0|105.0] "%" ASDM
 SG_ ReSideRdrLe20Obj30RdrObjUsedTracker : 193|2@0+ (1,0) [0|3] "" ASDM
 SG_ ReSideRdrLe20Obj30RdrObjVx : 175|14@0+ (0.02,-128.0) [-128.0|128.0] "m/s" ASDM
 SG_ ReSideRdrLe20Obj30RdrObjVxStdDe : 141|6@0+ (0.05,0.0) [0.0|2.0] "m/s" ASDM
 SG_ ReSideRdrLe20Obj30RdrObjVy : 191|14@0+ (0.02,-128.0) [-128.0|128.0] "m/s" ASDM
 SG_ ReSideRdrLe20Obj30RdrObjVyStdDe : 286|6@0+ (0.05,0.0) [0.0|2.0] "m/s" ASDM
 SG_ ReSideRdrLe20Obj30RelVx : 231|12@0+ (0.02,-35.6) [-35.6|35.6] "m/s" ASDM
 SG_ ReSideRdrLe20Obj30RelVy : 247|12@0+ (0.02,-35.6) [-35.6|35.6] "m/s" ASDM

BO_ 1073 SODLPrivateCANFD5Fr31 : 64 SODL
 SG_ ReSideRdrLe20Obj31_UB : 298|1@0+ (1,0) [0|1] "" ASDM
 SG_ ReSideRdrLe20Obj31Heading : 39|12@0+ (0.1,-180.0) [-180.0|180.0] "Deg" ASDM
 SG_ ReSideRdrLe20Obj31ObjBoxCenterLat : 111|9@0+ (0.1,-25.0) [-25.0|25.0] "m" ASDM
 SG_ ReSideRdrLe20Obj31ObjBoxCenterLgt : 23|9@0+ (0.1,-25.0) [-25.0|25.0] "m" ASDM
 SG_ ReSideRdrLe20Obj31ObservationHist : 79|32@0+ (1.0,0.0) [0.0|4294967295.0] "Unitless" ASDM
 SG_ ReSideRdrLe20Obj31QualityBits : 127|18@0+ (1.0,0.0) [0.0|262143.0] "Unitless" ASDM
 SG_ ReSideRdrLe20Obj31RdrObjAx : 55|8@0- (0.1,0.0) [-12.8|12.700000000000001] "m/s^2" ASDM
 SG_ ReSideRdrLe20Obj31RdrObjAy : 63|8@0- (0.1,0.0) [-12.8|12.700000000000001] "m/s^2" ASDM
 SG_ ReSideRdrLe20Obj31RdrObjBoxLength : 151|9@0+ (0.1,0.0) [0.0|50.0] "m" ASDM
 SG_ ReSideRdrLe20Obj31RdrObjBoxWidth : 279|9@0+ (0.1,0.0) [0.0|50.0] "m" ASDM
 SG_ ReSideRdrLe20Obj31RdrObjChks : 7|8@0+ (1.0,0.0) [0.0|255.0] "Unitless" ASDM
 SG_ ReSideRdrLe20Obj31RdrObjCntr : 15|4@0+ (1.0,0.0) [0.0|15.0] "Unitless" ASDM
 SG_ ReSideRdrLe20Obj31RdrObjCoastCnt : 158|5@0+ (1.0,0.0) [0.0|31.0] "Unitless" ASDM
 SG_ ReSideRdrLe20Obj31RdrObjConf : 11|4@0+ (7.0,0.0) [0.0|105.0] "%" ASDM
 SG_ ReSideRdrLe20Obj31RdrObjDx : 207|13@0+ (0.05,-200.0) [-200.0|200.0] "m" ASDM
 SG_ ReSideRdrLe20Obj31RdrObjDxStdDe : 71|8@0+ (0.05,0.0) [0.0|12.700000000000001] "m" ASDM
 SG_ ReSideRdrLe20Obj31RdrObjDy : 295|13@0+ (0.05,-200.0) [-200.0|200.0] "m" ASDM
 SG_ ReSideRdrLe20Obj31RdrObjDyStdDe : 167|8@0+ (0.05,0.0) [0.0|12.700000000000001] "m" ASDM
 SG_ ReSideRdrLe20Obj31RdrObjElevnConf : 43|4@0+ (7.0,0.0) [0.0|105.0] "%" ASDM
 SG_ ReSideRdrLe20Obj31RdrObjElevnSts : 153|2@0+ (1,0) [0|3] "" ASDM
 SG_ ReSideRdrLe20Obj31RdrObjID : 223|8@0+ (1.0,0.0) [0.0|255.0] "Unitless" ASDM
 SG_ ReSideRdrLe20Obj31RdrObjIsInFreeSpace : 280|1@0+ (1,0) [0|1] "" ASDM
 SG_ ReSideRdrLe20Obj31RdrObjMirrProblty : 263|4@0+ (7.0,0.0) [0.0|105.0] "%" ASDM
 SG_ ReSideRdrLe20Obj31RdrObjMtnPat : 210|3@0+ (1,0) [0|7] "" ASDM
 SG_ ReSideRdrLe20Obj31RdrObjNotRealProblty : 259|4@0+ (7.0,0.0) [0.0|105.0] "%" ASDM
 SG_ ReSideRdrLe20Obj31RdrObjStatyCnt : 30|7@0+ (1.0,0.0) [0.0|127.0] "Unitless" ASDM
 SG_ ReSideRdrLe20Obj31RdrObjTiAlv : 118|7@0+ (1.0,0.0) [0.0|127.0] "Unitless" ASDM
 SG_ ReSideRdrLe20Obj31RdrObjTrackSts : 177|2@0+ (1,0) [0|3] "" ASDM
 SG_ ReSideRdrLe20Obj31RdrObjTyp : 235|4@0+ (1,0) [0|15] "" ASDM
 SG_ ReSideRdrLe20Obj31RdrObjTypConfBike : 251|4@0+ (7.0,0.0) [0.0|105.0] "%" ASDM
 SG_ ReSideRdrLe20Obj31RdrObjTypConfPed : 271|4@0+ (7.0,0.0) [0.0|105.0] "%" ASDM
 SG_ ReSideRdrLe20Obj31RdrObjTypConfVeh : 267|4@0+ (7.0,0.0) [0.0|105.0] "%" ASDM
 SG_ ReSideRdrLe20Obj31RdrObjUsedTracker : 193|2@0+ (1,0) [0|3] "" ASDM
 SG_ ReSideRdrLe20Obj31RdrObjVx : 175|14@0+ (0.02,-128.0) [-128.0|128.0] "m/s" ASDM
 SG_ ReSideRdrLe20Obj31RdrObjVxStdDe : 141|6@0+ (0.05,0.0) [0.0|2.0] "m/s" ASDM
 SG_ ReSideRdrLe20Obj31RdrObjVy : 191|14@0+ (0.02,-128.0) [-128.0|128.0] "m/s" ASDM
 SG_ ReSideRdrLe20Obj31RdrObjVyStdDe : 286|6@0+ (0.05,0.0) [0.0|2.0] "m/s" ASDM
 SG_ ReSideRdrLe20Obj31RelVx : 231|12@0+ (0.02,-35.6) [-35.6|35.6] "m/s" ASDM
 SG_ ReSideRdrLe20Obj31RelVy : 247|12@0+ (0.02,-35.6) [-35.6|35.6] "m/s" ASDM

CM_ SG_ 1056 ReSideRdrLe20Obj20Heading "Refer to the data element description in FrntSideRdrLeObj1 with the same data element name.";
CM_ SG_ 1056 ReSideRdrLe20Obj20ObjBoxCenterLat "Refer to the data element description in FrntSideRdrLeObj1 with the same data element name.";
CM_ SG_ 1056 ReSideRdrLe20Obj20ObjBoxCenterLgt "Refer to the data element description in FrntSideRdrLeObj1 with the same data element name.";
CM_ SG_ 1056 ReSideRdrLe20Obj20ObservationHist "Refer to the data element description in FrntSideRdrLeObj1 with the same data element name.";
CM_ SG_ 1056 ReSideRdrLe20Obj20QualityBits "Refer to the data element description in FrntSideRdrLeObj1 with the same data element name.";
CM_ SG_ 1056 ReSideRdrLe20Obj20RdrObjAx "Refer to the data element description in FrntSideRdrLeObj1 with the same data element name.";
CM_ SG_ 1056 ReSideRdrLe20Obj20RdrObjAy "Refer to the data element description in FrntSideRdrLeObj1 with the same data element name.";
CM_ SG_ 1056 ReSideRdrLe20Obj20RdrObjBoxLength "Refer to the data element description in FrntSideRdrLeObj1 with the same data element name.";
CM_ SG_ 1056 ReSideRdrLe20Obj20RdrObjBoxWidth "Refer to the data element description in FrntSideRdrLeObj1 with the same data element name.";
CM_ SG_ 1056 ReSideRdrLe20Obj20RdrObjChks "Refer to the data element description in FrntSideRdrLeObj1 with the same data element name.";
CM_ SG_ 1056 ReSideRdrLe20Obj20RdrObjCntr "Refer to the data element description in FrntSideRdrLeObj1 with the same data element name.";
CM_ SG_ 1056 ReSideRdrLe20Obj20RdrObjCoastCnt "Refer to the data element description in FrntSideRdrLeObj1 with the same data element name.";
CM_ SG_ 1056 ReSideRdrLe20Obj20RdrObjConf "Refer to the data element description in FrntSideRdrLeObj1 with the same data element name.";
CM_ SG_ 1056 ReSideRdrLe20Obj20RdrObjDx "Refer to the data element description in FrntSideRdrLeObj1 with the same data element name.";
CM_ SG_ 1056 ReSideRdrLe20Obj20RdrObjDxStdDe "Refer to the data element description in FrntSideRdrLeObj1 with the same data element name.";
CM_ SG_ 1056 ReSideRdrLe20Obj20RdrObjDy "Refer to the data element description in FrntSideRdrLeObj1 with the same data element name.";
CM_ SG_ 1056 ReSideRdrLe20Obj20RdrObjDyStdDe "Refer to the data element description in FrntSideRdrLeObj1 with the same data element name.";
CM_ SG_ 1056 ReSideRdrLe20Obj20RdrObjElevnConf "Refer to the data element description in FrntSideRdrLeObj1 with the same data element name.";
CM_ SG_ 1056 ReSideRdrLe20Obj20RdrObjElevnSts "Refer to the data element description in FrntSideRdrLeObj1 with the same data element name.";
CM_ SG_ 1056 ReSideRdrLe20Obj20RdrObjID "Refer to the data element description in FrntSideRdrLeObj1 with the same data element name.";
CM_ SG_ 1056 ReSideRdrLe20Obj20RdrObjIsInFreeSpace "Refer to the data element description in FrntSideRdrLeObj1 with the same data element name.";
CM_ SG_ 1056 ReSideRdrLe20Obj20RdrObjMirrProblty "Refer to the data element description in FrntSideRdrLeObj1 with the same data element name.";
CM_ SG_ 1056 ReSideRdrLe20Obj20RdrObjMtnPat "Refer to the data element description in FrntSideRdrLeObj1 with the same data element name.";
CM_ SG_ 1056 ReSideRdrLe20Obj20RdrObjNotRealProblty "Refer to the data element description in FrntSideRdrLeObj1 with the same data element name.";
CM_ SG_ 1056 ReSideRdrLe20Obj20RdrObjStatyCnt "Refer to the data element description in FrntSideRdrLeObj1 with the same data element name.";
CM_ SG_ 1056 ReSideRdrLe20Obj20RdrObjTiAlv "Refer to the data element description in FrntSideRdrLeObj1 with the same data element name.";
CM_ SG_ 1056 ReSideRdrLe20Obj20RdrObjTrackSts "Refer to the data element description in FrntSideRdrLeObj1 with the same data element name.";
CM_ SG_ 1056 ReSideRdrLe20Obj20RdrObjTyp "Refer to the data element description in FrntSideRdrLeObj1 with the same data element name.";
CM_ SG_ 1056 ReSideRdrLe20Obj20RdrObjTypConfBike "Refer to the data element description in FrntSideRdrLeObj1 with the same data element name.";
CM_ SG_ 1056 ReSideRdrLe20Obj20RdrObjTypConfPed "Refer to the data element description in FrntSideRdrLeObj1 with the same data element name.";
CM_ SG_ 1056 ReSideRdrLe20Obj20RdrObjTypConfVeh "Refer to the data element description in FrntSideRdrLeObj1 with the same data element name.";
CM_ SG_ 1056 ReSideRdrLe20Obj20RdrObjUsedTracker "Refer to the data element description in FrntSideRdrLeObj1 with the same data element name.";
CM_ SG_ 1056 ReSideRdrLe20Obj20RdrObjVx "Refer to the data element description in FrntSideRdrLeObj1 with the same data element name.";
CM_ SG_ 1056 ReSideRdrLe20Obj20RdrObjVxStdDe "Refer to the data element description in FrntSideRdrLeObj1 with the same data element name.";
CM_ SG_ 1056 ReSideRdrLe20Obj20RdrObjVy "Refer to the data element description in FrntSideRdrLeObj1 with the same data element name.";
CM_ SG_ 1056 ReSideRdrLe20Obj20RdrObjVyStdDe "Refer to the data element description in FrntSideRdrLeObj1 with the same data element name.";
CM_ SG_ 1056 ReSideRdrLe20Obj20RelVx "Refer to the data element description in FrntSideRdrLeObj1 with the same data element name.";
CM_ SG_ 1056 ReSideRdrLe20Obj20RelVy "Refer to the data element description in FrntSideRdrLeObj1 with the same data element name.";
CM_ SG_ 1057 ReSideRdrLe20Obj21Heading "Refer to the data element description in FrntSideRdrLeObj1 with the same data element name.";
CM_ SG_ 1057 ReSideRdrLe20Obj21ObjBoxCenterLat "Refer to the data element description in FrntSideRdrLeObj1 with the same data element name.";
CM_ SG_ 1057 ReSideRdrLe20Obj21ObjBoxCenterLgt "Refer to the data element description in FrntSideRdrLeObj1 with the same data element name.";
CM_ SG_ 1057 ReSideRdrLe20Obj21ObservationHist "Refer to the data element description in FrntSideRdrLeObj1 with the same data element name.";
CM_ SG_ 1057 ReSideRdrLe20Obj21QualityBits "Refer to the data element description in FrntSideRdrLeObj1 with the same data element name.";
CM_ SG_ 1057 ReSideRdrLe20Obj21RdrObjAx "Refer to the data element description in FrntSideRdrLeObj1 with the same data element name.";
CM_ SG_ 1057 ReSideRdrLe20Obj21RdrObjAy "Refer to the data element description in FrntSideRdrLeObj1 with the same data element name.";
CM_ SG_ 1057 ReSideRdrLe20Obj21RdrObjBoxLength "Refer to the data element description in FrntSideRdrLeObj1 with the same data element name.";
CM_ SG_ 1057 ReSideRdrLe20Obj21RdrObjBoxWidth "Refer to the data element description in FrntSideRdrLeObj1 with the same data element name.";
CM_ SG_ 1057 ReSideRdrLe20Obj21RdrObjChks "Refer to the data element description in FrntSideRdrLeObj1 with the same data element name.";
CM_ SG_ 1057 ReSideRdrLe20Obj21RdrObjCntr "Refer to the data element description in FrntSideRdrLeObj1 with the same data element name.";
CM_ SG_ 1057 ReSideRdrLe20Obj21RdrObjCoastCnt "Refer to the data element description in FrntSideRdrLeObj1 with the same data element name.";
CM_ SG_ 1057 ReSideRdrLe20Obj21RdrObjConf "Refer to the data element description in FrntSideRdrLeObj1 with the same data element name.";
CM_ SG_ 1057 ReSideRdrLe20Obj21RdrObjDx "Refer to the data element description in FrntSideRdrLeObj1 with the same data element name.";
CM_ SG_ 1057 ReSideRdrLe20Obj21RdrObjDxStdDe "Refer to the data element description in FrntSideRdrLeObj1 with the same data element name.";
CM_ SG_ 1057 ReSideRdrLe20Obj21RdrObjDy "Refer to the data element description in FrntSideRdrLeObj1 with the same data element name.";
CM_ SG_ 1057 ReSideRdrLe20Obj21RdrObjDyStdDe "Refer to the data element description in FrntSideRdrLeObj1 with the same data element name.";
CM_ SG_ 1057 ReSideRdrLe20Obj21RdrObjElevnConf "Refer to the data element description in FrntSideRdrLeObj1 with the same data element name.";
CM_ SG_ 1057 ReSideRdrLe20Obj21RdrObjElevnSts "Refer to the data element description in FrntSideRdrLeObj1 with the same data element name.";
CM_ SG_ 1057 ReSideRdrLe20Obj21RdrObjID "Refer to the data element description in FrntSideRdrLeObj1 with the same data element name.";
CM_ SG_ 1057 ReSideRdrLe20Obj21RdrObjIsInFreeSpace "Refer to the data element description in FrntSideRdrLeObj1 with the same data element name.";
CM_ SG_ 1057 ReSideRdrLe20Obj21RdrObjMirrProblty "Refer to the data element description in FrntSideRdrLeObj1 with the same data element name.";
CM_ SG_ 1057 ReSideRdrLe20Obj21RdrObjMtnPat "Refer to the data element description in FrntSideRdrLeObj1 with the same data element name.";
CM_ SG_ 1057 ReSideRdrLe20Obj21RdrObjNotRealProblty "Refer to the data element description in FrntSideRdrLeObj1 with the same data element name.";
CM_ SG_ 1057 ReSideRdrLe20Obj21RdrObjStatyCnt "Refer to the data element description in FrntSideRdrLeObj1 with the same data element name.";
CM_ SG_ 1057 ReSideRdrLe20Obj21RdrObjTiAlv "Refer to the data element description in FrntSideRdrLeObj1 with the same data element name.";
CM_ SG_ 1057 ReSideRdrLe20Obj21RdrObjTrackSts "Refer to the data element description in FrntSideRdrLeObj1 with the same data element name.";
CM_ SG_ 1057 ReSideRdrLe20Obj21RdrObjTyp "Refer to the data element description in FrntSideRdrLeObj1 with the same data element name.";
CM_ SG_ 1057 ReSideRdrLe20Obj21RdrObjTypConfBike "Refer to the data element description in FrntSideRdrLeObj1 with the same data element name.";
CM_ SG_ 1057 ReSideRdrLe20Obj21RdrObjTypConfPed "Refer to the data element description in FrntSideRdrLeObj1 with the same data element name.";
CM_ SG_ 1057 ReSideRdrLe20Obj21RdrObjTypConfVeh "Refer to the data element description in FrntSideRdrLeObj1 with the same data element name.";
CM_ SG_ 1057 ReSideRdrLe20Obj21RdrObjUsedTracker "Refer to the data element description in FrntSideRdrLeObj1 with the same data element name.";
CM_ SG_ 1057 ReSideRdrLe20Obj21RdrObjVx "Refer to the data element description in FrntSideRdrLeObj1 with the same data element name.";
CM_ SG_ 1057 ReSideRdrLe20Obj21RdrObjVxStdDe "Refer to the data element description in FrntSideRdrLeObj1 with the same data element name.";
CM_ SG_ 1057 ReSideRdrLe20Obj21RdrObjVy "Refer to the data element description in FrntSideRdrLeObj1 with the same data element name.";
CM_ SG_ 1057 ReSideRdrLe20Obj21RdrObjVyStdDe "Refer to the data element description in FrntSideRdrLeObj1 with the same data element name.";
CM_ SG_ 1057 ReSideRdrLe20Obj21RelVx "Refer to the data element description in FrntSideRdrLeObj1 with the same data element name.";
CM_ SG_ 1057 ReSideRdrLe20Obj21RelVy "Refer to the data element description in FrntSideRdrLeObj1 with the same data element name.";
CM_ SG_ 1058 ReSideRdrLe20Obj22Heading "Refer to the data element description in FrntSideRdrLeObj1 with the same data element name.";
CM_ SG_ 1058 ReSideRdrLe20Obj22ObjBoxCenterLat "Refer to the data element description in FrntSideRdrLeObj1 with the same data element name.";
CM_ SG_ 1058 ReSideRdrLe20Obj22ObjBoxCenterLgt "Refer to the data element description in FrntSideRdrLeObj1 with the same data element name.";
CM_ SG_ 1058 ReSideRdrLe20Obj22ObservationHist "Refer to the data element description in FrntSideRdrLeObj1 with the same data element name.";
CM_ SG_ 1058 ReSideRdrLe20Obj22QualityBits "Refer to the data element description in FrntSideRdrLeObj1 with the same data element name.";
CM_ SG_ 1058 ReSideRdrLe20Obj22RdrObjAx "Refer to the data element description in FrntSideRdrLeObj1 with the same data element name.";
CM_ SG_ 1058 ReSideRdrLe20Obj22RdrObjAy "Refer to the data element description in FrntSideRdrLeObj1 with the same data element name.";
CM_ SG_ 1058 ReSideRdrLe20Obj22RdrObjBoxLength "Refer to the data element description in FrntSideRdrLeObj1 with the same data element name.";
CM_ SG_ 1058 ReSideRdrLe20Obj22RdrObjBoxWidth "Refer to the data element description in FrntSideRdrLeObj1 with the same data element name.";
CM_ SG_ 1058 ReSideRdrLe20Obj22RdrObjChks "Refer to the data element description in FrntSideRdrLeObj1 with the same data element name.";
CM_ SG_ 1058 ReSideRdrLe20Obj22RdrObjCntr "Refer to the data element description in FrntSideRdrLeObj1 with the same data element name.";
CM_ SG_ 1058 ReSideRdrLe20Obj22RdrObjCoastCnt "Refer to the data element description in FrntSideRdrLeObj1 with the same data element name.";
CM_ SG_ 1058 ReSideRdrLe20Obj22RdrObjConf "Refer to the data element description in FrntSideRdrLeObj1 with the same data element name.";
CM_ SG_ 1058 ReSideRdrLe20Obj22RdrObjDx "Refer to the data element description in FrntSideRdrLeObj1 with the same data element name.";
CM_ SG_ 1058 ReSideRdrLe20Obj22RdrObjDxStdDe "Refer to the data element description in FrntSideRdrLeObj1 with the same data element name.";
CM_ SG_ 1058 ReSideRdrLe20Obj22RdrObjDy "Refer to the data element description in FrntSideRdrLeObj1 with the same data element name.";
CM_ SG_ 1058 ReSideRdrLe20Obj22RdrObjDyStdDe "Refer to the data element description in FrntSideRdrLeObj1 with the same data element name.";
CM_ SG_ 1058 ReSideRdrLe20Obj22RdrObjElevnConf "Refer to the data element description in FrntSideRdrLeObj1 with the same data element name.";
CM_ SG_ 1058 ReSideRdrLe20Obj22RdrObjElevnSts "Refer to the data element description in FrntSideRdrLeObj1 with the same data element name.";
CM_ SG_ 1058 ReSideRdrLe20Obj22RdrObjID "Refer to the data element description in FrntSideRdrLeObj1 with the same data element name.";
CM_ SG_ 1058 ReSideRdrLe20Obj22RdrObjIsInFreeSpace "Refer to the data element description in FrntSideRdrLeObj1 with the same data element name.";
CM_ SG_ 1058 ReSideRdrLe20Obj22RdrObjMirrProblty "Refer to the data element description in FrntSideRdrLeObj1 with the same data element name.";
CM_ SG_ 1058 ReSideRdrLe20Obj22RdrObjMtnPat "Refer to the data element description in FrntSideRdrLeObj1 with the same data element name.";
CM_ SG_ 1058 ReSideRdrLe20Obj22RdrObjNotRealProblty "Refer to the data element description in FrntSideRdrLeObj1 with the same data element name.";
CM_ SG_ 1058 ReSideRdrLe20Obj22RdrObjStatyCnt "Refer to the data element description in FrntSideRdrLeObj1 with the same data element name.";
CM_ SG_ 1058 ReSideRdrLe20Obj22RdrObjTiAlv "Refer to the data element description in FrntSideRdrLeObj1 with the same data element name.";
CM_ SG_ 1058 ReSideRdrLe20Obj22RdrObjTrackSts "Refer to the data element description in FrntSideRdrLeObj1 with the same data element name.";
CM_ SG_ 1058 ReSideRdrLe20Obj22RdrObjTyp "Refer to the data element description in FrntSideRdrLeObj1 with the same data element name.";
CM_ SG_ 1058 ReSideRdrLe20Obj22RdrObjTypConfBike "Refer to the data element description in FrntSideRdrLeObj1 with the same data element name.";
CM_ SG_ 1058 ReSideRdrLe20Obj22RdrObjTypConfPed "Refer to the data element description in FrntSideRdrLeObj1 with the same data element name.";
CM_ SG_ 1058 ReSideRdrLe20Obj22RdrObjTypConfVeh "Refer to the data element description in FrntSideRdrLeObj1 with the same data element name.";
CM_ SG_ 1058 ReSideRdrLe20Obj22RdrObjUsedTracker "Refer to the data element description in FrntSideRdrLeObj1 with the same data element name.";
CM_ SG_ 1058 ReSideRdrLe20Obj22RdrObjVx "Refer to the data element description in FrntSideRdrLeObj1 with the same data element name.";
CM_ SG_ 1058 ReSideRdrLe20Obj22RdrObjVxStdDe "Refer to the data element description in FrntSideRdrLeObj1 with the same data element name.";
CM_ SG_ 1058 ReSideRdrLe20Obj22RdrObjVy "Refer to the data element description in FrntSideRdrLeObj1 with the same data element name.";
CM_ SG_ 1058 ReSideRdrLe20Obj22RdrObjVyStdDe "Refer to the data element description in FrntSideRdrLeObj1 with the same data element name.";
CM_ SG_ 1058 ReSideRdrLe20Obj22RelVx "Refer to the data element description in FrntSideRdrLeObj1 with the same data element name.";
CM_ SG_ 1058 ReSideRdrLe20Obj22RelVy "Refer to the data element description in FrntSideRdrLeObj1 with the same data element name.";
CM_ SG_ 1059 ReSideRdrLe20Obj23Heading "Refer to the data element description in FrntSideRdrLeObj1 with the same data element name.";
CM_ SG_ 1059 ReSideRdrLe20Obj23ObjBoxCenterLat "Refer to the data element description in FrntSideRdrLeObj1 with the same data element name.";
CM_ SG_ 1059 ReSideRdrLe20Obj23ObjBoxCenterLgt "Refer to the data element description in FrntSideRdrLeObj1 with the same data element name.";
CM_ SG_ 1059 ReSideRdrLe20Obj23ObservationHist "Refer to the data element description in FrntSideRdrLeObj1 with the same data element name.";
CM_ SG_ 1059 ReSideRdrLe20Obj23QualityBits "Refer to the data element description in FrntSideRdrLeObj1 with the same data element name.";
CM_ SG_ 1059 ReSideRdrLe20Obj23RdrObjAx "Refer to the data element description in FrntSideRdrLeObj1 with the same data element name.";
CM_ SG_ 1059 ReSideRdrLe20Obj23RdrObjAy "Refer to the data element description in FrntSideRdrLeObj1 with the same data element name.";
CM_ SG_ 1059 ReSideRdrLe20Obj23RdrObjBoxLength "Refer to the data element description in FrntSideRdrLeObj1 with the same data element name.";
CM_ SG_ 1059 ReSideRdrLe20Obj23RdrObjBoxWidth "Refer to the data element description in FrntSideRdrLeObj1 with the same data element name.";
CM_ SG_ 1059 ReSideRdrLe20Obj23RdrObjChks "Refer to the data element description in FrntSideRdrLeObj1 with the same data element name.";
CM_ SG_ 1059 ReSideRdrLe20Obj23RdrObjCntr "Refer to the data element description in FrntSideRdrLeObj1 with the same data element name.";
CM_ SG_ 1059 ReSideRdrLe20Obj23RdrObjCoastCnt "Refer to the data element description in FrntSideRdrLeObj1 with the same data element name.";
CM_ SG_ 1059 ReSideRdrLe20Obj23RdrObjConf "Refer to the data element description in FrntSideRdrLeObj1 with the same data element name.";
CM_ SG_ 1059 ReSideRdrLe20Obj23RdrObjDx "Refer to the data element description in FrntSideRdrLeObj1 with the same data element name.";
CM_ SG_ 1059 ReSideRdrLe20Obj23RdrObjDxStdDe "Refer to the data element description in FrntSideRdrLeObj1 with the same data element name.";
CM_ SG_ 1059 ReSideRdrLe20Obj23RdrObjDy "Refer to the data element description in FrntSideRdrLeObj1 with the same data element name.";
CM_ SG_ 1059 ReSideRdrLe20Obj23RdrObjDyStdDe "Refer to the data element description in FrntSideRdrLeObj1 with the same data element name.";
CM_ SG_ 1059 ReSideRdrLe20Obj23RdrObjElevnConf "Refer to the data element description in FrntSideRdrLeObj1 with the same data element name.";
CM_ SG_ 1059 ReSideRdrLe20Obj23RdrObjElevnSts "Refer to the data element description in FrntSideRdrLeObj1 with the same data element name.";
CM_ SG_ 1059 ReSideRdrLe20Obj23RdrObjID "Refer to the data element description in FrntSideRdrLeObj1 with the same data element name.";
CM_ SG_ 1059 ReSideRdrLe20Obj23RdrObjIsInFreeSpace "Refer to the data element description in FrntSideRdrLeObj1 with the same data element name.";
CM_ SG_ 1059 ReSideRdrLe20Obj23RdrObjMirrProblty "Refer to the data element description in FrntSideRdrLeObj1 with the same data element name.";
CM_ SG_ 1059 ReSideRdrLe20Obj23RdrObjMtnPat "Refer to the data element description in FrntSideRdrLeObj1 with the same data element name.";
CM_ SG_ 1059 ReSideRdrLe20Obj23RdrObjNotRealProblty "Refer to the data element description in FrntSideRdrLeObj1 with the same data element name.";
CM_ SG_ 1059 ReSideRdrLe20Obj23RdrObjStatyCnt "Refer to the data element description in FrntSideRdrLeObj1 with the same data element name.";
CM_ SG_ 1059 ReSideRdrLe20Obj23RdrObjTiAlv "Refer to the data element description in FrntSideRdrLeObj1 with the same data element name.";
CM_ SG_ 1059 ReSideRdrLe20Obj23RdrObjTrackSts "Refer to the data element description in FrntSideRdrLeObj1 with the same data element name.";
CM_ SG_ 1059 ReSideRdrLe20Obj23RdrObjTyp "Refer to the data element description in FrntSideRdrLeObj1 with the same data element name.";
CM_ SG_ 1059 ReSideRdrLe20Obj23RdrObjTypConfBike "Refer to the data element description in FrntSideRdrLeObj1 with the same data element name.";
CM_ SG_ 1059 ReSideRdrLe20Obj23RdrObjTypConfPed "Refer to the data element description in FrntSideRdrLeObj1 with the same data element name.";
CM_ SG_ 1059 ReSideRdrLe20Obj23RdrObjTypConfVeh "Refer to the data element description in FrntSideRdrLeObj1 with the same data element name.";
CM_ SG_ 1059 ReSideRdrLe20Obj23RdrObjUsedTracker "Refer to the data element description in FrntSideRdrLeObj1 with the same data element name.";
CM_ SG_ 1059 ReSideRdrLe20Obj23RdrObjVx "Refer to the data element description in FrntSideRdrLeObj1 with the same data element name.";
CM_ SG_ 1059 ReSideRdrLe20Obj23RdrObjVxStdDe "Refer to the data element description in FrntSideRdrLeObj1 with the same data element name.";
CM_ SG_ 1059 ReSideRdrLe20Obj23RdrObjVy "Refer to the data element description in FrntSideRdrLeObj1 with the same data element name.";
CM_ SG_ 1059 ReSideRdrLe20Obj23RdrObjVyStdDe "Refer to the data element description in FrntSideRdrLeObj1 with the same data element name.";
CM_ SG_ 1059 ReSideRdrLe20Obj23RelVx "Refer to the data element description in FrntSideRdrLeObj1 with the same data element name.";
CM_ SG_ 1059 ReSideRdrLe20Obj23RelVy "Refer to the data element description in FrntSideRdrLeObj1 with the same data element name.";
CM_ SG_ 1060 ReSideRdrLe20Obj24Heading "Refer to the data element description in FrntSideRdrLeObj1 with the same data element name.";
CM_ SG_ 1060 ReSideRdrLe20Obj24ObjBoxCenterLat "Refer to the data element description in FrntSideRdrLeObj1 with the same data element name.";
CM_ SG_ 1060 ReSideRdrLe20Obj24ObjBoxCenterLgt "Refer to the data element description in FrntSideRdrLeObj1 with the same data element name.";
CM_ SG_ 1060 ReSideRdrLe20Obj24ObservationHist "Refer to the data element description in FrntSideRdrLeObj1 with the same data element name.";
CM_ SG_ 1060 ReSideRdrLe20Obj24QualityBits "Refer to the data element description in FrntSideRdrLeObj1 with the same data element name.";
CM_ SG_ 1060 ReSideRdrLe20Obj24RdrObjAx "Refer to the data element description in FrntSideRdrLeObj1 with the same data element name.";
CM_ SG_ 1060 ReSideRdrLe20Obj24RdrObjAy "Refer to the data element description in FrntSideRdrLeObj1 with the same data element name.";
CM_ SG_ 1060 ReSideRdrLe20Obj24RdrObjBoxLength "Refer to the data element description in FrntSideRdrLeObj1 with the same data element name.";
CM_ SG_ 1060 ReSideRdrLe20Obj24RdrObjBoxWidth "Refer to the data element description in FrntSideRdrLeObj1 with the same data element name.";
CM_ SG_ 1060 ReSideRdrLe20Obj24RdrObjChks "Refer to the data element description in FrntSideRdrLeObj1 with the same data element name.";
CM_ SG_ 1060 ReSideRdrLe20Obj24RdrObjCntr "Refer to the data element description in FrntSideRdrLeObj1 with the same data element name.";
CM_ SG_ 1060 ReSideRdrLe20Obj24RdrObjCoastCnt "Refer to the data element description in FrntSideRdrLeObj1 with the same data element name.";
CM_ SG_ 1060 ReSideRdrLe20Obj24RdrObjConf "Refer to the data element description in FrntSideRdrLeObj1 with the same data element name.";
CM_ SG_ 1060 ReSideRdrLe20Obj24RdrObjDx "Refer to the data element description in FrntSideRdrLeObj1 with the same data element name.";
CM_ SG_ 1060 ReSideRdrLe20Obj24RdrObjDxStdDe "Refer to the data element description in FrntSideRdrLeObj1 with the same data element name.";
CM_ SG_ 1060 ReSideRdrLe20Obj24RdrObjDy "Refer to the data element description in FrntSideRdrLeObj1 with the same data element name.";
CM_ SG_ 1060 ReSideRdrLe20Obj24RdrObjDyStdDe "Refer to the data element description in FrntSideRdrLeObj1 with the same data element name.";
CM_ SG_ 1060 ReSideRdrLe20Obj24RdrObjElevnConf "Refer to the data element description in FrntSideRdrLeObj1 with the same data element name.";
CM_ SG_ 1060 ReSideRdrLe20Obj24RdrObjElevnSts "Refer to the data element description in FrntSideRdrLeObj1 with the same data element name.";
CM_ SG_ 1060 ReSideRdrLe20Obj24RdrObjID "Refer to the data element description in FrntSideRdrLeObj1 with the same data element name.";
CM_ SG_ 1060 ReSideRdrLe20Obj24RdrObjIsInFreeSpace "Refer to the data element description in FrntSideRdrLeObj1 with the same data element name.";
CM_ SG_ 1060 ReSideRdrLe20Obj24RdrObjMirrProblty "Refer to the data element description in FrntSideRdrLeObj1 with the same data element name.";
CM_ SG_ 1060 ReSideRdrLe20Obj24RdrObjMtnPat "Refer to the data element description in FrntSideRdrLeObj1 with the same data element name.";
CM_ SG_ 1060 ReSideRdrLe20Obj24RdrObjNotRealProblty "Refer to the data element description in FrntSideRdrLeObj1 with the same data element name.";
CM_ SG_ 1060 ReSideRdrLe20Obj24RdrObjStatyCnt "Refer to the data element description in FrntSideRdrLeObj1 with the same data element name.";
CM_ SG_ 1060 ReSideRdrLe20Obj24RdrObjTiAlv "Refer to the data element description in FrntSideRdrLeObj1 with the same data element name.";
CM_ SG_ 1060 ReSideRdrLe20Obj24RdrObjTrackSts "Refer to the data element description in FrntSideRdrLeObj1 with the same data element name.";
CM_ SG_ 1060 ReSideRdrLe20Obj24RdrObjTyp "Refer to the data element description in FrntSideRdrLeObj1 with the same data element name.";
CM_ SG_ 1060 ReSideRdrLe20Obj24RdrObjTypConfBike "Refer to the data element description in FrntSideRdrLeObj1 with the same data element name.";
CM_ SG_ 1060 ReSideRdrLe20Obj24RdrObjTypConfPed "Refer to the data element description in FrntSideRdrLeObj1 with the same data element name.";
CM_ SG_ 1060 ReSideRdrLe20Obj24RdrObjTypConfVeh "Refer to the data element description in FrntSideRdrLeObj1 with the same data element name.";
CM_ SG_ 1060 ReSideRdrLe20Obj24RdrObjUsedTracker "Refer to the data element description in FrntSideRdrLeObj1 with the same data element name.";
CM_ SG_ 1060 ReSideRdrLe20Obj24RdrObjVx "Refer to the data element description in FrntSideRdrLeObj1 with the same data element name.";
CM_ SG_ 1060 ReSideRdrLe20Obj24RdrObjVxStdDe "Refer to the data element description in FrntSideRdrLeObj1 with the same data element name.";
CM_ SG_ 1060 ReSideRdrLe20Obj24RdrObjVy "Refer to the data element description in FrntSideRdrLeObj1 with the same data element name.";
CM_ SG_ 1060 ReSideRdrLe20Obj24RdrObjVyStdDe "Refer to the data element description in FrntSideRdrLeObj1 with the same data element name.";
CM_ SG_ 1060 ReSideRdrLe20Obj24RelVx "Refer to the data element description in FrntSideRdrLeObj1 with the same data element name.";
CM_ SG_ 1060 ReSideRdrLe20Obj24RelVy "Refer to the data element description in FrntSideRdrLeObj1 with the same data element name.";
CM_ SG_ 1061 ReSideRdrLe20Obj25Heading "Refer to the data element description in FrntSideRdrLeObj1 with the same data element name.";
CM_ SG_ 1061 ReSideRdrLe20Obj25ObjBoxCenterLat "Refer to the data element description in FrntSideRdrLeObj1 with the same data element name.";
CM_ SG_ 1061 ReSideRdrLe20Obj25ObjBoxCenterLgt "Refer to the data element description in FrntSideRdrLeObj1 with the same data element name.";
CM_ SG_ 1061 ReSideRdrLe20Obj25ObservationHist "Refer to the data element description in FrntSideRdrLeObj1 with the same data element name.";
CM_ SG_ 1061 ReSideRdrLe20Obj25QualityBits "Refer to the data element description in FrntSideRdrLeObj1 with the same data element name.";
CM_ SG_ 1061 ReSideRdrLe20Obj25RdrObjAx "Refer to the data element description in FrntSideRdrLeObj1 with the same data element name.";
CM_ SG_ 1061 ReSideRdrLe20Obj25RdrObjAy "Refer to the data element description in FrntSideRdrLeObj1 with the same data element name.";
CM_ SG_ 1061 ReSideRdrLe20Obj25RdrObjBoxLength "Refer to the data element description in FrntSideRdrLeObj1 with the same data element name.";
CM_ SG_ 1061 ReSideRdrLe20Obj25RdrObjBoxWidth "Refer to the data element description in FrntSideRdrLeObj1 with the same data element name.";
CM_ SG_ 1061 ReSideRdrLe20Obj25RdrObjChks "Refer to the data element description in FrntSideRdrLeObj1 with the same data element name.";
CM_ SG_ 1061 ReSideRdrLe20Obj25RdrObjCntr "Refer to the data element description in FrntSideRdrLeObj1 with the same data element name.";
CM_ SG_ 1061 ReSideRdrLe20Obj25RdrObjCoastCnt "Refer to the data element description in FrntSideRdrLeObj1 with the same data element name.";
CM_ SG_ 1061 ReSideRdrLe20Obj25RdrObjConf "Refer to the data element description in FrntSideRdrLeObj1 with the same data element name.";
CM_ SG_ 1061 ReSideRdrLe20Obj25RdrObjDx "Refer to the data element description in FrntSideRdrLeObj1 with the same data element name.";
CM_ SG_ 1061 ReSideRdrLe20Obj25RdrObjDxStdDe "Refer to the data element description in FrntSideRdrLeObj1 with the same data element name.";
CM_ SG_ 1061 ReSideRdrLe20Obj25RdrObjDy "Refer to the data element description in FrntSideRdrLeObj1 with the same data element name.";
CM_ SG_ 1061 ReSideRdrLe20Obj25RdrObjDyStdDe "Refer to the data element description in FrntSideRdrLeObj1 with the same data element name.";
CM_ SG_ 1061 ReSideRdrLe20Obj25RdrObjElevnConf "Refer to the data element description in FrntSideRdrLeObj1 with the same data element name.";
CM_ SG_ 1061 ReSideRdrLe20Obj25RdrObjElevnSts "Refer to the data element description in FrntSideRdrLeObj1 with the same data element name.";
CM_ SG_ 1061 ReSideRdrLe20Obj25RdrObjID "Refer to the data element description in FrntSideRdrLeObj1 with the same data element name.";
CM_ SG_ 1061 ReSideRdrLe20Obj25RdrObjIsInFreeSpace "Refer to the data element description in FrntSideRdrLeObj1 with the same data element name.";
CM_ SG_ 1061 ReSideRdrLe20Obj25RdrObjMirrProblty "Refer to the data element description in FrntSideRdrLeObj1 with the same data element name.";
CM_ SG_ 1061 ReSideRdrLe20Obj25RdrObjMtnPat "Refer to the data element description in FrntSideRdrLeObj1 with the same data element name.";
CM_ SG_ 1061 ReSideRdrLe20Obj25RdrObjNotRealProblty "Refer to the data element description in FrntSideRdrLeObj1 with the same data element name.";
CM_ SG_ 1061 ReSideRdrLe20Obj25RdrObjStatyCnt "Refer to the data element description in FrntSideRdrLeObj1 with the same data element name.";
CM_ SG_ 1061 ReSideRdrLe20Obj25RdrObjTiAlv "Refer to the data element description in FrntSideRdrLeObj1 with the same data element name.";
CM_ SG_ 1061 ReSideRdrLe20Obj25RdrObjTrackSts "Refer to the data element description in FrntSideRdrLeObj1 with the same data element name.";
CM_ SG_ 1061 ReSideRdrLe20Obj25RdrObjTyp "Refer to the data element description in FrntSideRdrLeObj1 with the same data element name.";
CM_ SG_ 1061 ReSideRdrLe20Obj25RdrObjTypConfBike "Refer to the data element description in FrntSideRdrLeObj1 with the same data element name.";
CM_ SG_ 1061 ReSideRdrLe20Obj25RdrObjTypConfPed "Refer to the data element description in FrntSideRdrLeObj1 with the same data element name.";
CM_ SG_ 1061 ReSideRdrLe20Obj25RdrObjTypConfVeh "Refer to the data element description in FrntSideRdrLeObj1 with the same data element name.";
CM_ SG_ 1061 ReSideRdrLe20Obj25RdrObjUsedTracker "Refer to the data element description in FrntSideRdrLeObj1 with the same data element name.";
CM_ SG_ 1061 ReSideRdrLe20Obj25RdrObjVx "Refer to the data element description in FrntSideRdrLeObj1 with the same data element name.";
CM_ SG_ 1061 ReSideRdrLe20Obj25RdrObjVxStdDe "Refer to the data element description in FrntSideRdrLeObj1 with the same data element name.";
CM_ SG_ 1061 ReSideRdrLe20Obj25RdrObjVy "Refer to the data element description in FrntSideRdrLeObj1 with the same data element name.";
CM_ SG_ 1061 ReSideRdrLe20Obj25RdrObjVyStdDe "Refer to the data element description in FrntSideRdrLeObj1 with the same data element name.";
CM_ SG_ 1061 ReSideRdrLe20Obj25RelVx "Refer to the data element description in FrntSideRdrLeObj1 with the same data element name.";
CM_ SG_ 1061 ReSideRdrLe20Obj25RelVy "Refer to the data element description in FrntSideRdrLeObj1 with the same data element name.";
CM_ SG_ 1062 ReSideRdrLe20Obj26Heading "Refer to the data element description in FrntSideRdrLeObj1 with the same data element name.";
CM_ SG_ 1062 ReSideRdrLe20Obj26ObjBoxCenterLat "Refer to the data element description in FrntSideRdrLeObj1 with the same data element name.";
CM_ SG_ 1062 ReSideRdrLe20Obj26ObjBoxCenterLgt "Refer to the data element description in FrntSideRdrLeObj1 with the same data element name.";
CM_ SG_ 1062 ReSideRdrLe20Obj26ObservationHist "Refer to the data element description in FrntSideRdrLeObj1 with the same data element name.";
CM_ SG_ 1062 ReSideRdrLe20Obj26QualityBits "Refer to the data element description in FrntSideRdrLeObj1 with the same data element name.";
CM_ SG_ 1062 ReSideRdrLe20Obj26RdrObjAx "Refer to the data element description in FrntSideRdrLeObj1 with the same data element name.";
CM_ SG_ 1062 ReSideRdrLe20Obj26RdrObjAy "Refer to the data element description in FrntSideRdrLeObj1 with the same data element name.";
CM_ SG_ 1062 ReSideRdrLe20Obj26RdrObjBoxLength "Refer to the data element description in FrntSideRdrLeObj1 with the same data element name.";
CM_ SG_ 1062 ReSideRdrLe20Obj26RdrObjBoxWidth "Refer to the data element description in FrntSideRdrLeObj1 with the same data element name.";
CM_ SG_ 1062 ReSideRdrLe20Obj26RdrObjChks "Refer to the data element description in FrntSideRdrLeObj1 with the same data element name.";
CM_ SG_ 1062 ReSideRdrLe20Obj26RdrObjCntr "Refer to the data element description in FrntSideRdrLeObj1 with the same data element name.";
CM_ SG_ 1062 ReSideRdrLe20Obj26RdrObjCoastCnt "Refer to the data element description in FrntSideRdrLeObj1 with the same data element name.";
CM_ SG_ 1062 ReSideRdrLe20Obj26RdrObjConf "Refer to the data element description in FrntSideRdrLeObj1 with the same data element name.";
CM_ SG_ 1062 ReSideRdrLe20Obj26RdrObjDx "Refer to the data element description in FrntSideRdrLeObj1 with the same data element name.";
CM_ SG_ 1062 ReSideRdrLe20Obj26RdrObjDxStdDe "Refer to the data element description in FrntSideRdrLeObj1 with the same data element name.";
CM_ SG_ 1062 ReSideRdrLe20Obj26RdrObjDy "Refer to the data element description in FrntSideRdrLeObj1 with the same data element name.";
CM_ SG_ 1062 ReSideRdrLe20Obj26RdrObjDyStdDe "Refer to the data element description in FrntSideRdrLeObj1 with the same data element name.";
CM_ SG_ 1062 ReSideRdrLe20Obj26RdrObjElevnConf "Refer to the data element description in FrntSideRdrLeObj1 with the same data element name.";
CM_ SG_ 1062 ReSideRdrLe20Obj26RdrObjElevnSts "Refer to the data element description in FrntSideRdrLeObj1 with the same data element name.";
CM_ SG_ 1062 ReSideRdrLe20Obj26RdrObjID "Refer to the data element description in FrntSideRdrLeObj1 with the same data element name.";
CM_ SG_ 1062 ReSideRdrLe20Obj26RdrObjIsInFreeSpace "Refer to the data element description in FrntSideRdrLeObj1 with the same data element name.";
CM_ SG_ 1062 ReSideRdrLe20Obj26RdrObjMirrProblty "Refer to the data element description in FrntSideRdrLeObj1 with the same data element name.";
CM_ SG_ 1062 ReSideRdrLe20Obj26RdrObjMtnPat "Refer to the data element description in FrntSideRdrLeObj1 with the same data element name.";
CM_ SG_ 1062 ReSideRdrLe20Obj26RdrObjNotRealProblty "Refer to the data element description in FrntSideRdrLeObj1 with the same data element name.";
CM_ SG_ 1062 ReSideRdrLe20Obj26RdrObjStatyCnt "Refer to the data element description in FrntSideRdrLeObj1 with the same data element name.";
CM_ SG_ 1062 ReSideRdrLe20Obj26RdrObjTiAlv "Refer to the data element description in FrntSideRdrLeObj1 with the same data element name.";
CM_ SG_ 1062 ReSideRdrLe20Obj26RdrObjTrackSts "Refer to the data element description in FrntSideRdrLeObj1 with the same data element name.";
CM_ SG_ 1062 ReSideRdrLe20Obj26RdrObjTyp "Refer to the data element description in FrntSideRdrLeObj1 with the same data element name.";
CM_ SG_ 1062 ReSideRdrLe20Obj26RdrObjTypConfBike "Refer to the data element description in FrntSideRdrLeObj1 with the same data element name.";
CM_ SG_ 1062 ReSideRdrLe20Obj26RdrObjTypConfPed "Refer to the data element description in FrntSideRdrLeObj1 with the same data element name.";
CM_ SG_ 1062 ReSideRdrLe20Obj26RdrObjTypConfVeh "Refer to the data element description in FrntSideRdrLeObj1 with the same data element name.";
CM_ SG_ 1062 ReSideRdrLe20Obj26RdrObjUsedTracker "Refer to the data element description in FrntSideRdrLeObj1 with the same data element name.";
CM_ SG_ 1062 ReSideRdrLe20Obj26RdrObjVx "Refer to the data element description in FrntSideRdrLeObj1 with the same data element name.";
CM_ SG_ 1062 ReSideRdrLe20Obj26RdrObjVxStdDe "Refer to the data element description in FrntSideRdrLeObj1 with the same data element name.";
CM_ SG_ 1062 ReSideRdrLe20Obj26RdrObjVy "Refer to the data element description in FrntSideRdrLeObj1 with the same data element name.";
CM_ SG_ 1062 ReSideRdrLe20Obj26RdrObjVyStdDe "Refer to the data element description in FrntSideRdrLeObj1 with the same data element name.";
CM_ SG_ 1062 ReSideRdrLe20Obj26RelVx "Refer to the data element description in FrntSideRdrLeObj1 with the same data element name.";
CM_ SG_ 1062 ReSideRdrLe20Obj26RelVy "Refer to the data element description in FrntSideRdrLeObj1 with the same data element name.";
CM_ SG_ 1063 ReSideRdrLe20Obj27Heading "Refer to the data element description in FrntSideRdrLeObj1 with the same data element name.";
CM_ SG_ 1063 ReSideRdrLe20Obj27ObjBoxCenterLat "Refer to the data element description in FrntSideRdrLeObj1 with the same data element name.";
CM_ SG_ 1063 ReSideRdrLe20Obj27ObjBoxCenterLgt "Refer to the data element description in FrntSideRdrLeObj1 with the same data element name.";
CM_ SG_ 1063 ReSideRdrLe20Obj27ObservationHist "Refer to the data element description in FrntSideRdrLeObj1 with the same data element name.";
CM_ SG_ 1063 ReSideRdrLe20Obj27QualityBits "Refer to the data element description in FrntSideRdrLeObj1 with the same data element name.";
CM_ SG_ 1063 ReSideRdrLe20Obj27RdrObjAx "Refer to the data element description in FrntSideRdrLeObj1 with the same data element name.";
CM_ SG_ 1063 ReSideRdrLe20Obj27RdrObjAy "Refer to the data element description in FrntSideRdrLeObj1 with the same data element name.";
CM_ SG_ 1063 ReSideRdrLe20Obj27RdrObjBoxLength "Refer to the data element description in FrntSideRdrLeObj1 with the same data element name.";
CM_ SG_ 1063 ReSideRdrLe20Obj27RdrObjBoxWidth "Refer to the data element description in FrntSideRdrLeObj1 with the same data element name.";
CM_ SG_ 1063 ReSideRdrLe20Obj27RdrObjChks "Refer to the data element description in FrntSideRdrLeObj1 with the same data element name.";
CM_ SG_ 1063 ReSideRdrLe20Obj27RdrObjCntr "Refer to the data element description in FrntSideRdrLeObj1 with the same data element name.";
CM_ SG_ 1063 ReSideRdrLe20Obj27RdrObjCoastCnt "Refer to the data element description in FrntSideRdrLeObj1 with the same data element name.";
CM_ SG_ 1063 ReSideRdrLe20Obj27RdrObjConf "Refer to the data element description in FrntSideRdrLeObj1 with the same data element name.";
CM_ SG_ 1063 ReSideRdrLe20Obj27RdrObjDx "Refer to the data element description in FrntSideRdrLeObj1 with the same data element name.";
CM_ SG_ 1063 ReSideRdrLe20Obj27RdrObjDxStdDe "Refer to the data element description in FrntSideRdrLeObj1 with the same data element name.";
CM_ SG_ 1063 ReSideRdrLe20Obj27RdrObjDy "Refer to the data element description in FrntSideRdrLeObj1 with the same data element name.";
CM_ SG_ 1063 ReSideRdrLe20Obj27RdrObjDyStdDe "Refer to the data element description in FrntSideRdrLeObj1 with the same data element name.";
CM_ SG_ 1063 ReSideRdrLe20Obj27RdrObjElevnConf "Refer to the data element description in FrntSideRdrLeObj1 with the same data element name.";
CM_ SG_ 1063 ReSideRdrLe20Obj27RdrObjElevnSts "Refer to the data element description in FrntSideRdrLeObj1 with the same data element name.";
CM_ SG_ 1063 ReSideRdrLe20Obj27RdrObjID "Refer to the data element description in FrntSideRdrLeObj1 with the same data element name.";
CM_ SG_ 1063 ReSideRdrLe20Obj27RdrObjIsInFreeSpace "Refer to the data element description in FrntSideRdrLeObj1 with the same data element name.";
CM_ SG_ 1063 ReSideRdrLe20Obj27RdrObjMirrProblty "Refer to the data element description in FrntSideRdrLeObj1 with the same data element name.";
CM_ SG_ 1063 ReSideRdrLe20Obj27RdrObjMtnPat "Refer to the data element description in FrntSideRdrLeObj1 with the same data element name.";
CM_ SG_ 1063 ReSideRdrLe20Obj27RdrObjNotRealProblty "Refer to the data element description in FrntSideRdrLeObj1 with the same data element name.";
CM_ SG_ 1063 ReSideRdrLe20Obj27RdrObjStatyCnt "Refer to the data element description in FrntSideRdrLeObj1 with the same data element name.";
CM_ SG_ 1063 ReSideRdrLe20Obj27RdrObjTiAlv "Refer to the data element description in FrntSideRdrLeObj1 with the same data element name.";
CM_ SG_ 1063 ReSideRdrLe20Obj27RdrObjTrackSts "Refer to the data element description in FrntSideRdrLeObj1 with the same data element name.";
CM_ SG_ 1063 ReSideRdrLe20Obj27RdrObjTyp "Refer to the data element description in FrntSideRdrLeObj1 with the same data element name.";
CM_ SG_ 1063 ReSideRdrLe20Obj27RdrObjTypConfBike "Refer to the data element description in FrntSideRdrLeObj1 with the same data element name.";
CM_ SG_ 1063 ReSideRdrLe20Obj27RdrObjTypConfPed "Refer to the data element description in FrntSideRdrLeObj1 with the same data element name.";
CM_ SG_ 1063 ReSideRdrLe20Obj27RdrObjTypConfVeh "Refer to the data element description in FrntSideRdrLeObj1 with the same data element name.";
CM_ SG_ 1063 ReSideRdrLe20Obj27RdrObjUsedTracker "Refer to the data element description in FrntSideRdrLeObj1 with the same data element name.";
CM_ SG_ 1063 ReSideRdrLe20Obj27RdrObjVx "Refer to the data element description in FrntSideRdrLeObj1 with the same data element name.";
CM_ SG_ 1063 ReSideRdrLe20Obj27RdrObjVxStdDe "Refer to the data element description in FrntSideRdrLeObj1 with the same data element name.";
CM_ SG_ 1063 ReSideRdrLe20Obj27RdrObjVy "Refer to the data element description in FrntSideRdrLeObj1 with the same data element name.";
CM_ SG_ 1063 ReSideRdrLe20Obj27RdrObjVyStdDe "Refer to the data element description in FrntSideRdrLeObj1 with the same data element name.";
CM_ SG_ 1063 ReSideRdrLe20Obj27RelVx "Refer to the data element description in FrntSideRdrLeObj1 with the same data element name.";
CM_ SG_ 1063 ReSideRdrLe20Obj27RelVy "Refer to the data element description in FrntSideRdrLeObj1 with the same data element name.";
CM_ SG_ 1064 ReSideRdrLe20Obj28Heading "Refer to the data element description in FrntSideRdrLeObj1 with the same data element name.";
CM_ SG_ 1064 ReSideRdrLe20Obj28ObjBoxCenterLat "Refer to the data element description in FrntSideRdrLeObj1 with the same data element name.";
CM_ SG_ 1064 ReSideRdrLe20Obj28ObjBoxCenterLgt "Refer to the data element description in FrntSideRdrLeObj1 with the same data element name.";
CM_ SG_ 1064 ReSideRdrLe20Obj28ObservationHist "Refer to the data element description in FrntSideRdrLeObj1 with the same data element name.";
CM_ SG_ 1064 ReSideRdrLe20Obj28QualityBits "Refer to the data element description in FrntSideRdrLeObj1 with the same data element name.";
CM_ SG_ 1064 ReSideRdrLe20Obj28RdrObjAx "Refer to the data element description in FrntSideRdrLeObj1 with the same data element name.";
CM_ SG_ 1064 ReSideRdrLe20Obj28RdrObjAy "Refer to the data element description in FrntSideRdrLeObj1 with the same data element name.";
CM_ SG_ 1064 ReSideRdrLe20Obj28RdrObjBoxLength "Refer to the data element description in FrntSideRdrLeObj1 with the same data element name.";
CM_ SG_ 1064 ReSideRdrLe20Obj28RdrObjBoxWidth "Refer to the data element description in FrntSideRdrLeObj1 with the same data element name.";
CM_ SG_ 1064 ReSideRdrLe20Obj28RdrObjChks "Refer to the data element description in FrntSideRdrLeObj1 with the same data element name.";
CM_ SG_ 1064 ReSideRdrLe20Obj28RdrObjCntr "Refer to the data element description in FrntSideRdrLeObj1 with the same data element name.";
CM_ SG_ 1064 ReSideRdrLe20Obj28RdrObjCoastCnt "Refer to the data element description in FrntSideRdrLeObj1 with the same data element name.";
CM_ SG_ 1064 ReSideRdrLe20Obj28RdrObjConf "Refer to the data element description in FrntSideRdrLeObj1 with the same data element name.";
CM_ SG_ 1064 ReSideRdrLe20Obj28RdrObjDx "Refer to the data element description in FrntSideRdrLeObj1 with the same data element name.";
CM_ SG_ 1064 ReSideRdrLe20Obj28RdrObjDxStdDe "Refer to the data element description in FrntSideRdrLeObj1 with the same data element name.";
CM_ SG_ 1064 ReSideRdrLe20Obj28RdrObjDy "Refer to the data element description in FrntSideRdrLeObj1 with the same data element name.";
CM_ SG_ 1064 ReSideRdrLe20Obj28RdrObjDyStdDe "Refer to the data element description in FrntSideRdrLeObj1 with the same data element name.";
CM_ SG_ 1064 ReSideRdrLe20Obj28RdrObjElevnConf "Refer to the data element description in FrntSideRdrLeObj1 with the same data element name.";
CM_ SG_ 1064 ReSideRdrLe20Obj28RdrObjElevnSts "Refer to the data element description in FrntSideRdrLeObj1 with the same data element name.";
CM_ SG_ 1064 ReSideRdrLe20Obj28RdrObjID "Refer to the data element description in FrntSideRdrLeObj1 with the same data element name.";
CM_ SG_ 1064 ReSideRdrLe20Obj28RdrObjIsInFreeSpace "Refer to the data element description in FrntSideRdrLeObj1 with the same data element name.";
CM_ SG_ 1064 ReSideRdrLe20Obj28RdrObjMirrProblty "Refer to the data element description in FrntSideRdrLeObj1 with the same data element name.";
CM_ SG_ 1064 ReSideRdrLe20Obj28RdrObjMtnPat "Refer to the data element description in FrntSideRdrLeObj1 with the same data element name.";
CM_ SG_ 1064 ReSideRdrLe20Obj28RdrObjNotRealProblty "Refer to the data element description in FrntSideRdrLeObj1 with the same data element name.";
CM_ SG_ 1064 ReSideRdrLe20Obj28RdrObjStatyCnt "Refer to the data element description in FrntSideRdrLeObj1 with the same data element name.";
CM_ SG_ 1064 ReSideRdrLe20Obj28RdrObjTiAlv "Refer to the data element description in FrntSideRdrLeObj1 with the same data element name.";
CM_ SG_ 1064 ReSideRdrLe20Obj28RdrObjTrackSts "Refer to the data element description in FrntSideRdrLeObj1 with the same data element name.";
CM_ SG_ 1064 ReSideRdrLe20Obj28RdrObjTyp "Refer to the data element description in FrntSideRdrLeObj1 with the same data element name.";
CM_ SG_ 1064 ReSideRdrLe20Obj28RdrObjTypConfBike "Refer to the data element description in FrntSideRdrLeObj1 with the same data element name.";
CM_ SG_ 1064 ReSideRdrLe20Obj28RdrObjTypConfPed "Refer to the data element description in FrntSideRdrLeObj1 with the same data element name.";
CM_ SG_ 1064 ReSideRdrLe20Obj28RdrObjTypConfVeh "Refer to the data element description in FrntSideRdrLeObj1 with the same data element name.";
CM_ SG_ 1064 ReSideRdrLe20Obj28RdrObjUsedTracker "Refer to the data element description in FrntSideRdrLeObj1 with the same data element name.";
CM_ SG_ 1064 ReSideRdrLe20Obj28RdrObjVx "Refer to the data element description in FrntSideRdrLeObj1 with the same data element name.";
CM_ SG_ 1064 ReSideRdrLe20Obj28RdrObjVxStdDe "Refer to the data element description in FrntSideRdrLeObj1 with the same data element name.";
CM_ SG_ 1064 ReSideRdrLe20Obj28RdrObjVy "Refer to the data element description in FrntSideRdrLeObj1 with the same data element name.";
CM_ SG_ 1064 ReSideRdrLe20Obj28RdrObjVyStdDe "Refer to the data element description in FrntSideRdrLeObj1 with the same data element name.";
CM_ SG_ 1064 ReSideRdrLe20Obj28RelVx "Refer to the data element description in FrntSideRdrLeObj1 with the same data element name.";
CM_ SG_ 1064 ReSideRdrLe20Obj28RelVy "Refer to the data element description in FrntSideRdrLeObj1 with the same data element name.";
CM_ SG_ 1065 ReSideRdrLe20Obj29Heading "Refer to the data element description in FrntSideRdrLeObj1 with the same data element name.";
CM_ SG_ 1065 ReSideRdrLe20Obj29ObjBoxCenterLat "Refer to the data element description in FrntSideRdrLeObj1 with the same data element name.";
CM_ SG_ 1065 ReSideRdrLe20Obj29ObjBoxCenterLgt "Refer to the data element description in FrntSideRdrLeObj1 with the same data element name.";
CM_ SG_ 1065 ReSideRdrLe20Obj29ObservationHist "Refer to the data element description in FrntSideRdrLeObj1 with the same data element name.";
CM_ SG_ 1065 ReSideRdrLe20Obj29QualityBits "Refer to the data element description in FrntSideRdrLeObj1 with the same data element name.";
CM_ SG_ 1065 ReSideRdrLe20Obj29RdrObjAx "Refer to the data element description in FrntSideRdrLeObj1 with the same data element name.";
CM_ SG_ 1065 ReSideRdrLe20Obj29RdrObjAy "Refer to the data element description in FrntSideRdrLeObj1 with the same data element name.";
CM_ SG_ 1065 ReSideRdrLe20Obj29RdrObjBoxLength "Refer to the data element description in FrntSideRdrLeObj1 with the same data element name.";
CM_ SG_ 1065 ReSideRdrLe20Obj29RdrObjBoxWidth "Refer to the data element description in FrntSideRdrLeObj1 with the same data element name.";
CM_ SG_ 1065 ReSideRdrLe20Obj29RdrObjChks "Refer to the data element description in FrntSideRdrLeObj1 with the same data element name.";
CM_ SG_ 1065 ReSideRdrLe20Obj29RdrObjCntr "Refer to the data element description in FrntSideRdrLeObj1 with the same data element name.";
CM_ SG_ 1065 ReSideRdrLe20Obj29RdrObjCoastCnt "Refer to the data element description in FrntSideRdrLeObj1 with the same data element name.";
CM_ SG_ 1065 ReSideRdrLe20Obj29RdrObjConf "Refer to the data element description in FrntSideRdrLeObj1 with the same data element name.";
CM_ SG_ 1065 ReSideRdrLe20Obj29RdrObjDx "Refer to the data element description in FrntSideRdrLeObj1 with the same data element name.";
CM_ SG_ 1065 ReSideRdrLe20Obj29RdrObjDxStdDe "Refer to the data element description in FrntSideRdrLeObj1 with the same data element name.";
CM_ SG_ 1065 ReSideRdrLe20Obj29RdrObjDy "Refer to the data element description in FrntSideRdrLeObj1 with the same data element name.";
CM_ SG_ 1065 ReSideRdrLe20Obj29RdrObjDyStdDe "Refer to the data element description in FrntSideRdrLeObj1 with the same data element name.";
CM_ SG_ 1065 ReSideRdrLe20Obj29RdrObjElevnConf "Refer to the data element description in FrntSideRdrLeObj1 with the same data element name.";
CM_ SG_ 1065 ReSideRdrLe20Obj29RdrObjElevnSts "Refer to the data element description in FrntSideRdrLeObj1 with the same data element name.";
CM_ SG_ 1065 ReSideRdrLe20Obj29RdrObjID "Refer to the data element description in FrntSideRdrLeObj1 with the same data element name.";
CM_ SG_ 1065 ReSideRdrLe20Obj29RdrObjIsInFreeSpace "Refer to the data element description in FrntSideRdrLeObj1 with the same data element name.";
CM_ SG_ 1065 ReSideRdrLe20Obj29RdrObjMirrProblty "Refer to the data element description in FrntSideRdrLeObj1 with the same data element name.";
CM_ SG_ 1065 ReSideRdrLe20Obj29RdrObjMtnPat "Refer to the data element description in FrntSideRdrLeObj1 with the same data element name.";
CM_ SG_ 1065 ReSideRdrLe20Obj29RdrObjNotRealProblty "Refer to the data element description in FrntSideRdrLeObj1 with the same data element name.";
CM_ SG_ 1065 ReSideRdrLe20Obj29RdrObjStatyCnt "Refer to the data element description in FrntSideRdrLeObj1 with the same data element name.";
CM_ SG_ 1065 ReSideRdrLe20Obj29RdrObjTiAlv "Refer to the data element description in FrntSideRdrLeObj1 with the same data element name.";
CM_ SG_ 1065 ReSideRdrLe20Obj29RdrObjTrackSts "Refer to the data element description in FrntSideRdrLeObj1 with the same data element name.";
CM_ SG_ 1065 ReSideRdrLe20Obj29RdrObjTyp "Refer to the data element description in FrntSideRdrLeObj1 with the same data element name.";
CM_ SG_ 1065 ReSideRdrLe20Obj29RdrObjTypConfBike "Refer to the data element description in FrntSideRdrLeObj1 with the same data element name.";
CM_ SG_ 1065 ReSideRdrLe20Obj29RdrObjTypConfPed "Refer to the data element description in FrntSideRdrLeObj1 with the same data element name.";
CM_ SG_ 1065 ReSideRdrLe20Obj29RdrObjTypConfVeh "Refer to the data element description in FrntSideRdrLeObj1 with the same data element name.";
CM_ SG_ 1065 ReSideRdrLe20Obj29RdrObjUsedTracker "Refer to the data element description in FrntSideRdrLeObj1 with the same data element name.";
CM_ SG_ 1065 ReSideRdrLe20Obj29RdrObjVx "Refer to the data element description in FrntSideRdrLeObj1 with the same data element name.";
CM_ SG_ 1065 ReSideRdrLe20Obj29RdrObjVxStdDe "Refer to the data element description in FrntSideRdrLeObj1 with the same data element name.";
CM_ SG_ 1065 ReSideRdrLe20Obj29RdrObjVy "Refer to the data element description in FrntSideRdrLeObj1 with the same data element name.";
CM_ SG_ 1065 ReSideRdrLe20Obj29RdrObjVyStdDe "Refer to the data element description in FrntSideRdrLeObj1 with the same data element name.";
CM_ SG_ 1065 ReSideRdrLe20Obj29RelVx "Refer to the data element description in FrntSideRdrLeObj1 with the same data element name.";
CM_ SG_ 1065 ReSideRdrLe20Obj29RelVy "Refer to the data element description in FrntSideRdrLeObj1 with the same data element name.";
CM_ SG_ 1072 ReSideRdrLe20Obj30Heading "Refer to the data element description in FrntSideRdrLeObj1 with the same data element name.";
CM_ SG_ 1072 ReSideRdrLe20Obj30ObjBoxCenterLat "Refer to the data element description in FrntSideRdrLeObj1 with the same data element name.";
CM_ SG_ 1072 ReSideRdrLe20Obj30ObjBoxCenterLgt "Refer to the data element description in FrntSideRdrLeObj1 with the same data element name.";
CM_ SG_ 1072 ReSideRdrLe20Obj30ObservationHist "Refer to the data element description in FrntSideRdrLeObj1 with the same data element name.";
CM_ SG_ 1072 ReSideRdrLe20Obj30QualityBits "Refer to the data element description in FrntSideRdrLeObj1 with the same data element name.";
CM_ SG_ 1072 ReSideRdrLe20Obj30RdrObjAx "Refer to the data element description in FrntSideRdrLeObj1 with the same data element name.";
CM_ SG_ 1072 ReSideRdrLe20Obj30RdrObjAy "Refer to the data element description in FrntSideRdrLeObj1 with the same data element name.";
CM_ SG_ 1072 ReSideRdrLe20Obj30RdrObjBoxLength "Refer to the data element description in FrntSideRdrLeObj1 with the same data element name.";
CM_ SG_ 1072 ReSideRdrLe20Obj30RdrObjBoxWidth "Refer to the data element description in FrntSideRdrLeObj1 with the same data element name.";
CM_ SG_ 1072 ReSideRdrLe20Obj30RdrObjChks "Refer to the data element description in FrntSideRdrLeObj1 with the same data element name.";
CM_ SG_ 1072 ReSideRdrLe20Obj30RdrObjCntr "Refer to the data element description in FrntSideRdrLeObj1 with the same data element name.";
CM_ SG_ 1072 ReSideRdrLe20Obj30RdrObjCoastCnt "Refer to the data element description in FrntSideRdrLeObj1 with the same data element name.";
CM_ SG_ 1072 ReSideRdrLe20Obj30RdrObjConf "Refer to the data element description in FrntSideRdrLeObj1 with the same data element name.";
CM_ SG_ 1072 ReSideRdrLe20Obj30RdrObjDx "Refer to the data element description in FrntSideRdrLeObj1 with the same data element name.";
CM_ SG_ 1072 ReSideRdrLe20Obj30RdrObjDxStdDe "Refer to the data element description in FrntSideRdrLeObj1 with the same data element name.";
CM_ SG_ 1072 ReSideRdrLe20Obj30RdrObjDy "Refer to the data element description in FrntSideRdrLeObj1 with the same data element name.";
CM_ SG_ 1072 ReSideRdrLe20Obj30RdrObjDyStdDe "Refer to the data element description in FrntSideRdrLeObj1 with the same data element name.";
CM_ SG_ 1072 ReSideRdrLe20Obj30RdrObjElevnConf "Refer to the data element description in FrntSideRdrLeObj1 with the same data element name.";
CM_ SG_ 1072 ReSideRdrLe20Obj30RdrObjElevnSts "Refer to the data element description in FrntSideRdrLeObj1 with the same data element name.";
CM_ SG_ 1072 ReSideRdrLe20Obj30RdrObjID "Refer to the data element description in FrntSideRdrLeObj1 with the same data element name.";
CM_ SG_ 1072 ReSideRdrLe20Obj30RdrObjIsInFreeSpace "Refer to the data element description in FrntSideRdrLeObj1 with the same data element name.";
CM_ SG_ 1072 ReSideRdrLe20Obj30RdrObjMirrProblty "Refer to the data element description in FrntSideRdrLeObj1 with the same data element name.";
CM_ SG_ 1072 ReSideRdrLe20Obj30RdrObjMtnPat "Refer to the data element description in FrntSideRdrLeObj1 with the same data element name.";
CM_ SG_ 1072 ReSideRdrLe20Obj30RdrObjNotRealProblty "Refer to the data element description in FrntSideRdrLeObj1 with the same data element name.";
CM_ SG_ 1072 ReSideRdrLe20Obj30RdrObjStatyCnt "Refer to the data element description in FrntSideRdrLeObj1 with the same data element name.";
CM_ SG_ 1072 ReSideRdrLe20Obj30RdrObjTiAlv "Refer to the data element description in FrntSideRdrLeObj1 with the same data element name.";
CM_ SG_ 1072 ReSideRdrLe20Obj30RdrObjTrackSts "Refer to the data element description in FrntSideRdrLeObj1 with the same data element name.";
CM_ SG_ 1072 ReSideRdrLe20Obj30RdrObjTyp "Refer to the data element description in FrntSideRdrLeObj1 with the same data element name.";
CM_ SG_ 1072 ReSideRdrLe20Obj30RdrObjTypConfBike "Refer to the data element description in FrntSideRdrLeObj1 with the same data element name.";
CM_ SG_ 1072 ReSideRdrLe20Obj30RdrObjTypConfPed "Refer to the data element description in FrntSideRdrLeObj1 with the same data element name.";
CM_ SG_ 1072 ReSideRdrLe20Obj30RdrObjTypConfVeh "Refer to the data element description in FrntSideRdrLeObj1 with the same data element name.";
CM_ SG_ 1072 ReSideRdrLe20Obj30RdrObjUsedTracker "Refer to the data element description in FrntSideRdrLeObj1 with the same data element name.";
CM_ SG_ 1072 ReSideRdrLe20Obj30RdrObjVx "Refer to the data element description in FrntSideRdrLeObj1 with the same data element name.";
CM_ SG_ 1072 ReSideRdrLe20Obj30RdrObjVxStdDe "Refer to the data element description in FrntSideRdrLeObj1 with the same data element name.";
CM_ SG_ 1072 ReSideRdrLe20Obj30RdrObjVy "Refer to the data element description in FrntSideRdrLeObj1 with the same data element name.";
CM_ SG_ 1072 ReSideRdrLe20Obj30RdrObjVyStdDe "Refer to the data element description in FrntSideRdrLeObj1 with the same data element name.";
CM_ SG_ 1072 ReSideRdrLe20Obj30RelVx "Refer to the data element description in FrntSideRdrLeObj1 with the same data element name.";
CM_ SG_ 1072 ReSideRdrLe20Obj30RelVy "Refer to the data element description in FrntSideRdrLeObj1 with the same data element name.";
CM_ SG_ 1073 ReSideRdrLe20Obj31Heading "Refer to the data element description in FrntSideRdrLeObj1 with the same data element name.";
CM_ SG_ 1073 ReSideRdrLe20Obj31ObjBoxCenterLat "Refer to the data element description in FrntSideRdrLeObj1 with the same data element name.";
CM_ SG_ 1073 ReSideRdrLe20Obj31ObjBoxCenterLgt "Refer to the data element description in FrntSideRdrLeObj1 with the same data element name.";
CM_ SG_ 1073 ReSideRdrLe20Obj31ObservationHist "Refer to the data element description in FrntSideRdrLeObj1 with the same data element name.";
CM_ SG_ 1073 ReSideRdrLe20Obj31QualityBits "Refer to the data element description in FrntSideRdrLeObj1 with the same data element name.";
CM_ SG_ 1073 ReSideRdrLe20Obj31RdrObjAx "Refer to the data element description in FrntSideRdrLeObj1 with the same data element name.";
CM_ SG_ 1073 ReSideRdrLe20Obj31RdrObjAy "Refer to the data element description in FrntSideRdrLeObj1 with the same data element name.";
CM_ SG_ 1073 ReSideRdrLe20Obj31RdrObjBoxLength "Refer to the data element description in FrntSideRdrLeObj1 with the same data element name.";
CM_ SG_ 1073 ReSideRdrLe20Obj31RdrObjBoxWidth "Refer to the data element description in FrntSideRdrLeObj1 with the same data element name.";
CM_ SG_ 1073 ReSideRdrLe20Obj31RdrObjChks "Refer to the data element description in FrntSideRdrLeObj1 with the same data element name.";
CM_ SG_ 1073 ReSideRdrLe20Obj31RdrObjCntr "Refer to the data element description in FrntSideRdrLeObj1 with the same data element name.";
CM_ SG_ 1073 ReSideRdrLe20Obj31RdrObjCoastCnt "Refer to the data element description in FrntSideRdrLeObj1 with the same data element name.";
CM_ SG_ 1073 ReSideRdrLe20Obj31RdrObjConf "Refer to the data element description in FrntSideRdrLeObj1 with the same data element name.";
CM_ SG_ 1073 ReSideRdrLe20Obj31RdrObjDx "Refer to the data element description in FrntSideRdrLeObj1 with the same data element name.";
CM_ SG_ 1073 ReSideRdrLe20Obj31RdrObjDxStdDe "Refer to the data element description in FrntSideRdrLeObj1 with the same data element name.";
CM_ SG_ 1073 ReSideRdrLe20Obj31RdrObjDy "Refer to the data element description in FrntSideRdrLeObj1 with the same data element name.";
CM_ SG_ 1073 ReSideRdrLe20Obj31RdrObjDyStdDe "Refer to the data element description in FrntSideRdrLeObj1 with the same data element name.";
CM_ SG_ 1073 ReSideRdrLe20Obj31RdrObjElevnConf "Refer to the data element description in FrntSideRdrLeObj1 with the same data element name.";
CM_ SG_ 1073 ReSideRdrLe20Obj31RdrObjElevnSts "Refer to the data element description in FrntSideRdrLeObj1 with the same data element name.";
CM_ SG_ 1073 ReSideRdrLe20Obj31RdrObjID "Refer to the data element description in FrntSideRdrLeObj1 with the same data element name.";
CM_ SG_ 1073 ReSideRdrLe20Obj31RdrObjIsInFreeSpace "Refer to the data element description in FrntSideRdrLeObj1 with the same data element name.";
CM_ SG_ 1073 ReSideRdrLe20Obj31RdrObjMirrProblty "Refer to the data element description in FrntSideRdrLeObj1 with the same data element name.";
CM_ SG_ 1073 ReSideRdrLe20Obj31RdrObjMtnPat "Refer to the data element description in FrntSideRdrLeObj1 with the same data element name.";
CM_ SG_ 1073 ReSideRdrLe20Obj31RdrObjNotRealProblty "Refer to the data element description in FrntSideRdrLeObj1 with the same data element name.";
CM_ SG_ 1073 ReSideRdrLe20Obj31RdrObjStatyCnt "Refer to the data element description in FrntSideRdrLeObj1 with the same data element name.";
CM_ SG_ 1073 ReSideRdrLe20Obj31RdrObjTiAlv "Refer to the data element description in FrntSideRdrLeObj1 with the same data element name.";
CM_ SG_ 1073 ReSideRdrLe20Obj31RdrObjTrackSts "Refer to the data element description in FrntSideRdrLeObj1 with the same data element name.";
CM_ SG_ 1073 ReSideRdrLe20Obj31RdrObjTyp "Refer to the data element description in FrntSideRdrLeObj1 with the same data element name.";
CM_ SG_ 1073 ReSideRdrLe20Obj31RdrObjTypConfBike "Refer to the data element description in FrntSideRdrLeObj1 with the same data element name.";
CM_ SG_ 1073 ReSideRdrLe20Obj31RdrObjTypConfPed "Refer to the data element description in FrntSideRdrLeObj1 with the same data element name.";
CM_ SG_ 1073 ReSideRdrLe20Obj31RdrObjTypConfVeh "Refer to the data element description in FrntSideRdrLeObj1 with the same data element name.";
CM_ SG_ 1073 ReSideRdrLe20Obj31RdrObjUsedTracker "Refer to the data element description in FrntSideRdrLeObj1 with the same data element name.";
CM_ SG_ 1073 ReSideRdrLe20Obj31RdrObjVx "Refer to the data element description in FrntSideRdrLeObj1 with the same data element name.";
CM_ SG_ 1073 ReSideRdrLe20Obj31RdrObjVxStdDe "Refer to the data element description in FrntSideRdrLeObj1 with the same data element name.";
CM_ SG_ 1073 ReSideRdrLe20Obj31RdrObjVy "Refer to the data element description in FrntSideRdrLeObj1 with the same data element name.";
CM_ SG_ 1073 ReSideRdrLe20Obj31RdrObjVyStdDe "Refer to the data element description in FrntSideRdrLeObj1 with the same data element name.";
CM_ SG_ 1073 ReSideRdrLe20Obj31RelVx "Refer to the data element description in FrntSideRdrLeObj1 with the same data element name.";
CM_ SG_ 1073 ReSideRdrLe20Obj31RelVy "Refer to the data element description in FrntSideRdrLeObj1 with the same data element name.";
BA_DEF_ BO_ "CANFD_BRS" ENUM "0","1";
BA_DEF_ BO_ "GenMsgCycleTime" INT 0 65536; // [ms]
BA_DEF_ BO_ "GenMsgDelayTime" INT 0 65536; // [ms]
BA_DEF_ BO_ "GenMsgSendType" ENUM "cyclic", "spontaneous", "not-used", "not-used", "not-used", "cyclicAndSpontaneous", "not-used", "cyclicIfActive", "NoMsgSendType"; // [us]
BA_DEF_ BO_ "GenMsgStartDelayTime" INT 0 65536; // [ms]
BA_DEF_ BO_ "VFrameFormat" ENUM "StandardCAN","ExtendedCAN","reserved","J1939PG","reserved","reserved","reserved","reserved","reserved","reserved","reserved","reserved","reserved","reserved","StandardCAN_FD","ExtendedCAN_FD";
BA_DEF_ SG_ "GenSigSendType" ENUM "Cyclic","OnWrite","OnWriteWithRepetition","OnChange","OnChangeWithRepetition","IfActive","IfActiveWithRepetition","NoSigSendType";
BA_DEF_ SG_ "GenSigStartValue" HEX 0 80000000;
BA_DEF_ BO_ "GenMsgILSupport" ENUM "No","Yes";
BA_DEF_ BO_ "NmAsrMessage" ENUM "No","Yes";
BA_DEF_ SG_ "GenSigFuncType" ENUM "NoFunction","n/a","n/a","n/a","n/a","n/a","n/a","n/a","n/a","n/a","n/a","n/a","n/a","n/a","n/a","CHK","CNTR","n/a","n/a","n/a","CNTR_AR_01","CRC_AR_01_BOTH","CRC_AR_01_ALT","CRC_AR_01_LOW","CRC_AR_01_NIBBLE","CNTR_AR_04","CRC_AR_04A","CNTR_AR_05","CRC_AR_05";
BA_DEF_ SG_ "GenSigDataID" STRING;
BA_DEF_DEF_ "CANFD_BRS" "1";
BA_DEF_DEF_ "GenSigStartValue" 0;
BA_DEF_DEF_ "VFrameFormat" "J1939PG";
BA_DEF_DEF_ "GenSigSendType" "NoSigSendType";
BA_DEF_DEF_ "GenMsgCycleTime" 0;
BA_DEF_DEF_ "GenMsgDelayTime" 0;
BA_DEF_DEF_ "GenMsgStartDelayTime" 0;
BA_DEF_DEF_ "GenMsgSendType" "NoMsgSendType";
BA_DEF_DEF_ "GenMsgILSupport" "Yes";
BA_DEF_DEF_ "NmAsrMessage" "No";
BA_DEF_DEF_ "GenSigFuncType" "NoFunction";
BA_DEF_DEF_ "GenSigDataID" "";
// Frame: SODLPrivateCANFD5Fr20
BA_ "GenMsgCycleTime" BO_ 1056 50 ;
BA_ "GenMsgSendType" BO_ 1056 0;
BA_ "VFrameFormat" BO_ 1056 14;
// Frame: SODLPrivateCANFD5Fr21
BA_ "GenMsgCycleTime" BO_ 1057 50 ;
BA_ "GenMsgSendType" BO_ 1057 0;
BA_ "VFrameFormat" BO_ 1057 14;
// Frame: SODLPrivateCANFD5Fr22
BA_ "GenMsgCycleTime" BO_ 1058 50 ;
BA_ "GenMsgSendType" BO_ 1058 0;
BA_ "VFrameFormat" BO_ 1058 14;
// Frame: SODLPrivateCANFD5Fr23
BA_ "GenMsgCycleTime" BO_ 1059 50 ;
BA_ "GenMsgSendType" BO_ 1059 0;
BA_ "VFrameFormat" BO_ 1059 14;
// Frame: SODLPrivateCANFD5Fr24
BA_ "GenMsgCycleTime" BO_ 1060 50 ;
BA_ "GenMsgSendType" BO_ 1060 0;
BA_ "VFrameFormat" BO_ 1060 14;
// Frame: SODLPrivateCANFD5Fr25
BA_ "GenMsgCycleTime" BO_ 1061 50 ;
BA_ "GenMsgSendType" BO_ 1061 0;
BA_ "VFrameFormat" BO_ 1061 14;
// Frame: SODLPrivateCANFD5Fr26
BA_ "GenMsgCycleTime" BO_ 1062 50 ;
BA_ "GenMsgSendType" BO_ 1062 0;
BA_ "VFrameFormat" BO_ 1062 14;
// Frame: SODLPrivateCANFD5Fr27
BA_ "GenMsgCycleTime" BO_ 1063 50 ;
BA_ "GenMsgSendType" BO_ 1063 0;
BA_ "VFrameFormat" BO_ 1063 14;
// Frame: SODLPrivateCANFD5Fr28
BA_ "GenMsgCycleTime" BO_ 1064 50 ;
BA_ "GenMsgSendType" BO_ 1064 0;
BA_ "VFrameFormat" BO_ 1064 14;
// Frame: SODLPrivateCANFD5Fr29
BA_ "GenMsgCycleTime" BO_ 1065 50 ;
BA_ "GenMsgSendType" BO_ 1065 0;
BA_ "VFrameFormat" BO_ 1065 14;
// Frame: SODLPrivateCANFD5Fr30
BA_ "GenMsgCycleTime" BO_ 1072 50 ;
BA_ "GenMsgSendType" BO_ 1072 0;
BA_ "VFrameFormat" BO_ 1072 14;
// Frame: SODLPrivateCANFD5Fr31
BA_ "GenMsgCycleTime" BO_ 1073 50 ;
BA_ "GenMsgSendType" BO_ 1073 0;
BA_ "VFrameFormat" BO_ 1073 14;
BA_ "GenSigSendType" SG_ 1056 ReSideRdrLe20Obj20Heading 0;
BA_ "GenSigStartValue" SG_ 1056 ReSideRdrLe20Obj20Heading 1800;
BA_ "GenSigSendType" SG_ 1056 ReSideRdrLe20Obj20ObjBoxCenterLat 0;
BA_ "GenSigStartValue" SG_ 1056 ReSideRdrLe20Obj20ObjBoxCenterLat 250;
BA_ "GenSigSendType" SG_ 1056 ReSideRdrLe20Obj20ObjBoxCenterLgt 0;
BA_ "GenSigStartValue" SG_ 1056 ReSideRdrLe20Obj20ObjBoxCenterLgt 250;
BA_ "GenSigSendType" SG_ 1056 ReSideRdrLe20Obj20ObservationHist 0;
BA_ "GenSigSendType" SG_ 1056 ReSideRdrLe20Obj20QualityBits 0;
BA_ "GenSigSendType" SG_ 1056 ReSideRdrLe20Obj20RdrObjAx 0;
BA_ "GenSigSendType" SG_ 1056 ReSideRdrLe20Obj20RdrObjAy 0;
BA_ "GenSigSendType" SG_ 1056 ReSideRdrLe20Obj20RdrObjBoxLength 0;
BA_ "GenSigSendType" SG_ 1056 ReSideRdrLe20Obj20RdrObjBoxWidth 0;
BA_ "GenSigDataID" SG_ 1056 ReSideRdrLe20Obj20RdrObjChks "0x12A7";
BA_ "GenSigFuncType" SG_ 1056 ReSideRdrLe20Obj20RdrObjChks 15;
BA_ "GenSigSendType" SG_ 1056 ReSideRdrLe20Obj20RdrObjChks 0;
BA_ "GenSigFuncType" SG_ 1056 ReSideRdrLe20Obj20RdrObjCntr 16;
BA_ "GenSigSendType" SG_ 1056 ReSideRdrLe20Obj20RdrObjCntr 0;
BA_ "GenSigSendType" SG_ 1056 ReSideRdrLe20Obj20RdrObjCoastCnt 0;
BA_ "GenSigStartValue" SG_ 1056 ReSideRdrLe20Obj20RdrObjCoastCnt 31;
BA_ "GenSigSendType" SG_ 1056 ReSideRdrLe20Obj20RdrObjConf 0;
BA_ "GenSigSendType" SG_ 1056 ReSideRdrLe20Obj20RdrObjDx 0;
BA_ "GenSigSendType" SG_ 1056 ReSideRdrLe20Obj20RdrObjDxStdDe 0;
BA_ "GenSigSendType" SG_ 1056 ReSideRdrLe20Obj20RdrObjDy 0;
BA_ "GenSigStartValue" SG_ 1056 ReSideRdrLe20Obj20RdrObjDy 4000;
BA_ "GenSigSendType" SG_ 1056 ReSideRdrLe20Obj20RdrObjDyStdDe 0;
BA_ "GenSigSendType" SG_ 1056 ReSideRdrLe20Obj20RdrObjElevnConf 0;
BA_ "GenSigSendType" SG_ 1056 ReSideRdrLe20Obj20RdrObjElevnSts 0;
BA_ "GenSigSendType" SG_ 1056 ReSideRdrLe20Obj20RdrObjID 0;
BA_ "GenSigSendType" SG_ 1056 ReSideRdrLe20Obj20RdrObjIsInFreeSpace 0;
BA_ "GenSigStartValue" SG_ 1056 ReSideRdrLe20Obj20RdrObjIsInFreeSpace 1;
BA_ "GenSigSendType" SG_ 1056 ReSideRdrLe20Obj20RdrObjMirrProblty 0;
BA_ "GenSigSendType" SG_ 1056 ReSideRdrLe20Obj20RdrObjMtnPat 0;
BA_ "GenSigStartValue" SG_ 1056 ReSideRdrLe20Obj20RdrObjMtnPat 3;
BA_ "GenSigSendType" SG_ 1056 ReSideRdrLe20Obj20RdrObjNotRealProblty 0;
BA_ "GenSigSendType" SG_ 1056 ReSideRdrLe20Obj20RdrObjStatyCnt 0;
BA_ "GenSigSendType" SG_ 1056 ReSideRdrLe20Obj20RdrObjTiAlv 0;
BA_ "GenSigSendType" SG_ 1056 ReSideRdrLe20Obj20RdrObjTrackSts 0;
BA_ "GenSigSendType" SG_ 1056 ReSideRdrLe20Obj20RdrObjTyp 0;
BA_ "GenSigSendType" SG_ 1056 ReSideRdrLe20Obj20RdrObjTypConfBike 0;
BA_ "GenSigSendType" SG_ 1056 ReSideRdrLe20Obj20RdrObjTypConfPed 0;
BA_ "GenSigSendType" SG_ 1056 ReSideRdrLe20Obj20RdrObjTypConfVeh 0;
BA_ "GenSigSendType" SG_ 1056 ReSideRdrLe20Obj20RdrObjUsedTracker 0;
BA_ "GenSigStartValue" SG_ 1056 ReSideRdrLe20Obj20RdrObjUsedTracker 3;
BA_ "GenSigSendType" SG_ 1056 ReSideRdrLe20Obj20RdrObjVx 0;
BA_ "GenSigStartValue" SG_ 1056 ReSideRdrLe20Obj20RdrObjVx 6400;
BA_ "GenSigSendType" SG_ 1056 ReSideRdrLe20Obj20RdrObjVxStdDe 0;
BA_ "GenSigSendType" SG_ 1056 ReSideRdrLe20Obj20RdrObjVy 0;
BA_ "GenSigStartValue" SG_ 1056 ReSideRdrLe20Obj20RdrObjVy 6400;
BA_ "GenSigSendType" SG_ 1056 ReSideRdrLe20Obj20RdrObjVyStdDe 0;
BA_ "GenSigSendType" SG_ 1056 ReSideRdrLe20Obj20RelVx 0;
BA_ "GenSigStartValue" SG_ 1056 ReSideRdrLe20Obj20RelVx 1780;
BA_ "GenSigSendType" SG_ 1056 ReSideRdrLe20Obj20RelVy 0;
BA_ "GenSigStartValue" SG_ 1056 ReSideRdrLe20Obj20RelVy 1780;
BA_ "GenSigSendType" SG_ 1057 ReSideRdrLe20Obj21Heading 0;
BA_ "GenSigStartValue" SG_ 1057 ReSideRdrLe20Obj21Heading 1800;
BA_ "GenSigSendType" SG_ 1057 ReSideRdrLe20Obj21ObjBoxCenterLat 0;
BA_ "GenSigStartValue" SG_ 1057 ReSideRdrLe20Obj21ObjBoxCenterLat 250;
BA_ "GenSigSendType" SG_ 1057 ReSideRdrLe20Obj21ObjBoxCenterLgt 0;
BA_ "GenSigStartValue" SG_ 1057 ReSideRdrLe20Obj21ObjBoxCenterLgt 250;
BA_ "GenSigSendType" SG_ 1057 ReSideRdrLe20Obj21ObservationHist 0;
BA_ "GenSigSendType" SG_ 1057 ReSideRdrLe20Obj21QualityBits 0;
BA_ "GenSigSendType" SG_ 1057 ReSideRdrLe20Obj21RdrObjAx 0;
BA_ "GenSigSendType" SG_ 1057 ReSideRdrLe20Obj21RdrObjAy 0;
BA_ "GenSigSendType" SG_ 1057 ReSideRdrLe20Obj21RdrObjBoxLength 0;
BA_ "GenSigSendType" SG_ 1057 ReSideRdrLe20Obj21RdrObjBoxWidth 0;
BA_ "GenSigDataID" SG_ 1057 ReSideRdrLe20Obj21RdrObjChks "0x12A8";
BA_ "GenSigFuncType" SG_ 1057 ReSideRdrLe20Obj21RdrObjChks 15;
BA_ "GenSigSendType" SG_ 1057 ReSideRdrLe20Obj21RdrObjChks 0;
BA_ "GenSigFuncType" SG_ 1057 ReSideRdrLe20Obj21RdrObjCntr 16;
BA_ "GenSigSendType" SG_ 1057 ReSideRdrLe20Obj21RdrObjCntr 0;
BA_ "GenSigSendType" SG_ 1057 ReSideRdrLe20Obj21RdrObjCoastCnt 0;
BA_ "GenSigStartValue" SG_ 1057 ReSideRdrLe20Obj21RdrObjCoastCnt 31;
BA_ "GenSigSendType" SG_ 1057 ReSideRdrLe20Obj21RdrObjConf 0;
BA_ "GenSigSendType" SG_ 1057 ReSideRdrLe20Obj21RdrObjDx 0;
BA_ "GenSigSendType" SG_ 1057 ReSideRdrLe20Obj21RdrObjDxStdDe 0;
BA_ "GenSigSendType" SG_ 1057 ReSideRdrLe20Obj21RdrObjDy 0;
BA_ "GenSigStartValue" SG_ 1057 ReSideRdrLe20Obj21RdrObjDy 4000;
BA_ "GenSigSendType" SG_ 1057 ReSideRdrLe20Obj21RdrObjDyStdDe 0;
BA_ "GenSigSendType" SG_ 1057 ReSideRdrLe20Obj21RdrObjElevnConf 0;
BA_ "GenSigSendType" SG_ 1057 ReSideRdrLe20Obj21RdrObjElevnSts 0;
BA_ "GenSigSendType" SG_ 1057 ReSideRdrLe20Obj21RdrObjID 0;
BA_ "GenSigSendType" SG_ 1057 ReSideRdrLe20Obj21RdrObjIsInFreeSpace 0;
BA_ "GenSigStartValue" SG_ 1057 ReSideRdrLe20Obj21RdrObjIsInFreeSpace 1;
BA_ "GenSigSendType" SG_ 1057 ReSideRdrLe20Obj21RdrObjMirrProblty 0;
BA_ "GenSigSendType" SG_ 1057 ReSideRdrLe20Obj21RdrObjMtnPat 0;
BA_ "GenSigStartValue" SG_ 1057 ReSideRdrLe20Obj21RdrObjMtnPat 3;
BA_ "GenSigSendType" SG_ 1057 ReSideRdrLe20Obj21RdrObjNotRealProblty 0;
BA_ "GenSigSendType" SG_ 1057 ReSideRdrLe20Obj21RdrObjStatyCnt 0;
BA_ "GenSigSendType" SG_ 1057 ReSideRdrLe20Obj21RdrObjTiAlv 0;
BA_ "GenSigSendType" SG_ 1057 ReSideRdrLe20Obj21RdrObjTrackSts 0;
BA_ "GenSigSendType" SG_ 1057 ReSideRdrLe20Obj21RdrObjTyp 0;
BA_ "GenSigSendType" SG_ 1057 ReSideRdrLe20Obj21RdrObjTypConfBike 0;
BA_ "GenSigSendType" SG_ 1057 ReSideRdrLe20Obj21RdrObjTypConfPed 0;
BA_ "GenSigSendType" SG_ 1057 ReSideRdrLe20Obj21RdrObjTypConfVeh 0;
BA_ "GenSigSendType" SG_ 1057 ReSideRdrLe20Obj21RdrObjUsedTracker 0;
BA_ "GenSigStartValue" SG_ 1057 ReSideRdrLe20Obj21RdrObjUsedTracker 3;
BA_ "GenSigSendType" SG_ 1057 ReSideRdrLe20Obj21RdrObjVx 0;
BA_ "GenSigStartValue" SG_ 1057 ReSideRdrLe20Obj21RdrObjVx 6400;
BA_ "GenSigSendType" SG_ 1057 ReSideRdrLe20Obj21RdrObjVxStdDe 0;
BA_ "GenSigSendType" SG_ 1057 ReSideRdrLe20Obj21RdrObjVy 0;
BA_ "GenSigStartValue" SG_ 1057 ReSideRdrLe20Obj21RdrObjVy 6400;
BA_ "GenSigSendType" SG_ 1057 ReSideRdrLe20Obj21RdrObjVyStdDe 0;
BA_ "GenSigSendType" SG_ 1057 ReSideRdrLe20Obj21RelVx 0;
BA_ "GenSigStartValue" SG_ 1057 ReSideRdrLe20Obj21RelVx 1780;
BA_ "GenSigSendType" SG_ 1057 ReSideRdrLe20Obj21RelVy 0;
BA_ "GenSigStartValue" SG_ 1057 ReSideRdrLe20Obj21RelVy 1780;
BA_ "GenSigSendType" SG_ 1058 ReSideRdrLe20Obj22Heading 0;
BA_ "GenSigStartValue" SG_ 1058 ReSideRdrLe20Obj22Heading 1800;
BA_ "GenSigSendType" SG_ 1058 ReSideRdrLe20Obj22ObjBoxCenterLat 0;
BA_ "GenSigStartValue" SG_ 1058 ReSideRdrLe20Obj22ObjBoxCenterLat 250;
BA_ "GenSigSendType" SG_ 1058 ReSideRdrLe20Obj22ObjBoxCenterLgt 0;
BA_ "GenSigStartValue" SG_ 1058 ReSideRdrLe20Obj22ObjBoxCenterLgt 250;
BA_ "GenSigSendType" SG_ 1058 ReSideRdrLe20Obj22ObservationHist 0;
BA_ "GenSigSendType" SG_ 1058 ReSideRdrLe20Obj22QualityBits 0;
BA_ "GenSigSendType" SG_ 1058 ReSideRdrLe20Obj22RdrObjAx 0;
BA_ "GenSigSendType" SG_ 1058 ReSideRdrLe20Obj22RdrObjAy 0;
BA_ "GenSigSendType" SG_ 1058 ReSideRdrLe20Obj22RdrObjBoxLength 0;
BA_ "GenSigSendType" SG_ 1058 ReSideRdrLe20Obj22RdrObjBoxWidth 0;
BA_ "GenSigDataID" SG_ 1058 ReSideRdrLe20Obj22RdrObjChks "0x12A9";
BA_ "GenSigFuncType" SG_ 1058 ReSideRdrLe20Obj22RdrObjChks 15;
BA_ "GenSigSendType" SG_ 1058 ReSideRdrLe20Obj22RdrObjChks 0;
BA_ "GenSigFuncType" SG_ 1058 ReSideRdrLe20Obj22RdrObjCntr 16;
BA_ "GenSigSendType" SG_ 1058 ReSideRdrLe20Obj22RdrObjCntr 0;
BA_ "GenSigSendType" SG_ 1058 ReSideRdrLe20Obj22RdrObjCoastCnt 0;
BA_ "GenSigStartValue" SG_ 1058 ReSideRdrLe20Obj22RdrObjCoastCnt 31;
BA_ "GenSigSendType" SG_ 1058 ReSideRdrLe20Obj22RdrObjConf 0;
BA_ "GenSigSendType" SG_ 1058 ReSideRdrLe20Obj22RdrObjDx 0;
BA_ "GenSigSendType" SG_ 1058 ReSideRdrLe20Obj22RdrObjDxStdDe 0;
BA_ "GenSigSendType" SG_ 1058 ReSideRdrLe20Obj22RdrObjDy 0;
BA_ "GenSigStartValue" SG_ 1058 ReSideRdrLe20Obj22RdrObjDy 4000;
BA_ "GenSigSendType" SG_ 1058 ReSideRdrLe20Obj22RdrObjDyStdDe 0;
BA_ "GenSigSendType" SG_ 1058 ReSideRdrLe20Obj22RdrObjElevnConf 0;
BA_ "GenSigSendType" SG_ 1058 ReSideRdrLe20Obj22RdrObjElevnSts 0;
BA_ "GenSigSendType" SG_ 1058 ReSideRdrLe20Obj22RdrObjID 0;
BA_ "GenSigSendType" SG_ 1058 ReSideRdrLe20Obj22RdrObjIsInFreeSpace 0;
BA_ "GenSigStartValue" SG_ 1058 ReSideRdrLe20Obj22RdrObjIsInFreeSpace 1;
BA_ "GenSigSendType" SG_ 1058 ReSideRdrLe20Obj22RdrObjMirrProblty 0;
BA_ "GenSigSendType" SG_ 1058 ReSideRdrLe20Obj22RdrObjMtnPat 0;
BA_ "GenSigStartValue" SG_ 1058 ReSideRdrLe20Obj22RdrObjMtnPat 3;
BA_ "GenSigSendType" SG_ 1058 ReSideRdrLe20Obj22RdrObjNotRealProblty 0;
BA_ "GenSigSendType" SG_ 1058 ReSideRdrLe20Obj22RdrObjStatyCnt 0;
BA_ "GenSigSendType" SG_ 1058 ReSideRdrLe20Obj22RdrObjTiAlv 0;
BA_ "GenSigSendType" SG_ 1058 ReSideRdrLe20Obj22RdrObjTrackSts 0;
BA_ "GenSigSendType" SG_ 1058 ReSideRdrLe20Obj22RdrObjTyp 0;
BA_ "GenSigSendType" SG_ 1058 ReSideRdrLe20Obj22RdrObjTypConfBike 0;
BA_ "GenSigSendType" SG_ 1058 ReSideRdrLe20Obj22RdrObjTypConfPed 0;
BA_ "GenSigSendType" SG_ 1058 ReSideRdrLe20Obj22RdrObjTypConfVeh 0;
BA_ "GenSigSendType" SG_ 1058 ReSideRdrLe20Obj22RdrObjUsedTracker 0;
BA_ "GenSigStartValue" SG_ 1058 ReSideRdrLe20Obj22RdrObjUsedTracker 3;
BA_ "GenSigSendType" SG_ 1058 ReSideRdrLe20Obj22RdrObjVx 0;
BA_ "GenSigStartValue" SG_ 1058 ReSideRdrLe20Obj22RdrObjVx 6400;
BA_ "GenSigSendType" SG_ 1058 ReSideRdrLe20Obj22RdrObjVxStdDe 0;
BA_ "GenSigSendType" SG_ 1058 ReSideRdrLe20Obj22RdrObjVy 0;
BA_ "GenSigStartValue" SG_ 1058 ReSideRdrLe20Obj22RdrObjVy 6400;
BA_ "GenSigSendType" SG_ 1058 ReSideRdrLe20Obj22RdrObjVyStdDe 0;
BA_ "GenSigSendType" SG_ 1058 ReSideRdrLe20Obj22RelVx 0;
BA_ "GenSigStartValue" SG_ 1058 ReSideRdrLe20Obj22RelVx 1780;
BA_ "GenSigSendType" SG_ 1058 ReSideRdrLe20Obj22RelVy 0;
BA_ "GenSigStartValue" SG_ 1058 ReSideRdrLe20Obj22RelVy 1780;
BA_ "GenSigSendType" SG_ 1059 ReSideRdrLe20Obj23Heading 0;
BA_ "GenSigStartValue" SG_ 1059 ReSideRdrLe20Obj23Heading 1800;
BA_ "GenSigSendType" SG_ 1059 ReSideRdrLe20Obj23ObjBoxCenterLat 0;
BA_ "GenSigStartValue" SG_ 1059 ReSideRdrLe20Obj23ObjBoxCenterLat 250;
BA_ "GenSigSendType" SG_ 1059 ReSideRdrLe20Obj23ObjBoxCenterLgt 0;
BA_ "GenSigStartValue" SG_ 1059 ReSideRdrLe20Obj23ObjBoxCenterLgt 250;
BA_ "GenSigSendType" SG_ 1059 ReSideRdrLe20Obj23ObservationHist 0;
BA_ "GenSigSendType" SG_ 1059 ReSideRdrLe20Obj23QualityBits 0;
BA_ "GenSigSendType" SG_ 1059 ReSideRdrLe20Obj23RdrObjAx 0;
BA_ "GenSigSendType" SG_ 1059 ReSideRdrLe20Obj23RdrObjAy 0;
BA_ "GenSigSendType" SG_ 1059 ReSideRdrLe20Obj23RdrObjBoxLength 0;
BA_ "GenSigSendType" SG_ 1059 ReSideRdrLe20Obj23RdrObjBoxWidth 0;
BA_ "GenSigDataID" SG_ 1059 ReSideRdrLe20Obj23RdrObjChks "0x12AA";
BA_ "GenSigFuncType" SG_ 1059 ReSideRdrLe20Obj23RdrObjChks 15;
BA_ "GenSigSendType" SG_ 1059 ReSideRdrLe20Obj23RdrObjChks 0;
BA_ "GenSigFuncType" SG_ 1059 ReSideRdrLe20Obj23RdrObjCntr 16;
BA_ "GenSigSendType" SG_ 1059 ReSideRdrLe20Obj23RdrObjCntr 0;
BA_ "GenSigSendType" SG_ 1059 ReSideRdrLe20Obj23RdrObjCoastCnt 0;
BA_ "GenSigStartValue" SG_ 1059 ReSideRdrLe20Obj23RdrObjCoastCnt 31;
BA_ "GenSigSendType" SG_ 1059 ReSideRdrLe20Obj23RdrObjConf 0;
BA_ "GenSigSendType" SG_ 1059 ReSideRdrLe20Obj23RdrObjDx 0;
BA_ "GenSigSendType" SG_ 1059 ReSideRdrLe20Obj23RdrObjDxStdDe 0;
BA_ "GenSigSendType" SG_ 1059 ReSideRdrLe20Obj23RdrObjDy 0;
BA_ "GenSigStartValue" SG_ 1059 ReSideRdrLe20Obj23RdrObjDy 4000;
BA_ "GenSigSendType" SG_ 1059 ReSideRdrLe20Obj23RdrObjDyStdDe 0;
BA_ "GenSigSendType" SG_ 1059 ReSideRdrLe20Obj23RdrObjElevnConf 0;
BA_ "GenSigSendType" SG_ 1059 ReSideRdrLe20Obj23RdrObjElevnSts 0;
BA_ "GenSigSendType" SG_ 1059 ReSideRdrLe20Obj23RdrObjID 0;
BA_ "GenSigSendType" SG_ 1059 ReSideRdrLe20Obj23RdrObjIsInFreeSpace 0;
BA_ "GenSigStartValue" SG_ 1059 ReSideRdrLe20Obj23RdrObjIsInFreeSpace 1;
BA_ "GenSigSendType" SG_ 1059 ReSideRdrLe20Obj23RdrObjMirrProblty 0;
BA_ "GenSigSendType" SG_ 1059 ReSideRdrLe20Obj23RdrObjMtnPat 0;
BA_ "GenSigStartValue" SG_ 1059 ReSideRdrLe20Obj23RdrObjMtnPat 3;
BA_ "GenSigSendType" SG_ 1059 ReSideRdrLe20Obj23RdrObjNotRealProblty 0;
BA_ "GenSigSendType" SG_ 1059 ReSideRdrLe20Obj23RdrObjStatyCnt 0;
BA_ "GenSigSendType" SG_ 1059 ReSideRdrLe20Obj23RdrObjTiAlv 0;
BA_ "GenSigSendType" SG_ 1059 ReSideRdrLe20Obj23RdrObjTrackSts 0;
BA_ "GenSigSendType" SG_ 1059 ReSideRdrLe20Obj23RdrObjTyp 0;
BA_ "GenSigSendType" SG_ 1059 ReSideRdrLe20Obj23RdrObjTypConfBike 0;
BA_ "GenSigSendType" SG_ 1059 ReSideRdrLe20Obj23RdrObjTypConfPed 0;
BA_ "GenSigSendType" SG_ 1059 ReSideRdrLe20Obj23RdrObjTypConfVeh 0;
BA_ "GenSigSendType" SG_ 1059 ReSideRdrLe20Obj23RdrObjUsedTracker 0;
BA_ "GenSigStartValue" SG_ 1059 ReSideRdrLe20Obj23RdrObjUsedTracker 3;
BA_ "GenSigSendType" SG_ 1059 ReSideRdrLe20Obj23RdrObjVx 0;
BA_ "GenSigStartValue" SG_ 1059 ReSideRdrLe20Obj23RdrObjVx 6400;
BA_ "GenSigSendType" SG_ 1059 ReSideRdrLe20Obj23RdrObjVxStdDe 0;
BA_ "GenSigSendType" SG_ 1059 ReSideRdrLe20Obj23RdrObjVy 0;
BA_ "GenSigStartValue" SG_ 1059 ReSideRdrLe20Obj23RdrObjVy 6400;
BA_ "GenSigSendType" SG_ 1059 ReSideRdrLe20Obj23RdrObjVyStdDe 0;
BA_ "GenSigSendType" SG_ 1059 ReSideRdrLe20Obj23RelVx 0;
BA_ "GenSigStartValue" SG_ 1059 ReSideRdrLe20Obj23RelVx 1780;
BA_ "GenSigSendType" SG_ 1059 ReSideRdrLe20Obj23RelVy 0;
BA_ "GenSigStartValue" SG_ 1059 ReSideRdrLe20Obj23RelVy 1780;
BA_ "GenSigSendType" SG_ 1060 ReSideRdrLe20Obj24Heading 0;
BA_ "GenSigStartValue" SG_ 1060 ReSideRdrLe20Obj24Heading 1800;
BA_ "GenSigSendType" SG_ 1060 ReSideRdrLe20Obj24ObjBoxCenterLat 0;
BA_ "GenSigStartValue" SG_ 1060 ReSideRdrLe20Obj24ObjBoxCenterLat 250;
BA_ "GenSigSendType" SG_ 1060 ReSideRdrLe20Obj24ObjBoxCenterLgt 0;
BA_ "GenSigStartValue" SG_ 1060 ReSideRdrLe20Obj24ObjBoxCenterLgt 250;
BA_ "GenSigSendType" SG_ 1060 ReSideRdrLe20Obj24ObservationHist 0;
BA_ "GenSigSendType" SG_ 1060 ReSideRdrLe20Obj24QualityBits 0;
BA_ "GenSigSendType" SG_ 1060 ReSideRdrLe20Obj24RdrObjAx 0;
BA_ "GenSigSendType" SG_ 1060 ReSideRdrLe20Obj24RdrObjAy 0;
BA_ "GenSigSendType" SG_ 1060 ReSideRdrLe20Obj24RdrObjBoxLength 0;
BA_ "GenSigSendType" SG_ 1060 ReSideRdrLe20Obj24RdrObjBoxWidth 0;
BA_ "GenSigDataID" SG_ 1060 ReSideRdrLe20Obj24RdrObjChks "0x12AB";
BA_ "GenSigFuncType" SG_ 1060 ReSideRdrLe20Obj24RdrObjChks 15;
BA_ "GenSigSendType" SG_ 1060 ReSideRdrLe20Obj24RdrObjChks 0;
BA_ "GenSigFuncType" SG_ 1060 ReSideRdrLe20Obj24RdrObjCntr 16;
BA_ "GenSigSendType" SG_ 1060 ReSideRdrLe20Obj24RdrObjCntr 0;
BA_ "GenSigSendType" SG_ 1060 ReSideRdrLe20Obj24RdrObjCoastCnt 0;
BA_ "GenSigStartValue" SG_ 1060 ReSideRdrLe20Obj24RdrObjCoastCnt 31;
BA_ "GenSigSendType" SG_ 1060 ReSideRdrLe20Obj24RdrObjConf 0;
BA_ "GenSigSendType" SG_ 1060 ReSideRdrLe20Obj24RdrObjDx 0;
BA_ "GenSigSendType" SG_ 1060 ReSideRdrLe20Obj24RdrObjDxStdDe 0;
BA_ "GenSigSendType" SG_ 1060 ReSideRdrLe20Obj24RdrObjDy 0;
BA_ "GenSigStartValue" SG_ 1060 ReSideRdrLe20Obj24RdrObjDy 4000;
BA_ "GenSigSendType" SG_ 1060 ReSideRdrLe20Obj24RdrObjDyStdDe 0;
BA_ "GenSigSendType" SG_ 1060 ReSideRdrLe20Obj24RdrObjElevnConf 0;
BA_ "GenSigSendType" SG_ 1060 ReSideRdrLe20Obj24RdrObjElevnSts 0;
BA_ "GenSigSendType" SG_ 1060 ReSideRdrLe20Obj24RdrObjID 0;
BA_ "GenSigSendType" SG_ 1060 ReSideRdrLe20Obj24RdrObjIsInFreeSpace 0;
BA_ "GenSigStartValue" SG_ 1060 ReSideRdrLe20Obj24RdrObjIsInFreeSpace 1;
BA_ "GenSigSendType" SG_ 1060 ReSideRdrLe20Obj24RdrObjMirrProblty 0;
BA_ "GenSigSendType" SG_ 1060 ReSideRdrLe20Obj24RdrObjMtnPat 0;
BA_ "GenSigStartValue" SG_ 1060 ReSideRdrLe20Obj24RdrObjMtnPat 3;
BA_ "GenSigSendType" SG_ 1060 ReSideRdrLe20Obj24RdrObjNotRealProblty 0;
BA_ "GenSigSendType" SG_ 1060 ReSideRdrLe20Obj24RdrObjStatyCnt 0;
BA_ "GenSigSendType" SG_ 1060 ReSideRdrLe20Obj24RdrObjTiAlv 0;
BA_ "GenSigSendType" SG_ 1060 ReSideRdrLe20Obj24RdrObjTrackSts 0;
BA_ "GenSigSendType" SG_ 1060 ReSideRdrLe20Obj24RdrObjTyp 0;
BA_ "GenSigSendType" SG_ 1060 ReSideRdrLe20Obj24RdrObjTypConfBike 0;
BA_ "GenSigSendType" SG_ 1060 ReSideRdrLe20Obj24RdrObjTypConfPed 0;
BA_ "GenSigSendType" SG_ 1060 ReSideRdrLe20Obj24RdrObjTypConfVeh 0;
BA_ "GenSigSendType" SG_ 1060 ReSideRdrLe20Obj24RdrObjUsedTracker 0;
BA_ "GenSigStartValue" SG_ 1060 ReSideRdrLe20Obj24RdrObjUsedTracker 3;
BA_ "GenSigSendType" SG_ 1060 ReSideRdrLe20Obj24RdrObjVx 0;
BA_ "GenSigStartValue" SG_ 1060 ReSideRdrLe20Obj24RdrObjVx 6400;
BA_ "GenSigSendType" SG_ 1060 ReSideRdrLe20Obj24RdrObjVxStdDe 0;
BA_ "GenSigSendType" SG_ 1060 ReSideRdrLe20Obj24RdrObjVy 0;
BA_ "GenSigStartValue" SG_ 1060 ReSideRdrLe20Obj24RdrObjVy 6400;
BA_ "GenSigSendType" SG_ 1060 ReSideRdrLe20Obj24RdrObjVyStdDe 0;
BA_ "GenSigSendType" SG_ 1060 ReSideRdrLe20Obj24RelVx 0;
BA_ "GenSigStartValue" SG_ 1060 ReSideRdrLe20Obj24RelVx 1780;
BA_ "GenSigSendType" SG_ 1060 ReSideRdrLe20Obj24RelVy 0;
BA_ "GenSigStartValue" SG_ 1060 ReSideRdrLe20Obj24RelVy 1780;
BA_ "GenSigSendType" SG_ 1061 ReSideRdrLe20Obj25Heading 0;
BA_ "GenSigStartValue" SG_ 1061 ReSideRdrLe20Obj25Heading 1800;
BA_ "GenSigSendType" SG_ 1061 ReSideRdrLe20Obj25ObjBoxCenterLat 0;
BA_ "GenSigStartValue" SG_ 1061 ReSideRdrLe20Obj25ObjBoxCenterLat 250;
BA_ "GenSigSendType" SG_ 1061 ReSideRdrLe20Obj25ObjBoxCenterLgt 0;
BA_ "GenSigStartValue" SG_ 1061 ReSideRdrLe20Obj25ObjBoxCenterLgt 250;
BA_ "GenSigSendType" SG_ 1061 ReSideRdrLe20Obj25ObservationHist 0;
BA_ "GenSigSendType" SG_ 1061 ReSideRdrLe20Obj25QualityBits 0;
BA_ "GenSigSendType" SG_ 1061 ReSideRdrLe20Obj25RdrObjAx 0;
BA_ "GenSigSendType" SG_ 1061 ReSideRdrLe20Obj25RdrObjAy 0;
BA_ "GenSigSendType" SG_ 1061 ReSideRdrLe20Obj25RdrObjBoxLength 0;
BA_ "GenSigSendType" SG_ 1061 ReSideRdrLe20Obj25RdrObjBoxWidth 0;
BA_ "GenSigDataID" SG_ 1061 ReSideRdrLe20Obj25RdrObjChks "0x12AC";
BA_ "GenSigFuncType" SG_ 1061 ReSideRdrLe20Obj25RdrObjChks 15;
BA_ "GenSigSendType" SG_ 1061 ReSideRdrLe20Obj25RdrObjChks 0;
BA_ "GenSigFuncType" SG_ 1061 ReSideRdrLe20Obj25RdrObjCntr 16;
BA_ "GenSigSendType" SG_ 1061 ReSideRdrLe20Obj25RdrObjCntr 0;
BA_ "GenSigSendType" SG_ 1061 ReSideRdrLe20Obj25RdrObjCoastCnt 0;
BA_ "GenSigStartValue" SG_ 1061 ReSideRdrLe20Obj25RdrObjCoastCnt 31;
BA_ "GenSigSendType" SG_ 1061 ReSideRdrLe20Obj25RdrObjConf 0;
BA_ "GenSigSendType" SG_ 1061 ReSideRdrLe20Obj25RdrObjDx 0;
BA_ "GenSigSendType" SG_ 1061 ReSideRdrLe20Obj25RdrObjDxStdDe 0;
BA_ "GenSigSendType" SG_ 1061 ReSideRdrLe20Obj25RdrObjDy 0;
BA_ "GenSigStartValue" SG_ 1061 ReSideRdrLe20Obj25RdrObjDy 4000;
BA_ "GenSigSendType" SG_ 1061 ReSideRdrLe20Obj25RdrObjDyStdDe 0;
BA_ "GenSigSendType" SG_ 1061 ReSideRdrLe20Obj25RdrObjElevnConf 0;
BA_ "GenSigSendType" SG_ 1061 ReSideRdrLe20Obj25RdrObjElevnSts 0;
BA_ "GenSigSendType" SG_ 1061 ReSideRdrLe20Obj25RdrObjID 0;
BA_ "GenSigSendType" SG_ 1061 ReSideRdrLe20Obj25RdrObjIsInFreeSpace 0;
BA_ "GenSigStartValue" SG_ 1061 ReSideRdrLe20Obj25RdrObjIsInFreeSpace 1;
BA_ "GenSigSendType" SG_ 1061 ReSideRdrLe20Obj25RdrObjMirrProblty 0;
BA_ "GenSigSendType" SG_ 1061 ReSideRdrLe20Obj25RdrObjMtnPat 0;
BA_ "GenSigStartValue" SG_ 1061 ReSideRdrLe20Obj25RdrObjMtnPat 3;
BA_ "GenSigSendType" SG_ 1061 ReSideRdrLe20Obj25RdrObjNotRealProblty 0;
BA_ "GenSigSendType" SG_ 1061 ReSideRdrLe20Obj25RdrObjStatyCnt 0;
BA_ "GenSigSendType" SG_ 1061 ReSideRdrLe20Obj25RdrObjTiAlv 0;
BA_ "GenSigSendType" SG_ 1061 ReSideRdrLe20Obj25RdrObjTrackSts 0;
BA_ "GenSigSendType" SG_ 1061 ReSideRdrLe20Obj25RdrObjTyp 0;
BA_ "GenSigSendType" SG_ 1061 ReSideRdrLe20Obj25RdrObjTypConfBike 0;
BA_ "GenSigSendType" SG_ 1061 ReSideRdrLe20Obj25RdrObjTypConfPed 0;
BA_ "GenSigSendType" SG_ 1061 ReSideRdrLe20Obj25RdrObjTypConfVeh 0;
BA_ "GenSigSendType" SG_ 1061 ReSideRdrLe20Obj25RdrObjUsedTracker 0;
BA_ "GenSigStartValue" SG_ 1061 ReSideRdrLe20Obj25RdrObjUsedTracker 3;
BA_ "GenSigSendType" SG_ 1061 ReSideRdrLe20Obj25RdrObjVx 0;
BA_ "GenSigStartValue" SG_ 1061 ReSideRdrLe20Obj25RdrObjVx 6400;
BA_ "GenSigSendType" SG_ 1061 ReSideRdrLe20Obj25RdrObjVxStdDe 0;
BA_ "GenSigSendType" SG_ 1061 ReSideRdrLe20Obj25RdrObjVy 0;
BA_ "GenSigStartValue" SG_ 1061 ReSideRdrLe20Obj25RdrObjVy 6400;
BA_ "GenSigSendType" SG_ 1061 ReSideRdrLe20Obj25RdrObjVyStdDe 0;
BA_ "GenSigSendType" SG_ 1061 ReSideRdrLe20Obj25RelVx 0;
BA_ "GenSigStartValue" SG_ 1061 ReSideRdrLe20Obj25RelVx 1780;
BA_ "GenSigSendType" SG_ 1061 ReSideRdrLe20Obj25RelVy 0;
BA_ "GenSigStartValue" SG_ 1061 ReSideRdrLe20Obj25RelVy 1780;
BA_ "GenSigSendType" SG_ 1062 ReSideRdrLe20Obj26Heading 0;
BA_ "GenSigStartValue" SG_ 1062 ReSideRdrLe20Obj26Heading 1800;
BA_ "GenSigSendType" SG_ 1062 ReSideRdrLe20Obj26ObjBoxCenterLat 0;
BA_ "GenSigStartValue" SG_ 1062 ReSideRdrLe20Obj26ObjBoxCenterLat 250;
BA_ "GenSigSendType" SG_ 1062 ReSideRdrLe20Obj26ObjBoxCenterLgt 0;
BA_ "GenSigStartValue" SG_ 1062 ReSideRdrLe20Obj26ObjBoxCenterLgt 250;
BA_ "GenSigSendType" SG_ 1062 ReSideRdrLe20Obj26ObservationHist 0;
BA_ "GenSigSendType" SG_ 1062 ReSideRdrLe20Obj26QualityBits 0;
BA_ "GenSigSendType" SG_ 1062 ReSideRdrLe20Obj26RdrObjAx 0;
BA_ "GenSigSendType" SG_ 1062 ReSideRdrLe20Obj26RdrObjAy 0;
BA_ "GenSigSendType" SG_ 1062 ReSideRdrLe20Obj26RdrObjBoxLength 0;
BA_ "GenSigSendType" SG_ 1062 ReSideRdrLe20Obj26RdrObjBoxWidth 0;
BA_ "GenSigDataID" SG_ 1062 ReSideRdrLe20Obj26RdrObjChks "0x12AD";
BA_ "GenSigFuncType" SG_ 1062 ReSideRdrLe20Obj26RdrObjChks 15;
BA_ "GenSigSendType" SG_ 1062 ReSideRdrLe20Obj26RdrObjChks 0;
BA_ "GenSigFuncType" SG_ 1062 ReSideRdrLe20Obj26RdrObjCntr 16;
BA_ "GenSigSendType" SG_ 1062 ReSideRdrLe20Obj26RdrObjCntr 0;
BA_ "GenSigSendType" SG_ 1062 ReSideRdrLe20Obj26RdrObjCoastCnt 0;
BA_ "GenSigStartValue" SG_ 1062 ReSideRdrLe20Obj26RdrObjCoastCnt 31;
BA_ "GenSigSendType" SG_ 1062 ReSideRdrLe20Obj26RdrObjConf 0;
BA_ "GenSigSendType" SG_ 1062 ReSideRdrLe20Obj26RdrObjDx 0;
BA_ "GenSigSendType" SG_ 1062 ReSideRdrLe20Obj26RdrObjDxStdDe 0;
BA_ "GenSigSendType" SG_ 1062 ReSideRdrLe20Obj26RdrObjDy 0;
BA_ "GenSigStartValue" SG_ 1062 ReSideRdrLe20Obj26RdrObjDy 4000;
BA_ "GenSigSendType" SG_ 1062 ReSideRdrLe20Obj26RdrObjDyStdDe 0;
BA_ "GenSigSendType" SG_ 1062 ReSideRdrLe20Obj26RdrObjElevnConf 0;
BA_ "GenSigSendType" SG_ 1062 ReSideRdrLe20Obj26RdrObjElevnSts 0;
BA_ "GenSigSendType" SG_ 1062 ReSideRdrLe20Obj26RdrObjID 0;
BA_ "GenSigSendType" SG_ 1062 ReSideRdrLe20Obj26RdrObjIsInFreeSpace 0;
BA_ "GenSigStartValue" SG_ 1062 ReSideRdrLe20Obj26RdrObjIsInFreeSpace 1;
BA_ "GenSigSendType" SG_ 1062 ReSideRdrLe20Obj26RdrObjMirrProblty 0;
BA_ "GenSigSendType" SG_ 1062 ReSideRdrLe20Obj26RdrObjMtnPat 0;
BA_ "GenSigStartValue" SG_ 1062 ReSideRdrLe20Obj26RdrObjMtnPat 3;
BA_ "GenSigSendType" SG_ 1062 ReSideRdrLe20Obj26RdrObjNotRealProblty 0;
BA_ "GenSigSendType" SG_ 1062 ReSideRdrLe20Obj26RdrObjStatyCnt 0;
BA_ "GenSigSendType" SG_ 1062 ReSideRdrLe20Obj26RdrObjTiAlv 0;
BA_ "GenSigSendType" SG_ 1062 ReSideRdrLe20Obj26RdrObjTrackSts 0;
BA_ "GenSigSendType" SG_ 1062 ReSideRdrLe20Obj26RdrObjTyp 0;
BA_ "GenSigSendType" SG_ 1062 ReSideRdrLe20Obj26RdrObjTypConfBike 0;
BA_ "GenSigSendType" SG_ 1062 ReSideRdrLe20Obj26RdrObjTypConfPed 0;
BA_ "GenSigSendType" SG_ 1062 ReSideRdrLe20Obj26RdrObjTypConfVeh 0;
BA_ "GenSigSendType" SG_ 1062 ReSideRdrLe20Obj26RdrObjUsedTracker 0;
BA_ "GenSigStartValue" SG_ 1062 ReSideRdrLe20Obj26RdrObjUsedTracker 3;
BA_ "GenSigSendType" SG_ 1062 ReSideRdrLe20Obj26RdrObjVx 0;
BA_ "GenSigStartValue" SG_ 1062 ReSideRdrLe20Obj26RdrObjVx 6400;
BA_ "GenSigSendType" SG_ 1062 ReSideRdrLe20Obj26RdrObjVxStdDe 0;
BA_ "GenSigSendType" SG_ 1062 ReSideRdrLe20Obj26RdrObjVy 0;
BA_ "GenSigStartValue" SG_ 1062 ReSideRdrLe20Obj26RdrObjVy 6400;
BA_ "GenSigSendType" SG_ 1062 ReSideRdrLe20Obj26RdrObjVyStdDe 0;
BA_ "GenSigSendType" SG_ 1062 ReSideRdrLe20Obj26RelVx 0;
BA_ "GenSigStartValue" SG_ 1062 ReSideRdrLe20Obj26RelVx 1780;
BA_ "GenSigSendType" SG_ 1062 ReSideRdrLe20Obj26RelVy 0;
BA_ "GenSigStartValue" SG_ 1062 ReSideRdrLe20Obj26RelVy 1780;
BA_ "GenSigSendType" SG_ 1063 ReSideRdrLe20Obj27Heading 0;
BA_ "GenSigStartValue" SG_ 1063 ReSideRdrLe20Obj27Heading 1800;
BA_ "GenSigSendType" SG_ 1063 ReSideRdrLe20Obj27ObjBoxCenterLat 0;
BA_ "GenSigStartValue" SG_ 1063 ReSideRdrLe20Obj27ObjBoxCenterLat 250;
BA_ "GenSigSendType" SG_ 1063 ReSideRdrLe20Obj27ObjBoxCenterLgt 0;
BA_ "GenSigStartValue" SG_ 1063 ReSideRdrLe20Obj27ObjBoxCenterLgt 250;
BA_ "GenSigSendType" SG_ 1063 ReSideRdrLe20Obj27ObservationHist 0;
BA_ "GenSigSendType" SG_ 1063 ReSideRdrLe20Obj27QualityBits 0;
BA_ "GenSigSendType" SG_ 1063 ReSideRdrLe20Obj27RdrObjAx 0;
BA_ "GenSigSendType" SG_ 1063 ReSideRdrLe20Obj27RdrObjAy 0;
BA_ "GenSigSendType" SG_ 1063 ReSideRdrLe20Obj27RdrObjBoxLength 0;
BA_ "GenSigSendType" SG_ 1063 ReSideRdrLe20Obj27RdrObjBoxWidth 0;
BA_ "GenSigDataID" SG_ 1063 ReSideRdrLe20Obj27RdrObjChks "0x12AE";
BA_ "GenSigFuncType" SG_ 1063 ReSideRdrLe20Obj27RdrObjChks 15;
BA_ "GenSigSendType" SG_ 1063 ReSideRdrLe20Obj27RdrObjChks 0;
BA_ "GenSigFuncType" SG_ 1063 ReSideRdrLe20Obj27RdrObjCntr 16;
BA_ "GenSigSendType" SG_ 1063 ReSideRdrLe20Obj27RdrObjCntr 0;
BA_ "GenSigSendType" SG_ 1063 ReSideRdrLe20Obj27RdrObjCoastCnt 0;
BA_ "GenSigStartValue" SG_ 1063 ReSideRdrLe20Obj27RdrObjCoastCnt 31;
BA_ "GenSigSendType" SG_ 1063 ReSideRdrLe20Obj27RdrObjConf 0;
BA_ "GenSigSendType" SG_ 1063 ReSideRdrLe20Obj27RdrObjDx 0;
BA_ "GenSigSendType" SG_ 1063 ReSideRdrLe20Obj27RdrObjDxStdDe 0;
BA_ "GenSigSendType" SG_ 1063 ReSideRdrLe20Obj27RdrObjDy 0;
BA_ "GenSigStartValue" SG_ 1063 ReSideRdrLe20Obj27RdrObjDy 4000;
BA_ "GenSigSendType" SG_ 1063 ReSideRdrLe20Obj27RdrObjDyStdDe 0;
BA_ "GenSigSendType" SG_ 1063 ReSideRdrLe20Obj27RdrObjElevnConf 0;
BA_ "GenSigSendType" SG_ 1063 ReSideRdrLe20Obj27RdrObjElevnSts 0;
BA_ "GenSigSendType" SG_ 1063 ReSideRdrLe20Obj27RdrObjID 0;
BA_ "GenSigSendType" SG_ 1063 ReSideRdrLe20Obj27RdrObjIsInFreeSpace 0;
BA_ "GenSigStartValue" SG_ 1063 ReSideRdrLe20Obj27RdrObjIsInFreeSpace 1;
BA_ "GenSigSendType" SG_ 1063 ReSideRdrLe20Obj27RdrObjMirrProblty 0;
BA_ "GenSigSendType" SG_ 1063 ReSideRdrLe20Obj27RdrObjMtnPat 0;
BA_ "GenSigStartValue" SG_ 1063 ReSideRdrLe20Obj27RdrObjMtnPat 3;
BA_ "GenSigSendType" SG_ 1063 ReSideRdrLe20Obj27RdrObjNotRealProblty 0;
BA_ "GenSigSendType" SG_ 1063 ReSideRdrLe20Obj27RdrObjStatyCnt 0;
BA_ "GenSigSendType" SG_ 1063 ReSideRdrLe20Obj27RdrObjTiAlv 0;
BA_ "GenSigSendType" SG_ 1063 ReSideRdrLe20Obj27RdrObjTrackSts 0;
BA_ "GenSigSendType" SG_ 1063 ReSideRdrLe20Obj27RdrObjTyp 0;
BA_ "GenSigSendType" SG_ 1063 ReSideRdrLe20Obj27RdrObjTypConfBike 0;
BA_ "GenSigSendType" SG_ 1063 ReSideRdrLe20Obj27RdrObjTypConfPed 0;
BA_ "GenSigSendType" SG_ 1063 ReSideRdrLe20Obj27RdrObjTypConfVeh 0;
BA_ "GenSigSendType" SG_ 1063 ReSideRdrLe20Obj27RdrObjUsedTracker 0;
BA_ "GenSigStartValue" SG_ 1063 ReSideRdrLe20Obj27RdrObjUsedTracker 3;
BA_ "GenSigSendType" SG_ 1063 ReSideRdrLe20Obj27RdrObjVx 0;
BA_ "GenSigStartValue" SG_ 1063 ReSideRdrLe20Obj27RdrObjVx 6400;
BA_ "GenSigSendType" SG_ 1063 ReSideRdrLe20Obj27RdrObjVxStdDe 0;
BA_ "GenSigSendType" SG_ 1063 ReSideRdrLe20Obj27RdrObjVy 0;
BA_ "GenSigStartValue" SG_ 1063 ReSideRdrLe20Obj27RdrObjVy 6400;
BA_ "GenSigSendType" SG_ 1063 ReSideRdrLe20Obj27RdrObjVyStdDe 0;
BA_ "GenSigSendType" SG_ 1063 ReSideRdrLe20Obj27RelVx 0;
BA_ "GenSigStartValue" SG_ 1063 ReSideRdrLe20Obj27RelVx 1780;
BA_ "GenSigSendType" SG_ 1063 ReSideRdrLe20Obj27RelVy 0;
BA_ "GenSigStartValue" SG_ 1063 ReSideRdrLe20Obj27RelVy 1780;
BA_ "GenSigSendType" SG_ 1064 ReSideRdrLe20Obj28Heading 0;
BA_ "GenSigStartValue" SG_ 1064 ReSideRdrLe20Obj28Heading 1800;
BA_ "GenSigSendType" SG_ 1064 ReSideRdrLe20Obj28ObjBoxCenterLat 0;
BA_ "GenSigStartValue" SG_ 1064 ReSideRdrLe20Obj28ObjBoxCenterLat 250;
BA_ "GenSigSendType" SG_ 1064 ReSideRdrLe20Obj28ObjBoxCenterLgt 0;
BA_ "GenSigStartValue" SG_ 1064 ReSideRdrLe20Obj28ObjBoxCenterLgt 250;
BA_ "GenSigSendType" SG_ 1064 ReSideRdrLe20Obj28ObservationHist 0;
BA_ "GenSigSendType" SG_ 1064 ReSideRdrLe20Obj28QualityBits 0;
BA_ "GenSigSendType" SG_ 1064 ReSideRdrLe20Obj28RdrObjAx 0;
BA_ "GenSigSendType" SG_ 1064 ReSideRdrLe20Obj28RdrObjAy 0;
BA_ "GenSigSendType" SG_ 1064 ReSideRdrLe20Obj28RdrObjBoxLength 0;
BA_ "GenSigSendType" SG_ 1064 ReSideRdrLe20Obj28RdrObjBoxWidth 0;
BA_ "GenSigDataID" SG_ 1064 ReSideRdrLe20Obj28RdrObjChks "0x12AF";
BA_ "GenSigFuncType" SG_ 1064 ReSideRdrLe20Obj28RdrObjChks 15;
BA_ "GenSigSendType" SG_ 1064 ReSideRdrLe20Obj28RdrObjChks 0;
BA_ "GenSigFuncType" SG_ 1064 ReSideRdrLe20Obj28RdrObjCntr 16;
BA_ "GenSigSendType" SG_ 1064 ReSideRdrLe20Obj28RdrObjCntr 0;
BA_ "GenSigSendType" SG_ 1064 ReSideRdrLe20Obj28RdrObjCoastCnt 0;
BA_ "GenSigStartValue" SG_ 1064 ReSideRdrLe20Obj28RdrObjCoastCnt 31;
BA_ "GenSigSendType" SG_ 1064 ReSideRdrLe20Obj28RdrObjConf 0;
BA_ "GenSigSendType" SG_ 1064 ReSideRdrLe20Obj28RdrObjDx 0;
BA_ "GenSigSendType" SG_ 1064 ReSideRdrLe20Obj28RdrObjDxStdDe 0;
BA_ "GenSigSendType" SG_ 1064 ReSideRdrLe20Obj28RdrObjDy 0;
BA_ "GenSigStartValue" SG_ 1064 ReSideRdrLe20Obj28RdrObjDy 4000;
BA_ "GenSigSendType" SG_ 1064 ReSideRdrLe20Obj28RdrObjDyStdDe 0;
BA_ "GenSigSendType" SG_ 1064 ReSideRdrLe20Obj28RdrObjElevnConf 0;
BA_ "GenSigSendType" SG_ 1064 ReSideRdrLe20Obj28RdrObjElevnSts 0;
BA_ "GenSigSendType" SG_ 1064 ReSideRdrLe20Obj28RdrObjID 0;
BA_ "GenSigSendType" SG_ 1064 ReSideRdrLe20Obj28RdrObjIsInFreeSpace 0;
BA_ "GenSigStartValue" SG_ 1064 ReSideRdrLe20Obj28RdrObjIsInFreeSpace 1;
BA_ "GenSigSendType" SG_ 1064 ReSideRdrLe20Obj28RdrObjMirrProblty 0;
BA_ "GenSigSendType" SG_ 1064 ReSideRdrLe20Obj28RdrObjMtnPat 0;
BA_ "GenSigStartValue" SG_ 1064 ReSideRdrLe20Obj28RdrObjMtnPat 3;
BA_ "GenSigSendType" SG_ 1064 ReSideRdrLe20Obj28RdrObjNotRealProblty 0;
BA_ "GenSigSendType" SG_ 1064 ReSideRdrLe20Obj28RdrObjStatyCnt 0;
BA_ "GenSigSendType" SG_ 1064 ReSideRdrLe20Obj28RdrObjTiAlv 0;
BA_ "GenSigSendType" SG_ 1064 ReSideRdrLe20Obj28RdrObjTrackSts 0;
BA_ "GenSigSendType" SG_ 1064 ReSideRdrLe20Obj28RdrObjTyp 0;
BA_ "GenSigSendType" SG_ 1064 ReSideRdrLe20Obj28RdrObjTypConfBike 0;
BA_ "GenSigSendType" SG_ 1064 ReSideRdrLe20Obj28RdrObjTypConfPed 0;
BA_ "GenSigSendType" SG_ 1064 ReSideRdrLe20Obj28RdrObjTypConfVeh 0;
BA_ "GenSigSendType" SG_ 1064 ReSideRdrLe20Obj28RdrObjUsedTracker 0;
BA_ "GenSigStartValue" SG_ 1064 ReSideRdrLe20Obj28RdrObjUsedTracker 3;
BA_ "GenSigSendType" SG_ 1064 ReSideRdrLe20Obj28RdrObjVx 0;
BA_ "GenSigStartValue" SG_ 1064 ReSideRdrLe20Obj28RdrObjVx 6400;
BA_ "GenSigSendType" SG_ 1064 ReSideRdrLe20Obj28RdrObjVxStdDe 0;
BA_ "GenSigSendType" SG_ 1064 ReSideRdrLe20Obj28RdrObjVy 0;
BA_ "GenSigStartValue" SG_ 1064 ReSideRdrLe20Obj28RdrObjVy 6400;
BA_ "GenSigSendType" SG_ 1064 ReSideRdrLe20Obj28RdrObjVyStdDe 0;
BA_ "GenSigSendType" SG_ 1064 ReSideRdrLe20Obj28RelVx 0;
BA_ "GenSigStartValue" SG_ 1064 ReSideRdrLe20Obj28RelVx 1780;
BA_ "GenSigSendType" SG_ 1064 ReSideRdrLe20Obj28RelVy 0;
BA_ "GenSigStartValue" SG_ 1064 ReSideRdrLe20Obj28RelVy 1780;
BA_ "GenSigSendType" SG_ 1065 ReSideRdrLe20Obj29Heading 0;
BA_ "GenSigStartValue" SG_ 1065 ReSideRdrLe20Obj29Heading 1800;
BA_ "GenSigSendType" SG_ 1065 ReSideRdrLe20Obj29ObjBoxCenterLat 0;
BA_ "GenSigStartValue" SG_ 1065 ReSideRdrLe20Obj29ObjBoxCenterLat 250;
BA_ "GenSigSendType" SG_ 1065 ReSideRdrLe20Obj29ObjBoxCenterLgt 0;
BA_ "GenSigStartValue" SG_ 1065 ReSideRdrLe20Obj29ObjBoxCenterLgt 250;
BA_ "GenSigSendType" SG_ 1065 ReSideRdrLe20Obj29ObservationHist 0;
BA_ "GenSigSendType" SG_ 1065 ReSideRdrLe20Obj29QualityBits 0;
BA_ "GenSigSendType" SG_ 1065 ReSideRdrLe20Obj29RdrObjAx 0;
BA_ "GenSigSendType" SG_ 1065 ReSideRdrLe20Obj29RdrObjAy 0;
BA_ "GenSigSendType" SG_ 1065 ReSideRdrLe20Obj29RdrObjBoxLength 0;
BA_ "GenSigSendType" SG_ 1065 ReSideRdrLe20Obj29RdrObjBoxWidth 0;
BA_ "GenSigDataID" SG_ 1065 ReSideRdrLe20Obj29RdrObjChks "0x12B0";
BA_ "GenSigFuncType" SG_ 1065 ReSideRdrLe20Obj29RdrObjChks 15;
BA_ "GenSigSendType" SG_ 1065 ReSideRdrLe20Obj29RdrObjChks 0;
BA_ "GenSigFuncType" SG_ 1065 ReSideRdrLe20Obj29RdrObjCntr 16;
BA_ "GenSigSendType" SG_ 1065 ReSideRdrLe20Obj29RdrObjCntr 0;
BA_ "GenSigSendType" SG_ 1065 ReSideRdrLe20Obj29RdrObjCoastCnt 0;
BA_ "GenSigStartValue" SG_ 1065 ReSideRdrLe20Obj29RdrObjCoastCnt 31;
BA_ "GenSigSendType" SG_ 1065 ReSideRdrLe20Obj29RdrObjConf 0;
BA_ "GenSigSendType" SG_ 1065 ReSideRdrLe20Obj29RdrObjDx 0;
BA_ "GenSigSendType" SG_ 1065 ReSideRdrLe20Obj29RdrObjDxStdDe 0;
BA_ "GenSigSendType" SG_ 1065 ReSideRdrLe20Obj29RdrObjDy 0;
BA_ "GenSigStartValue" SG_ 1065 ReSideRdrLe20Obj29RdrObjDy 4000;
BA_ "GenSigSendType" SG_ 1065 ReSideRdrLe20Obj29RdrObjDyStdDe 0;
BA_ "GenSigSendType" SG_ 1065 ReSideRdrLe20Obj29RdrObjElevnConf 0;
BA_ "GenSigSendType" SG_ 1065 ReSideRdrLe20Obj29RdrObjElevnSts 0;
BA_ "GenSigSendType" SG_ 1065 ReSideRdrLe20Obj29RdrObjID 0;
BA_ "GenSigSendType" SG_ 1065 ReSideRdrLe20Obj29RdrObjIsInFreeSpace 0;
BA_ "GenSigStartValue" SG_ 1065 ReSideRdrLe20Obj29RdrObjIsInFreeSpace 1;
BA_ "GenSigSendType" SG_ 1065 ReSideRdrLe20Obj29RdrObjMirrProblty 0;
BA_ "GenSigSendType" SG_ 1065 ReSideRdrLe20Obj29RdrObjMtnPat 0;
BA_ "GenSigStartValue" SG_ 1065 ReSideRdrLe20Obj29RdrObjMtnPat 3;
BA_ "GenSigSendType" SG_ 1065 ReSideRdrLe20Obj29RdrObjNotRealProblty 0;
BA_ "GenSigSendType" SG_ 1065 ReSideRdrLe20Obj29RdrObjStatyCnt 0;
BA_ "GenSigSendType" SG_ 1065 ReSideRdrLe20Obj29RdrObjTiAlv 0;
BA_ "GenSigSendType" SG_ 1065 ReSideRdrLe20Obj29RdrObjTrackSts 0;
BA_ "GenSigSendType" SG_ 1065 ReSideRdrLe20Obj29RdrObjTyp 0;
BA_ "GenSigSendType" SG_ 1065 ReSideRdrLe20Obj29RdrObjTypConfBike 0;
BA_ "GenSigSendType" SG_ 1065 ReSideRdrLe20Obj29RdrObjTypConfPed 0;
BA_ "GenSigSendType" SG_ 1065 ReSideRdrLe20Obj29RdrObjTypConfVeh 0;
BA_ "GenSigSendType" SG_ 1065 ReSideRdrLe20Obj29RdrObjUsedTracker 0;
BA_ "GenSigStartValue" SG_ 1065 ReSideRdrLe20Obj29RdrObjUsedTracker 3;
BA_ "GenSigSendType" SG_ 1065 ReSideRdrLe20Obj29RdrObjVx 0;
BA_ "GenSigStartValue" SG_ 1065 ReSideRdrLe20Obj29RdrObjVx 6400;
BA_ "GenSigSendType" SG_ 1065 ReSideRdrLe20Obj29RdrObjVxStdDe 0;
BA_ "GenSigSendType" SG_ 1065 ReSideRdrLe20Obj29RdrObjVy 0;
BA_ "GenSigStartValue" SG_ 1065 ReSideRdrLe20Obj29RdrObjVy 6400;
BA_ "GenSigSendType" SG_ 1065 ReSideRdrLe20Obj29RdrObjVyStdDe 0;
BA_ "GenSigSendType" SG_ 1065 ReSideRdrLe20Obj29RelVx 0;
BA_ "GenSigStartValue" SG_ 1065 ReSideRdrLe20Obj29RelVx 1780;
BA_ "GenSigSendType" SG_ 1065 ReSideRdrLe20Obj29RelVy 0;
BA_ "GenSigStartValue" SG_ 1065 ReSideRdrLe20Obj29RelVy 1780;
BA_ "GenSigSendType" SG_ 1072 ReSideRdrLe20Obj30Heading 0;
BA_ "GenSigStartValue" SG_ 1072 ReSideRdrLe20Obj30Heading 1800;
BA_ "GenSigSendType" SG_ 1072 ReSideRdrLe20Obj30ObjBoxCenterLat 0;
BA_ "GenSigStartValue" SG_ 1072 ReSideRdrLe20Obj30ObjBoxCenterLat 250;
BA_ "GenSigSendType" SG_ 1072 ReSideRdrLe20Obj30ObjBoxCenterLgt 0;
BA_ "GenSigStartValue" SG_ 1072 ReSideRdrLe20Obj30ObjBoxCenterLgt 250;
BA_ "GenSigSendType" SG_ 1072 ReSideRdrLe20Obj30ObservationHist 0;
BA_ "GenSigSendType" SG_ 1072 ReSideRdrLe20Obj30QualityBits 0;
BA_ "GenSigSendType" SG_ 1072 ReSideRdrLe20Obj30RdrObjAx 0;
BA_ "GenSigSendType" SG_ 1072 ReSideRdrLe20Obj30RdrObjAy 0;
BA_ "GenSigSendType" SG_ 1072 ReSideRdrLe20Obj30RdrObjBoxLength 0;
BA_ "GenSigSendType" SG_ 1072 ReSideRdrLe20Obj30RdrObjBoxWidth 0;
BA_ "GenSigDataID" SG_ 1072 ReSideRdrLe20Obj30RdrObjChks "0x12B1";
BA_ "GenSigFuncType" SG_ 1072 ReSideRdrLe20Obj30RdrObjChks 15;
BA_ "GenSigSendType" SG_ 1072 ReSideRdrLe20Obj30RdrObjChks 0;
BA_ "GenSigFuncType" SG_ 1072 ReSideRdrLe20Obj30RdrObjCntr 16;
BA_ "GenSigSendType" SG_ 1072 ReSideRdrLe20Obj30RdrObjCntr 0;
BA_ "GenSigSendType" SG_ 1072 ReSideRdrLe20Obj30RdrObjCoastCnt 0;
BA_ "GenSigStartValue" SG_ 1072 ReSideRdrLe20Obj30RdrObjCoastCnt 31;
BA_ "GenSigSendType" SG_ 1072 ReSideRdrLe20Obj30RdrObjConf 0;
BA_ "GenSigSendType" SG_ 1072 ReSideRdrLe20Obj30RdrObjDx 0;
BA_ "GenSigSendType" SG_ 1072 ReSideRdrLe20Obj30RdrObjDxStdDe 0;
BA_ "GenSigSendType" SG_ 1072 ReSideRdrLe20Obj30RdrObjDy 0;
BA_ "GenSigStartValue" SG_ 1072 ReSideRdrLe20Obj30RdrObjDy 4000;
BA_ "GenSigSendType" SG_ 1072 ReSideRdrLe20Obj30RdrObjDyStdDe 0;
BA_ "GenSigSendType" SG_ 1072 ReSideRdrLe20Obj30RdrObjElevnConf 0;
BA_ "GenSigSendType" SG_ 1072 ReSideRdrLe20Obj30RdrObjElevnSts 0;
BA_ "GenSigSendType" SG_ 1072 ReSideRdrLe20Obj30RdrObjID 0;
BA_ "GenSigSendType" SG_ 1072 ReSideRdrLe20Obj30RdrObjIsInFreeSpace 0;
BA_ "GenSigStartValue" SG_ 1072 ReSideRdrLe20Obj30RdrObjIsInFreeSpace 1;
BA_ "GenSigSendType" SG_ 1072 ReSideRdrLe20Obj30RdrObjMirrProblty 0;
BA_ "GenSigSendType" SG_ 1072 ReSideRdrLe20Obj30RdrObjMtnPat 0;
BA_ "GenSigStartValue" SG_ 1072 ReSideRdrLe20Obj30RdrObjMtnPat 3;
BA_ "GenSigSendType" SG_ 1072 ReSideRdrLe20Obj30RdrObjNotRealProblty 0;
BA_ "GenSigSendType" SG_ 1072 ReSideRdrLe20Obj30RdrObjStatyCnt 0;
BA_ "GenSigSendType" SG_ 1072 ReSideRdrLe20Obj30RdrObjTiAlv 0;
BA_ "GenSigSendType" SG_ 1072 ReSideRdrLe20Obj30RdrObjTrackSts 0;
BA_ "GenSigSendType" SG_ 1072 ReSideRdrLe20Obj30RdrObjTyp 0;
BA_ "GenSigSendType" SG_ 1072 ReSideRdrLe20Obj30RdrObjTypConfBike 0;
BA_ "GenSigSendType" SG_ 1072 ReSideRdrLe20Obj30RdrObjTypConfPed 0;
BA_ "GenSigSendType" SG_ 1072 ReSideRdrLe20Obj30RdrObjTypConfVeh 0;
BA_ "GenSigSendType" SG_ 1072 ReSideRdrLe20Obj30RdrObjUsedTracker 0;
BA_ "GenSigStartValue" SG_ 1072 ReSideRdrLe20Obj30RdrObjUsedTracker 3;
BA_ "GenSigSendType" SG_ 1072 ReSideRdrLe20Obj30RdrObjVx 0;
BA_ "GenSigStartValue" SG_ 1072 ReSideRdrLe20Obj30RdrObjVx 6400;
BA_ "GenSigSendType" SG_ 1072 ReSideRdrLe20Obj30RdrObjVxStdDe 0;
BA_ "GenSigSendType" SG_ 1072 ReSideRdrLe20Obj30RdrObjVy 0;
BA_ "GenSigStartValue" SG_ 1072 ReSideRdrLe20Obj30RdrObjVy 6400;
BA_ "GenSigSendType" SG_ 1072 ReSideRdrLe20Obj30RdrObjVyStdDe 0;
BA_ "GenSigSendType" SG_ 1072 ReSideRdrLe20Obj30RelVx 0;
BA_ "GenSigStartValue" SG_ 1072 ReSideRdrLe20Obj30RelVx 1780;
BA_ "GenSigSendType" SG_ 1072 ReSideRdrLe20Obj30RelVy 0;
BA_ "GenSigStartValue" SG_ 1072 ReSideRdrLe20Obj30RelVy 1780;
BA_ "GenSigSendType" SG_ 1073 ReSideRdrLe20Obj31Heading 0;
BA_ "GenSigStartValue" SG_ 1073 ReSideRdrLe20Obj31Heading 1800;
BA_ "GenSigSendType" SG_ 1073 ReSideRdrLe20Obj31ObjBoxCenterLat 0;
BA_ "GenSigStartValue" SG_ 1073 ReSideRdrLe20Obj31ObjBoxCenterLat 250;
BA_ "GenSigSendType" SG_ 1073 ReSideRdrLe20Obj31ObjBoxCenterLgt 0;
BA_ "GenSigStartValue" SG_ 1073 ReSideRdrLe20Obj31ObjBoxCenterLgt 250;
BA_ "GenSigSendType" SG_ 1073 ReSideRdrLe20Obj31ObservationHist 0;
BA_ "GenSigSendType" SG_ 1073 ReSideRdrLe20Obj31QualityBits 0;
BA_ "GenSigSendType" SG_ 1073 ReSideRdrLe20Obj31RdrObjAx 0;
BA_ "GenSigSendType" SG_ 1073 ReSideRdrLe20Obj31RdrObjAy 0;
BA_ "GenSigSendType" SG_ 1073 ReSideRdrLe20Obj31RdrObjBoxLength 0;
BA_ "GenSigSendType" SG_ 1073 ReSideRdrLe20Obj31RdrObjBoxWidth 0;
BA_ "GenSigDataID" SG_ 1073 ReSideRdrLe20Obj31RdrObjChks "0x12B2";
BA_ "GenSigFuncType" SG_ 1073 ReSideRdrLe20Obj31RdrObjChks 15;
BA_ "GenSigSendType" SG_ 1073 ReSideRdrLe20Obj31RdrObjChks 0;
BA_ "GenSigFuncType" SG_ 1073 ReSideRdrLe20Obj31RdrObjCntr 16;
BA_ "GenSigSendType" SG_ 1073 ReSideRdrLe20Obj31RdrObjCntr 0;
BA_ "GenSigSendType" SG_ 1073 ReSideRdrLe20Obj31RdrObjCoastCnt 0;
BA_ "GenSigStartValue" SG_ 1073 ReSideRdrLe20Obj31RdrObjCoastCnt 31;
BA_ "GenSigSendType" SG_ 1073 ReSideRdrLe20Obj31RdrObjConf 0;
BA_ "GenSigSendType" SG_ 1073 ReSideRdrLe20Obj31RdrObjDx 0;
BA_ "GenSigSendType" SG_ 1073 ReSideRdrLe20Obj31RdrObjDxStdDe 0;
BA_ "GenSigSendType" SG_ 1073 ReSideRdrLe20Obj31RdrObjDy 0;
BA_ "GenSigStartValue" SG_ 1073 ReSideRdrLe20Obj31RdrObjDy 4000;
BA_ "GenSigSendType" SG_ 1073 ReSideRdrLe20Obj31RdrObjDyStdDe 0;
BA_ "GenSigSendType" SG_ 1073 ReSideRdrLe20Obj31RdrObjElevnConf 0;
BA_ "GenSigSendType" SG_ 1073 ReSideRdrLe20Obj31RdrObjElevnSts 0;
BA_ "GenSigSendType" SG_ 1073 ReSideRdrLe20Obj31RdrObjID 0;
BA_ "GenSigSendType" SG_ 1073 ReSideRdrLe20Obj31RdrObjIsInFreeSpace 0;
BA_ "GenSigStartValue" SG_ 1073 ReSideRdrLe20Obj31RdrObjIsInFreeSpace 1;
BA_ "GenSigSendType" SG_ 1073 ReSideRdrLe20Obj31RdrObjMirrProblty 0;
BA_ "GenSigSendType" SG_ 1073 ReSideRdrLe20Obj31RdrObjMtnPat 0;
BA_ "GenSigStartValue" SG_ 1073 ReSideRdrLe20Obj31RdrObjMtnPat 3;
BA_ "GenSigSendType" SG_ 1073 ReSideRdrLe20Obj31RdrObjNotRealProblty 0;
BA_ "GenSigSendType" SG_ 1073 ReSideRdrLe20Obj31RdrObjStatyCnt 0;
BA_ "GenSigSendType" SG_ 1073 ReSideRdrLe20Obj31RdrObjTiAlv 0;
BA_ "GenSigSendType" SG_ 1073 ReSideRdrLe20Obj31RdrObjTrackSts 0;
BA_ "GenSigSendType" SG_ 1073 ReSideRdrLe20Obj31RdrObjTyp 0;
BA_ "GenSigSendType" SG_ 1073 ReSideRdrLe20Obj31RdrObjTypConfBike 0;
BA_ "GenSigSendType" SG_ 1073 ReSideRdrLe20Obj31RdrObjTypConfPed 0;
BA_ "GenSigSendType" SG_ 1073 ReSideRdrLe20Obj31RdrObjTypConfVeh 0;
BA_ "GenSigSendType" SG_ 1073 ReSideRdrLe20Obj31RdrObjUsedTracker 0;
BA_ "GenSigStartValue" SG_ 1073 ReSideRdrLe20Obj31RdrObjUsedTracker 3;
BA_ "GenSigSendType" SG_ 1073 ReSideRdrLe20Obj31RdrObjVx 0;
BA_ "GenSigStartValue" SG_ 1073 ReSideRdrLe20Obj31RdrObjVx 6400;
BA_ "GenSigSendType" SG_ 1073 ReSideRdrLe20Obj31RdrObjVxStdDe 0;
BA_ "GenSigSendType" SG_ 1073 ReSideRdrLe20Obj31RdrObjVy 0;
BA_ "GenSigStartValue" SG_ 1073 ReSideRdrLe20Obj31RdrObjVy 6400;
BA_ "GenSigSendType" SG_ 1073 ReSideRdrLe20Obj31RdrObjVyStdDe 0;
BA_ "GenSigSendType" SG_ 1073 ReSideRdrLe20Obj31RelVx 0;
BA_ "GenSigStartValue" SG_ 1073 ReSideRdrLe20Obj31RelVx 1780;
BA_ "GenSigSendType" SG_ 1073 ReSideRdrLe20Obj31RelVy 0;
BA_ "GenSigStartValue" SG_ 1073 ReSideRdrLe20Obj31RelVy 1780;
VAL_ 1056 ReSideRdrLe20Obj20RdrObjElevnSts 0 "RdrObjElevnSts_Unknown" 1 "RdrObjElevnSts_OverRidable" 2 "RdrObjElevnSts_Rlv" 3 "RdrObjElevnSts_UnderRidable";
VAL_ 1056 ReSideRdrLe20Obj20RdrObjIsInFreeSpace 0 "YesNo2_No" 1 "YesNo2_Yes";
VAL_ 1056 ReSideRdrLe20Obj20RdrObjMtnPat 0 "RdrObjMtnPat_Ukwn" 1 "RdrObjMtnPat_Staty" 2 "RdrObjMtnPat_StatyFromMovg" 3 "RdrObjMtnPat_Movg" 4 "RdrObjMtnPat_Receding" 5 "RdrObjMtnPat_Oncoming" 6 "RdrObjMtnPat_CrossingFromLe" 7 "RdrObjMtnPat_CrossingFromRi";
VAL_ 1056 ReSideRdrLe20Obj20RdrObjTrackSts 0 "RdrObjTrackSts_Invld" 1 "RdrObjTrackSts_Updated" 2 "RdrObjTrackSts_New" 3 "RdrObjTrackSts_Coasted";
VAL_ 1056 ReSideRdrLe20Obj20RdrObjTyp 0 "RdrObjTyp_Ukwn" 1 "RdrObjTyp_Car" 2 "RdrObjTyp_MotorCycle" 3 "RdrObjTyp_Truck" 4 "RdrObjTyp_Ped" 5 "RdrObjTyp_ObstdVert1" 6 "RdrObjTyp_ObstdVert2" 7 "RdrObjTyp_Anim" 8 "RdrObjTyp_ObjGen" 9 "RdrObjTyp_Bicycle" 10 "RdrObjTyp_VehofUkwnClass" 11 "RdrObjTyp_Reserved";
VAL_ 1056 ReSideRdrLe20Obj20RdrObjUsedTracker 0 "RdrObjUsedTracker_Stationary" 1 "RdrObjUsedTracker_MovingCVModel" 2 "RdrObjUsedTracker_MovingCTModel" 3 "RdrObjUsedTracker_Undefined";
VAL_ 1057 ReSideRdrLe20Obj21RdrObjElevnSts 0 "RdrObjElevnSts_Unknown" 1 "RdrObjElevnSts_OverRidable" 2 "RdrObjElevnSts_Rlv" 3 "RdrObjElevnSts_UnderRidable";
VAL_ 1057 ReSideRdrLe20Obj21RdrObjIsInFreeSpace 0 "YesNo2_No" 1 "YesNo2_Yes";
VAL_ 1057 ReSideRdrLe20Obj21RdrObjMtnPat 0 "RdrObjMtnPat_Ukwn" 1 "RdrObjMtnPat_Staty" 2 "RdrObjMtnPat_StatyFromMovg" 3 "RdrObjMtnPat_Movg" 4 "RdrObjMtnPat_Receding" 5 "RdrObjMtnPat_Oncoming" 6 "RdrObjMtnPat_CrossingFromLe" 7 "RdrObjMtnPat_CrossingFromRi";
VAL_ 1057 ReSideRdrLe20Obj21RdrObjTrackSts 0 "RdrObjTrackSts_Invld" 1 "RdrObjTrackSts_Updated" 2 "RdrObjTrackSts_New" 3 "RdrObjTrackSts_Coasted";
VAL_ 1057 ReSideRdrLe20Obj21RdrObjTyp 0 "RdrObjTyp_Ukwn" 1 "RdrObjTyp_Car" 2 "RdrObjTyp_MotorCycle" 3 "RdrObjTyp_Truck" 4 "RdrObjTyp_Ped" 5 "RdrObjTyp_ObstdVert1" 6 "RdrObjTyp_ObstdVert2" 7 "RdrObjTyp_Anim" 8 "RdrObjTyp_ObjGen" 9 "RdrObjTyp_Bicycle" 10 "RdrObjTyp_VehofUkwnClass" 11 "RdrObjTyp_Reserved";
VAL_ 1057 ReSideRdrLe20Obj21RdrObjUsedTracker 0 "RdrObjUsedTracker_Stationary" 1 "RdrObjUsedTracker_MovingCVModel" 2 "RdrObjUsedTracker_MovingCTModel" 3 "RdrObjUsedTracker_Undefined";
VAL_ 1058 ReSideRdrLe20Obj22RdrObjElevnSts 0 "RdrObjElevnSts_Unknown" 1 "RdrObjElevnSts_OverRidable" 2 "RdrObjElevnSts_Rlv" 3 "RdrObjElevnSts_UnderRidable";
VAL_ 1058 ReSideRdrLe20Obj22RdrObjIsInFreeSpace 0 "YesNo2_No" 1 "YesNo2_Yes";
VAL_ 1058 ReSideRdrLe20Obj22RdrObjMtnPat 0 "RdrObjMtnPat_Ukwn" 1 "RdrObjMtnPat_Staty" 2 "RdrObjMtnPat_StatyFromMovg" 3 "RdrObjMtnPat_Movg" 4 "RdrObjMtnPat_Receding" 5 "RdrObjMtnPat_Oncoming" 6 "RdrObjMtnPat_CrossingFromLe" 7 "RdrObjMtnPat_CrossingFromRi";
VAL_ 1058 ReSideRdrLe20Obj22RdrObjTrackSts 0 "RdrObjTrackSts_Invld" 1 "RdrObjTrackSts_Updated" 2 "RdrObjTrackSts_New" 3 "RdrObjTrackSts_Coasted";
VAL_ 1058 ReSideRdrLe20Obj22RdrObjTyp 0 "RdrObjTyp_Ukwn" 1 "RdrObjTyp_Car" 2 "RdrObjTyp_MotorCycle" 3 "RdrObjTyp_Truck" 4 "RdrObjTyp_Ped" 5 "RdrObjTyp_ObstdVert1" 6 "RdrObjTyp_ObstdVert2" 7 "RdrObjTyp_Anim" 8 "RdrObjTyp_ObjGen" 9 "RdrObjTyp_Bicycle" 10 "RdrObjTyp_VehofUkwnClass" 11 "RdrObjTyp_Reserved";
VAL_ 1058 ReSideRdrLe20Obj22RdrObjUsedTracker 0 "RdrObjUsedTracker_Stationary" 1 "RdrObjUsedTracker_MovingCVModel" 2 "RdrObjUsedTracker_MovingCTModel" 3 "RdrObjUsedTracker_Undefined";
VAL_ 1059 ReSideRdrLe20Obj23RdrObjElevnSts 0 "RdrObjElevnSts_Unknown" 1 "RdrObjElevnSts_OverRidable" 2 "RdrObjElevnSts_Rlv" 3 "RdrObjElevnSts_UnderRidable";
VAL_ 1059 ReSideRdrLe20Obj23RdrObjIsInFreeSpace 0 "YesNo2_No" 1 "YesNo2_Yes";
VAL_ 1059 ReSideRdrLe20Obj23RdrObjMtnPat 0 "RdrObjMtnPat_Ukwn" 1 "RdrObjMtnPat_Staty" 2 "RdrObjMtnPat_StatyFromMovg" 3 "RdrObjMtnPat_Movg" 4 "RdrObjMtnPat_Receding" 5 "RdrObjMtnPat_Oncoming" 6 "RdrObjMtnPat_CrossingFromLe" 7 "RdrObjMtnPat_CrossingFromRi";
VAL_ 1059 ReSideRdrLe20Obj23RdrObjTrackSts 0 "RdrObjTrackSts_Invld" 1 "RdrObjTrackSts_Updated" 2 "RdrObjTrackSts_New" 3 "RdrObjTrackSts_Coasted";
VAL_ 1059 ReSideRdrLe20Obj23RdrObjTyp 0 "RdrObjTyp_Ukwn" 1 "RdrObjTyp_Car" 2 "RdrObjTyp_MotorCycle" 3 "RdrObjTyp_Truck" 4 "RdrObjTyp_Ped" 5 "RdrObjTyp_ObstdVert1" 6 "RdrObjTyp_ObstdVert2" 7 "RdrObjTyp_Anim" 8 "RdrObjTyp_ObjGen" 9 "RdrObjTyp_Bicycle" 10 "RdrObjTyp_VehofUkwnClass" 11 "RdrObjTyp_Reserved";
VAL_ 1059 ReSideRdrLe20Obj23RdrObjUsedTracker 0 "RdrObjUsedTracker_Stationary" 1 "RdrObjUsedTracker_MovingCVModel" 2 "RdrObjUsedTracker_MovingCTModel" 3 "RdrObjUsedTracker_Undefined";
VAL_ 1060 ReSideRdrLe20Obj24RdrObjElevnSts 0 "RdrObjElevnSts_Unknown" 1 "RdrObjElevnSts_OverRidable" 2 "RdrObjElevnSts_Rlv" 3 "RdrObjElevnSts_UnderRidable";
VAL_ 1060 ReSideRdrLe20Obj24RdrObjIsInFreeSpace 0 "YesNo2_No" 1 "YesNo2_Yes";
VAL_ 1060 ReSideRdrLe20Obj24RdrObjMtnPat 0 "RdrObjMtnPat_Ukwn" 1 "RdrObjMtnPat_Staty" 2 "RdrObjMtnPat_StatyFromMovg" 3 "RdrObjMtnPat_Movg" 4 "RdrObjMtnPat_Receding" 5 "RdrObjMtnPat_Oncoming" 6 "RdrObjMtnPat_CrossingFromLe" 7 "RdrObjMtnPat_CrossingFromRi";
VAL_ 1060 ReSideRdrLe20Obj24RdrObjTrackSts 0 "RdrObjTrackSts_Invld" 1 "RdrObjTrackSts_Updated" 2 "RdrObjTrackSts_New" 3 "RdrObjTrackSts_Coasted";
VAL_ 1060 ReSideRdrLe20Obj24RdrObjTyp 0 "RdrObjTyp_Ukwn" 1 "RdrObjTyp_Car" 2 "RdrObjTyp_MotorCycle" 3 "RdrObjTyp_Truck" 4 "RdrObjTyp_Ped" 5 "RdrObjTyp_ObstdVert1" 6 "RdrObjTyp_ObstdVert2" 7 "RdrObjTyp_Anim" 8 "RdrObjTyp_ObjGen" 9 "RdrObjTyp_Bicycle" 10 "RdrObjTyp_VehofUkwnClass" 11 "RdrObjTyp_Reserved";
VAL_ 1060 ReSideRdrLe20Obj24RdrObjUsedTracker 0 "RdrObjUsedTracker_Stationary" 1 "RdrObjUsedTracker_MovingCVModel" 2 "RdrObjUsedTracker_MovingCTModel" 3 "RdrObjUsedTracker_Undefined";
VAL_ 1061 ReSideRdrLe20Obj25RdrObjElevnSts 0 "RdrObjElevnSts_Unknown" 1 "RdrObjElevnSts_OverRidable" 2 "RdrObjElevnSts_Rlv" 3 "RdrObjElevnSts_UnderRidable";
VAL_ 1061 ReSideRdrLe20Obj25RdrObjIsInFreeSpace 0 "YesNo2_No" 1 "YesNo2_Yes";
VAL_ 1061 ReSideRdrLe20Obj25RdrObjMtnPat 0 "RdrObjMtnPat_Ukwn" 1 "RdrObjMtnPat_Staty" 2 "RdrObjMtnPat_StatyFromMovg" 3 "RdrObjMtnPat_Movg" 4 "RdrObjMtnPat_Receding" 5 "RdrObjMtnPat_Oncoming" 6 "RdrObjMtnPat_CrossingFromLe" 7 "RdrObjMtnPat_CrossingFromRi";
VAL_ 1061 ReSideRdrLe20Obj25RdrObjTrackSts 0 "RdrObjTrackSts_Invld" 1 "RdrObjTrackSts_Updated" 2 "RdrObjTrackSts_New" 3 "RdrObjTrackSts_Coasted";
VAL_ 1061 ReSideRdrLe20Obj25RdrObjTyp 0 "RdrObjTyp_Ukwn" 1 "RdrObjTyp_Car" 2 "RdrObjTyp_MotorCycle" 3 "RdrObjTyp_Truck" 4 "RdrObjTyp_Ped" 5 "RdrObjTyp_ObstdVert1" 6 "RdrObjTyp_ObstdVert2" 7 "RdrObjTyp_Anim" 8 "RdrObjTyp_ObjGen" 9 "RdrObjTyp_Bicycle" 10 "RdrObjTyp_VehofUkwnClass" 11 "RdrObjTyp_Reserved";
VAL_ 1061 ReSideRdrLe20Obj25RdrObjUsedTracker 0 "RdrObjUsedTracker_Stationary" 1 "RdrObjUsedTracker_MovingCVModel" 2 "RdrObjUsedTracker_MovingCTModel" 3 "RdrObjUsedTracker_Undefined";
VAL_ 1062 ReSideRdrLe20Obj26RdrObjElevnSts 0 "RdrObjElevnSts_Unknown" 1 "RdrObjElevnSts_OverRidable" 2 "RdrObjElevnSts_Rlv" 3 "RdrObjElevnSts_UnderRidable";
VAL_ 1062 ReSideRdrLe20Obj26RdrObjIsInFreeSpace 0 "YesNo2_No" 1 "YesNo2_Yes";
VAL_ 1062 ReSideRdrLe20Obj26RdrObjMtnPat 0 "RdrObjMtnPat_Ukwn" 1 "RdrObjMtnPat_Staty" 2 "RdrObjMtnPat_StatyFromMovg" 3 "RdrObjMtnPat_Movg" 4 "RdrObjMtnPat_Receding" 5 "RdrObjMtnPat_Oncoming" 6 "RdrObjMtnPat_CrossingFromLe" 7 "RdrObjMtnPat_CrossingFromRi";
VAL_ 1062 ReSideRdrLe20Obj26RdrObjTrackSts 0 "RdrObjTrackSts_Invld" 1 "RdrObjTrackSts_Updated" 2 "RdrObjTrackSts_New" 3 "RdrObjTrackSts_Coasted";
VAL_ 1062 ReSideRdrLe20Obj26RdrObjTyp 0 "RdrObjTyp_Ukwn" 1 "RdrObjTyp_Car" 2 "RdrObjTyp_MotorCycle" 3 "RdrObjTyp_Truck" 4 "RdrObjTyp_Ped" 5 "RdrObjTyp_ObstdVert1" 6 "RdrObjTyp_ObstdVert2" 7 "RdrObjTyp_Anim" 8 "RdrObjTyp_ObjGen" 9 "RdrObjTyp_Bicycle" 10 "RdrObjTyp_VehofUkwnClass" 11 "RdrObjTyp_Reserved";
VAL_ 1062 ReSideRdrLe20Obj26RdrObjUsedTracker 0 "RdrObjUsedTracker_Stationary" 1 "RdrObjUsedTracker_MovingCVModel" 2 "RdrObjUsedTracker_MovingCTModel" 3 "RdrObjUsedTracker_Undefined";
VAL_ 1063 ReSideRdrLe20Obj27RdrObjElevnSts 0 "RdrObjElevnSts_Unknown" 1 "RdrObjElevnSts_OverRidable" 2 "RdrObjElevnSts_Rlv" 3 "RdrObjElevnSts_UnderRidable";
VAL_ 1063 ReSideRdrLe20Obj27RdrObjIsInFreeSpace 0 "YesNo2_No" 1 "YesNo2_Yes";
VAL_ 1063 ReSideRdrLe20Obj27RdrObjMtnPat 0 "RdrObjMtnPat_Ukwn" 1 "RdrObjMtnPat_Staty" 2 "RdrObjMtnPat_StatyFromMovg" 3 "RdrObjMtnPat_Movg" 4 "RdrObjMtnPat_Receding" 5 "RdrObjMtnPat_Oncoming" 6 "RdrObjMtnPat_CrossingFromLe" 7 "RdrObjMtnPat_CrossingFromRi";
VAL_ 1063 ReSideRdrLe20Obj27RdrObjTrackSts 0 "RdrObjTrackSts_Invld" 1 "RdrObjTrackSts_Updated" 2 "RdrObjTrackSts_New" 3 "RdrObjTrackSts_Coasted";
VAL_ 1063 ReSideRdrLe20Obj27RdrObjTyp 0 "RdrObjTyp_Ukwn" 1 "RdrObjTyp_Car" 2 "RdrObjTyp_MotorCycle" 3 "RdrObjTyp_Truck" 4 "RdrObjTyp_Ped" 5 "RdrObjTyp_ObstdVert1" 6 "RdrObjTyp_ObstdVert2" 7 "RdrObjTyp_Anim" 8 "RdrObjTyp_ObjGen" 9 "RdrObjTyp_Bicycle" 10 "RdrObjTyp_VehofUkwnClass" 11 "RdrObjTyp_Reserved";
VAL_ 1063 ReSideRdrLe20Obj27RdrObjUsedTracker 0 "RdrObjUsedTracker_Stationary" 1 "RdrObjUsedTracker_MovingCVModel" 2 "RdrObjUsedTracker_MovingCTModel" 3 "RdrObjUsedTracker_Undefined";
VAL_ 1064 ReSideRdrLe20Obj28RdrObjElevnSts 0 "RdrObjElevnSts_Unknown" 1 "RdrObjElevnSts_OverRidable" 2 "RdrObjElevnSts_Rlv" 3 "RdrObjElevnSts_UnderRidable";
VAL_ 1064 ReSideRdrLe20Obj28RdrObjIsInFreeSpace 0 "YesNo2_No" 1 "YesNo2_Yes";
VAL_ 1064 ReSideRdrLe20Obj28RdrObjMtnPat 0 "RdrObjMtnPat_Ukwn" 1 "RdrObjMtnPat_Staty" 2 "RdrObjMtnPat_StatyFromMovg" 3 "RdrObjMtnPat_Movg" 4 "RdrObjMtnPat_Receding" 5 "RdrObjMtnPat_Oncoming" 6 "RdrObjMtnPat_CrossingFromLe" 7 "RdrObjMtnPat_CrossingFromRi";
VAL_ 1064 ReSideRdrLe20Obj28RdrObjTrackSts 0 "RdrObjTrackSts_Invld" 1 "RdrObjTrackSts_Updated" 2 "RdrObjTrackSts_New" 3 "RdrObjTrackSts_Coasted";
VAL_ 1064 ReSideRdrLe20Obj28RdrObjTyp 0 "RdrObjTyp_Ukwn" 1 "RdrObjTyp_Car" 2 "RdrObjTyp_MotorCycle" 3 "RdrObjTyp_Truck" 4 "RdrObjTyp_Ped" 5 "RdrObjTyp_ObstdVert1" 6 "RdrObjTyp_ObstdVert2" 7 "RdrObjTyp_Anim" 8 "RdrObjTyp_ObjGen" 9 "RdrObjTyp_Bicycle" 10 "RdrObjTyp_VehofUkwnClass" 11 "RdrObjTyp_Reserved";
VAL_ 1064 ReSideRdrLe20Obj28RdrObjUsedTracker 0 "RdrObjUsedTracker_Stationary" 1 "RdrObjUsedTracker_MovingCVModel" 2 "RdrObjUsedTracker_MovingCTModel" 3 "RdrObjUsedTracker_Undefined";
VAL_ 1065 ReSideRdrLe20Obj29RdrObjElevnSts 0 "RdrObjElevnSts_Unknown" 1 "RdrObjElevnSts_OverRidable" 2 "RdrObjElevnSts_Rlv" 3 "RdrObjElevnSts_UnderRidable";
VAL_ 1065 ReSideRdrLe20Obj29RdrObjIsInFreeSpace 0 "YesNo2_No" 1 "YesNo2_Yes";
VAL_ 1065 ReSideRdrLe20Obj29RdrObjMtnPat 0 "RdrObjMtnPat_Ukwn" 1 "RdrObjMtnPat_Staty" 2 "RdrObjMtnPat_StatyFromMovg" 3 "RdrObjMtnPat_Movg" 4 "RdrObjMtnPat_Receding" 5 "RdrObjMtnPat_Oncoming" 6 "RdrObjMtnPat_CrossingFromLe" 7 "RdrObjMtnPat_CrossingFromRi";
VAL_ 1065 ReSideRdrLe20Obj29RdrObjTrackSts 0 "RdrObjTrackSts_Invld" 1 "RdrObjTrackSts_Updated" 2 "RdrObjTrackSts_New" 3 "RdrObjTrackSts_Coasted";
VAL_ 1065 ReSideRdrLe20Obj29RdrObjTyp 0 "RdrObjTyp_Ukwn" 1 "RdrObjTyp_Car" 2 "RdrObjTyp_MotorCycle" 3 "RdrObjTyp_Truck" 4 "RdrObjTyp_Ped" 5 "RdrObjTyp_ObstdVert1" 6 "RdrObjTyp_ObstdVert2" 7 "RdrObjTyp_Anim" 8 "RdrObjTyp_ObjGen" 9 "RdrObjTyp_Bicycle" 10 "RdrObjTyp_VehofUkwnClass" 11 "RdrObjTyp_Reserved";
VAL_ 1065 ReSideRdrLe20Obj29RdrObjUsedTracker 0 "RdrObjUsedTracker_Stationary" 1 "RdrObjUsedTracker_MovingCVModel" 2 "RdrObjUsedTracker_MovingCTModel" 3 "RdrObjUsedTracker_Undefined";
VAL_ 1072 ReSideRdrLe20Obj30RdrObjElevnSts 0 "RdrObjElevnSts_Unknown" 1 "RdrObjElevnSts_OverRidable" 2 "RdrObjElevnSts_Rlv" 3 "RdrObjElevnSts_UnderRidable";
VAL_ 1072 ReSideRdrLe20Obj30RdrObjIsInFreeSpace 0 "YesNo2_No" 1 "YesNo2_Yes";
VAL_ 1072 ReSideRdrLe20Obj30RdrObjMtnPat 0 "RdrObjMtnPat_Ukwn" 1 "RdrObjMtnPat_Staty" 2 "RdrObjMtnPat_StatyFromMovg" 3 "RdrObjMtnPat_Movg" 4 "RdrObjMtnPat_Receding" 5 "RdrObjMtnPat_Oncoming" 6 "RdrObjMtnPat_CrossingFromLe" 7 "RdrObjMtnPat_CrossingFromRi";
VAL_ 1072 ReSideRdrLe20Obj30RdrObjTrackSts 0 "RdrObjTrackSts_Invld" 1 "RdrObjTrackSts_Updated" 2 "RdrObjTrackSts_New" 3 "RdrObjTrackSts_Coasted";
VAL_ 1072 ReSideRdrLe20Obj30RdrObjTyp 0 "RdrObjTyp_Ukwn" 1 "RdrObjTyp_Car" 2 "RdrObjTyp_MotorCycle" 3 "RdrObjTyp_Truck" 4 "RdrObjTyp_Ped" 5 "RdrObjTyp_ObstdVert1" 6 "RdrObjTyp_ObstdVert2" 7 "RdrObjTyp_Anim" 8 "RdrObjTyp_ObjGen" 9 "RdrObjTyp_Bicycle" 10 "RdrObjTyp_VehofUkwnClass" 11 "RdrObjTyp_Reserved";
VAL_ 1072 ReSideRdrLe20Obj30RdrObjUsedTracker 0 "RdrObjUsedTracker_Stationary" 1 "RdrObjUsedTracker_MovingCVModel" 2 "RdrObjUsedTracker_MovingCTModel" 3 "RdrObjUsedTracker_Undefined";
VAL_ 1073 ReSideRdrLe20Obj31RdrObjElevnSts 0 "RdrObjElevnSts_Unknown" 1 "RdrObjElevnSts_OverRidable" 2 "RdrObjElevnSts_Rlv" 3 "RdrObjElevnSts_UnderRidable";
VAL_ 1073 ReSideRdrLe20Obj31RdrObjIsInFreeSpace 0 "YesNo2_No" 1 "YesNo2_Yes";
VAL_ 1073 ReSideRdrLe20Obj31RdrObjMtnPat 0 "RdrObjMtnPat_Ukwn" 1 "RdrObjMtnPat_Staty" 2 "RdrObjMtnPat_StatyFromMovg" 3 "RdrObjMtnPat_Movg" 4 "RdrObjMtnPat_Receding" 5 "RdrObjMtnPat_Oncoming" 6 "RdrObjMtnPat_CrossingFromLe" 7 "RdrObjMtnPat_CrossingFromRi";
VAL_ 1073 ReSideRdrLe20Obj31RdrObjTrackSts 0 "RdrObjTrackSts_Invld" 1 "RdrObjTrackSts_Updated" 2 "RdrObjTrackSts_New" 3 "RdrObjTrackSts_Coasted";
VAL_ 1073 ReSideRdrLe20Obj31RdrObjTyp 0 "RdrObjTyp_Ukwn" 1 "RdrObjTyp_Car" 2 "RdrObjTyp_MotorCycle" 3 "RdrObjTyp_Truck" 4 "RdrObjTyp_Ped" 5 "RdrObjTyp_ObstdVert1" 6 "RdrObjTyp_ObstdVert2" 7 "RdrObjTyp_Anim" 8 "RdrObjTyp_ObjGen" 9 "RdrObjTyp_Bicycle" 10 "RdrObjTyp_VehofUkwnClass" 11 "RdrObjTyp_Reserved";
VAL_ 1073 ReSideRdrLe20Obj31RdrObjUsedTracker 0 "RdrObjUsedTracker_Stationary" 1 "RdrObjUsedTracker_MovingCVModel" 2 "RdrObjUsedTracker_MovingCTModel" 3 "RdrObjUsedTracker_Undefined";
SIG_GROUP_ 1056 ReSideRdrLe20Obj20 1 : ReSideRdrLe20Obj20Heading ReSideRdrLe20Obj20ObjBoxCenterLat ReSideRdrLe20Obj20ObjBoxCenterLgt ReSideRdrLe20Obj20ObservationHist ReSideRdrLe20Obj20QualityBits ReSideRdrLe20Obj20RdrObjAx ReSideRdrLe20Obj20RdrObjAy ReSideRdrLe20Obj20RdrObjBoxLength ReSideRdrLe20Obj20RdrObjBoxWidth ReSideRdrLe20Obj20RdrObjChks ReSideRdrLe20Obj20RdrObjCntr ReSideRdrLe20Obj20RdrObjCoastCnt ReSideRdrLe20Obj20RdrObjConf ReSideRdrLe20Obj20RdrObjDx ReSideRdrLe20Obj20RdrObjDxStdDe ReSideRdrLe20Obj20RdrObjDy ReSideRdrLe20Obj20RdrObjDyStdDe ReSideRdrLe20Obj20RdrObjElevnConf ReSideRdrLe20Obj20RdrObjElevnSts ReSideRdrLe20Obj20RdrObjID ReSideRdrLe20Obj20RdrObjIsInFreeSpace ReSideRdrLe20Obj20RdrObjMirrProblty ReSideRdrLe20Obj20RdrObjMtnPat ReSideRdrLe20Obj20RdrObjNotRealProblty ReSideRdrLe20Obj20RdrObjStatyCnt ReSideRdrLe20Obj20RdrObjTiAlv ReSideRdrLe20Obj20RdrObjTrackSts ReSideRdrLe20Obj20RdrObjTyp ReSideRdrLe20Obj20RdrObjTypConfBike ReSideRdrLe20Obj20RdrObjTypConfPed ReSideRdrLe20Obj20RdrObjTypConfVeh ReSideRdrLe20Obj20RdrObjUsedTracker ReSideRdrLe20Obj20RdrObjVx ReSideRdrLe20Obj20RdrObjVxStdDe ReSideRdrLe20Obj20RdrObjVy ReSideRdrLe20Obj20RdrObjVyStdDe ReSideRdrLe20Obj20RelVx ReSideRdrLe20Obj20RelVy;
SIG_GROUP_ 1057 ReSideRdrLe20Obj21 1 : ReSideRdrLe20Obj21Heading ReSideRdrLe20Obj21ObjBoxCenterLat ReSideRdrLe20Obj21ObjBoxCenterLgt ReSideRdrLe20Obj21ObservationHist ReSideRdrLe20Obj21QualityBits ReSideRdrLe20Obj21RdrObjAx ReSideRdrLe20Obj21RdrObjAy ReSideRdrLe20Obj21RdrObjBoxLength ReSideRdrLe20Obj21RdrObjBoxWidth ReSideRdrLe20Obj21RdrObjChks ReSideRdrLe20Obj21RdrObjCntr ReSideRdrLe20Obj21RdrObjCoastCnt ReSideRdrLe20Obj21RdrObjConf ReSideRdrLe20Obj21RdrObjDx ReSideRdrLe20Obj21RdrObjDxStdDe ReSideRdrLe20Obj21RdrObjDy ReSideRdrLe20Obj21RdrObjDyStdDe ReSideRdrLe20Obj21RdrObjElevnConf ReSideRdrLe20Obj21RdrObjElevnSts ReSideRdrLe20Obj21RdrObjID ReSideRdrLe20Obj21RdrObjIsInFreeSpace ReSideRdrLe20Obj21RdrObjMirrProblty ReSideRdrLe20Obj21RdrObjMtnPat ReSideRdrLe20Obj21RdrObjNotRealProblty ReSideRdrLe20Obj21RdrObjStatyCnt ReSideRdrLe20Obj21RdrObjTiAlv ReSideRdrLe20Obj21RdrObjTrackSts ReSideRdrLe20Obj21RdrObjTyp ReSideRdrLe20Obj21RdrObjTypConfBike ReSideRdrLe20Obj21RdrObjTypConfPed ReSideRdrLe20Obj21RdrObjTypConfVeh ReSideRdrLe20Obj21RdrObjUsedTracker ReSideRdrLe20Obj21RdrObjVx ReSideRdrLe20Obj21RdrObjVxStdDe ReSideRdrLe20Obj21RdrObjVy ReSideRdrLe20Obj21RdrObjVyStdDe ReSideRdrLe20Obj21RelVx ReSideRdrLe20Obj21RelVy;
SIG_GROUP_ 1058 ReSideRdrLe20Obj22 1 : ReSideRdrLe20Obj22Heading ReSideRdrLe20Obj22ObjBoxCenterLat ReSideRdrLe20Obj22ObjBoxCenterLgt ReSideRdrLe20Obj22ObservationHist ReSideRdrLe20Obj22QualityBits ReSideRdrLe20Obj22RdrObjAx ReSideRdrLe20Obj22RdrObjAy ReSideRdrLe20Obj22RdrObjBoxLength ReSideRdrLe20Obj22RdrObjBoxWidth ReSideRdrLe20Obj22RdrObjChks ReSideRdrLe20Obj22RdrObjCntr ReSideRdrLe20Obj22RdrObjCoastCnt ReSideRdrLe20Obj22RdrObjConf ReSideRdrLe20Obj22RdrObjDx ReSideRdrLe20Obj22RdrObjDxStdDe ReSideRdrLe20Obj22RdrObjDy ReSideRdrLe20Obj22RdrObjDyStdDe ReSideRdrLe20Obj22RdrObjElevnConf ReSideRdrLe20Obj22RdrObjElevnSts ReSideRdrLe20Obj22RdrObjID ReSideRdrLe20Obj22RdrObjIsInFreeSpace ReSideRdrLe20Obj22RdrObjMirrProblty ReSideRdrLe20Obj22RdrObjMtnPat ReSideRdrLe20Obj22RdrObjNotRealProblty ReSideRdrLe20Obj22RdrObjStatyCnt ReSideRdrLe20Obj22RdrObjTiAlv ReSideRdrLe20Obj22RdrObjTrackSts ReSideRdrLe20Obj22RdrObjTyp ReSideRdrLe20Obj22RdrObjTypConfBike ReSideRdrLe20Obj22RdrObjTypConfPed ReSideRdrLe20Obj22RdrObjTypConfVeh ReSideRdrLe20Obj22RdrObjUsedTracker ReSideRdrLe20Obj22RdrObjVx ReSideRdrLe20Obj22RdrObjVxStdDe ReSideRdrLe20Obj22RdrObjVy ReSideRdrLe20Obj22RdrObjVyStdDe ReSideRdrLe20Obj22RelVx ReSideRdrLe20Obj22RelVy;
SIG_GROUP_ 1059 ReSideRdrLe20Obj23 1 : ReSideRdrLe20Obj23Heading ReSideRdrLe20Obj23ObjBoxCenterLat ReSideRdrLe20Obj23ObjBoxCenterLgt ReSideRdrLe20Obj23ObservationHist ReSideRdrLe20Obj23QualityBits ReSideRdrLe20Obj23RdrObjAx ReSideRdrLe20Obj23RdrObjAy ReSideRdrLe20Obj23RdrObjBoxLength ReSideRdrLe20Obj23RdrObjBoxWidth ReSideRdrLe20Obj23RdrObjChks ReSideRdrLe20Obj23RdrObjCntr ReSideRdrLe20Obj23RdrObjCoastCnt ReSideRdrLe20Obj23RdrObjConf ReSideRdrLe20Obj23RdrObjDx ReSideRdrLe20Obj23RdrObjDxStdDe ReSideRdrLe20Obj23RdrObjDy ReSideRdrLe20Obj23RdrObjDyStdDe ReSideRdrLe20Obj23RdrObjElevnConf ReSideRdrLe20Obj23RdrObjElevnSts ReSideRdrLe20Obj23RdrObjID ReSideRdrLe20Obj23RdrObjIsInFreeSpace ReSideRdrLe20Obj23RdrObjMirrProblty ReSideRdrLe20Obj23RdrObjMtnPat ReSideRdrLe20Obj23RdrObjNotRealProblty ReSideRdrLe20Obj23RdrObjStatyCnt ReSideRdrLe20Obj23RdrObjTiAlv ReSideRdrLe20Obj23RdrObjTrackSts ReSideRdrLe20Obj23RdrObjTyp ReSideRdrLe20Obj23RdrObjTypConfBike ReSideRdrLe20Obj23RdrObjTypConfPed ReSideRdrLe20Obj23RdrObjTypConfVeh ReSideRdrLe20Obj23RdrObjUsedTracker ReSideRdrLe20Obj23RdrObjVx ReSideRdrLe20Obj23RdrObjVxStdDe ReSideRdrLe20Obj23RdrObjVy ReSideRdrLe20Obj23RdrObjVyStdDe ReSideRdrLe20Obj23RelVx ReSideRdrLe20Obj23RelVy;
SIG_GROUP_ 1060 ReSideRdrLe20Obj24 1 : ReSideRdrLe20Obj24Heading ReSideRdrLe20Obj24ObjBoxCenterLat ReSideRdrLe20Obj24ObjBoxCenterLgt ReSideRdrLe20Obj24ObservationHist ReSideRdrLe20Obj24QualityBits ReSideRdrLe20Obj24RdrObjAx ReSideRdrLe20Obj24RdrObjAy ReSideRdrLe20Obj24RdrObjBoxLength ReSideRdrLe20Obj24RdrObjBoxWidth ReSideRdrLe20Obj24RdrObjChks ReSideRdrLe20Obj24RdrObjCntr ReSideRdrLe20Obj24RdrObjCoastCnt ReSideRdrLe20Obj24RdrObjConf ReSideRdrLe20Obj24RdrObjDx ReSideRdrLe20Obj24RdrObjDxStdDe ReSideRdrLe20Obj24RdrObjDy ReSideRdrLe20Obj24RdrObjDyStdDe ReSideRdrLe20Obj24RdrObjElevnConf ReSideRdrLe20Obj24RdrObjElevnSts ReSideRdrLe20Obj24RdrObjID ReSideRdrLe20Obj24RdrObjIsInFreeSpace ReSideRdrLe20Obj24RdrObjMirrProblty ReSideRdrLe20Obj24RdrObjMtnPat ReSideRdrLe20Obj24RdrObjNotRealProblty ReSideRdrLe20Obj24RdrObjStatyCnt ReSideRdrLe20Obj24RdrObjTiAlv ReSideRdrLe20Obj24RdrObjTrackSts ReSideRdrLe20Obj24RdrObjTyp ReSideRdrLe20Obj24RdrObjTypConfBike ReSideRdrLe20Obj24RdrObjTypConfPed ReSideRdrLe20Obj24RdrObjTypConfVeh ReSideRdrLe20Obj24RdrObjUsedTracker ReSideRdrLe20Obj24RdrObjVx ReSideRdrLe20Obj24RdrObjVxStdDe ReSideRdrLe20Obj24RdrObjVy ReSideRdrLe20Obj24RdrObjVyStdDe ReSideRdrLe20Obj24RelVx ReSideRdrLe20Obj24RelVy;
SIG_GROUP_ 1061 ReSideRdrLe20Obj25 1 : ReSideRdrLe20Obj25Heading ReSideRdrLe20Obj25ObjBoxCenterLat ReSideRdrLe20Obj25ObjBoxCenterLgt ReSideRdrLe20Obj25ObservationHist ReSideRdrLe20Obj25QualityBits ReSideRdrLe20Obj25RdrObjAx ReSideRdrLe20Obj25RdrObjAy ReSideRdrLe20Obj25RdrObjBoxLength ReSideRdrLe20Obj25RdrObjBoxWidth ReSideRdrLe20Obj25RdrObjChks ReSideRdrLe20Obj25RdrObjCntr ReSideRdrLe20Obj25RdrObjCoastCnt ReSideRdrLe20Obj25RdrObjConf ReSideRdrLe20Obj25RdrObjDx ReSideRdrLe20Obj25RdrObjDxStdDe ReSideRdrLe20Obj25RdrObjDy ReSideRdrLe20Obj25RdrObjDyStdDe ReSideRdrLe20Obj25RdrObjElevnConf ReSideRdrLe20Obj25RdrObjElevnSts ReSideRdrLe20Obj25RdrObjID ReSideRdrLe20Obj25RdrObjIsInFreeSpace ReSideRdrLe20Obj25RdrObjMirrProblty ReSideRdrLe20Obj25RdrObjMtnPat ReSideRdrLe20Obj25RdrObjNotRealProblty ReSideRdrLe20Obj25RdrObjStatyCnt ReSideRdrLe20Obj25RdrObjTiAlv ReSideRdrLe20Obj25RdrObjTrackSts ReSideRdrLe20Obj25RdrObjTyp ReSideRdrLe20Obj25RdrObjTypConfBike ReSideRdrLe20Obj25RdrObjTypConfPed ReSideRdrLe20Obj25RdrObjTypConfVeh ReSideRdrLe20Obj25RdrObjUsedTracker ReSideRdrLe20Obj25RdrObjVx ReSideRdrLe20Obj25RdrObjVxStdDe ReSideRdrLe20Obj25RdrObjVy ReSideRdrLe20Obj25RdrObjVyStdDe ReSideRdrLe20Obj25RelVx ReSideRdrLe20Obj25RelVy;
SIG_GROUP_ 1062 ReSideRdrLe20Obj26 1 : ReSideRdrLe20Obj26Heading ReSideRdrLe20Obj26ObjBoxCenterLat ReSideRdrLe20Obj26ObjBoxCenterLgt ReSideRdrLe20Obj26ObservationHist ReSideRdrLe20Obj26QualityBits ReSideRdrLe20Obj26RdrObjAx ReSideRdrLe20Obj26RdrObjAy ReSideRdrLe20Obj26RdrObjBoxLength ReSideRdrLe20Obj26RdrObjBoxWidth ReSideRdrLe20Obj26RdrObjChks ReSideRdrLe20Obj26RdrObjCntr ReSideRdrLe20Obj26RdrObjCoastCnt ReSideRdrLe20Obj26RdrObjConf ReSideRdrLe20Obj26RdrObjDx ReSideRdrLe20Obj26RdrObjDxStdDe ReSideRdrLe20Obj26RdrObjDy ReSideRdrLe20Obj26RdrObjDyStdDe ReSideRdrLe20Obj26RdrObjElevnConf ReSideRdrLe20Obj26RdrObjElevnSts ReSideRdrLe20Obj26RdrObjID ReSideRdrLe20Obj26RdrObjIsInFreeSpace ReSideRdrLe20Obj26RdrObjMirrProblty ReSideRdrLe20Obj26RdrObjMtnPat ReSideRdrLe20Obj26RdrObjNotRealProblty ReSideRdrLe20Obj26RdrObjStatyCnt ReSideRdrLe20Obj26RdrObjTiAlv ReSideRdrLe20Obj26RdrObjTrackSts ReSideRdrLe20Obj26RdrObjTyp ReSideRdrLe20Obj26RdrObjTypConfBike ReSideRdrLe20Obj26RdrObjTypConfPed ReSideRdrLe20Obj26RdrObjTypConfVeh ReSideRdrLe20Obj26RdrObjUsedTracker ReSideRdrLe20Obj26RdrObjVx ReSideRdrLe20Obj26RdrObjVxStdDe ReSideRdrLe20Obj26RdrObjVy ReSideRdrLe20Obj26RdrObjVyStdDe ReSideRdrLe20Obj26RelVx ReSideRdrLe20Obj26RelVy;
SIG_GROUP_ 1063 ReSideRdrLe20Obj27 1 : ReSideRdrLe20Obj27Heading ReSideRdrLe20Obj27ObjBoxCenterLat ReSideRdrLe20Obj27ObjBoxCenterLgt ReSideRdrLe20Obj27ObservationHist ReSideRdrLe20Obj27QualityBits ReSideRdrLe20Obj27RdrObjAx ReSideRdrLe20Obj27RdrObjAy ReSideRdrLe20Obj27RdrObjBoxLength ReSideRdrLe20Obj27RdrObjBoxWidth ReSideRdrLe20Obj27RdrObjChks ReSideRdrLe20Obj27RdrObjCntr ReSideRdrLe20Obj27RdrObjCoastCnt ReSideRdrLe20Obj27RdrObjConf ReSideRdrLe20Obj27RdrObjDx ReSideRdrLe20Obj27RdrObjDxStdDe ReSideRdrLe20Obj27RdrObjDy ReSideRdrLe20Obj27RdrObjDyStdDe ReSideRdrLe20Obj27RdrObjElevnConf ReSideRdrLe20Obj27RdrObjElevnSts ReSideRdrLe20Obj27RdrObjID ReSideRdrLe20Obj27RdrObjIsInFreeSpace ReSideRdrLe20Obj27RdrObjMirrProblty ReSideRdrLe20Obj27RdrObjMtnPat ReSideRdrLe20Obj27RdrObjNotRealProblty ReSideRdrLe20Obj27RdrObjStatyCnt ReSideRdrLe20Obj27RdrObjTiAlv ReSideRdrLe20Obj27RdrObjTrackSts ReSideRdrLe20Obj27RdrObjTyp ReSideRdrLe20Obj27RdrObjTypConfBike ReSideRdrLe20Obj27RdrObjTypConfPed ReSideRdrLe20Obj27RdrObjTypConfVeh ReSideRdrLe20Obj27RdrObjUsedTracker ReSideRdrLe20Obj27RdrObjVx ReSideRdrLe20Obj27RdrObjVxStdDe ReSideRdrLe20Obj27RdrObjVy ReSideRdrLe20Obj27RdrObjVyStdDe ReSideRdrLe20Obj27RelVx ReSideRdrLe20Obj27RelVy;
SIG_GROUP_ 1064 ReSideRdrLe20Obj28 1 : ReSideRdrLe20Obj28Heading ReSideRdrLe20Obj28ObjBoxCenterLat ReSideRdrLe20Obj28ObjBoxCenterLgt ReSideRdrLe20Obj28ObservationHist ReSideRdrLe20Obj28QualityBits ReSideRdrLe20Obj28RdrObjAx ReSideRdrLe20Obj28RdrObjAy ReSideRdrLe20Obj28RdrObjBoxLength ReSideRdrLe20Obj28RdrObjBoxWidth ReSideRdrLe20Obj28RdrObjChks ReSideRdrLe20Obj28RdrObjCntr ReSideRdrLe20Obj28RdrObjCoastCnt ReSideRdrLe20Obj28RdrObjConf ReSideRdrLe20Obj28RdrObjDx ReSideRdrLe20Obj28RdrObjDxStdDe ReSideRdrLe20Obj28RdrObjDy ReSideRdrLe20Obj28RdrObjDyStdDe ReSideRdrLe20Obj28RdrObjElevnConf ReSideRdrLe20Obj28RdrObjElevnSts ReSideRdrLe20Obj28RdrObjID ReSideRdrLe20Obj28RdrObjIsInFreeSpace ReSideRdrLe20Obj28RdrObjMirrProblty ReSideRdrLe20Obj28RdrObjMtnPat ReSideRdrLe20Obj28RdrObjNotRealProblty ReSideRdrLe20Obj28RdrObjStatyCnt ReSideRdrLe20Obj28RdrObjTiAlv ReSideRdrLe20Obj28RdrObjTrackSts ReSideRdrLe20Obj28RdrObjTyp ReSideRdrLe20Obj28RdrObjTypConfBike ReSideRdrLe20Obj28RdrObjTypConfPed ReSideRdrLe20Obj28RdrObjTypConfVeh ReSideRdrLe20Obj28RdrObjUsedTracker ReSideRdrLe20Obj28RdrObjVx ReSideRdrLe20Obj28RdrObjVxStdDe ReSideRdrLe20Obj28RdrObjVy ReSideRdrLe20Obj28RdrObjVyStdDe ReSideRdrLe20Obj28RelVx ReSideRdrLe20Obj28RelVy;
SIG_GROUP_ 1065 ReSideRdrLe20Obj29 1 : ReSideRdrLe20Obj29Heading ReSideRdrLe20Obj29ObjBoxCenterLat ReSideRdrLe20Obj29ObjBoxCenterLgt ReSideRdrLe20Obj29ObservationHist ReSideRdrLe20Obj29QualityBits ReSideRdrLe20Obj29RdrObjAx ReSideRdrLe20Obj29RdrObjAy ReSideRdrLe20Obj29RdrObjBoxLength ReSideRdrLe20Obj29RdrObjBoxWidth ReSideRdrLe20Obj29RdrObjChks ReSideRdrLe20Obj29RdrObjCntr ReSideRdrLe20Obj29RdrObjCoastCnt ReSideRdrLe20Obj29RdrObjConf ReSideRdrLe20Obj29RdrObjDx ReSideRdrLe20Obj29RdrObjDxStdDe ReSideRdrLe20Obj29RdrObjDy ReSideRdrLe20Obj29RdrObjDyStdDe ReSideRdrLe20Obj29RdrObjElevnConf ReSideRdrLe20Obj29RdrObjElevnSts ReSideRdrLe20Obj29RdrObjID ReSideRdrLe20Obj29RdrObjIsInFreeSpace ReSideRdrLe20Obj29RdrObjMirrProblty ReSideRdrLe20Obj29RdrObjMtnPat ReSideRdrLe20Obj29RdrObjNotRealProblty ReSideRdrLe20Obj29RdrObjStatyCnt ReSideRdrLe20Obj29RdrObjTiAlv ReSideRdrLe20Obj29RdrObjTrackSts ReSideRdrLe20Obj29RdrObjTyp ReSideRdrLe20Obj29RdrObjTypConfBike ReSideRdrLe20Obj29RdrObjTypConfPed ReSideRdrLe20Obj29RdrObjTypConfVeh ReSideRdrLe20Obj29RdrObjUsedTracker ReSideRdrLe20Obj29RdrObjVx ReSideRdrLe20Obj29RdrObjVxStdDe ReSideRdrLe20Obj29RdrObjVy ReSideRdrLe20Obj29RdrObjVyStdDe ReSideRdrLe20Obj29RelVx ReSideRdrLe20Obj29RelVy;
SIG_GROUP_ 1072 ReSideRdrLe20Obj30 1 : ReSideRdrLe20Obj30Heading ReSideRdrLe20Obj30ObjBoxCenterLat ReSideRdrLe20Obj30ObjBoxCenterLgt ReSideRdrLe20Obj30ObservationHist ReSideRdrLe20Obj30QualityBits ReSideRdrLe20Obj30RdrObjAx ReSideRdrLe20Obj30RdrObjAy ReSideRdrLe20Obj30RdrObjBoxLength ReSideRdrLe20Obj30RdrObjBoxWidth ReSideRdrLe20Obj30RdrObjChks ReSideRdrLe20Obj30RdrObjCntr ReSideRdrLe20Obj30RdrObjCoastCnt ReSideRdrLe20Obj30RdrObjConf ReSideRdrLe20Obj30RdrObjDx ReSideRdrLe20Obj30RdrObjDxStdDe ReSideRdrLe20Obj30RdrObjDy ReSideRdrLe20Obj30RdrObjDyStdDe ReSideRdrLe20Obj30RdrObjElevnConf ReSideRdrLe20Obj30RdrObjElevnSts ReSideRdrLe20Obj30RdrObjID ReSideRdrLe20Obj30RdrObjIsInFreeSpace ReSideRdrLe20Obj30RdrObjMirrProblty ReSideRdrLe20Obj30RdrObjMtnPat ReSideRdrLe20Obj30RdrObjNotRealProblty ReSideRdrLe20Obj30RdrObjStatyCnt ReSideRdrLe20Obj30RdrObjTiAlv ReSideRdrLe20Obj30RdrObjTrackSts ReSideRdrLe20Obj30RdrObjTyp ReSideRdrLe20Obj30RdrObjTypConfBike ReSideRdrLe20Obj30RdrObjTypConfPed ReSideRdrLe20Obj30RdrObjTypConfVeh ReSideRdrLe20Obj30RdrObjUsedTracker ReSideRdrLe20Obj30RdrObjVx ReSideRdrLe20Obj30RdrObjVxStdDe ReSideRdrLe20Obj30RdrObjVy ReSideRdrLe20Obj30RdrObjVyStdDe ReSideRdrLe20Obj30RelVx ReSideRdrLe20Obj30RelVy;
SIG_GROUP_ 1073 ReSideRdrLe20Obj31 1 : ReSideRdrLe20Obj31Heading ReSideRdrLe20Obj31ObjBoxCenterLat ReSideRdrLe20Obj31ObjBoxCenterLgt ReSideRdrLe20Obj31ObservationHist ReSideRdrLe20Obj31QualityBits ReSideRdrLe20Obj31RdrObjAx ReSideRdrLe20Obj31RdrObjAy ReSideRdrLe20Obj31RdrObjBoxLength ReSideRdrLe20Obj31RdrObjBoxWidth ReSideRdrLe20Obj31RdrObjChks ReSideRdrLe20Obj31RdrObjCntr ReSideRdrLe20Obj31RdrObjCoastCnt ReSideRdrLe20Obj31RdrObjConf ReSideRdrLe20Obj31RdrObjDx ReSideRdrLe20Obj31RdrObjDxStdDe ReSideRdrLe20Obj31RdrObjDy ReSideRdrLe20Obj31RdrObjDyStdDe ReSideRdrLe20Obj31RdrObjElevnConf ReSideRdrLe20Obj31RdrObjElevnSts ReSideRdrLe20Obj31RdrObjID ReSideRdrLe20Obj31RdrObjIsInFreeSpace ReSideRdrLe20Obj31RdrObjMirrProblty ReSideRdrLe20Obj31RdrObjMtnPat ReSideRdrLe20Obj31RdrObjNotRealProblty ReSideRdrLe20Obj31RdrObjStatyCnt ReSideRdrLe20Obj31RdrObjTiAlv ReSideRdrLe20Obj31RdrObjTrackSts ReSideRdrLe20Obj31RdrObjTyp ReSideRdrLe20Obj31RdrObjTypConfBike ReSideRdrLe20Obj31RdrObjTypConfPed ReSideRdrLe20Obj31RdrObjTypConfVeh ReSideRdrLe20Obj31RdrObjUsedTracker ReSideRdrLe20Obj31RdrObjVx ReSideRdrLe20Obj31RdrObjVxStdDe ReSideRdrLe20Obj31RdrObjVy ReSideRdrLe20Obj31RdrObjVyStdDe ReSideRdrLe20Obj31RelVx ReSideRdrLe20Obj31RelVy;
