// *************************************************************************** *
// *                                                                           *
// * Description:         CANDB File                                           *
// * Generated at:        2023-03-30 16:08                                     *
// * System:              ZSDB123101                                           *
// * Variant:             CS1E                                                 *
// * Network:             Private_CANFD5                                       *
// *                                                                           *
// *************************************************************************** *
VERSION "Private_CANFD5"

NS_ :

BS_ :

BU_ :  ASDM SODL

BO_ 1032 SODLPrivateCANFD5Fr08 : 64 SODL
 SG_ ReSideRdrLe20Obj8_UB : 298|1@0+ (1,0) [0|1] "" ASDM
 SG_ ReSideRdrLe20Obj8Heading : 39|12@0+ (0.1,-180.0) [-180.0|180.0] "Deg" ASDM
 SG_ ReSideRdrLe20Obj8ObjBoxCenterLat : 111|9@0+ (0.1,-25.0) [-25.0|25.0] "m" ASDM
 SG_ ReSideRdrLe20Obj8ObjBoxCenterLgt : 23|9@0+ (0.1,-25.0) [-25.0|25.0] "m" ASDM
 SG_ ReSideRdrLe20Obj8ObservationHist : 79|32@0+ (1.0,0.0) [0.0|4294967295.0] "Unitless" ASDM
 SG_ ReSideRdrLe20Obj8QualityBits : 127|18@0+ (1.0,0.0) [0.0|262143.0] "Unitless" ASDM
 SG_ ReSideRdrLe20Obj8RdrObjAx : 55|8@0- (0.1,0.0) [-12.8|12.700000000000001] "m/s^2" ASDM
 SG_ ReSideRdrLe20Obj8RdrObjAy : 63|8@0- (0.1,0.0) [-12.8|12.700000000000001] "m/s^2" ASDM
 SG_ ReSideRdrLe20Obj8RdrObjBoxLength : 151|9@0+ (0.1,0.0) [0.0|50.0] "m" ASDM
 SG_ ReSideRdrLe20Obj8RdrObjBoxWidth : 279|9@0+ (0.1,0.0) [0.0|50.0] "m" ASDM
 SG_ ReSideRdrLe20Obj8RdrObjChks : 7|8@0+ (1.0,0.0) [0.0|255.0] "Unitless" ASDM
 SG_ ReSideRdrLe20Obj8RdrObjCntr : 15|4@0+ (1.0,0.0) [0.0|15.0] "Unitless" ASDM
 SG_ ReSideRdrLe20Obj8RdrObjCoastCnt : 158|5@0+ (1.0,0.0) [0.0|31.0] "Unitless" ASDM
 SG_ ReSideRdrLe20Obj8RdrObjConf : 11|4@0+ (7.0,0.0) [0.0|105.0] "%" ASDM
 SG_ ReSideRdrLe20Obj8RdrObjDx : 207|13@0+ (0.05,-200.0) [-200.0|200.0] "m" ASDM
 SG_ ReSideRdrLe20Obj8RdrObjDxStdDe : 71|8@0+ (0.05,0.0) [0.0|12.700000000000001] "m" ASDM
 SG_ ReSideRdrLe20Obj8RdrObjDy : 295|13@0+ (0.05,-200.0) [-200.0|200.0] "m" ASDM
 SG_ ReSideRdrLe20Obj8RdrObjDyStdDe : 167|8@0+ (0.05,0.0) [0.0|12.700000000000001] "m" ASDM
 SG_ ReSideRdrLe20Obj8RdrObjElevnConf : 43|4@0+ (7.0,0.0) [0.0|105.0] "%" ASDM
 SG_ ReSideRdrLe20Obj8RdrObjElevnSts : 153|2@0+ (1,0) [0|3] "" ASDM
 SG_ ReSideRdrLe20Obj8RdrObjID : 223|8@0+ (1.0,0.0) [0.0|255.0] "Unitless" ASDM
 SG_ ReSideRdrLe20Obj8RdrObjIsInFreeSpace : 280|1@0+ (1,0) [0|1] "" ASDM
 SG_ ReSideRdrLe20Obj8RdrObjMirrProblty : 263|4@0+ (7.0,0.0) [0.0|105.0] "%" ASDM
 SG_ ReSideRdrLe20Obj8RdrObjMtnPat : 210|3@0+ (1,0) [0|7] "" ASDM
 SG_ ReSideRdrLe20Obj8RdrObjNotRealProblty : 259|4@0+ (7.0,0.0) [0.0|105.0] "%" ASDM
 SG_ ReSideRdrLe20Obj8RdrObjStatyCnt : 30|7@0+ (1.0,0.0) [0.0|127.0] "Unitless" ASDM
 SG_ ReSideRdrLe20Obj8RdrObjTiAlv : 118|7@0+ (1.0,0.0) [0.0|127.0] "Unitless" ASDM
 SG_ ReSideRdrLe20Obj8RdrObjTrackSts : 177|2@0+ (1,0) [0|3] "" ASDM
 SG_ ReSideRdrLe20Obj8RdrObjTyp : 235|4@0+ (1,0) [0|15] "" ASDM
 SG_ ReSideRdrLe20Obj8RdrObjTypConfBike : 251|4@0+ (7.0,0.0) [0.0|105.0] "%" ASDM
 SG_ ReSideRdrLe20Obj8RdrObjTypConfPed : 271|4@0+ (7.0,0.0) [0.0|105.0] "%" ASDM
 SG_ ReSideRdrLe20Obj8RdrObjTypConfVeh : 267|4@0+ (7.0,0.0) [0.0|105.0] "%" ASDM
 SG_ ReSideRdrLe20Obj8RdrObjUsedTracker : 193|2@0+ (1,0) [0|3] "" ASDM
 SG_ ReSideRdrLe20Obj8RdrObjVx : 175|14@0+ (0.02,-128.0) [-128.0|128.0] "m/s" ASDM
 SG_ ReSideRdrLe20Obj8RdrObjVxStdDe : 141|6@0+ (0.05,0.0) [0.0|2.0] "m/s" ASDM
 SG_ ReSideRdrLe20Obj8RdrObjVy : 191|14@0+ (0.02,-128.0) [-128.0|128.0] "m/s" ASDM
 SG_ ReSideRdrLe20Obj8RdrObjVyStdDe : 286|6@0+ (0.05,0.0) [0.0|2.0] "m/s" ASDM
 SG_ ReSideRdrLe20Obj8RelVx : 231|12@0+ (0.02,-35.6) [-35.6|35.6] "m/s" ASDM
 SG_ ReSideRdrLe20Obj8RelVy : 247|12@0+ (0.02,-35.6) [-35.6|35.6] "m/s" ASDM

BO_ 1033 SODLPrivateCANFD5Fr09 : 64 SODL
 SG_ ReSideRdrLe20Obj9_UB : 298|1@0+ (1,0) [0|1] "" ASDM
 SG_ ReSideRdrLe20Obj9Heading : 39|12@0+ (0.1,-180.0) [-180.0|180.0] "Deg" ASDM
 SG_ ReSideRdrLe20Obj9ObjBoxCenterLat : 111|9@0+ (0.1,-25.0) [-25.0|25.0] "m" ASDM
 SG_ ReSideRdrLe20Obj9ObjBoxCenterLgt : 23|9@0+ (0.1,-25.0) [-25.0|25.0] "m" ASDM
 SG_ ReSideRdrLe20Obj9ObservationHist : 79|32@0+ (1.0,0.0) [0.0|4294967295.0] "Unitless" ASDM
 SG_ ReSideRdrLe20Obj9QualityBits : 127|18@0+ (1.0,0.0) [0.0|262143.0] "Unitless" ASDM
 SG_ ReSideRdrLe20Obj9RdrObjAx : 55|8@0- (0.1,0.0) [-12.8|12.700000000000001] "m/s^2" ASDM
 SG_ ReSideRdrLe20Obj9RdrObjAy : 63|8@0- (0.1,0.0) [-12.8|12.700000000000001] "m/s^2" ASDM
 SG_ ReSideRdrLe20Obj9RdrObjBoxLength : 151|9@0+ (0.1,0.0) [0.0|50.0] "m" ASDM
 SG_ ReSideRdrLe20Obj9RdrObjBoxWidth : 279|9@0+ (0.1,0.0) [0.0|50.0] "m" ASDM
 SG_ ReSideRdrLe20Obj9RdrObjChks : 7|8@0+ (1.0,0.0) [0.0|255.0] "Unitless" ASDM
 SG_ ReSideRdrLe20Obj9RdrObjCntr : 15|4@0+ (1.0,0.0) [0.0|15.0] "Unitless" ASDM
 SG_ ReSideRdrLe20Obj9RdrObjCoastCnt : 158|5@0+ (1.0,0.0) [0.0|31.0] "Unitless" ASDM
 SG_ ReSideRdrLe20Obj9RdrObjConf : 11|4@0+ (7.0,0.0) [0.0|105.0] "%" ASDM
 SG_ ReSideRdrLe20Obj9RdrObjDx : 207|13@0+ (0.05,-200.0) [-200.0|200.0] "m" ASDM
 SG_ ReSideRdrLe20Obj9RdrObjDxStdDe : 71|8@0+ (0.05,0.0) [0.0|12.700000000000001] "m" ASDM
 SG_ ReSideRdrLe20Obj9RdrObjDy : 295|13@0+ (0.05,-200.0) [-200.0|200.0] "m" ASDM
 SG_ ReSideRdrLe20Obj9RdrObjDyStdDe : 167|8@0+ (0.05,0.0) [0.0|12.700000000000001] "m" ASDM
 SG_ ReSideRdrLe20Obj9RdrObjElevnConf : 43|4@0+ (7.0,0.0) [0.0|105.0] "%" ASDM
 SG_ ReSideRdrLe20Obj9RdrObjElevnSts : 153|2@0+ (1,0) [0|3] "" ASDM
 SG_ ReSideRdrLe20Obj9RdrObjID : 223|8@0+ (1.0,0.0) [0.0|255.0] "Unitless" ASDM
 SG_ ReSideRdrLe20Obj9RdrObjIsInFreeSpace : 280|1@0+ (1,0) [0|1] "" ASDM
 SG_ ReSideRdrLe20Obj9RdrObjMirrProblty : 263|4@0+ (7.0,0.0) [0.0|105.0] "%" ASDM
 SG_ ReSideRdrLe20Obj9RdrObjMtnPat : 210|3@0+ (1,0) [0|7] "" ASDM
 SG_ ReSideRdrLe20Obj9RdrObjNotRealProblty : 259|4@0+ (7.0,0.0) [0.0|105.0] "%" ASDM
 SG_ ReSideRdrLe20Obj9RdrObjStatyCnt : 30|7@0+ (1.0,0.0) [0.0|127.0] "Unitless" ASDM
 SG_ ReSideRdrLe20Obj9RdrObjTiAlv : 118|7@0+ (1.0,0.0) [0.0|127.0] "Unitless" ASDM
 SG_ ReSideRdrLe20Obj9RdrObjTrackSts : 177|2@0+ (1,0) [0|3] "" ASDM
 SG_ ReSideRdrLe20Obj9RdrObjTyp : 235|4@0+ (1,0) [0|15] "" ASDM
 SG_ ReSideRdrLe20Obj9RdrObjTypConfBike : 251|4@0+ (7.0,0.0) [0.0|105.0] "%" ASDM
 SG_ ReSideRdrLe20Obj9RdrObjTypConfPed : 271|4@0+ (7.0,0.0) [0.0|105.0] "%" ASDM
 SG_ ReSideRdrLe20Obj9RdrObjTypConfVeh : 267|4@0+ (7.0,0.0) [0.0|105.0] "%" ASDM
 SG_ ReSideRdrLe20Obj9RdrObjUsedTracker : 193|2@0+ (1,0) [0|3] "" ASDM
 SG_ ReSideRdrLe20Obj9RdrObjVx : 175|14@0+ (0.02,-128.0) [-128.0|128.0] "m/s" ASDM
 SG_ ReSideRdrLe20Obj9RdrObjVxStdDe : 141|6@0+ (0.05,0.0) [0.0|2.0] "m/s" ASDM
 SG_ ReSideRdrLe20Obj9RdrObjVy : 191|14@0+ (0.02,-128.0) [-128.0|128.0] "m/s" ASDM
 SG_ ReSideRdrLe20Obj9RdrObjVyStdDe : 286|6@0+ (0.05,0.0) [0.0|2.0] "m/s" ASDM
 SG_ ReSideRdrLe20Obj9RelVx : 231|12@0+ (0.02,-35.6) [-35.6|35.6] "m/s" ASDM
 SG_ ReSideRdrLe20Obj9RelVy : 247|12@0+ (0.02,-35.6) [-35.6|35.6] "m/s" ASDM

BO_ 1040 SODLPrivateCANFD5Fr10 : 64 SODL
 SG_ ReSideRdrLe20Obj10_UB : 298|1@0+ (1,0) [0|1] "" ASDM
 SG_ ReSideRdrLe20Obj10Heading : 39|12@0+ (0.1,-180.0) [-180.0|180.0] "Deg" ASDM
 SG_ ReSideRdrLe20Obj10ObjBoxCenterLat : 111|9@0+ (0.1,-25.0) [-25.0|25.0] "m" ASDM
 SG_ ReSideRdrLe20Obj10ObjBoxCenterLgt : 23|9@0+ (0.1,-25.0) [-25.0|25.0] "m" ASDM
 SG_ ReSideRdrLe20Obj10ObservationHist : 79|32@0+ (1.0,0.0) [0.0|4294967295.0] "Unitless" ASDM
 SG_ ReSideRdrLe20Obj10QualityBits : 127|18@0+ (1.0,0.0) [0.0|262143.0] "Unitless" ASDM
 SG_ ReSideRdrLe20Obj10RdrObjAx : 55|8@0- (0.1,0.0) [-12.8|12.700000000000001] "m/s^2" ASDM
 SG_ ReSideRdrLe20Obj10RdrObjAy : 63|8@0- (0.1,0.0) [-12.8|12.700000000000001] "m/s^2" ASDM
 SG_ ReSideRdrLe20Obj10RdrObjBoxLength : 151|9@0+ (0.1,0.0) [0.0|50.0] "m" ASDM
 SG_ ReSideRdrLe20Obj10RdrObjBoxWidth : 279|9@0+ (0.1,0.0) [0.0|50.0] "m" ASDM
 SG_ ReSideRdrLe20Obj10RdrObjChks : 7|8@0+ (1.0,0.0) [0.0|255.0] "Unitless" ASDM
 SG_ ReSideRdrLe20Obj10RdrObjCntr : 15|4@0+ (1.0,0.0) [0.0|15.0] "Unitless" ASDM
 SG_ ReSideRdrLe20Obj10RdrObjCoastCnt : 158|5@0+ (1.0,0.0) [0.0|31.0] "Unitless" ASDM
 SG_ ReSideRdrLe20Obj10RdrObjConf : 11|4@0+ (7.0,0.0) [0.0|105.0] "%" ASDM
 SG_ ReSideRdrLe20Obj10RdrObjDx : 207|13@0+ (0.05,-200.0) [-200.0|200.0] "m" ASDM
 SG_ ReSideRdrLe20Obj10RdrObjDxStdDe : 71|8@0+ (0.05,0.0) [0.0|12.700000000000001] "m" ASDM
 SG_ ReSideRdrLe20Obj10RdrObjDy : 295|13@0+ (0.05,-200.0) [-200.0|200.0] "m" ASDM
 SG_ ReSideRdrLe20Obj10RdrObjDyStdDe : 167|8@0+ (0.05,0.0) [0.0|12.700000000000001] "m" ASDM
 SG_ ReSideRdrLe20Obj10RdrObjElevnConf : 43|4@0+ (7.0,0.0) [0.0|105.0] "%" ASDM
 SG_ ReSideRdrLe20Obj10RdrObjElevnSts : 153|2@0+ (1,0) [0|3] "" ASDM
 SG_ ReSideRdrLe20Obj10RdrObjID : 223|8@0+ (1.0,0.0) [0.0|255.0] "Unitless" ASDM
 SG_ ReSideRdrLe20Obj10RdrObjIsInFreeSpace : 280|1@0+ (1,0) [0|1] "" ASDM
 SG_ ReSideRdrLe20Obj10RdrObjMirrProblty : 263|4@0+ (7.0,0.0) [0.0|105.0] "%" ASDM
 SG_ ReSideRdrLe20Obj10RdrObjMtnPat : 210|3@0+ (1,0) [0|7] "" ASDM
 SG_ ReSideRdrLe20Obj10RdrObjNotRealProblty : 259|4@0+ (7.0,0.0) [0.0|105.0] "%" ASDM
 SG_ ReSideRdrLe20Obj10RdrObjStatyCnt : 30|7@0+ (1.0,0.0) [0.0|127.0] "Unitless" ASDM
 SG_ ReSideRdrLe20Obj10RdrObjTiAlv : 118|7@0+ (1.0,0.0) [0.0|127.0] "Unitless" ASDM
 SG_ ReSideRdrLe20Obj10RdrObjTrackSts : 177|2@0+ (1,0) [0|3] "" ASDM
 SG_ ReSideRdrLe20Obj10RdrObjTyp : 235|4@0+ (1,0) [0|15] "" ASDM
 SG_ ReSideRdrLe20Obj10RdrObjTypConfBike : 251|4@0+ (7.0,0.0) [0.0|105.0] "%" ASDM
 SG_ ReSideRdrLe20Obj10RdrObjTypConfPed : 271|4@0+ (7.0,0.0) [0.0|105.0] "%" ASDM
 SG_ ReSideRdrLe20Obj10RdrObjTypConfVeh : 267|4@0+ (7.0,0.0) [0.0|105.0] "%" ASDM
 SG_ ReSideRdrLe20Obj10RdrObjUsedTracker : 193|2@0+ (1,0) [0|3] "" ASDM
 SG_ ReSideRdrLe20Obj10RdrObjVx : 175|14@0+ (0.02,-128.0) [-128.0|128.0] "m/s" ASDM
 SG_ ReSideRdrLe20Obj10RdrObjVxStdDe : 141|6@0+ (0.05,0.0) [0.0|2.0] "m/s" ASDM
 SG_ ReSideRdrLe20Obj10RdrObjVy : 191|14@0+ (0.02,-128.0) [-128.0|128.0] "m/s" ASDM
 SG_ ReSideRdrLe20Obj10RdrObjVyStdDe : 286|6@0+ (0.05,0.0) [0.0|2.0] "m/s" ASDM
 SG_ ReSideRdrLe20Obj10RelVx : 231|12@0+ (0.02,-35.6) [-35.6|35.6] "m/s" ASDM
 SG_ ReSideRdrLe20Obj10RelVy : 247|12@0+ (0.02,-35.6) [-35.6|35.6] "m/s" ASDM

BO_ 1041 SODLPrivateCANFD5Fr11 : 64 SODL
 SG_ ReSideRdrLe20Obj11_UB : 298|1@0+ (1,0) [0|1] "" ASDM
 SG_ ReSideRdrLe20Obj11Heading : 39|12@0+ (0.1,-180.0) [-180.0|180.0] "Deg" ASDM
 SG_ ReSideRdrLe20Obj11ObjBoxCenterLat : 111|9@0+ (0.1,-25.0) [-25.0|25.0] "m" ASDM
 SG_ ReSideRdrLe20Obj11ObjBoxCenterLgt : 23|9@0+ (0.1,-25.0) [-25.0|25.0] "m" ASDM
 SG_ ReSideRdrLe20Obj11ObservationHist : 79|32@0+ (1.0,0.0) [0.0|4294967295.0] "Unitless" ASDM
 SG_ ReSideRdrLe20Obj11QualityBits : 127|18@0+ (1.0,0.0) [0.0|262143.0] "Unitless" ASDM
 SG_ ReSideRdrLe20Obj11RdrObjAx : 55|8@0- (0.1,0.0) [-12.8|12.700000000000001] "m/s^2" ASDM
 SG_ ReSideRdrLe20Obj11RdrObjAy : 63|8@0- (0.1,0.0) [-12.8|12.700000000000001] "m/s^2" ASDM
 SG_ ReSideRdrLe20Obj11RdrObjBoxLength : 151|9@0+ (0.1,0.0) [0.0|50.0] "m" ASDM
 SG_ ReSideRdrLe20Obj11RdrObjBoxWidth : 279|9@0+ (0.1,0.0) [0.0|50.0] "m" ASDM
 SG_ ReSideRdrLe20Obj11RdrObjChks : 7|8@0+ (1.0,0.0) [0.0|255.0] "Unitless" ASDM
 SG_ ReSideRdrLe20Obj11RdrObjCntr : 15|4@0+ (1.0,0.0) [0.0|15.0] "Unitless" ASDM
 SG_ ReSideRdrLe20Obj11RdrObjCoastCnt : 158|5@0+ (1.0,0.0) [0.0|31.0] "Unitless" ASDM
 SG_ ReSideRdrLe20Obj11RdrObjConf : 11|4@0+ (7.0,0.0) [0.0|105.0] "%" ASDM
 SG_ ReSideRdrLe20Obj11RdrObjDx : 207|13@0+ (0.05,-200.0) [-200.0|200.0] "m" ASDM
 SG_ ReSideRdrLe20Obj11RdrObjDxStdDe : 71|8@0+ (0.05,0.0) [0.0|12.700000000000001] "m" ASDM
 SG_ ReSideRdrLe20Obj11RdrObjDy : 295|13@0+ (0.05,-200.0) [-200.0|200.0] "m" ASDM
 SG_ ReSideRdrLe20Obj11RdrObjDyStdDe : 167|8@0+ (0.05,0.0) [0.0|12.700000000000001] "m" ASDM
 SG_ ReSideRdrLe20Obj11RdrObjElevnConf : 43|4@0+ (7.0,0.0) [0.0|105.0] "%" ASDM
 SG_ ReSideRdrLe20Obj11RdrObjElevnSts : 153|2@0+ (1,0) [0|3] "" ASDM
 SG_ ReSideRdrLe20Obj11RdrObjID : 223|8@0+ (1.0,0.0) [0.0|255.0] "Unitless" ASDM
 SG_ ReSideRdrLe20Obj11RdrObjIsInFreeSpace : 280|1@0+ (1,0) [0|1] "" ASDM
 SG_ ReSideRdrLe20Obj11RdrObjMirrProblty : 263|4@0+ (7.0,0.0) [0.0|105.0] "%" ASDM
 SG_ ReSideRdrLe20Obj11RdrObjMtnPat : 210|3@0+ (1,0) [0|7] "" ASDM
 SG_ ReSideRdrLe20Obj11RdrObjNotRealProblty : 259|4@0+ (7.0,0.0) [0.0|105.0] "%" ASDM
 SG_ ReSideRdrLe20Obj11RdrObjStatyCnt : 30|7@0+ (1.0,0.0) [0.0|127.0] "Unitless" ASDM
 SG_ ReSideRdrLe20Obj11RdrObjTiAlv : 118|7@0+ (1.0,0.0) [0.0|127.0] "Unitless" ASDM
 SG_ ReSideRdrLe20Obj11RdrObjTrackSts : 177|2@0+ (1,0) [0|3] "" ASDM
 SG_ ReSideRdrLe20Obj11RdrObjTyp : 235|4@0+ (1,0) [0|15] "" ASDM
 SG_ ReSideRdrLe20Obj11RdrObjTypConfBike : 251|4@0+ (7.0,0.0) [0.0|105.0] "%" ASDM
 SG_ ReSideRdrLe20Obj11RdrObjTypConfPed : 271|4@0+ (7.0,0.0) [0.0|105.0] "%" ASDM
 SG_ ReSideRdrLe20Obj11RdrObjTypConfVeh : 267|4@0+ (7.0,0.0) [0.0|105.0] "%" ASDM
 SG_ ReSideRdrLe20Obj11RdrObjUsedTracker : 193|2@0+ (1,0) [0|3] "" ASDM
 SG_ ReSideRdrLe20Obj11RdrObjVx : 175|14@0+ (0.02,-128.0) [-128.0|128.0] "m/s" ASDM
 SG_ ReSideRdrLe20Obj11RdrObjVxStdDe : 141|6@0+ (0.05,0.0) [0.0|2.0] "m/s" ASDM
 SG_ ReSideRdrLe20Obj11RdrObjVy : 191|14@0+ (0.02,-128.0) [-128.0|128.0] "m/s" ASDM
 SG_ ReSideRdrLe20Obj11RdrObjVyStdDe : 286|6@0+ (0.05,0.0) [0.0|2.0] "m/s" ASDM
 SG_ ReSideRdrLe20Obj11RelVx : 231|12@0+ (0.02,-35.6) [-35.6|35.6] "m/s" ASDM
 SG_ ReSideRdrLe20Obj11RelVy : 247|12@0+ (0.02,-35.6) [-35.6|35.6] "m/s" ASDM

BO_ 1042 SODLPrivateCANFD5Fr12 : 64 SODL
 SG_ ReSideRdrLe20Obj12_UB : 298|1@0+ (1,0) [0|1] "" ASDM
 SG_ ReSideRdrLe20Obj12Heading : 39|12@0+ (0.1,-180.0) [-180.0|180.0] "Deg" ASDM
 SG_ ReSideRdrLe20Obj12ObjBoxCenterLat : 111|9@0+ (0.1,-25.0) [-25.0|25.0] "m" ASDM
 SG_ ReSideRdrLe20Obj12ObjBoxCenterLgt : 23|9@0+ (0.1,-25.0) [-25.0|25.0] "m" ASDM
 SG_ ReSideRdrLe20Obj12ObservationHist : 79|32@0+ (1.0,0.0) [0.0|4294967295.0] "Unitless" ASDM
 SG_ ReSideRdrLe20Obj12QualityBits : 127|18@0+ (1.0,0.0) [0.0|262143.0] "Unitless" ASDM
 SG_ ReSideRdrLe20Obj12RdrObjAx : 55|8@0- (0.1,0.0) [-12.8|12.700000000000001] "m/s^2" ASDM
 SG_ ReSideRdrLe20Obj12RdrObjAy : 63|8@0- (0.1,0.0) [-12.8|12.700000000000001] "m/s^2" ASDM
 SG_ ReSideRdrLe20Obj12RdrObjBoxLength : 151|9@0+ (0.1,0.0) [0.0|50.0] "m" ASDM
 SG_ ReSideRdrLe20Obj12RdrObjBoxWidth : 279|9@0+ (0.1,0.0) [0.0|50.0] "m" ASDM
 SG_ ReSideRdrLe20Obj12RdrObjChks : 7|8@0+ (1.0,0.0) [0.0|255.0] "Unitless" ASDM
 SG_ ReSideRdrLe20Obj12RdrObjCntr : 15|4@0+ (1.0,0.0) [0.0|15.0] "Unitless" ASDM
 SG_ ReSideRdrLe20Obj12RdrObjCoastCnt : 158|5@0+ (1.0,0.0) [0.0|31.0] "Unitless" ASDM
 SG_ ReSideRdrLe20Obj12RdrObjConf : 11|4@0+ (7.0,0.0) [0.0|105.0] "%" ASDM
 SG_ ReSideRdrLe20Obj12RdrObjDx : 207|13@0+ (0.05,-200.0) [-200.0|200.0] "m" ASDM
 SG_ ReSideRdrLe20Obj12RdrObjDxStdDe : 71|8@0+ (0.05,0.0) [0.0|12.700000000000001] "m" ASDM
 SG_ ReSideRdrLe20Obj12RdrObjDy : 295|13@0+ (0.05,-200.0) [-200.0|200.0] "m" ASDM
 SG_ ReSideRdrLe20Obj12RdrObjDyStdDe : 167|8@0+ (0.05,0.0) [0.0|12.700000000000001] "m" ASDM
 SG_ ReSideRdrLe20Obj12RdrObjElevnConf : 43|4@0+ (7.0,0.0) [0.0|105.0] "%" ASDM
 SG_ ReSideRdrLe20Obj12RdrObjElevnSts : 153|2@0+ (1,0) [0|3] "" ASDM
 SG_ ReSideRdrLe20Obj12RdrObjID : 223|8@0+ (1.0,0.0) [0.0|255.0] "Unitless" ASDM
 SG_ ReSideRdrLe20Obj12RdrObjIsInFreeSpace : 280|1@0+ (1,0) [0|1] "" ASDM
 SG_ ReSideRdrLe20Obj12RdrObjMirrProblty : 263|4@0+ (7.0,0.0) [0.0|105.0] "%" ASDM
 SG_ ReSideRdrLe20Obj12RdrObjMtnPat : 210|3@0+ (1,0) [0|7] "" ASDM
 SG_ ReSideRdrLe20Obj12RdrObjNotRealProblty : 259|4@0+ (7.0,0.0) [0.0|105.0] "%" ASDM
 SG_ ReSideRdrLe20Obj12RdrObjStatyCnt : 30|7@0+ (1.0,0.0) [0.0|127.0] "Unitless" ASDM
 SG_ ReSideRdrLe20Obj12RdrObjTiAlv : 118|7@0+ (1.0,0.0) [0.0|127.0] "Unitless" ASDM
 SG_ ReSideRdrLe20Obj12RdrObjTrackSts : 177|2@0+ (1,0) [0|3] "" ASDM
 SG_ ReSideRdrLe20Obj12RdrObjTyp : 235|4@0+ (1,0) [0|15] "" ASDM
 SG_ ReSideRdrLe20Obj12RdrObjTypConfBike : 251|4@0+ (7.0,0.0) [0.0|105.0] "%" ASDM
 SG_ ReSideRdrLe20Obj12RdrObjTypConfPed : 271|4@0+ (7.0,0.0) [0.0|105.0] "%" ASDM
 SG_ ReSideRdrLe20Obj12RdrObjTypConfVeh : 267|4@0+ (7.0,0.0) [0.0|105.0] "%" ASDM
 SG_ ReSideRdrLe20Obj12RdrObjUsedTracker : 193|2@0+ (1,0) [0|3] "" ASDM
 SG_ ReSideRdrLe20Obj12RdrObjVx : 175|14@0+ (0.02,-128.0) [-128.0|128.0] "m/s" ASDM
 SG_ ReSideRdrLe20Obj12RdrObjVxStdDe : 141|6@0+ (0.05,0.0) [0.0|2.0] "m/s" ASDM
 SG_ ReSideRdrLe20Obj12RdrObjVy : 191|14@0+ (0.02,-128.0) [-128.0|128.0] "m/s" ASDM
 SG_ ReSideRdrLe20Obj12RdrObjVyStdDe : 286|6@0+ (0.05,0.0) [0.0|2.0] "m/s" ASDM
 SG_ ReSideRdrLe20Obj12RelVx : 231|12@0+ (0.02,-35.6) [-35.6|35.6] "m/s" ASDM
 SG_ ReSideRdrLe20Obj12RelVy : 247|12@0+ (0.02,-35.6) [-35.6|35.6] "m/s" ASDM

BO_ 1043 SODLPrivateCANFD5Fr13 : 64 SODL
 SG_ ReSideRdrLe20Obj13_UB : 298|1@0+ (1,0) [0|1] "" ASDM
 SG_ ReSideRdrLe20Obj13Heading : 39|12@0+ (0.1,-180.0) [-180.0|180.0] "Deg" ASDM
 SG_ ReSideRdrLe20Obj13ObjBoxCenterLat : 111|9@0+ (0.1,-25.0) [-25.0|25.0] "m" ASDM
 SG_ ReSideRdrLe20Obj13ObjBoxCenterLgt : 23|9@0+ (0.1,-25.0) [-25.0|25.0] "m" ASDM
 SG_ ReSideRdrLe20Obj13ObservationHist : 79|32@0+ (1.0,0.0) [0.0|4294967295.0] "Unitless" ASDM
 SG_ ReSideRdrLe20Obj13QualityBits : 127|18@0+ (1.0,0.0) [0.0|262143.0] "Unitless" ASDM
 SG_ ReSideRdrLe20Obj13RdrObjAx : 55|8@0- (0.1,0.0) [-12.8|12.700000000000001] "m/s^2" ASDM
 SG_ ReSideRdrLe20Obj13RdrObjAy : 63|8@0- (0.1,0.0) [-12.8|12.700000000000001] "m/s^2" ASDM
 SG_ ReSideRdrLe20Obj13RdrObjBoxLength : 151|9@0+ (0.1,0.0) [0.0|50.0] "m" ASDM
 SG_ ReSideRdrLe20Obj13RdrObjBoxWidth : 279|9@0+ (0.1,0.0) [0.0|50.0] "m" ASDM
 SG_ ReSideRdrLe20Obj13RdrObjChks : 7|8@0+ (1.0,0.0) [0.0|255.0] "Unitless" ASDM
 SG_ ReSideRdrLe20Obj13RdrObjCntr : 15|4@0+ (1.0,0.0) [0.0|15.0] "Unitless" ASDM
 SG_ ReSideRdrLe20Obj13RdrObjCoastCnt : 158|5@0+ (1.0,0.0) [0.0|31.0] "Unitless" ASDM
 SG_ ReSideRdrLe20Obj13RdrObjConf : 11|4@0+ (7.0,0.0) [0.0|105.0] "%" ASDM
 SG_ ReSideRdrLe20Obj13RdrObjDx : 207|13@0+ (0.05,-200.0) [-200.0|200.0] "m" ASDM
 SG_ ReSideRdrLe20Obj13RdrObjDxStdDe : 71|8@0+ (0.05,0.0) [0.0|12.700000000000001] "m" ASDM
 SG_ ReSideRdrLe20Obj13RdrObjDy : 295|13@0+ (0.05,-200.0) [-200.0|200.0] "m" ASDM
 SG_ ReSideRdrLe20Obj13RdrObjDyStdDe : 167|8@0+ (0.05,0.0) [0.0|12.700000000000001] "m" ASDM
 SG_ ReSideRdrLe20Obj13RdrObjElevnConf : 43|4@0+ (7.0,0.0) [0.0|105.0] "%" ASDM
 SG_ ReSideRdrLe20Obj13RdrObjElevnSts : 153|2@0+ (1,0) [0|3] "" ASDM
 SG_ ReSideRdrLe20Obj13RdrObjID : 223|8@0+ (1.0,0.0) [0.0|255.0] "Unitless" ASDM
 SG_ ReSideRdrLe20Obj13RdrObjIsInFreeSpace : 280|1@0+ (1,0) [0|1] "" ASDM
 SG_ ReSideRdrLe20Obj13RdrObjMirrProblty : 263|4@0+ (7.0,0.0) [0.0|105.0] "%" ASDM
 SG_ ReSideRdrLe20Obj13RdrObjMtnPat : 210|3@0+ (1,0) [0|7] "" ASDM
 SG_ ReSideRdrLe20Obj13RdrObjNotRealProblty : 259|4@0+ (7.0,0.0) [0.0|105.0] "%" ASDM
 SG_ ReSideRdrLe20Obj13RdrObjStatyCnt : 30|7@0+ (1.0,0.0) [0.0|127.0] "Unitless" ASDM
 SG_ ReSideRdrLe20Obj13RdrObjTiAlv : 118|7@0+ (1.0,0.0) [0.0|127.0] "Unitless" ASDM
 SG_ ReSideRdrLe20Obj13RdrObjTrackSts : 177|2@0+ (1,0) [0|3] "" ASDM
 SG_ ReSideRdrLe20Obj13RdrObjTyp : 235|4@0+ (1,0) [0|15] "" ASDM
 SG_ ReSideRdrLe20Obj13RdrObjTypConfBike : 251|4@0+ (7.0,0.0) [0.0|105.0] "%" ASDM
 SG_ ReSideRdrLe20Obj13RdrObjTypConfPed : 271|4@0+ (7.0,0.0) [0.0|105.0] "%" ASDM
 SG_ ReSideRdrLe20Obj13RdrObjTypConfVeh : 267|4@0+ (7.0,0.0) [0.0|105.0] "%" ASDM
 SG_ ReSideRdrLe20Obj13RdrObjUsedTracker : 193|2@0+ (1,0) [0|3] "" ASDM
 SG_ ReSideRdrLe20Obj13RdrObjVx : 175|14@0+ (0.02,-128.0) [-128.0|128.0] "m/s" ASDM
 SG_ ReSideRdrLe20Obj13RdrObjVxStdDe : 141|6@0+ (0.05,0.0) [0.0|2.0] "m/s" ASDM
 SG_ ReSideRdrLe20Obj13RdrObjVy : 191|14@0+ (0.02,-128.0) [-128.0|128.0] "m/s" ASDM
 SG_ ReSideRdrLe20Obj13RdrObjVyStdDe : 286|6@0+ (0.05,0.0) [0.0|2.0] "m/s" ASDM
 SG_ ReSideRdrLe20Obj13RelVx : 231|12@0+ (0.02,-35.6) [-35.6|35.6] "m/s" ASDM
 SG_ ReSideRdrLe20Obj13RelVy : 247|12@0+ (0.02,-35.6) [-35.6|35.6] "m/s" ASDM

BO_ 1044 SODLPrivateCANFD5Fr14 : 64 SODL
 SG_ ReSideRdrLe20Obj14_UB : 298|1@0+ (1,0) [0|1] "" ASDM
 SG_ ReSideRdrLe20Obj14Heading : 39|12@0+ (0.1,-180.0) [-180.0|180.0] "Deg" ASDM
 SG_ ReSideRdrLe20Obj14ObjBoxCenterLat : 111|9@0+ (0.1,-25.0) [-25.0|25.0] "m" ASDM
 SG_ ReSideRdrLe20Obj14ObjBoxCenterLgt : 23|9@0+ (0.1,-25.0) [-25.0|25.0] "m" ASDM
 SG_ ReSideRdrLe20Obj14ObservationHist : 79|32@0+ (1.0,0.0) [0.0|4294967295.0] "Unitless" ASDM
 SG_ ReSideRdrLe20Obj14QualityBits : 127|18@0+ (1.0,0.0) [0.0|262143.0] "Unitless" ASDM
 SG_ ReSideRdrLe20Obj14RdrObjAx : 55|8@0- (0.1,0.0) [-12.8|12.700000000000001] "m/s^2" ASDM
 SG_ ReSideRdrLe20Obj14RdrObjAy : 63|8@0- (0.1,0.0) [-12.8|12.700000000000001] "m/s^2" ASDM
 SG_ ReSideRdrLe20Obj14RdrObjBoxLength : 151|9@0+ (0.1,0.0) [0.0|50.0] "m" ASDM
 SG_ ReSideRdrLe20Obj14RdrObjBoxWidth : 279|9@0+ (0.1,0.0) [0.0|50.0] "m" ASDM
 SG_ ReSideRdrLe20Obj14RdrObjChks : 7|8@0+ (1.0,0.0) [0.0|255.0] "Unitless" ASDM
 SG_ ReSideRdrLe20Obj14RdrObjCntr : 15|4@0+ (1.0,0.0) [0.0|15.0] "Unitless" ASDM
 SG_ ReSideRdrLe20Obj14RdrObjCoastCnt : 158|5@0+ (1.0,0.0) [0.0|31.0] "Unitless" ASDM
 SG_ ReSideRdrLe20Obj14RdrObjConf : 11|4@0+ (7.0,0.0) [0.0|105.0] "%" ASDM
 SG_ ReSideRdrLe20Obj14RdrObjDx : 207|13@0+ (0.05,-200.0) [-200.0|200.0] "m" ASDM
 SG_ ReSideRdrLe20Obj14RdrObjDxStdDe : 71|8@0+ (0.05,0.0) [0.0|12.700000000000001] "m" ASDM
 SG_ ReSideRdrLe20Obj14RdrObjDy : 295|13@0+ (0.05,-200.0) [-200.0|200.0] "m" ASDM
 SG_ ReSideRdrLe20Obj14RdrObjDyStdDe : 167|8@0+ (0.05,0.0) [0.0|12.700000000000001] "m" ASDM
 SG_ ReSideRdrLe20Obj14RdrObjElevnConf : 43|4@0+ (7.0,0.0) [0.0|105.0] "%" ASDM
 SG_ ReSideRdrLe20Obj14RdrObjElevnSts : 153|2@0+ (1,0) [0|3] "" ASDM
 SG_ ReSideRdrLe20Obj14RdrObjID : 223|8@0+ (1.0,0.0) [0.0|255.0] "Unitless" ASDM
 SG_ ReSideRdrLe20Obj14RdrObjIsInFreeSpace : 280|1@0+ (1,0) [0|1] "" ASDM
 SG_ ReSideRdrLe20Obj14RdrObjMirrProblty : 263|4@0+ (7.0,0.0) [0.0|105.0] "%" ASDM
 SG_ ReSideRdrLe20Obj14RdrObjMtnPat : 210|3@0+ (1,0) [0|7] "" ASDM
 SG_ ReSideRdrLe20Obj14RdrObjNotRealProblty : 259|4@0+ (7.0,0.0) [0.0|105.0] "%" ASDM
 SG_ ReSideRdrLe20Obj14RdrObjStatyCnt : 30|7@0+ (1.0,0.0) [0.0|127.0] "Unitless" ASDM
 SG_ ReSideRdrLe20Obj14RdrObjTiAlv : 118|7@0+ (1.0,0.0) [0.0|127.0] "Unitless" ASDM
 SG_ ReSideRdrLe20Obj14RdrObjTrackSts : 177|2@0+ (1,0) [0|3] "" ASDM
 SG_ ReSideRdrLe20Obj14RdrObjTyp : 235|4@0+ (1,0) [0|15] "" ASDM
 SG_ ReSideRdrLe20Obj14RdrObjTypConfBike : 251|4@0+ (7.0,0.0) [0.0|105.0] "%" ASDM
 SG_ ReSideRdrLe20Obj14RdrObjTypConfPed : 271|4@0+ (7.0,0.0) [0.0|105.0] "%" ASDM
 SG_ ReSideRdrLe20Obj14RdrObjTypConfVeh : 267|4@0+ (7.0,0.0) [0.0|105.0] "%" ASDM
 SG_ ReSideRdrLe20Obj14RdrObjUsedTracker : 193|2@0+ (1,0) [0|3] "" ASDM
 SG_ ReSideRdrLe20Obj14RdrObjVx : 175|14@0+ (0.02,-128.0) [-128.0|128.0] "m/s" ASDM
 SG_ ReSideRdrLe20Obj14RdrObjVxStdDe : 141|6@0+ (0.05,0.0) [0.0|2.0] "m/s" ASDM
 SG_ ReSideRdrLe20Obj14RdrObjVy : 191|14@0+ (0.02,-128.0) [-128.0|128.0] "m/s" ASDM
 SG_ ReSideRdrLe20Obj14RdrObjVyStdDe : 286|6@0+ (0.05,0.0) [0.0|2.0] "m/s" ASDM
 SG_ ReSideRdrLe20Obj14RelVx : 231|12@0+ (0.02,-35.6) [-35.6|35.6] "m/s" ASDM
 SG_ ReSideRdrLe20Obj14RelVy : 247|12@0+ (0.02,-35.6) [-35.6|35.6] "m/s" ASDM

BO_ 1045 SODLPrivateCANFD5Fr15 : 64 SODL
 SG_ ReSideRdrLe20Obj15_UB : 298|1@0+ (1,0) [0|1] "" ASDM
 SG_ ReSideRdrLe20Obj15Heading : 39|12@0+ (0.1,-180.0) [-180.0|180.0] "Deg" ASDM
 SG_ ReSideRdrLe20Obj15ObjBoxCenterLat : 111|9@0+ (0.1,-25.0) [-25.0|25.0] "m" ASDM
 SG_ ReSideRdrLe20Obj15ObjBoxCenterLgt : 23|9@0+ (0.1,-25.0) [-25.0|25.0] "m" ASDM
 SG_ ReSideRdrLe20Obj15ObservationHist : 79|32@0+ (1.0,0.0) [0.0|4294967295.0] "Unitless" ASDM
 SG_ ReSideRdrLe20Obj15QualityBits : 127|18@0+ (1.0,0.0) [0.0|262143.0] "Unitless" ASDM
 SG_ ReSideRdrLe20Obj15RdrObjAx : 55|8@0- (0.1,0.0) [-12.8|12.700000000000001] "m/s^2" ASDM
 SG_ ReSideRdrLe20Obj15RdrObjAy : 63|8@0- (0.1,0.0) [-12.8|12.700000000000001] "m/s^2" ASDM
 SG_ ReSideRdrLe20Obj15RdrObjBoxLength : 151|9@0+ (0.1,0.0) [0.0|50.0] "m" ASDM
 SG_ ReSideRdrLe20Obj15RdrObjBoxWidth : 279|9@0+ (0.1,0.0) [0.0|50.0] "m" ASDM
 SG_ ReSideRdrLe20Obj15RdrObjChks : 7|8@0+ (1.0,0.0) [0.0|255.0] "Unitless" ASDM
 SG_ ReSideRdrLe20Obj15RdrObjCntr : 15|4@0+ (1.0,0.0) [0.0|15.0] "Unitless" ASDM
 SG_ ReSideRdrLe20Obj15RdrObjCoastCnt : 158|5@0+ (1.0,0.0) [0.0|31.0] "Unitless" ASDM
 SG_ ReSideRdrLe20Obj15RdrObjConf : 11|4@0+ (7.0,0.0) [0.0|105.0] "%" ASDM
 SG_ ReSideRdrLe20Obj15RdrObjDx : 207|13@0+ (0.05,-200.0) [-200.0|200.0] "m" ASDM
 SG_ ReSideRdrLe20Obj15RdrObjDxStdDe : 71|8@0+ (0.05,0.0) [0.0|12.700000000000001] "m" ASDM
 SG_ ReSideRdrLe20Obj15RdrObjDy : 295|13@0+ (0.05,-200.0) [-200.0|200.0] "m" ASDM
 SG_ ReSideRdrLe20Obj15RdrObjDyStdDe : 167|8@0+ (0.05,0.0) [0.0|12.700000000000001] "m" ASDM
 SG_ ReSideRdrLe20Obj15RdrObjElevnConf : 43|4@0+ (7.0,0.0) [0.0|105.0] "%" ASDM
 SG_ ReSideRdrLe20Obj15RdrObjElevnSts : 153|2@0+ (1,0) [0|3] "" ASDM
 SG_ ReSideRdrLe20Obj15RdrObjID : 223|8@0+ (1.0,0.0) [0.0|255.0] "Unitless" ASDM
 SG_ ReSideRdrLe20Obj15RdrObjIsInFreeSpace : 280|1@0+ (1,0) [0|1] "" ASDM
 SG_ ReSideRdrLe20Obj15RdrObjMirrProblty : 263|4@0+ (7.0,0.0) [0.0|105.0] "%" ASDM
 SG_ ReSideRdrLe20Obj15RdrObjMtnPat : 210|3@0+ (1,0) [0|7] "" ASDM
 SG_ ReSideRdrLe20Obj15RdrObjNotRealProblty : 259|4@0+ (7.0,0.0) [0.0|105.0] "%" ASDM
 SG_ ReSideRdrLe20Obj15RdrObjStatyCnt : 30|7@0+ (1.0,0.0) [0.0|127.0] "Unitless" ASDM
 SG_ ReSideRdrLe20Obj15RdrObjTiAlv : 118|7@0+ (1.0,0.0) [0.0|127.0] "Unitless" ASDM
 SG_ ReSideRdrLe20Obj15RdrObjTrackSts : 177|2@0+ (1,0) [0|3] "" ASDM
 SG_ ReSideRdrLe20Obj15RdrObjTyp : 235|4@0+ (1,0) [0|15] "" ASDM
 SG_ ReSideRdrLe20Obj15RdrObjTypConfBike : 251|4@0+ (7.0,0.0) [0.0|105.0] "%" ASDM
 SG_ ReSideRdrLe20Obj15RdrObjTypConfPed : 271|4@0+ (7.0,0.0) [0.0|105.0] "%" ASDM
 SG_ ReSideRdrLe20Obj15RdrObjTypConfVeh : 267|4@0+ (7.0,0.0) [0.0|105.0] "%" ASDM
 SG_ ReSideRdrLe20Obj15RdrObjUsedTracker : 193|2@0+ (1,0) [0|3] "" ASDM
 SG_ ReSideRdrLe20Obj15RdrObjVx : 175|14@0+ (0.02,-128.0) [-128.0|128.0] "m/s" ASDM
 SG_ ReSideRdrLe20Obj15RdrObjVxStdDe : 141|6@0+ (0.05,0.0) [0.0|2.0] "m/s" ASDM
 SG_ ReSideRdrLe20Obj15RdrObjVy : 191|14@0+ (0.02,-128.0) [-128.0|128.0] "m/s" ASDM
 SG_ ReSideRdrLe20Obj15RdrObjVyStdDe : 286|6@0+ (0.05,0.0) [0.0|2.0] "m/s" ASDM
 SG_ ReSideRdrLe20Obj15RelVx : 231|12@0+ (0.02,-35.6) [-35.6|35.6] "m/s" ASDM
 SG_ ReSideRdrLe20Obj15RelVy : 247|12@0+ (0.02,-35.6) [-35.6|35.6] "m/s" ASDM

BO_ 1046 SODLPrivateCANFD5Fr16 : 64 SODL
 SG_ ReSideRdrLe20Obj16_UB : 298|1@0+ (1,0) [0|1] "" ASDM
 SG_ ReSideRdrLe20Obj16Heading : 39|12@0+ (0.1,-180.0) [-180.0|180.0] "Deg" ASDM
 SG_ ReSideRdrLe20Obj16ObjBoxCenterLat : 111|9@0+ (0.1,-25.0) [-25.0|25.0] "m" ASDM
 SG_ ReSideRdrLe20Obj16ObjBoxCenterLgt : 23|9@0+ (0.1,-25.0) [-25.0|25.0] "m" ASDM
 SG_ ReSideRdrLe20Obj16ObservationHist : 79|32@0+ (1.0,0.0) [0.0|4294967295.0] "Unitless" ASDM
 SG_ ReSideRdrLe20Obj16QualityBits : 127|18@0+ (1.0,0.0) [0.0|262143.0] "Unitless" ASDM
 SG_ ReSideRdrLe20Obj16RdrObjAx : 55|8@0- (0.1,0.0) [-12.8|12.700000000000001] "m/s^2" ASDM
 SG_ ReSideRdrLe20Obj16RdrObjAy : 63|8@0- (0.1,0.0) [-12.8|12.700000000000001] "m/s^2" ASDM
 SG_ ReSideRdrLe20Obj16RdrObjBoxLength : 151|9@0+ (0.1,0.0) [0.0|50.0] "m" ASDM
 SG_ ReSideRdrLe20Obj16RdrObjBoxWidth : 279|9@0+ (0.1,0.0) [0.0|50.0] "m" ASDM
 SG_ ReSideRdrLe20Obj16RdrObjChks : 7|8@0+ (1.0,0.0) [0.0|255.0] "Unitless" ASDM
 SG_ ReSideRdrLe20Obj16RdrObjCntr : 15|4@0+ (1.0,0.0) [0.0|15.0] "Unitless" ASDM
 SG_ ReSideRdrLe20Obj16RdrObjCoastCnt : 158|5@0+ (1.0,0.0) [0.0|31.0] "Unitless" ASDM
 SG_ ReSideRdrLe20Obj16RdrObjConf : 11|4@0+ (7.0,0.0) [0.0|105.0] "%" ASDM
 SG_ ReSideRdrLe20Obj16RdrObjDx : 207|13@0+ (0.05,-200.0) [-200.0|200.0] "m" ASDM
 SG_ ReSideRdrLe20Obj16RdrObjDxStdDe : 71|8@0+ (0.05,0.0) [0.0|12.700000000000001] "m" ASDM
 SG_ ReSideRdrLe20Obj16RdrObjDy : 295|13@0+ (0.05,-200.0) [-200.0|200.0] "m" ASDM
 SG_ ReSideRdrLe20Obj16RdrObjDyStdDe : 167|8@0+ (0.05,0.0) [0.0|12.700000000000001] "m" ASDM
 SG_ ReSideRdrLe20Obj16RdrObjElevnConf : 43|4@0+ (7.0,0.0) [0.0|105.0] "%" ASDM
 SG_ ReSideRdrLe20Obj16RdrObjElevnSts : 153|2@0+ (1,0) [0|3] "" ASDM
 SG_ ReSideRdrLe20Obj16RdrObjID : 223|8@0+ (1.0,0.0) [0.0|255.0] "Unitless" ASDM
 SG_ ReSideRdrLe20Obj16RdrObjIsInFreeSpace : 280|1@0+ (1,0) [0|1] "" ASDM
 SG_ ReSideRdrLe20Obj16RdrObjMirrProblty : 263|4@0+ (7.0,0.0) [0.0|105.0] "%" ASDM
 SG_ ReSideRdrLe20Obj16RdrObjMtnPat : 210|3@0+ (1,0) [0|7] "" ASDM
 SG_ ReSideRdrLe20Obj16RdrObjNotRealProblty : 259|4@0+ (7.0,0.0) [0.0|105.0] "%" ASDM
 SG_ ReSideRdrLe20Obj16RdrObjStatyCnt : 30|7@0+ (1.0,0.0) [0.0|127.0] "Unitless" ASDM
 SG_ ReSideRdrLe20Obj16RdrObjTiAlv : 118|7@0+ (1.0,0.0) [0.0|127.0] "Unitless" ASDM
 SG_ ReSideRdrLe20Obj16RdrObjTrackSts : 177|2@0+ (1,0) [0|3] "" ASDM
 SG_ ReSideRdrLe20Obj16RdrObjTyp : 235|4@0+ (1,0) [0|15] "" ASDM
 SG_ ReSideRdrLe20Obj16RdrObjTypConfBike : 251|4@0+ (7.0,0.0) [0.0|105.0] "%" ASDM
 SG_ ReSideRdrLe20Obj16RdrObjTypConfPed : 271|4@0+ (7.0,0.0) [0.0|105.0] "%" ASDM
 SG_ ReSideRdrLe20Obj16RdrObjTypConfVeh : 267|4@0+ (7.0,0.0) [0.0|105.0] "%" ASDM
 SG_ ReSideRdrLe20Obj16RdrObjUsedTracker : 193|2@0+ (1,0) [0|3] "" ASDM
 SG_ ReSideRdrLe20Obj16RdrObjVx : 175|14@0+ (0.02,-128.0) [-128.0|128.0] "m/s" ASDM
 SG_ ReSideRdrLe20Obj16RdrObjVxStdDe : 141|6@0+ (0.05,0.0) [0.0|2.0] "m/s" ASDM
 SG_ ReSideRdrLe20Obj16RdrObjVy : 191|14@0+ (0.02,-128.0) [-128.0|128.0] "m/s" ASDM
 SG_ ReSideRdrLe20Obj16RdrObjVyStdDe : 286|6@0+ (0.05,0.0) [0.0|2.0] "m/s" ASDM
 SG_ ReSideRdrLe20Obj16RelVx : 231|12@0+ (0.02,-35.6) [-35.6|35.6] "m/s" ASDM
 SG_ ReSideRdrLe20Obj16RelVy : 247|12@0+ (0.02,-35.6) [-35.6|35.6] "m/s" ASDM

BO_ 1047 SODLPrivateCANFD5Fr17 : 64 SODL
 SG_ ReSideRdrLe20Obj17_UB : 298|1@0+ (1,0) [0|1] "" ASDM
 SG_ ReSideRdrLe20Obj17Heading : 39|12@0+ (0.1,-180.0) [-180.0|180.0] "Deg" ASDM
 SG_ ReSideRdrLe20Obj17ObjBoxCenterLat : 111|9@0+ (0.1,-25.0) [-25.0|25.0] "m" ASDM
 SG_ ReSideRdrLe20Obj17ObjBoxCenterLgt : 23|9@0+ (0.1,-25.0) [-25.0|25.0] "m" ASDM
 SG_ ReSideRdrLe20Obj17ObservationHist : 79|32@0+ (1.0,0.0) [0.0|4294967295.0] "Unitless" ASDM
 SG_ ReSideRdrLe20Obj17QualityBits : 127|18@0+ (1.0,0.0) [0.0|262143.0] "Unitless" ASDM
 SG_ ReSideRdrLe20Obj17RdrObjAx : 55|8@0- (0.1,0.0) [-12.8|12.700000000000001] "m/s^2" ASDM
 SG_ ReSideRdrLe20Obj17RdrObjAy : 63|8@0- (0.1,0.0) [-12.8|12.700000000000001] "m/s^2" ASDM
 SG_ ReSideRdrLe20Obj17RdrObjBoxLength : 151|9@0+ (0.1,0.0) [0.0|50.0] "m" ASDM
 SG_ ReSideRdrLe20Obj17RdrObjBoxWidth : 279|9@0+ (0.1,0.0) [0.0|50.0] "m" ASDM
 SG_ ReSideRdrLe20Obj17RdrObjChks : 7|8@0+ (1.0,0.0) [0.0|255.0] "Unitless" ASDM
 SG_ ReSideRdrLe20Obj17RdrObjCntr : 15|4@0+ (1.0,0.0) [0.0|15.0] "Unitless" ASDM
 SG_ ReSideRdrLe20Obj17RdrObjCoastCnt : 158|5@0+ (1.0,0.0) [0.0|31.0] "Unitless" ASDM
 SG_ ReSideRdrLe20Obj17RdrObjConf : 11|4@0+ (7.0,0.0) [0.0|105.0] "%" ASDM
 SG_ ReSideRdrLe20Obj17RdrObjDx : 207|13@0+ (0.05,-200.0) [-200.0|200.0] "m" ASDM
 SG_ ReSideRdrLe20Obj17RdrObjDxStdDe : 71|8@0+ (0.05,0.0) [0.0|12.700000000000001] "m" ASDM
 SG_ ReSideRdrLe20Obj17RdrObjDy : 295|13@0+ (0.05,-200.0) [-200.0|200.0] "m" ASDM
 SG_ ReSideRdrLe20Obj17RdrObjDyStdDe : 167|8@0+ (0.05,0.0) [0.0|12.700000000000001] "m" ASDM
 SG_ ReSideRdrLe20Obj17RdrObjElevnConf : 43|4@0+ (7.0,0.0) [0.0|105.0] "%" ASDM
 SG_ ReSideRdrLe20Obj17RdrObjElevnSts : 153|2@0+ (1,0) [0|3] "" ASDM
 SG_ ReSideRdrLe20Obj17RdrObjID : 223|8@0+ (1.0,0.0) [0.0|255.0] "Unitless" ASDM
 SG_ ReSideRdrLe20Obj17RdrObjIsInFreeSpace : 280|1@0+ (1,0) [0|1] "" ASDM
 SG_ ReSideRdrLe20Obj17RdrObjMirrProblty : 263|4@0+ (7.0,0.0) [0.0|105.0] "%" ASDM
 SG_ ReSideRdrLe20Obj17RdrObjMtnPat : 210|3@0+ (1,0) [0|7] "" ASDM
 SG_ ReSideRdrLe20Obj17RdrObjNotRealProblty : 259|4@0+ (7.0,0.0) [0.0|105.0] "%" ASDM
 SG_ ReSideRdrLe20Obj17RdrObjStatyCnt : 30|7@0+ (1.0,0.0) [0.0|127.0] "Unitless" ASDM
 SG_ ReSideRdrLe20Obj17RdrObjTiAlv : 118|7@0+ (1.0,0.0) [0.0|127.0] "Unitless" ASDM
 SG_ ReSideRdrLe20Obj17RdrObjTrackSts : 177|2@0+ (1,0) [0|3] "" ASDM
 SG_ ReSideRdrLe20Obj17RdrObjTyp : 235|4@0+ (1,0) [0|15] "" ASDM
 SG_ ReSideRdrLe20Obj17RdrObjTypConfBike : 251|4@0+ (7.0,0.0) [0.0|105.0] "%" ASDM
 SG_ ReSideRdrLe20Obj17RdrObjTypConfPed : 271|4@0+ (7.0,0.0) [0.0|105.0] "%" ASDM
 SG_ ReSideRdrLe20Obj17RdrObjTypConfVeh : 267|4@0+ (7.0,0.0) [0.0|105.0] "%" ASDM
 SG_ ReSideRdrLe20Obj17RdrObjUsedTracker : 193|2@0+ (1,0) [0|3] "" ASDM
 SG_ ReSideRdrLe20Obj17RdrObjVx : 175|14@0+ (0.02,-128.0) [-128.0|128.0] "m/s" ASDM
 SG_ ReSideRdrLe20Obj17RdrObjVxStdDe : 141|6@0+ (0.05,0.0) [0.0|2.0] "m/s" ASDM
 SG_ ReSideRdrLe20Obj17RdrObjVy : 191|14@0+ (0.02,-128.0) [-128.0|128.0] "m/s" ASDM
 SG_ ReSideRdrLe20Obj17RdrObjVyStdDe : 286|6@0+ (0.05,0.0) [0.0|2.0] "m/s" ASDM
 SG_ ReSideRdrLe20Obj17RelVx : 231|12@0+ (0.02,-35.6) [-35.6|35.6] "m/s" ASDM
 SG_ ReSideRdrLe20Obj17RelVy : 247|12@0+ (0.02,-35.6) [-35.6|35.6] "m/s" ASDM

BO_ 1048 SODLPrivateCANFD5Fr18 : 64 SODL
 SG_ ReSideRdrLe20Obj18_UB : 298|1@0+ (1,0) [0|1] "" ASDM
 SG_ ReSideRdrLe20Obj18Heading : 39|12@0+ (0.1,-180.0) [-180.0|180.0] "Deg" ASDM
 SG_ ReSideRdrLe20Obj18ObjBoxCenterLat : 111|9@0+ (0.1,-25.0) [-25.0|25.0] "m" ASDM
 SG_ ReSideRdrLe20Obj18ObjBoxCenterLgt : 23|9@0+ (0.1,-25.0) [-25.0|25.0] "m" ASDM
 SG_ ReSideRdrLe20Obj18ObservationHist : 79|32@0+ (1.0,0.0) [0.0|4294967295.0] "Unitless" ASDM
 SG_ ReSideRdrLe20Obj18QualityBits : 127|18@0+ (1.0,0.0) [0.0|262143.0] "Unitless" ASDM
 SG_ ReSideRdrLe20Obj18RdrObjAx : 55|8@0- (0.1,0.0) [-12.8|12.700000000000001] "m/s^2" ASDM
 SG_ ReSideRdrLe20Obj18RdrObjAy : 63|8@0- (0.1,0.0) [-12.8|12.700000000000001] "m/s^2" ASDM
 SG_ ReSideRdrLe20Obj18RdrObjBoxLength : 151|9@0+ (0.1,0.0) [0.0|50.0] "m" ASDM
 SG_ ReSideRdrLe20Obj18RdrObjBoxWidth : 279|9@0+ (0.1,0.0) [0.0|50.0] "m" ASDM
 SG_ ReSideRdrLe20Obj18RdrObjChks : 7|8@0+ (1.0,0.0) [0.0|255.0] "Unitless" ASDM
 SG_ ReSideRdrLe20Obj18RdrObjCntr : 15|4@0+ (1.0,0.0) [0.0|15.0] "Unitless" ASDM
 SG_ ReSideRdrLe20Obj18RdrObjCoastCnt : 158|5@0+ (1.0,0.0) [0.0|31.0] "Unitless" ASDM
 SG_ ReSideRdrLe20Obj18RdrObjConf : 11|4@0+ (7.0,0.0) [0.0|105.0] "%" ASDM
 SG_ ReSideRdrLe20Obj18RdrObjDx : 207|13@0+ (0.05,-200.0) [-200.0|200.0] "m" ASDM
 SG_ ReSideRdrLe20Obj18RdrObjDxStdDe : 71|8@0+ (0.05,0.0) [0.0|12.700000000000001] "m" ASDM
 SG_ ReSideRdrLe20Obj18RdrObjDy : 295|13@0+ (0.05,-200.0) [-200.0|200.0] "m" ASDM
 SG_ ReSideRdrLe20Obj18RdrObjDyStdDe : 167|8@0+ (0.05,0.0) [0.0|12.700000000000001] "m" ASDM
 SG_ ReSideRdrLe20Obj18RdrObjElevnConf : 43|4@0+ (7.0,0.0) [0.0|105.0] "%" ASDM
 SG_ ReSideRdrLe20Obj18RdrObjElevnSts : 153|2@0+ (1,0) [0|3] "" ASDM
 SG_ ReSideRdrLe20Obj18RdrObjID : 223|8@0+ (1.0,0.0) [0.0|255.0] "Unitless" ASDM
 SG_ ReSideRdrLe20Obj18RdrObjIsInFreeSpace : 280|1@0+ (1,0) [0|1] "" ASDM
 SG_ ReSideRdrLe20Obj18RdrObjMirrProblty : 263|4@0+ (7.0,0.0) [0.0|105.0] "%" ASDM
 SG_ ReSideRdrLe20Obj18RdrObjMtnPat : 210|3@0+ (1,0) [0|7] "" ASDM
 SG_ ReSideRdrLe20Obj18RdrObjNotRealProblty : 259|4@0+ (7.0,0.0) [0.0|105.0] "%" ASDM
 SG_ ReSideRdrLe20Obj18RdrObjStatyCnt : 30|7@0+ (1.0,0.0) [0.0|127.0] "Unitless" ASDM
 SG_ ReSideRdrLe20Obj18RdrObjTiAlv : 118|7@0+ (1.0,0.0) [0.0|127.0] "Unitless" ASDM
 SG_ ReSideRdrLe20Obj18RdrObjTrackSts : 177|2@0+ (1,0) [0|3] "" ASDM
 SG_ ReSideRdrLe20Obj18RdrObjTyp : 235|4@0+ (1,0) [0|15] "" ASDM
 SG_ ReSideRdrLe20Obj18RdrObjTypConfBike : 251|4@0+ (7.0,0.0) [0.0|105.0] "%" ASDM
 SG_ ReSideRdrLe20Obj18RdrObjTypConfPed : 271|4@0+ (7.0,0.0) [0.0|105.0] "%" ASDM
 SG_ ReSideRdrLe20Obj18RdrObjTypConfVeh : 267|4@0+ (7.0,0.0) [0.0|105.0] "%" ASDM
 SG_ ReSideRdrLe20Obj18RdrObjUsedTracker : 193|2@0+ (1,0) [0|3] "" ASDM
 SG_ ReSideRdrLe20Obj18RdrObjVx : 175|14@0+ (0.02,-128.0) [-128.0|128.0] "m/s" ASDM
 SG_ ReSideRdrLe20Obj18RdrObjVxStdDe : 141|6@0+ (0.05,0.0) [0.0|2.0] "m/s" ASDM
 SG_ ReSideRdrLe20Obj18RdrObjVy : 191|14@0+ (0.02,-128.0) [-128.0|128.0] "m/s" ASDM
 SG_ ReSideRdrLe20Obj18RdrObjVyStdDe : 286|6@0+ (0.05,0.0) [0.0|2.0] "m/s" ASDM
 SG_ ReSideRdrLe20Obj18RelVx : 231|12@0+ (0.02,-35.6) [-35.6|35.6] "m/s" ASDM
 SG_ ReSideRdrLe20Obj18RelVy : 247|12@0+ (0.02,-35.6) [-35.6|35.6] "m/s" ASDM

BO_ 1049 SODLPrivateCANFD5Fr19 : 64 SODL
 SG_ ReSideRdrLe20Obj19_UB : 298|1@0+ (1,0) [0|1] "" ASDM
 SG_ ReSideRdrLe20Obj19Heading : 39|12@0+ (0.1,-180.0) [-180.0|180.0] "Deg" ASDM
 SG_ ReSideRdrLe20Obj19ObjBoxCenterLat : 111|9@0+ (0.1,-25.0) [-25.0|25.0] "m" ASDM
 SG_ ReSideRdrLe20Obj19ObjBoxCenterLgt : 23|9@0+ (0.1,-25.0) [-25.0|25.0] "m" ASDM
 SG_ ReSideRdrLe20Obj19ObservationHist : 79|32@0+ (1.0,0.0) [0.0|4294967295.0] "Unitless" ASDM
 SG_ ReSideRdrLe20Obj19QualityBits : 127|18@0+ (1.0,0.0) [0.0|262143.0] "Unitless" ASDM
 SG_ ReSideRdrLe20Obj19RdrObjAx : 55|8@0- (0.1,0.0) [-12.8|12.700000000000001] "m/s^2" ASDM
 SG_ ReSideRdrLe20Obj19RdrObjAy : 63|8@0- (0.1,0.0) [-12.8|12.700000000000001] "m/s^2" ASDM
 SG_ ReSideRdrLe20Obj19RdrObjBoxLength : 151|9@0+ (0.1,0.0) [0.0|50.0] "m" ASDM
 SG_ ReSideRdrLe20Obj19RdrObjBoxWidth : 279|9@0+ (0.1,0.0) [0.0|50.0] "m" ASDM
 SG_ ReSideRdrLe20Obj19RdrObjChks : 7|8@0+ (1.0,0.0) [0.0|255.0] "Unitless" ASDM
 SG_ ReSideRdrLe20Obj19RdrObjCntr : 15|4@0+ (1.0,0.0) [0.0|15.0] "Unitless" ASDM
 SG_ ReSideRdrLe20Obj19RdrObjCoastCnt : 158|5@0+ (1.0,0.0) [0.0|31.0] "Unitless" ASDM
 SG_ ReSideRdrLe20Obj19RdrObjConf : 11|4@0+ (7.0,0.0) [0.0|105.0] "%" ASDM
 SG_ ReSideRdrLe20Obj19RdrObjDx : 207|13@0+ (0.05,-200.0) [-200.0|200.0] "m" ASDM
 SG_ ReSideRdrLe20Obj19RdrObjDxStdDe : 71|8@0+ (0.05,0.0) [0.0|12.700000000000001] "m" ASDM
 SG_ ReSideRdrLe20Obj19RdrObjDy : 295|13@0+ (0.05,-200.0) [-200.0|200.0] "m" ASDM
 SG_ ReSideRdrLe20Obj19RdrObjDyStdDe : 167|8@0+ (0.05,0.0) [0.0|12.700000000000001] "m" ASDM
 SG_ ReSideRdrLe20Obj19RdrObjElevnConf : 43|4@0+ (7.0,0.0) [0.0|105.0] "%" ASDM
 SG_ ReSideRdrLe20Obj19RdrObjElevnSts : 153|2@0+ (1,0) [0|3] "" ASDM
 SG_ ReSideRdrLe20Obj19RdrObjID : 223|8@0+ (1.0,0.0) [0.0|255.0] "Unitless" ASDM
 SG_ ReSideRdrLe20Obj19RdrObjIsInFreeSpace : 280|1@0+ (1,0) [0|1] "" ASDM
 SG_ ReSideRdrLe20Obj19RdrObjMirrProblty : 263|4@0+ (7.0,0.0) [0.0|105.0] "%" ASDM
 SG_ ReSideRdrLe20Obj19RdrObjMtnPat : 210|3@0+ (1,0) [0|7] "" ASDM
 SG_ ReSideRdrLe20Obj19RdrObjNotRealProblty : 259|4@0+ (7.0,0.0) [0.0|105.0] "%" ASDM
 SG_ ReSideRdrLe20Obj19RdrObjStatyCnt : 30|7@0+ (1.0,0.0) [0.0|127.0] "Unitless" ASDM
 SG_ ReSideRdrLe20Obj19RdrObjTiAlv : 118|7@0+ (1.0,0.0) [0.0|127.0] "Unitless" ASDM
 SG_ ReSideRdrLe20Obj19RdrObjTrackSts : 177|2@0+ (1,0) [0|3] "" ASDM
 SG_ ReSideRdrLe20Obj19RdrObjTyp : 235|4@0+ (1,0) [0|15] "" ASDM
 SG_ ReSideRdrLe20Obj19RdrObjTypConfBike : 251|4@0+ (7.0,0.0) [0.0|105.0] "%" ASDM
 SG_ ReSideRdrLe20Obj19RdrObjTypConfPed : 271|4@0+ (7.0,0.0) [0.0|105.0] "%" ASDM
 SG_ ReSideRdrLe20Obj19RdrObjTypConfVeh : 267|4@0+ (7.0,0.0) [0.0|105.0] "%" ASDM
 SG_ ReSideRdrLe20Obj19RdrObjUsedTracker : 193|2@0+ (1,0) [0|3] "" ASDM
 SG_ ReSideRdrLe20Obj19RdrObjVx : 175|14@0+ (0.02,-128.0) [-128.0|128.0] "m/s" ASDM
 SG_ ReSideRdrLe20Obj19RdrObjVxStdDe : 141|6@0+ (0.05,0.0) [0.0|2.0] "m/s" ASDM
 SG_ ReSideRdrLe20Obj19RdrObjVy : 191|14@0+ (0.02,-128.0) [-128.0|128.0] "m/s" ASDM
 SG_ ReSideRdrLe20Obj19RdrObjVyStdDe : 286|6@0+ (0.05,0.0) [0.0|2.0] "m/s" ASDM
 SG_ ReSideRdrLe20Obj19RelVx : 231|12@0+ (0.02,-35.6) [-35.6|35.6] "m/s" ASDM
 SG_ ReSideRdrLe20Obj19RelVy : 247|12@0+ (0.02,-35.6) [-35.6|35.6] "m/s" ASDM

CM_ SG_ 1032 ReSideRdrLe20Obj8Heading "Refer to the data element description in FrntSideRdrLeObj1 with the same data element name.";
CM_ SG_ 1032 ReSideRdrLe20Obj8ObjBoxCenterLat "Refer to the data element description in FrntSideRdrLeObj1 with the same data element name.";
CM_ SG_ 1032 ReSideRdrLe20Obj8ObjBoxCenterLgt "Refer to the data element description in FrntSideRdrLeObj1 with the same data element name.";
CM_ SG_ 1032 ReSideRdrLe20Obj8ObservationHist "Refer to the data element description in FrntSideRdrLeObj1 with the same data element name.";
CM_ SG_ 1032 ReSideRdrLe20Obj8QualityBits "Refer to the data element description in FrntSideRdrLeObj1 with the same data element name.";
CM_ SG_ 1032 ReSideRdrLe20Obj8RdrObjAx "Refer to the data element description in FrntSideRdrLeObj1 with the same data element name.";
CM_ SG_ 1032 ReSideRdrLe20Obj8RdrObjAy "Refer to the data element description in FrntSideRdrLeObj1 with the same data element name.";
CM_ SG_ 1032 ReSideRdrLe20Obj8RdrObjBoxLength "Refer to the data element description in FrntSideRdrLeObj1 with the same data element name.";
CM_ SG_ 1032 ReSideRdrLe20Obj8RdrObjBoxWidth "Refer to the data element description in FrntSideRdrLeObj1 with the same data element name.";
CM_ SG_ 1032 ReSideRdrLe20Obj8RdrObjChks "Refer to the data element description in FrntSideRdrLeObj1 with the same data element name.";
CM_ SG_ 1032 ReSideRdrLe20Obj8RdrObjCntr "Refer to the data element description in FrntSideRdrLeObj1 with the same data element name.";
CM_ SG_ 1032 ReSideRdrLe20Obj8RdrObjCoastCnt "Refer to the data element description in FrntSideRdrLeObj1 with the same data element name.";
CM_ SG_ 1032 ReSideRdrLe20Obj8RdrObjConf "Refer to the data element description in FrntSideRdrLeObj1 with the same data element name.";
CM_ SG_ 1032 ReSideRdrLe20Obj8RdrObjDx "Refer to the data element description in FrntSideRdrLeObj1 with the same data element name.";
CM_ SG_ 1032 ReSideRdrLe20Obj8RdrObjDxStdDe "Refer to the data element description in FrntSideRdrLeObj1 with the same data element name.";
CM_ SG_ 1032 ReSideRdrLe20Obj8RdrObjDy "Refer to the data element description in FrntSideRdrLeObj1 with the same data element name.";
CM_ SG_ 1032 ReSideRdrLe20Obj8RdrObjDyStdDe "Refer to the data element description in FrntSideRdrLeObj1 with the same data element name.";
CM_ SG_ 1032 ReSideRdrLe20Obj8RdrObjElevnConf "Refer to the data element description in FrntSideRdrLeObj1 with the same data element name.";
CM_ SG_ 1032 ReSideRdrLe20Obj8RdrObjElevnSts "Refer to the data element description in FrntSideRdrLeObj1 with the same data element name.";
CM_ SG_ 1032 ReSideRdrLe20Obj8RdrObjID "Refer to the data element description in FrntSideRdrLeObj1 with the same data element name.";
CM_ SG_ 1032 ReSideRdrLe20Obj8RdrObjIsInFreeSpace "Refer to the data element description in FrntSideRdrLeObj1 with the same data element name.";
CM_ SG_ 1032 ReSideRdrLe20Obj8RdrObjMirrProblty "Refer to the data element description in FrntSideRdrLeObj1 with the same data element name.";
CM_ SG_ 1032 ReSideRdrLe20Obj8RdrObjMtnPat "Refer to the data element description in FrntSideRdrLeObj1 with the same data element name.";
CM_ SG_ 1032 ReSideRdrLe20Obj8RdrObjNotRealProblty "Refer to the data element description in FrntSideRdrLeObj1 with the same data element name.";
CM_ SG_ 1032 ReSideRdrLe20Obj8RdrObjStatyCnt "Refer to the data element description in FrntSideRdrLeObj1 with the same data element name.";
CM_ SG_ 1032 ReSideRdrLe20Obj8RdrObjTiAlv "Refer to the data element description in FrntSideRdrLeObj1 with the same data element name.";
CM_ SG_ 1032 ReSideRdrLe20Obj8RdrObjTrackSts "Refer to the data element description in FrntSideRdrLeObj1 with the same data element name.";
CM_ SG_ 1032 ReSideRdrLe20Obj8RdrObjTyp "Refer to the data element description in FrntSideRdrLeObj1 with the same data element name.";
CM_ SG_ 1032 ReSideRdrLe20Obj8RdrObjTypConfBike "Refer to the data element description in FrntSideRdrLeObj1 with the same data element name.";
CM_ SG_ 1032 ReSideRdrLe20Obj8RdrObjTypConfPed "Refer to the data element description in FrntSideRdrLeObj1 with the same data element name.";
CM_ SG_ 1032 ReSideRdrLe20Obj8RdrObjTypConfVeh "Refer to the data element description in FrntSideRdrLeObj1 with the same data element name.";
CM_ SG_ 1032 ReSideRdrLe20Obj8RdrObjUsedTracker "Refer to the data element description in FrntSideRdrLeObj1 with the same data element name.";
CM_ SG_ 1032 ReSideRdrLe20Obj8RdrObjVx "Refer to the data element description in FrntSideRdrLeObj1 with the same data element name.";
CM_ SG_ 1032 ReSideRdrLe20Obj8RdrObjVxStdDe "Refer to the data element description in FrntSideRdrLeObj1 with the same data element name.";
CM_ SG_ 1032 ReSideRdrLe20Obj8RdrObjVy "Refer to the data element description in FrntSideRdrLeObj1 with the same data element name.";
CM_ SG_ 1032 ReSideRdrLe20Obj8RdrObjVyStdDe "Refer to the data element description in FrntSideRdrLeObj1 with the same data element name.";
CM_ SG_ 1032 ReSideRdrLe20Obj8RelVx "Refer to the data element description in FrntSideRdrLeObj1 with the same data element name.";
CM_ SG_ 1032 ReSideRdrLe20Obj8RelVy "Refer to the data element description in FrntSideRdrLeObj1 with the same data element name.";
CM_ SG_ 1033 ReSideRdrLe20Obj9Heading "Refer to the data element description in FrntSideRdrLeObj1 with the same data element name.";
CM_ SG_ 1033 ReSideRdrLe20Obj9ObjBoxCenterLat "Refer to the data element description in FrntSideRdrLeObj1 with the same data element name.";
CM_ SG_ 1033 ReSideRdrLe20Obj9ObjBoxCenterLgt "Refer to the data element description in FrntSideRdrLeObj1 with the same data element name.";
CM_ SG_ 1033 ReSideRdrLe20Obj9ObservationHist "Refer to the data element description in FrntSideRdrLeObj1 with the same data element name.";
CM_ SG_ 1033 ReSideRdrLe20Obj9QualityBits "Refer to the data element description in FrntSideRdrLeObj1 with the same data element name.";
CM_ SG_ 1033 ReSideRdrLe20Obj9RdrObjAx "Refer to the data element description in FrntSideRdrLeObj1 with the same data element name.";
CM_ SG_ 1033 ReSideRdrLe20Obj9RdrObjAy "Refer to the data element description in FrntSideRdrLeObj1 with the same data element name.";
CM_ SG_ 1033 ReSideRdrLe20Obj9RdrObjBoxLength "Refer to the data element description in FrntSideRdrLeObj1 with the same data element name.";
CM_ SG_ 1033 ReSideRdrLe20Obj9RdrObjBoxWidth "Refer to the data element description in FrntSideRdrLeObj1 with the same data element name.";
CM_ SG_ 1033 ReSideRdrLe20Obj9RdrObjChks "Refer to the data element description in FrntSideRdrLeObj1 with the same data element name.";
CM_ SG_ 1033 ReSideRdrLe20Obj9RdrObjCntr "Refer to the data element description in FrntSideRdrLeObj1 with the same data element name.";
CM_ SG_ 1033 ReSideRdrLe20Obj9RdrObjCoastCnt "Refer to the data element description in FrntSideRdrLeObj1 with the same data element name.";
CM_ SG_ 1033 ReSideRdrLe20Obj9RdrObjConf "Refer to the data element description in FrntSideRdrLeObj1 with the same data element name.";
CM_ SG_ 1033 ReSideRdrLe20Obj9RdrObjDx "Refer to the data element description in FrntSideRdrLeObj1 with the same data element name.";
CM_ SG_ 1033 ReSideRdrLe20Obj9RdrObjDxStdDe "Refer to the data element description in FrntSideRdrLeObj1 with the same data element name.";
CM_ SG_ 1033 ReSideRdrLe20Obj9RdrObjDy "Refer to the data element description in FrntSideRdrLeObj1 with the same data element name.";
CM_ SG_ 1033 ReSideRdrLe20Obj9RdrObjDyStdDe "Refer to the data element description in FrntSideRdrLeObj1 with the same data element name.";
CM_ SG_ 1033 ReSideRdrLe20Obj9RdrObjElevnConf "Refer to the data element description in FrntSideRdrLeObj1 with the same data element name.";
CM_ SG_ 1033 ReSideRdrLe20Obj9RdrObjElevnSts "Refer to the data element description in FrntSideRdrLeObj1 with the same data element name.";
CM_ SG_ 1033 ReSideRdrLe20Obj9RdrObjID "Refer to the data element description in FrntSideRdrLeObj1 with the same data element name.";
CM_ SG_ 1033 ReSideRdrLe20Obj9RdrObjIsInFreeSpace "Refer to the data element description in FrntSideRdrLeObj1 with the same data element name.";
CM_ SG_ 1033 ReSideRdrLe20Obj9RdrObjMirrProblty "Refer to the data element description in FrntSideRdrLeObj1 with the same data element name.";
CM_ SG_ 1033 ReSideRdrLe20Obj9RdrObjMtnPat "Refer to the data element description in FrntSideRdrLeObj1 with the same data element name.";
CM_ SG_ 1033 ReSideRdrLe20Obj9RdrObjNotRealProblty "Refer to the data element description in FrntSideRdrLeObj1 with the same data element name.";
CM_ SG_ 1033 ReSideRdrLe20Obj9RdrObjStatyCnt "Refer to the data element description in FrntSideRdrLeObj1 with the same data element name.";
CM_ SG_ 1033 ReSideRdrLe20Obj9RdrObjTiAlv "Refer to the data element description in FrntSideRdrLeObj1 with the same data element name.";
CM_ SG_ 1033 ReSideRdrLe20Obj9RdrObjTrackSts "Refer to the data element description in FrntSideRdrLeObj1 with the same data element name.";
CM_ SG_ 1033 ReSideRdrLe20Obj9RdrObjTyp "Refer to the data element description in FrntSideRdrLeObj1 with the same data element name.";
CM_ SG_ 1033 ReSideRdrLe20Obj9RdrObjTypConfBike "Refer to the data element description in FrntSideRdrLeObj1 with the same data element name.";
CM_ SG_ 1033 ReSideRdrLe20Obj9RdrObjTypConfPed "Refer to the data element description in FrntSideRdrLeObj1 with the same data element name.";
CM_ SG_ 1033 ReSideRdrLe20Obj9RdrObjTypConfVeh "Refer to the data element description in FrntSideRdrLeObj1 with the same data element name.";
CM_ SG_ 1033 ReSideRdrLe20Obj9RdrObjUsedTracker "Refer to the data element description in FrntSideRdrLeObj1 with the same data element name.";
CM_ SG_ 1033 ReSideRdrLe20Obj9RdrObjVx "Refer to the data element description in FrntSideRdrLeObj1 with the same data element name.";
CM_ SG_ 1033 ReSideRdrLe20Obj9RdrObjVxStdDe "Refer to the data element description in FrntSideRdrLeObj1 with the same data element name.";
CM_ SG_ 1033 ReSideRdrLe20Obj9RdrObjVy "Refer to the data element description in FrntSideRdrLeObj1 with the same data element name.";
CM_ SG_ 1033 ReSideRdrLe20Obj9RdrObjVyStdDe "Refer to the data element description in FrntSideRdrLeObj1 with the same data element name.";
CM_ SG_ 1033 ReSideRdrLe20Obj9RelVx "Refer to the data element description in FrntSideRdrLeObj1 with the same data element name.";
CM_ SG_ 1033 ReSideRdrLe20Obj9RelVy "Refer to the data element description in FrntSideRdrLeObj1 with the same data element name.";
CM_ SG_ 1040 ReSideRdrLe20Obj10Heading "Refer to the data element description in FrntSideRdrLeObj1 with the same data element name.";
CM_ SG_ 1040 ReSideRdrLe20Obj10ObjBoxCenterLat "Refer to the data element description in FrntSideRdrLeObj1 with the same data element name.";
CM_ SG_ 1040 ReSideRdrLe20Obj10ObjBoxCenterLgt "Refer to the data element description in FrntSideRdrLeObj1 with the same data element name.";
CM_ SG_ 1040 ReSideRdrLe20Obj10ObservationHist "Refer to the data element description in FrntSideRdrLeObj1 with the same data element name.";
CM_ SG_ 1040 ReSideRdrLe20Obj10QualityBits "Refer to the data element description in FrntSideRdrLeObj1 with the same data element name.";
CM_ SG_ 1040 ReSideRdrLe20Obj10RdrObjAx "Refer to the data element description in FrntSideRdrLeObj1 with the same data element name.";
CM_ SG_ 1040 ReSideRdrLe20Obj10RdrObjAy "Refer to the data element description in FrntSideRdrLeObj1 with the same data element name.";
CM_ SG_ 1040 ReSideRdrLe20Obj10RdrObjBoxLength "Refer to the data element description in FrntSideRdrLeObj1 with the same data element name.";
CM_ SG_ 1040 ReSideRdrLe20Obj10RdrObjBoxWidth "Refer to the data element description in FrntSideRdrLeObj1 with the same data element name.";
CM_ SG_ 1040 ReSideRdrLe20Obj10RdrObjChks "Refer to the data element description in FrntSideRdrLeObj1 with the same data element name.";
CM_ SG_ 1040 ReSideRdrLe20Obj10RdrObjCntr "Refer to the data element description in FrntSideRdrLeObj1 with the same data element name.";
CM_ SG_ 1040 ReSideRdrLe20Obj10RdrObjCoastCnt "Refer to the data element description in FrntSideRdrLeObj1 with the same data element name.";
CM_ SG_ 1040 ReSideRdrLe20Obj10RdrObjConf "Refer to the data element description in FrntSideRdrLeObj1 with the same data element name.";
CM_ SG_ 1040 ReSideRdrLe20Obj10RdrObjDx "Refer to the data element description in FrntSideRdrLeObj1 with the same data element name.";
CM_ SG_ 1040 ReSideRdrLe20Obj10RdrObjDxStdDe "Refer to the data element description in FrntSideRdrLeObj1 with the same data element name.";
CM_ SG_ 1040 ReSideRdrLe20Obj10RdrObjDy "Refer to the data element description in FrntSideRdrLeObj1 with the same data element name.";
CM_ SG_ 1040 ReSideRdrLe20Obj10RdrObjDyStdDe "Refer to the data element description in FrntSideRdrLeObj1 with the same data element name.";
CM_ SG_ 1040 ReSideRdrLe20Obj10RdrObjElevnConf "Refer to the data element description in FrntSideRdrLeObj1 with the same data element name.";
CM_ SG_ 1040 ReSideRdrLe20Obj10RdrObjElevnSts "Refer to the data element description in FrntSideRdrLeObj1 with the same data element name.";
CM_ SG_ 1040 ReSideRdrLe20Obj10RdrObjID "Refer to the data element description in FrntSideRdrLeObj1 with the same data element name.";
CM_ SG_ 1040 ReSideRdrLe20Obj10RdrObjIsInFreeSpace "Refer to the data element description in FrntSideRdrLeObj1 with the same data element name.";
CM_ SG_ 1040 ReSideRdrLe20Obj10RdrObjMirrProblty "Refer to the data element description in FrntSideRdrLeObj1 with the same data element name.";
CM_ SG_ 1040 ReSideRdrLe20Obj10RdrObjMtnPat "Refer to the data element description in FrntSideRdrLeObj1 with the same data element name.";
CM_ SG_ 1040 ReSideRdrLe20Obj10RdrObjNotRealProblty "Refer to the data element description in FrntSideRdrLeObj1 with the same data element name.";
CM_ SG_ 1040 ReSideRdrLe20Obj10RdrObjStatyCnt "Refer to the data element description in FrntSideRdrLeObj1 with the same data element name.";
CM_ SG_ 1040 ReSideRdrLe20Obj10RdrObjTiAlv "Refer to the data element description in FrntSideRdrLeObj1 with the same data element name.";
CM_ SG_ 1040 ReSideRdrLe20Obj10RdrObjTrackSts "Refer to the data element description in FrntSideRdrLeObj1 with the same data element name.";
CM_ SG_ 1040 ReSideRdrLe20Obj10RdrObjTyp "Refer to the data element description in FrntSideRdrLeObj1 with the same data element name.";
CM_ SG_ 1040 ReSideRdrLe20Obj10RdrObjTypConfBike "Refer to the data element description in FrntSideRdrLeObj1 with the same data element name.";
CM_ SG_ 1040 ReSideRdrLe20Obj10RdrObjTypConfPed "Refer to the data element description in FrntSideRdrLeObj1 with the same data element name.";
CM_ SG_ 1040 ReSideRdrLe20Obj10RdrObjTypConfVeh "Refer to the data element description in FrntSideRdrLeObj1 with the same data element name.";
CM_ SG_ 1040 ReSideRdrLe20Obj10RdrObjUsedTracker "Refer to the data element description in FrntSideRdrLeObj1 with the same data element name.";
CM_ SG_ 1040 ReSideRdrLe20Obj10RdrObjVx "Refer to the data element description in FrntSideRdrLeObj1 with the same data element name.";
CM_ SG_ 1040 ReSideRdrLe20Obj10RdrObjVxStdDe "Refer to the data element description in FrntSideRdrLeObj1 with the same data element name.";
CM_ SG_ 1040 ReSideRdrLe20Obj10RdrObjVy "Refer to the data element description in FrntSideRdrLeObj1 with the same data element name.";
CM_ SG_ 1040 ReSideRdrLe20Obj10RdrObjVyStdDe "Refer to the data element description in FrntSideRdrLeObj1 with the same data element name.";
CM_ SG_ 1040 ReSideRdrLe20Obj10RelVx "Refer to the data element description in FrntSideRdrLeObj1 with the same data element name.";
CM_ SG_ 1040 ReSideRdrLe20Obj10RelVy "Refer to the data element description in FrntSideRdrLeObj1 with the same data element name.";
CM_ SG_ 1041 ReSideRdrLe20Obj11Heading "Refer to the data element description in FrntSideRdrLeObj1 with the same data element name.";
CM_ SG_ 1041 ReSideRdrLe20Obj11ObjBoxCenterLat "Refer to the data element description in FrntSideRdrLeObj1 with the same data element name.";
CM_ SG_ 1041 ReSideRdrLe20Obj11ObjBoxCenterLgt "Refer to the data element description in FrntSideRdrLeObj1 with the same data element name.";
CM_ SG_ 1041 ReSideRdrLe20Obj11ObservationHist "Refer to the data element description in FrntSideRdrLeObj1 with the same data element name.";
CM_ SG_ 1041 ReSideRdrLe20Obj11QualityBits "Refer to the data element description in FrntSideRdrLeObj1 with the same data element name.";
CM_ SG_ 1041 ReSideRdrLe20Obj11RdrObjAx "Refer to the data element description in FrntSideRdrLeObj1 with the same data element name.";
CM_ SG_ 1041 ReSideRdrLe20Obj11RdrObjAy "Refer to the data element description in FrntSideRdrLeObj1 with the same data element name.";
CM_ SG_ 1041 ReSideRdrLe20Obj11RdrObjBoxLength "Refer to the data element description in FrntSideRdrLeObj1 with the same data element name.";
CM_ SG_ 1041 ReSideRdrLe20Obj11RdrObjBoxWidth "Refer to the data element description in FrntSideRdrLeObj1 with the same data element name.";
CM_ SG_ 1041 ReSideRdrLe20Obj11RdrObjChks "Refer to the data element description in FrntSideRdrLeObj1 with the same data element name.";
CM_ SG_ 1041 ReSideRdrLe20Obj11RdrObjCntr "Refer to the data element description in FrntSideRdrLeObj1 with the same data element name.";
CM_ SG_ 1041 ReSideRdrLe20Obj11RdrObjCoastCnt "Refer to the data element description in FrntSideRdrLeObj1 with the same data element name.";
CM_ SG_ 1041 ReSideRdrLe20Obj11RdrObjConf "Refer to the data element description in FrntSideRdrLeObj1 with the same data element name.";
CM_ SG_ 1041 ReSideRdrLe20Obj11RdrObjDx "Refer to the data element description in FrntSideRdrLeObj1 with the same data element name.";
CM_ SG_ 1041 ReSideRdrLe20Obj11RdrObjDxStdDe "Refer to the data element description in FrntSideRdrLeObj1 with the same data element name.";
CM_ SG_ 1041 ReSideRdrLe20Obj11RdrObjDy "Refer to the data element description in FrntSideRdrLeObj1 with the same data element name.";
CM_ SG_ 1041 ReSideRdrLe20Obj11RdrObjDyStdDe "Refer to the data element description in FrntSideRdrLeObj1 with the same data element name.";
CM_ SG_ 1041 ReSideRdrLe20Obj11RdrObjElevnConf "Refer to the data element description in FrntSideRdrLeObj1 with the same data element name.";
CM_ SG_ 1041 ReSideRdrLe20Obj11RdrObjElevnSts "Refer to the data element description in FrntSideRdrLeObj1 with the same data element name.";
CM_ SG_ 1041 ReSideRdrLe20Obj11RdrObjID "Refer to the data element description in FrntSideRdrLeObj1 with the same data element name.";
CM_ SG_ 1041 ReSideRdrLe20Obj11RdrObjIsInFreeSpace "Refer to the data element description in FrntSideRdrLeObj1 with the same data element name.";
CM_ SG_ 1041 ReSideRdrLe20Obj11RdrObjMirrProblty "Refer to the data element description in FrntSideRdrLeObj1 with the same data element name.";
CM_ SG_ 1041 ReSideRdrLe20Obj11RdrObjMtnPat "Refer to the data element description in FrntSideRdrLeObj1 with the same data element name.";
CM_ SG_ 1041 ReSideRdrLe20Obj11RdrObjNotRealProblty "Refer to the data element description in FrntSideRdrLeObj1 with the same data element name.";
CM_ SG_ 1041 ReSideRdrLe20Obj11RdrObjStatyCnt "Refer to the data element description in FrntSideRdrLeObj1 with the same data element name.";
CM_ SG_ 1041 ReSideRdrLe20Obj11RdrObjTiAlv "Refer to the data element description in FrntSideRdrLeObj1 with the same data element name.";
CM_ SG_ 1041 ReSideRdrLe20Obj11RdrObjTrackSts "Refer to the data element description in FrntSideRdrLeObj1 with the same data element name.";
CM_ SG_ 1041 ReSideRdrLe20Obj11RdrObjTyp "Refer to the data element description in FrntSideRdrLeObj1 with the same data element name.";
CM_ SG_ 1041 ReSideRdrLe20Obj11RdrObjTypConfBike "Refer to the data element description in FrntSideRdrLeObj1 with the same data element name.";
CM_ SG_ 1041 ReSideRdrLe20Obj11RdrObjTypConfPed "Refer to the data element description in FrntSideRdrLeObj1 with the same data element name.";
CM_ SG_ 1041 ReSideRdrLe20Obj11RdrObjTypConfVeh "Refer to the data element description in FrntSideRdrLeObj1 with the same data element name.";
CM_ SG_ 1041 ReSideRdrLe20Obj11RdrObjUsedTracker "Refer to the data element description in FrntSideRdrLeObj1 with the same data element name.";
CM_ SG_ 1041 ReSideRdrLe20Obj11RdrObjVx "Refer to the data element description in FrntSideRdrLeObj1 with the same data element name.";
CM_ SG_ 1041 ReSideRdrLe20Obj11RdrObjVxStdDe "Refer to the data element description in FrntSideRdrLeObj1 with the same data element name.";
CM_ SG_ 1041 ReSideRdrLe20Obj11RdrObjVy "Refer to the data element description in FrntSideRdrLeObj1 with the same data element name.";
CM_ SG_ 1041 ReSideRdrLe20Obj11RdrObjVyStdDe "Refer to the data element description in FrntSideRdrLeObj1 with the same data element name.";
CM_ SG_ 1041 ReSideRdrLe20Obj11RelVx "Refer to the data element description in FrntSideRdrLeObj1 with the same data element name.";
CM_ SG_ 1041 ReSideRdrLe20Obj11RelVy "Refer to the data element description in FrntSideRdrLeObj1 with the same data element name.";
CM_ SG_ 1042 ReSideRdrLe20Obj12Heading "Refer to the data element description in FrntSideRdrLeObj1 with the same data element name.";
CM_ SG_ 1042 ReSideRdrLe20Obj12ObjBoxCenterLat "Refer to the data element description in FrntSideRdrLeObj1 with the same data element name.";
CM_ SG_ 1042 ReSideRdrLe20Obj12ObjBoxCenterLgt "Refer to the data element description in FrntSideRdrLeObj1 with the same data element name.";
CM_ SG_ 1042 ReSideRdrLe20Obj12ObservationHist "Refer to the data element description in FrntSideRdrLeObj1 with the same data element name.";
CM_ SG_ 1042 ReSideRdrLe20Obj12QualityBits "Refer to the data element description in FrntSideRdrLeObj1 with the same data element name.";
CM_ SG_ 1042 ReSideRdrLe20Obj12RdrObjAx "Refer to the data element description in FrntSideRdrLeObj1 with the same data element name.";
CM_ SG_ 1042 ReSideRdrLe20Obj12RdrObjAy "Refer to the data element description in FrntSideRdrLeObj1 with the same data element name.";
CM_ SG_ 1042 ReSideRdrLe20Obj12RdrObjBoxLength "Refer to the data element description in FrntSideRdrLeObj1 with the same data element name.";
CM_ SG_ 1042 ReSideRdrLe20Obj12RdrObjBoxWidth "Refer to the data element description in FrntSideRdrLeObj1 with the same data element name.";
CM_ SG_ 1042 ReSideRdrLe20Obj12RdrObjChks "Refer to the data element description in FrntSideRdrLeObj1 with the same data element name.";
CM_ SG_ 1042 ReSideRdrLe20Obj12RdrObjCntr "Refer to the data element description in FrntSideRdrLeObj1 with the same data element name.";
CM_ SG_ 1042 ReSideRdrLe20Obj12RdrObjCoastCnt "Refer to the data element description in FrntSideRdrLeObj1 with the same data element name.";
CM_ SG_ 1042 ReSideRdrLe20Obj12RdrObjConf "Refer to the data element description in FrntSideRdrLeObj1 with the same data element name.";
CM_ SG_ 1042 ReSideRdrLe20Obj12RdrObjDx "Refer to the data element description in FrntSideRdrLeObj1 with the same data element name.";
CM_ SG_ 1042 ReSideRdrLe20Obj12RdrObjDxStdDe "Refer to the data element description in FrntSideRdrLeObj1 with the same data element name.";
CM_ SG_ 1042 ReSideRdrLe20Obj12RdrObjDy "Refer to the data element description in FrntSideRdrLeObj1 with the same data element name.";
CM_ SG_ 1042 ReSideRdrLe20Obj12RdrObjDyStdDe "Refer to the data element description in FrntSideRdrLeObj1 with the same data element name.";
CM_ SG_ 1042 ReSideRdrLe20Obj12RdrObjElevnConf "Refer to the data element description in FrntSideRdrLeObj1 with the same data element name.";
CM_ SG_ 1042 ReSideRdrLe20Obj12RdrObjElevnSts "Refer to the data element description in FrntSideRdrLeObj1 with the same data element name.";
CM_ SG_ 1042 ReSideRdrLe20Obj12RdrObjID "Refer to the data element description in FrntSideRdrLeObj1 with the same data element name.";
CM_ SG_ 1042 ReSideRdrLe20Obj12RdrObjIsInFreeSpace "Refer to the data element description in FrntSideRdrLeObj1 with the same data element name.";
CM_ SG_ 1042 ReSideRdrLe20Obj12RdrObjMirrProblty "Refer to the data element description in FrntSideRdrLeObj1 with the same data element name.";
CM_ SG_ 1042 ReSideRdrLe20Obj12RdrObjMtnPat "Refer to the data element description in FrntSideRdrLeObj1 with the same data element name.";
CM_ SG_ 1042 ReSideRdrLe20Obj12RdrObjNotRealProblty "Refer to the data element description in FrntSideRdrLeObj1 with the same data element name.";
CM_ SG_ 1042 ReSideRdrLe20Obj12RdrObjStatyCnt "Refer to the data element description in FrntSideRdrLeObj1 with the same data element name.";
CM_ SG_ 1042 ReSideRdrLe20Obj12RdrObjTiAlv "Refer to the data element description in FrntSideRdrLeObj1 with the same data element name.";
CM_ SG_ 1042 ReSideRdrLe20Obj12RdrObjTrackSts "Refer to the data element description in FrntSideRdrLeObj1 with the same data element name.";
CM_ SG_ 1042 ReSideRdrLe20Obj12RdrObjTyp "Refer to the data element description in FrntSideRdrLeObj1 with the same data element name.";
CM_ SG_ 1042 ReSideRdrLe20Obj12RdrObjTypConfBike "Refer to the data element description in FrntSideRdrLeObj1 with the same data element name.";
CM_ SG_ 1042 ReSideRdrLe20Obj12RdrObjTypConfPed "Refer to the data element description in FrntSideRdrLeObj1 with the same data element name.";
CM_ SG_ 1042 ReSideRdrLe20Obj12RdrObjTypConfVeh "Refer to the data element description in FrntSideRdrLeObj1 with the same data element name.";
CM_ SG_ 1042 ReSideRdrLe20Obj12RdrObjUsedTracker "Refer to the data element description in FrntSideRdrLeObj1 with the same data element name.";
CM_ SG_ 1042 ReSideRdrLe20Obj12RdrObjVx "Refer to the data element description in FrntSideRdrLeObj1 with the same data element name.";
CM_ SG_ 1042 ReSideRdrLe20Obj12RdrObjVxStdDe "Refer to the data element description in FrntSideRdrLeObj1 with the same data element name.";
CM_ SG_ 1042 ReSideRdrLe20Obj12RdrObjVy "Refer to the data element description in FrntSideRdrLeObj1 with the same data element name.";
CM_ SG_ 1042 ReSideRdrLe20Obj12RdrObjVyStdDe "Refer to the data element description in FrntSideRdrLeObj1 with the same data element name.";
CM_ SG_ 1042 ReSideRdrLe20Obj12RelVx "Refer to the data element description in FrntSideRdrLeObj1 with the same data element name.";
CM_ SG_ 1042 ReSideRdrLe20Obj12RelVy "Refer to the data element description in FrntSideRdrLeObj1 with the same data element name.";
CM_ SG_ 1043 ReSideRdrLe20Obj13Heading "Refer to the data element description in FrntSideRdrLeObj1 with the same data element name.";
CM_ SG_ 1043 ReSideRdrLe20Obj13ObjBoxCenterLat "Refer to the data element description in FrntSideRdrLeObj1 with the same data element name.";
CM_ SG_ 1043 ReSideRdrLe20Obj13ObjBoxCenterLgt "Refer to the data element description in FrntSideRdrLeObj1 with the same data element name.";
CM_ SG_ 1043 ReSideRdrLe20Obj13ObservationHist "Refer to the data element description in FrntSideRdrLeObj1 with the same data element name.";
CM_ SG_ 1043 ReSideRdrLe20Obj13QualityBits "Refer to the data element description in FrntSideRdrLeObj1 with the same data element name.";
CM_ SG_ 1043 ReSideRdrLe20Obj13RdrObjAx "Refer to the data element description in FrntSideRdrLeObj1 with the same data element name.";
CM_ SG_ 1043 ReSideRdrLe20Obj13RdrObjAy "Refer to the data element description in FrntSideRdrLeObj1 with the same data element name.";
CM_ SG_ 1043 ReSideRdrLe20Obj13RdrObjBoxLength "Refer to the data element description in FrntSideRdrLeObj1 with the same data element name.";
CM_ SG_ 1043 ReSideRdrLe20Obj13RdrObjBoxWidth "Refer to the data element description in FrntSideRdrLeObj1 with the same data element name.";
CM_ SG_ 1043 ReSideRdrLe20Obj13RdrObjChks "Refer to the data element description in FrntSideRdrLeObj1 with the same data element name.";
CM_ SG_ 1043 ReSideRdrLe20Obj13RdrObjCntr "Refer to the data element description in FrntSideRdrLeObj1 with the same data element name.";
CM_ SG_ 1043 ReSideRdrLe20Obj13RdrObjCoastCnt "Refer to the data element description in FrntSideRdrLeObj1 with the same data element name.";
CM_ SG_ 1043 ReSideRdrLe20Obj13RdrObjConf "Refer to the data element description in FrntSideRdrLeObj1 with the same data element name.";
CM_ SG_ 1043 ReSideRdrLe20Obj13RdrObjDx "Refer to the data element description in FrntSideRdrLeObj1 with the same data element name.";
CM_ SG_ 1043 ReSideRdrLe20Obj13RdrObjDxStdDe "Refer to the data element description in FrntSideRdrLeObj1 with the same data element name.";
CM_ SG_ 1043 ReSideRdrLe20Obj13RdrObjDy "Refer to the data element description in FrntSideRdrLeObj1 with the same data element name.";
CM_ SG_ 1043 ReSideRdrLe20Obj13RdrObjDyStdDe "Refer to the data element description in FrntSideRdrLeObj1 with the same data element name.";
CM_ SG_ 1043 ReSideRdrLe20Obj13RdrObjElevnConf "Refer to the data element description in FrntSideRdrLeObj1 with the same data element name.";
CM_ SG_ 1043 ReSideRdrLe20Obj13RdrObjElevnSts "Refer to the data element description in FrntSideRdrLeObj1 with the same data element name.";
CM_ SG_ 1043 ReSideRdrLe20Obj13RdrObjID "Refer to the data element description in FrntSideRdrLeObj1 with the same data element name.";
CM_ SG_ 1043 ReSideRdrLe20Obj13RdrObjIsInFreeSpace "Refer to the data element description in FrntSideRdrLeObj1 with the same data element name.";
CM_ SG_ 1043 ReSideRdrLe20Obj13RdrObjMirrProblty "Refer to the data element description in FrntSideRdrLeObj1 with the same data element name.";
CM_ SG_ 1043 ReSideRdrLe20Obj13RdrObjMtnPat "Refer to the data element description in FrntSideRdrLeObj1 with the same data element name.";
CM_ SG_ 1043 ReSideRdrLe20Obj13RdrObjNotRealProblty "Refer to the data element description in FrntSideRdrLeObj1 with the same data element name.";
CM_ SG_ 1043 ReSideRdrLe20Obj13RdrObjStatyCnt "Refer to the data element description in FrntSideRdrLeObj1 with the same data element name.";
CM_ SG_ 1043 ReSideRdrLe20Obj13RdrObjTiAlv "Refer to the data element description in FrntSideRdrLeObj1 with the same data element name.";
CM_ SG_ 1043 ReSideRdrLe20Obj13RdrObjTrackSts "Refer to the data element description in FrntSideRdrLeObj1 with the same data element name.";
CM_ SG_ 1043 ReSideRdrLe20Obj13RdrObjTyp "Refer to the data element description in FrntSideRdrLeObj1 with the same data element name.";
CM_ SG_ 1043 ReSideRdrLe20Obj13RdrObjTypConfBike "Refer to the data element description in FrntSideRdrLeObj1 with the same data element name.";
CM_ SG_ 1043 ReSideRdrLe20Obj13RdrObjTypConfPed "Refer to the data element description in FrntSideRdrLeObj1 with the same data element name.";
CM_ SG_ 1043 ReSideRdrLe20Obj13RdrObjTypConfVeh "Refer to the data element description in FrntSideRdrLeObj1 with the same data element name.";
CM_ SG_ 1043 ReSideRdrLe20Obj13RdrObjUsedTracker "Refer to the data element description in FrntSideRdrLeObj1 with the same data element name.";
CM_ SG_ 1043 ReSideRdrLe20Obj13RdrObjVx "Refer to the data element description in FrntSideRdrLeObj1 with the same data element name.";
CM_ SG_ 1043 ReSideRdrLe20Obj13RdrObjVxStdDe "Refer to the data element description in FrntSideRdrLeObj1 with the same data element name.";
CM_ SG_ 1043 ReSideRdrLe20Obj13RdrObjVy "Refer to the data element description in FrntSideRdrLeObj1 with the same data element name.";
CM_ SG_ 1043 ReSideRdrLe20Obj13RdrObjVyStdDe "Refer to the data element description in FrntSideRdrLeObj1 with the same data element name.";
CM_ SG_ 1043 ReSideRdrLe20Obj13RelVx "Refer to the data element description in FrntSideRdrLeObj1 with the same data element name.";
CM_ SG_ 1043 ReSideRdrLe20Obj13RelVy "Refer to the data element description in FrntSideRdrLeObj1 with the same data element name.";
CM_ SG_ 1044 ReSideRdrLe20Obj14Heading "Refer to the data element description in FrntSideRdrLeObj1 with the same data element name.";
CM_ SG_ 1044 ReSideRdrLe20Obj14ObjBoxCenterLat "Refer to the data element description in FrntSideRdrLeObj1 with the same data element name.";
CM_ SG_ 1044 ReSideRdrLe20Obj14ObjBoxCenterLgt "Refer to the data element description in FrntSideRdrLeObj1 with the same data element name.";
CM_ SG_ 1044 ReSideRdrLe20Obj14ObservationHist "Refer to the data element description in FrntSideRdrLeObj1 with the same data element name.";
CM_ SG_ 1044 ReSideRdrLe20Obj14QualityBits "Refer to the data element description in FrntSideRdrLeObj1 with the same data element name.";
CM_ SG_ 1044 ReSideRdrLe20Obj14RdrObjAx "Refer to the data element description in FrntSideRdrLeObj1 with the same data element name.";
CM_ SG_ 1044 ReSideRdrLe20Obj14RdrObjAy "Refer to the data element description in FrntSideRdrLeObj1 with the same data element name.";
CM_ SG_ 1044 ReSideRdrLe20Obj14RdrObjBoxLength "Refer to the data element description in FrntSideRdrLeObj1 with the same data element name.";
CM_ SG_ 1044 ReSideRdrLe20Obj14RdrObjBoxWidth "Refer to the data element description in FrntSideRdrLeObj1 with the same data element name.";
CM_ SG_ 1044 ReSideRdrLe20Obj14RdrObjChks "Refer to the data element description in FrntSideRdrLeObj1 with the same data element name.";
CM_ SG_ 1044 ReSideRdrLe20Obj14RdrObjCntr "Refer to the data element description in FrntSideRdrLeObj1 with the same data element name.";
CM_ SG_ 1044 ReSideRdrLe20Obj14RdrObjCoastCnt "Refer to the data element description in FrntSideRdrLeObj1 with the same data element name.";
CM_ SG_ 1044 ReSideRdrLe20Obj14RdrObjConf "Refer to the data element description in FrntSideRdrLeObj1 with the same data element name.";
CM_ SG_ 1044 ReSideRdrLe20Obj14RdrObjDx "Refer to the data element description in FrntSideRdrLeObj1 with the same data element name.";
CM_ SG_ 1044 ReSideRdrLe20Obj14RdrObjDxStdDe "Refer to the data element description in FrntSideRdrLeObj1 with the same data element name.";
CM_ SG_ 1044 ReSideRdrLe20Obj14RdrObjDy "Refer to the data element description in FrntSideRdrLeObj1 with the same data element name.";
CM_ SG_ 1044 ReSideRdrLe20Obj14RdrObjDyStdDe "Refer to the data element description in FrntSideRdrLeObj1 with the same data element name.";
CM_ SG_ 1044 ReSideRdrLe20Obj14RdrObjElevnConf "Refer to the data element description in FrntSideRdrLeObj1 with the same data element name.";
CM_ SG_ 1044 ReSideRdrLe20Obj14RdrObjElevnSts "Refer to the data element description in FrntSideRdrLeObj1 with the same data element name.";
CM_ SG_ 1044 ReSideRdrLe20Obj14RdrObjID "Refer to the data element description in FrntSideRdrLeObj1 with the same data element name.";
CM_ SG_ 1044 ReSideRdrLe20Obj14RdrObjIsInFreeSpace "Refer to the data element description in FrntSideRdrLeObj1 with the same data element name.";
CM_ SG_ 1044 ReSideRdrLe20Obj14RdrObjMirrProblty "Refer to the data element description in FrntSideRdrLeObj1 with the same data element name.";
CM_ SG_ 1044 ReSideRdrLe20Obj14RdrObjMtnPat "Refer to the data element description in FrntSideRdrLeObj1 with the same data element name.";
CM_ SG_ 1044 ReSideRdrLe20Obj14RdrObjNotRealProblty "Refer to the data element description in FrntSideRdrLeObj1 with the same data element name.";
CM_ SG_ 1044 ReSideRdrLe20Obj14RdrObjStatyCnt "Refer to the data element description in FrntSideRdrLeObj1 with the same data element name.";
CM_ SG_ 1044 ReSideRdrLe20Obj14RdrObjTiAlv "Refer to the data element description in FrntSideRdrLeObj1 with the same data element name.";
CM_ SG_ 1044 ReSideRdrLe20Obj14RdrObjTrackSts "Refer to the data element description in FrntSideRdrLeObj1 with the same data element name.";
CM_ SG_ 1044 ReSideRdrLe20Obj14RdrObjTyp "Refer to the data element description in FrntSideRdrLeObj1 with the same data element name.";
CM_ SG_ 1044 ReSideRdrLe20Obj14RdrObjTypConfBike "Refer to the data element description in FrntSideRdrLeObj1 with the same data element name.";
CM_ SG_ 1044 ReSideRdrLe20Obj14RdrObjTypConfPed "Refer to the data element description in FrntSideRdrLeObj1 with the same data element name.";
CM_ SG_ 1044 ReSideRdrLe20Obj14RdrObjTypConfVeh "Refer to the data element description in FrntSideRdrLeObj1 with the same data element name.";
CM_ SG_ 1044 ReSideRdrLe20Obj14RdrObjUsedTracker "Refer to the data element description in FrntSideRdrLeObj1 with the same data element name.";
CM_ SG_ 1044 ReSideRdrLe20Obj14RdrObjVx "Refer to the data element description in FrntSideRdrLeObj1 with the same data element name.";
CM_ SG_ 1044 ReSideRdrLe20Obj14RdrObjVxStdDe "Refer to the data element description in FrntSideRdrLeObj1 with the same data element name.";
CM_ SG_ 1044 ReSideRdrLe20Obj14RdrObjVy "Refer to the data element description in FrntSideRdrLeObj1 with the same data element name.";
CM_ SG_ 1044 ReSideRdrLe20Obj14RdrObjVyStdDe "Refer to the data element description in FrntSideRdrLeObj1 with the same data element name.";
CM_ SG_ 1044 ReSideRdrLe20Obj14RelVx "Refer to the data element description in FrntSideRdrLeObj1 with the same data element name.";
CM_ SG_ 1044 ReSideRdrLe20Obj14RelVy "Refer to the data element description in FrntSideRdrLeObj1 with the same data element name.";
CM_ SG_ 1045 ReSideRdrLe20Obj15Heading "Refer to the data element description in FrntSideRdrLeObj1 with the same data element name.";
CM_ SG_ 1045 ReSideRdrLe20Obj15ObjBoxCenterLat "Refer to the data element description in FrntSideRdrLeObj1 with the same data element name.";
CM_ SG_ 1045 ReSideRdrLe20Obj15ObjBoxCenterLgt "Refer to the data element description in FrntSideRdrLeObj1 with the same data element name.";
CM_ SG_ 1045 ReSideRdrLe20Obj15ObservationHist "Refer to the data element description in FrntSideRdrLeObj1 with the same data element name.";
CM_ SG_ 1045 ReSideRdrLe20Obj15QualityBits "Refer to the data element description in FrntSideRdrLeObj1 with the same data element name.";
CM_ SG_ 1045 ReSideRdrLe20Obj15RdrObjAx "Refer to the data element description in FrntSideRdrLeObj1 with the same data element name.";
CM_ SG_ 1045 ReSideRdrLe20Obj15RdrObjAy "Refer to the data element description in FrntSideRdrLeObj1 with the same data element name.";
CM_ SG_ 1045 ReSideRdrLe20Obj15RdrObjBoxLength "Refer to the data element description in FrntSideRdrLeObj1 with the same data element name.";
CM_ SG_ 1045 ReSideRdrLe20Obj15RdrObjBoxWidth "Refer to the data element description in FrntSideRdrLeObj1 with the same data element name.";
CM_ SG_ 1045 ReSideRdrLe20Obj15RdrObjChks "Refer to the data element description in FrntSideRdrLeObj1 with the same data element name.";
CM_ SG_ 1045 ReSideRdrLe20Obj15RdrObjCntr "Refer to the data element description in FrntSideRdrLeObj1 with the same data element name.";
CM_ SG_ 1045 ReSideRdrLe20Obj15RdrObjCoastCnt "Refer to the data element description in FrntSideRdrLeObj1 with the same data element name.";
CM_ SG_ 1045 ReSideRdrLe20Obj15RdrObjConf "Refer to the data element description in FrntSideRdrLeObj1 with the same data element name.";
CM_ SG_ 1045 ReSideRdrLe20Obj15RdrObjDx "Refer to the data element description in FrntSideRdrLeObj1 with the same data element name.";
CM_ SG_ 1045 ReSideRdrLe20Obj15RdrObjDxStdDe "Refer to the data element description in FrntSideRdrLeObj1 with the same data element name.";
CM_ SG_ 1045 ReSideRdrLe20Obj15RdrObjDy "Refer to the data element description in FrntSideRdrLeObj1 with the same data element name.";
CM_ SG_ 1045 ReSideRdrLe20Obj15RdrObjDyStdDe "Refer to the data element description in FrntSideRdrLeObj1 with the same data element name.";
CM_ SG_ 1045 ReSideRdrLe20Obj15RdrObjElevnConf "Refer to the data element description in FrntSideRdrLeObj1 with the same data element name.";
CM_ SG_ 1045 ReSideRdrLe20Obj15RdrObjElevnSts "Refer to the data element description in FrntSideRdrLeObj1 with the same data element name.";
CM_ SG_ 1045 ReSideRdrLe20Obj15RdrObjID "Refer to the data element description in FrntSideRdrLeObj1 with the same data element name.";
CM_ SG_ 1045 ReSideRdrLe20Obj15RdrObjIsInFreeSpace "Refer to the data element description in FrntSideRdrLeObj1 with the same data element name.";
CM_ SG_ 1045 ReSideRdrLe20Obj15RdrObjMirrProblty "Refer to the data element description in FrntSideRdrLeObj1 with the same data element name.";
CM_ SG_ 1045 ReSideRdrLe20Obj15RdrObjMtnPat "Refer to the data element description in FrntSideRdrLeObj1 with the same data element name.";
CM_ SG_ 1045 ReSideRdrLe20Obj15RdrObjNotRealProblty "Refer to the data element description in FrntSideRdrLeObj1 with the same data element name.";
CM_ SG_ 1045 ReSideRdrLe20Obj15RdrObjStatyCnt "Refer to the data element description in FrntSideRdrLeObj1 with the same data element name.";
CM_ SG_ 1045 ReSideRdrLe20Obj15RdrObjTiAlv "Refer to the data element description in FrntSideRdrLeObj1 with the same data element name.";
CM_ SG_ 1045 ReSideRdrLe20Obj15RdrObjTrackSts "Refer to the data element description in FrntSideRdrLeObj1 with the same data element name.";
CM_ SG_ 1045 ReSideRdrLe20Obj15RdrObjTyp "Refer to the data element description in FrntSideRdrLeObj1 with the same data element name.";
CM_ SG_ 1045 ReSideRdrLe20Obj15RdrObjTypConfBike "Refer to the data element description in FrntSideRdrLeObj1 with the same data element name.";
CM_ SG_ 1045 ReSideRdrLe20Obj15RdrObjTypConfPed "Refer to the data element description in FrntSideRdrLeObj1 with the same data element name.";
CM_ SG_ 1045 ReSideRdrLe20Obj15RdrObjTypConfVeh "Refer to the data element description in FrntSideRdrLeObj1 with the same data element name.";
CM_ SG_ 1045 ReSideRdrLe20Obj15RdrObjUsedTracker "Refer to the data element description in FrntSideRdrLeObj1 with the same data element name.";
CM_ SG_ 1045 ReSideRdrLe20Obj15RdrObjVx "Refer to the data element description in FrntSideRdrLeObj1 with the same data element name.";
CM_ SG_ 1045 ReSideRdrLe20Obj15RdrObjVxStdDe "Refer to the data element description in FrntSideRdrLeObj1 with the same data element name.";
CM_ SG_ 1045 ReSideRdrLe20Obj15RdrObjVy "Refer to the data element description in FrntSideRdrLeObj1 with the same data element name.";
CM_ SG_ 1045 ReSideRdrLe20Obj15RdrObjVyStdDe "Refer to the data element description in FrntSideRdrLeObj1 with the same data element name.";
CM_ SG_ 1045 ReSideRdrLe20Obj15RelVx "Refer to the data element description in FrntSideRdrLeObj1 with the same data element name.";
CM_ SG_ 1045 ReSideRdrLe20Obj15RelVy "Refer to the data element description in FrntSideRdrLeObj1 with the same data element name.";
CM_ SG_ 1046 ReSideRdrLe20Obj16Heading "Refer to the data element description in FrntSideRdrLeObj1 with the same data element name.";
CM_ SG_ 1046 ReSideRdrLe20Obj16ObjBoxCenterLat "Refer to the data element description in FrntSideRdrLeObj1 with the same data element name.";
CM_ SG_ 1046 ReSideRdrLe20Obj16ObjBoxCenterLgt "Refer to the data element description in FrntSideRdrLeObj1 with the same data element name.";
CM_ SG_ 1046 ReSideRdrLe20Obj16ObservationHist "Refer to the data element description in FrntSideRdrLeObj1 with the same data element name.";
CM_ SG_ 1046 ReSideRdrLe20Obj16QualityBits "Refer to the data element description in FrntSideRdrLeObj1 with the same data element name.";
CM_ SG_ 1046 ReSideRdrLe20Obj16RdrObjAx "Refer to the data element description in FrntSideRdrLeObj1 with the same data element name.";
CM_ SG_ 1046 ReSideRdrLe20Obj16RdrObjAy "Refer to the data element description in FrntSideRdrLeObj1 with the same data element name.";
CM_ SG_ 1046 ReSideRdrLe20Obj16RdrObjBoxLength "Refer to the data element description in FrntSideRdrLeObj1 with the same data element name.";
CM_ SG_ 1046 ReSideRdrLe20Obj16RdrObjBoxWidth "Refer to the data element description in FrntSideRdrLeObj1 with the same data element name.";
CM_ SG_ 1046 ReSideRdrLe20Obj16RdrObjChks "Refer to the data element description in FrntSideRdrLeObj1 with the same data element name.";
CM_ SG_ 1046 ReSideRdrLe20Obj16RdrObjCntr "Refer to the data element description in FrntSideRdrLeObj1 with the same data element name.";
CM_ SG_ 1046 ReSideRdrLe20Obj16RdrObjCoastCnt "Refer to the data element description in FrntSideRdrLeObj1 with the same data element name.";
CM_ SG_ 1046 ReSideRdrLe20Obj16RdrObjConf "Refer to the data element description in FrntSideRdrLeObj1 with the same data element name.";
CM_ SG_ 1046 ReSideRdrLe20Obj16RdrObjDx "Refer to the data element description in FrntSideRdrLeObj1 with the same data element name.";
CM_ SG_ 1046 ReSideRdrLe20Obj16RdrObjDxStdDe "Refer to the data element description in FrntSideRdrLeObj1 with the same data element name.";
CM_ SG_ 1046 ReSideRdrLe20Obj16RdrObjDy "Refer to the data element description in FrntSideRdrLeObj1 with the same data element name.";
CM_ SG_ 1046 ReSideRdrLe20Obj16RdrObjDyStdDe "Refer to the data element description in FrntSideRdrLeObj1 with the same data element name.";
CM_ SG_ 1046 ReSideRdrLe20Obj16RdrObjElevnConf "Refer to the data element description in FrntSideRdrLeObj1 with the same data element name.";
CM_ SG_ 1046 ReSideRdrLe20Obj16RdrObjElevnSts "Refer to the data element description in FrntSideRdrLeObj1 with the same data element name.";
CM_ SG_ 1046 ReSideRdrLe20Obj16RdrObjID "Refer to the data element description in FrntSideRdrLeObj1 with the same data element name.";
CM_ SG_ 1046 ReSideRdrLe20Obj16RdrObjIsInFreeSpace "Refer to the data element description in FrntSideRdrLeObj1 with the same data element name.";
CM_ SG_ 1046 ReSideRdrLe20Obj16RdrObjMirrProblty "Refer to the data element description in FrntSideRdrLeObj1 with the same data element name.";
CM_ SG_ 1046 ReSideRdrLe20Obj16RdrObjMtnPat "Refer to the data element description in FrntSideRdrLeObj1 with the same data element name.";
CM_ SG_ 1046 ReSideRdrLe20Obj16RdrObjNotRealProblty "Refer to the data element description in FrntSideRdrLeObj1 with the same data element name.";
CM_ SG_ 1046 ReSideRdrLe20Obj16RdrObjStatyCnt "Refer to the data element description in FrntSideRdrLeObj1 with the same data element name.";
CM_ SG_ 1046 ReSideRdrLe20Obj16RdrObjTiAlv "Refer to the data element description in FrntSideRdrLeObj1 with the same data element name.";
CM_ SG_ 1046 ReSideRdrLe20Obj16RdrObjTrackSts "Refer to the data element description in FrntSideRdrLeObj1 with the same data element name.";
CM_ SG_ 1046 ReSideRdrLe20Obj16RdrObjTyp "Refer to the data element description in FrntSideRdrLeObj1 with the same data element name.";
CM_ SG_ 1046 ReSideRdrLe20Obj16RdrObjTypConfBike "Refer to the data element description in FrntSideRdrLeObj1 with the same data element name.";
CM_ SG_ 1046 ReSideRdrLe20Obj16RdrObjTypConfPed "Refer to the data element description in FrntSideRdrLeObj1 with the same data element name.";
CM_ SG_ 1046 ReSideRdrLe20Obj16RdrObjTypConfVeh "Refer to the data element description in FrntSideRdrLeObj1 with the same data element name.";
CM_ SG_ 1046 ReSideRdrLe20Obj16RdrObjUsedTracker "Refer to the data element description in FrntSideRdrLeObj1 with the same data element name.";
CM_ SG_ 1046 ReSideRdrLe20Obj16RdrObjVx "Refer to the data element description in FrntSideRdrLeObj1 with the same data element name.";
CM_ SG_ 1046 ReSideRdrLe20Obj16RdrObjVxStdDe "Refer to the data element description in FrntSideRdrLeObj1 with the same data element name.";
CM_ SG_ 1046 ReSideRdrLe20Obj16RdrObjVy "Refer to the data element description in FrntSideRdrLeObj1 with the same data element name.";
CM_ SG_ 1046 ReSideRdrLe20Obj16RdrObjVyStdDe "Refer to the data element description in FrntSideRdrLeObj1 with the same data element name.";
CM_ SG_ 1046 ReSideRdrLe20Obj16RelVx "Refer to the data element description in FrntSideRdrLeObj1 with the same data element name.";
CM_ SG_ 1046 ReSideRdrLe20Obj16RelVy "Refer to the data element description in FrntSideRdrLeObj1 with the same data element name.";
CM_ SG_ 1047 ReSideRdrLe20Obj17Heading "Refer to the data element description in FrntSideRdrLeObj1 with the same data element name.";
CM_ SG_ 1047 ReSideRdrLe20Obj17ObjBoxCenterLat "Refer to the data element description in FrntSideRdrLeObj1 with the same data element name.";
CM_ SG_ 1047 ReSideRdrLe20Obj17ObjBoxCenterLgt "Refer to the data element description in FrntSideRdrLeObj1 with the same data element name.";
CM_ SG_ 1047 ReSideRdrLe20Obj17ObservationHist "Refer to the data element description in FrntSideRdrLeObj1 with the same data element name.";
CM_ SG_ 1047 ReSideRdrLe20Obj17QualityBits "Refer to the data element description in FrntSideRdrLeObj1 with the same data element name.";
CM_ SG_ 1047 ReSideRdrLe20Obj17RdrObjAx "Refer to the data element description in FrntSideRdrLeObj1 with the same data element name.";
CM_ SG_ 1047 ReSideRdrLe20Obj17RdrObjAy "Refer to the data element description in FrntSideRdrLeObj1 with the same data element name.";
CM_ SG_ 1047 ReSideRdrLe20Obj17RdrObjBoxLength "Refer to the data element description in FrntSideRdrLeObj1 with the same data element name.";
CM_ SG_ 1047 ReSideRdrLe20Obj17RdrObjBoxWidth "Refer to the data element description in FrntSideRdrLeObj1 with the same data element name.";
CM_ SG_ 1047 ReSideRdrLe20Obj17RdrObjChks "Refer to the data element description in FrntSideRdrLeObj1 with the same data element name.";
CM_ SG_ 1047 ReSideRdrLe20Obj17RdrObjCntr "Refer to the data element description in FrntSideRdrLeObj1 with the same data element name.";
CM_ SG_ 1047 ReSideRdrLe20Obj17RdrObjCoastCnt "Refer to the data element description in FrntSideRdrLeObj1 with the same data element name.";
CM_ SG_ 1047 ReSideRdrLe20Obj17RdrObjConf "Refer to the data element description in FrntSideRdrLeObj1 with the same data element name.";
CM_ SG_ 1047 ReSideRdrLe20Obj17RdrObjDx "Refer to the data element description in FrntSideRdrLeObj1 with the same data element name.";
CM_ SG_ 1047 ReSideRdrLe20Obj17RdrObjDxStdDe "Refer to the data element description in FrntSideRdrLeObj1 with the same data element name.";
CM_ SG_ 1047 ReSideRdrLe20Obj17RdrObjDy "Refer to the data element description in FrntSideRdrLeObj1 with the same data element name.";
CM_ SG_ 1047 ReSideRdrLe20Obj17RdrObjDyStdDe "Refer to the data element description in FrntSideRdrLeObj1 with the same data element name.";
CM_ SG_ 1047 ReSideRdrLe20Obj17RdrObjElevnConf "Refer to the data element description in FrntSideRdrLeObj1 with the same data element name.";
CM_ SG_ 1047 ReSideRdrLe20Obj17RdrObjElevnSts "Refer to the data element description in FrntSideRdrLeObj1 with the same data element name.";
CM_ SG_ 1047 ReSideRdrLe20Obj17RdrObjID "Refer to the data element description in FrntSideRdrLeObj1 with the same data element name.";
CM_ SG_ 1047 ReSideRdrLe20Obj17RdrObjIsInFreeSpace "Refer to the data element description in FrntSideRdrLeObj1 with the same data element name.";
CM_ SG_ 1047 ReSideRdrLe20Obj17RdrObjMirrProblty "Refer to the data element description in FrntSideRdrLeObj1 with the same data element name.";
CM_ SG_ 1047 ReSideRdrLe20Obj17RdrObjMtnPat "Refer to the data element description in FrntSideRdrLeObj1 with the same data element name.";
CM_ SG_ 1047 ReSideRdrLe20Obj17RdrObjNotRealProblty "Refer to the data element description in FrntSideRdrLeObj1 with the same data element name.";
CM_ SG_ 1047 ReSideRdrLe20Obj17RdrObjStatyCnt "Refer to the data element description in FrntSideRdrLeObj1 with the same data element name.";
CM_ SG_ 1047 ReSideRdrLe20Obj17RdrObjTiAlv "Refer to the data element description in FrntSideRdrLeObj1 with the same data element name.";
CM_ SG_ 1047 ReSideRdrLe20Obj17RdrObjTrackSts "Refer to the data element description in FrntSideRdrLeObj1 with the same data element name.";
CM_ SG_ 1047 ReSideRdrLe20Obj17RdrObjTyp "Refer to the data element description in FrntSideRdrLeObj1 with the same data element name.";
CM_ SG_ 1047 ReSideRdrLe20Obj17RdrObjTypConfBike "Refer to the data element description in FrntSideRdrLeObj1 with the same data element name.";
CM_ SG_ 1047 ReSideRdrLe20Obj17RdrObjTypConfPed "Refer to the data element description in FrntSideRdrLeObj1 with the same data element name.";
CM_ SG_ 1047 ReSideRdrLe20Obj17RdrObjTypConfVeh "Refer to the data element description in FrntSideRdrLeObj1 with the same data element name.";
CM_ SG_ 1047 ReSideRdrLe20Obj17RdrObjUsedTracker "Refer to the data element description in FrntSideRdrLeObj1 with the same data element name.";
CM_ SG_ 1047 ReSideRdrLe20Obj17RdrObjVx "Refer to the data element description in FrntSideRdrLeObj1 with the same data element name.";
CM_ SG_ 1047 ReSideRdrLe20Obj17RdrObjVxStdDe "Refer to the data element description in FrntSideRdrLeObj1 with the same data element name.";
CM_ SG_ 1047 ReSideRdrLe20Obj17RdrObjVy "Refer to the data element description in FrntSideRdrLeObj1 with the same data element name.";
CM_ SG_ 1047 ReSideRdrLe20Obj17RdrObjVyStdDe "Refer to the data element description in FrntSideRdrLeObj1 with the same data element name.";
CM_ SG_ 1047 ReSideRdrLe20Obj17RelVx "Refer to the data element description in FrntSideRdrLeObj1 with the same data element name.";
CM_ SG_ 1047 ReSideRdrLe20Obj17RelVy "Refer to the data element description in FrntSideRdrLeObj1 with the same data element name.";
CM_ SG_ 1048 ReSideRdrLe20Obj18Heading "Refer to the data element description in FrntSideRdrLeObj1 with the same data element name.";
CM_ SG_ 1048 ReSideRdrLe20Obj18ObjBoxCenterLat "Refer to the data element description in FrntSideRdrLeObj1 with the same data element name.";
CM_ SG_ 1048 ReSideRdrLe20Obj18ObjBoxCenterLgt "Refer to the data element description in FrntSideRdrLeObj1 with the same data element name.";
CM_ SG_ 1048 ReSideRdrLe20Obj18ObservationHist "Refer to the data element description in FrntSideRdrLeObj1 with the same data element name.";
CM_ SG_ 1048 ReSideRdrLe20Obj18QualityBits "Refer to the data element description in FrntSideRdrLeObj1 with the same data element name.";
CM_ SG_ 1048 ReSideRdrLe20Obj18RdrObjAx "Refer to the data element description in FrntSideRdrLeObj1 with the same data element name.";
CM_ SG_ 1048 ReSideRdrLe20Obj18RdrObjAy "Refer to the data element description in FrntSideRdrLeObj1 with the same data element name.";
CM_ SG_ 1048 ReSideRdrLe20Obj18RdrObjBoxLength "Refer to the data element description in FrntSideRdrLeObj1 with the same data element name.";
CM_ SG_ 1048 ReSideRdrLe20Obj18RdrObjBoxWidth "Refer to the data element description in FrntSideRdrLeObj1 with the same data element name.";
CM_ SG_ 1048 ReSideRdrLe20Obj18RdrObjChks "Refer to the data element description in FrntSideRdrLeObj1 with the same data element name.";
CM_ SG_ 1048 ReSideRdrLe20Obj18RdrObjCntr "Refer to the data element description in FrntSideRdrLeObj1 with the same data element name.";
CM_ SG_ 1048 ReSideRdrLe20Obj18RdrObjCoastCnt "Refer to the data element description in FrntSideRdrLeObj1 with the same data element name.";
CM_ SG_ 1048 ReSideRdrLe20Obj18RdrObjConf "Refer to the data element description in FrntSideRdrLeObj1 with the same data element name.";
CM_ SG_ 1048 ReSideRdrLe20Obj18RdrObjDx "Refer to the data element description in FrntSideRdrLeObj1 with the same data element name.";
CM_ SG_ 1048 ReSideRdrLe20Obj18RdrObjDxStdDe "Refer to the data element description in FrntSideRdrLeObj1 with the same data element name.";
CM_ SG_ 1048 ReSideRdrLe20Obj18RdrObjDy "Refer to the data element description in FrntSideRdrLeObj1 with the same data element name.";
CM_ SG_ 1048 ReSideRdrLe20Obj18RdrObjDyStdDe "Refer to the data element description in FrntSideRdrLeObj1 with the same data element name.";
CM_ SG_ 1048 ReSideRdrLe20Obj18RdrObjElevnConf "Refer to the data element description in FrntSideRdrLeObj1 with the same data element name.";
CM_ SG_ 1048 ReSideRdrLe20Obj18RdrObjElevnSts "Refer to the data element description in FrntSideRdrLeObj1 with the same data element name.";
CM_ SG_ 1048 ReSideRdrLe20Obj18RdrObjID "Refer to the data element description in FrntSideRdrLeObj1 with the same data element name.";
CM_ SG_ 1048 ReSideRdrLe20Obj18RdrObjIsInFreeSpace "Refer to the data element description in FrntSideRdrLeObj1 with the same data element name.";
CM_ SG_ 1048 ReSideRdrLe20Obj18RdrObjMirrProblty "Refer to the data element description in FrntSideRdrLeObj1 with the same data element name.";
CM_ SG_ 1048 ReSideRdrLe20Obj18RdrObjMtnPat "Refer to the data element description in FrntSideRdrLeObj1 with the same data element name.";
CM_ SG_ 1048 ReSideRdrLe20Obj18RdrObjNotRealProblty "Refer to the data element description in FrntSideRdrLeObj1 with the same data element name.";
CM_ SG_ 1048 ReSideRdrLe20Obj18RdrObjStatyCnt "Refer to the data element description in FrntSideRdrLeObj1 with the same data element name.";
CM_ SG_ 1048 ReSideRdrLe20Obj18RdrObjTiAlv "Refer to the data element description in FrntSideRdrLeObj1 with the same data element name.";
CM_ SG_ 1048 ReSideRdrLe20Obj18RdrObjTrackSts "Refer to the data element description in FrntSideRdrLeObj1 with the same data element name.";
CM_ SG_ 1048 ReSideRdrLe20Obj18RdrObjTyp "Refer to the data element description in FrntSideRdrLeObj1 with the same data element name.";
CM_ SG_ 1048 ReSideRdrLe20Obj18RdrObjTypConfBike "Refer to the data element description in FrntSideRdrLeObj1 with the same data element name.";
CM_ SG_ 1048 ReSideRdrLe20Obj18RdrObjTypConfPed "Refer to the data element description in FrntSideRdrLeObj1 with the same data element name.";
CM_ SG_ 1048 ReSideRdrLe20Obj18RdrObjTypConfVeh "Refer to the data element description in FrntSideRdrLeObj1 with the same data element name.";
CM_ SG_ 1048 ReSideRdrLe20Obj18RdrObjUsedTracker "Refer to the data element description in FrntSideRdrLeObj1 with the same data element name.";
CM_ SG_ 1048 ReSideRdrLe20Obj18RdrObjVx "Refer to the data element description in FrntSideRdrLeObj1 with the same data element name.";
CM_ SG_ 1048 ReSideRdrLe20Obj18RdrObjVxStdDe "Refer to the data element description in FrntSideRdrLeObj1 with the same data element name.";
CM_ SG_ 1048 ReSideRdrLe20Obj18RdrObjVy "Refer to the data element description in FrntSideRdrLeObj1 with the same data element name.";
CM_ SG_ 1048 ReSideRdrLe20Obj18RdrObjVyStdDe "Refer to the data element description in FrntSideRdrLeObj1 with the same data element name.";
CM_ SG_ 1048 ReSideRdrLe20Obj18RelVx "Refer to the data element description in FrntSideRdrLeObj1 with the same data element name.";
CM_ SG_ 1048 ReSideRdrLe20Obj18RelVy "Refer to the data element description in FrntSideRdrLeObj1 with the same data element name.";
CM_ SG_ 1049 ReSideRdrLe20Obj19Heading "Refer to the data element description in FrntSideRdrLeObj1 with the same data element name.";
CM_ SG_ 1049 ReSideRdrLe20Obj19ObjBoxCenterLat "Refer to the data element description in FrntSideRdrLeObj1 with the same data element name.";
CM_ SG_ 1049 ReSideRdrLe20Obj19ObjBoxCenterLgt "Refer to the data element description in FrntSideRdrLeObj1 with the same data element name.";
CM_ SG_ 1049 ReSideRdrLe20Obj19ObservationHist "Refer to the data element description in FrntSideRdrLeObj1 with the same data element name.";
CM_ SG_ 1049 ReSideRdrLe20Obj19QualityBits "Refer to the data element description in FrntSideRdrLeObj1 with the same data element name.";
CM_ SG_ 1049 ReSideRdrLe20Obj19RdrObjAx "Refer to the data element description in FrntSideRdrLeObj1 with the same data element name.";
CM_ SG_ 1049 ReSideRdrLe20Obj19RdrObjAy "Refer to the data element description in FrntSideRdrLeObj1 with the same data element name.";
CM_ SG_ 1049 ReSideRdrLe20Obj19RdrObjBoxLength "Refer to the data element description in FrntSideRdrLeObj1 with the same data element name.";
CM_ SG_ 1049 ReSideRdrLe20Obj19RdrObjBoxWidth "Refer to the data element description in FrntSideRdrLeObj1 with the same data element name.";
CM_ SG_ 1049 ReSideRdrLe20Obj19RdrObjChks "Refer to the data element description in FrntSideRdrLeObj1 with the same data element name.";
CM_ SG_ 1049 ReSideRdrLe20Obj19RdrObjCntr "Refer to the data element description in FrntSideRdrLeObj1 with the same data element name.";
CM_ SG_ 1049 ReSideRdrLe20Obj19RdrObjCoastCnt "Refer to the data element description in FrntSideRdrLeObj1 with the same data element name.";
CM_ SG_ 1049 ReSideRdrLe20Obj19RdrObjConf "Refer to the data element description in FrntSideRdrLeObj1 with the same data element name.";
CM_ SG_ 1049 ReSideRdrLe20Obj19RdrObjDx "Refer to the data element description in FrntSideRdrLeObj1 with the same data element name.";
CM_ SG_ 1049 ReSideRdrLe20Obj19RdrObjDxStdDe "Refer to the data element description in FrntSideRdrLeObj1 with the same data element name.";
CM_ SG_ 1049 ReSideRdrLe20Obj19RdrObjDy "Refer to the data element description in FrntSideRdrLeObj1 with the same data element name.";
CM_ SG_ 1049 ReSideRdrLe20Obj19RdrObjDyStdDe "Refer to the data element description in FrntSideRdrLeObj1 with the same data element name.";
CM_ SG_ 1049 ReSideRdrLe20Obj19RdrObjElevnConf "Refer to the data element description in FrntSideRdrLeObj1 with the same data element name.";
CM_ SG_ 1049 ReSideRdrLe20Obj19RdrObjElevnSts "Refer to the data element description in FrntSideRdrLeObj1 with the same data element name.";
CM_ SG_ 1049 ReSideRdrLe20Obj19RdrObjID "Refer to the data element description in FrntSideRdrLeObj1 with the same data element name.";
CM_ SG_ 1049 ReSideRdrLe20Obj19RdrObjIsInFreeSpace "Refer to the data element description in FrntSideRdrLeObj1 with the same data element name.";
CM_ SG_ 1049 ReSideRdrLe20Obj19RdrObjMirrProblty "Refer to the data element description in FrntSideRdrLeObj1 with the same data element name.";
CM_ SG_ 1049 ReSideRdrLe20Obj19RdrObjMtnPat "Refer to the data element description in FrntSideRdrLeObj1 with the same data element name.";
CM_ SG_ 1049 ReSideRdrLe20Obj19RdrObjNotRealProblty "Refer to the data element description in FrntSideRdrLeObj1 with the same data element name.";
CM_ SG_ 1049 ReSideRdrLe20Obj19RdrObjStatyCnt "Refer to the data element description in FrntSideRdrLeObj1 with the same data element name.";
CM_ SG_ 1049 ReSideRdrLe20Obj19RdrObjTiAlv "Refer to the data element description in FrntSideRdrLeObj1 with the same data element name.";
CM_ SG_ 1049 ReSideRdrLe20Obj19RdrObjTrackSts "Refer to the data element description in FrntSideRdrLeObj1 with the same data element name.";
CM_ SG_ 1049 ReSideRdrLe20Obj19RdrObjTyp "Refer to the data element description in FrntSideRdrLeObj1 with the same data element name.";
CM_ SG_ 1049 ReSideRdrLe20Obj19RdrObjTypConfBike "Refer to the data element description in FrntSideRdrLeObj1 with the same data element name.";
CM_ SG_ 1049 ReSideRdrLe20Obj19RdrObjTypConfPed "Refer to the data element description in FrntSideRdrLeObj1 with the same data element name.";
CM_ SG_ 1049 ReSideRdrLe20Obj19RdrObjTypConfVeh "Refer to the data element description in FrntSideRdrLeObj1 with the same data element name.";
CM_ SG_ 1049 ReSideRdrLe20Obj19RdrObjUsedTracker "Refer to the data element description in FrntSideRdrLeObj1 with the same data element name.";
CM_ SG_ 1049 ReSideRdrLe20Obj19RdrObjVx "Refer to the data element description in FrntSideRdrLeObj1 with the same data element name.";
CM_ SG_ 1049 ReSideRdrLe20Obj19RdrObjVxStdDe "Refer to the data element description in FrntSideRdrLeObj1 with the same data element name.";
CM_ SG_ 1049 ReSideRdrLe20Obj19RdrObjVy "Refer to the data element description in FrntSideRdrLeObj1 with the same data element name.";
CM_ SG_ 1049 ReSideRdrLe20Obj19RdrObjVyStdDe "Refer to the data element description in FrntSideRdrLeObj1 with the same data element name.";
CM_ SG_ 1049 ReSideRdrLe20Obj19RelVx "Refer to the data element description in FrntSideRdrLeObj1 with the same data element name.";
CM_ SG_ 1049 ReSideRdrLe20Obj19RelVy "Refer to the data element description in FrntSideRdrLeObj1 with the same data element name.";
BA_DEF_ BO_ "CANFD_BRS" ENUM "0","1";
BA_DEF_ BO_ "GenMsgCycleTime" INT 0 65536; // [ms]
BA_DEF_ BO_ "GenMsgDelayTime" INT 0 65536; // [ms]
BA_DEF_ BO_ "GenMsgSendType" ENUM "cyclic", "spontaneous", "not-used", "not-used", "not-used", "cyclicAndSpontaneous", "not-used", "cyclicIfActive", "NoMsgSendType"; // [us]
BA_DEF_ BO_ "GenMsgStartDelayTime" INT 0 65536; // [ms]
BA_DEF_ BO_ "VFrameFormat" ENUM "StandardCAN","ExtendedCAN","reserved","J1939PG","reserved","reserved","reserved","reserved","reserved","reserved","reserved","reserved","reserved","reserved","StandardCAN_FD","ExtendedCAN_FD";
BA_DEF_ SG_ "GenSigSendType" ENUM "Cyclic","OnWrite","OnWriteWithRepetition","OnChange","OnChangeWithRepetition","IfActive","IfActiveWithRepetition","NoSigSendType";
BA_DEF_ SG_ "GenSigStartValue" HEX 0 80000000;
BA_DEF_ BO_ "GenMsgILSupport" ENUM "No","Yes";
BA_DEF_ BO_ "NmAsrMessage" ENUM "No","Yes";
BA_DEF_ SG_ "GenSigFuncType" ENUM "NoFunction","n/a","n/a","n/a","n/a","n/a","n/a","n/a","n/a","n/a","n/a","n/a","n/a","n/a","n/a","CHK","CNTR","n/a","n/a","n/a","CNTR_AR_01","CRC_AR_01_BOTH","CRC_AR_01_ALT","CRC_AR_01_LOW","CRC_AR_01_NIBBLE","CNTR_AR_04","CRC_AR_04A","CNTR_AR_05","CRC_AR_05";
BA_DEF_ SG_ "GenSigDataID" STRING;
BA_DEF_DEF_ "CANFD_BRS" "1";
BA_DEF_DEF_ "GenSigStartValue" 0;
BA_DEF_DEF_ "VFrameFormat" "J1939PG";
BA_DEF_DEF_ "GenSigSendType" "NoSigSendType";
BA_DEF_DEF_ "GenMsgCycleTime" 0;
BA_DEF_DEF_ "GenMsgDelayTime" 0;
BA_DEF_DEF_ "GenMsgStartDelayTime" 0;
BA_DEF_DEF_ "GenMsgSendType" "NoMsgSendType";
BA_DEF_DEF_ "GenMsgILSupport" "Yes";
BA_DEF_DEF_ "NmAsrMessage" "No";
BA_DEF_DEF_ "GenSigFuncType" "NoFunction";
BA_DEF_DEF_ "GenSigDataID" "";
// Frame: SODLPrivateCANFD5Fr08
BA_ "GenMsgCycleTime" BO_ 1032 50 ;
BA_ "GenMsgSendType" BO_ 1032 0;
BA_ "VFrameFormat" BO_ 1032 14;
// Frame: SODLPrivateCANFD5Fr09
BA_ "GenMsgCycleTime" BO_ 1033 50 ;
BA_ "GenMsgSendType" BO_ 1033 0;
BA_ "VFrameFormat" BO_ 1033 14;
// Frame: SODLPrivateCANFD5Fr10
BA_ "GenMsgCycleTime" BO_ 1040 50 ;
BA_ "GenMsgSendType" BO_ 1040 0;
BA_ "VFrameFormat" BO_ 1040 14;
// Frame: SODLPrivateCANFD5Fr11
BA_ "GenMsgCycleTime" BO_ 1041 50 ;
BA_ "GenMsgSendType" BO_ 1041 0;
BA_ "VFrameFormat" BO_ 1041 14;
// Frame: SODLPrivateCANFD5Fr12
BA_ "GenMsgCycleTime" BO_ 1042 50 ;
BA_ "GenMsgSendType" BO_ 1042 0;
BA_ "VFrameFormat" BO_ 1042 14;
// Frame: SODLPrivateCANFD5Fr13
BA_ "GenMsgCycleTime" BO_ 1043 50 ;
BA_ "GenMsgSendType" BO_ 1043 0;
BA_ "VFrameFormat" BO_ 1043 14;
// Frame: SODLPrivateCANFD5Fr14
BA_ "GenMsgCycleTime" BO_ 1044 50 ;
BA_ "GenMsgSendType" BO_ 1044 0;
BA_ "VFrameFormat" BO_ 1044 14;
// Frame: SODLPrivateCANFD5Fr15
BA_ "GenMsgCycleTime" BO_ 1045 50 ;
BA_ "GenMsgSendType" BO_ 1045 0;
BA_ "VFrameFormat" BO_ 1045 14;
// Frame: SODLPrivateCANFD5Fr16
BA_ "GenMsgCycleTime" BO_ 1046 50 ;
BA_ "GenMsgSendType" BO_ 1046 0;
BA_ "VFrameFormat" BO_ 1046 14;
// Frame: SODLPrivateCANFD5Fr17
BA_ "GenMsgCycleTime" BO_ 1047 50 ;
BA_ "GenMsgSendType" BO_ 1047 0;
BA_ "VFrameFormat" BO_ 1047 14;
// Frame: SODLPrivateCANFD5Fr18
BA_ "GenMsgCycleTime" BO_ 1048 50 ;
BA_ "GenMsgSendType" BO_ 1048 0;
BA_ "VFrameFormat" BO_ 1048 14;
// Frame: SODLPrivateCANFD5Fr19
BA_ "GenMsgCycleTime" BO_ 1049 50 ;
BA_ "GenMsgSendType" BO_ 1049 0;
BA_ "VFrameFormat" BO_ 1049 14;
BA_ "GenSigSendType" SG_ 1040 ReSideRdrLe20Obj10Heading 0;
BA_ "GenSigStartValue" SG_ 1040 ReSideRdrLe20Obj10Heading 1800;
BA_ "GenSigSendType" SG_ 1040 ReSideRdrLe20Obj10ObjBoxCenterLat 0;
BA_ "GenSigStartValue" SG_ 1040 ReSideRdrLe20Obj10ObjBoxCenterLat 250;
BA_ "GenSigSendType" SG_ 1040 ReSideRdrLe20Obj10ObjBoxCenterLgt 0;
BA_ "GenSigStartValue" SG_ 1040 ReSideRdrLe20Obj10ObjBoxCenterLgt 250;
BA_ "GenSigSendType" SG_ 1040 ReSideRdrLe20Obj10ObservationHist 0;
BA_ "GenSigSendType" SG_ 1040 ReSideRdrLe20Obj10QualityBits 0;
BA_ "GenSigSendType" SG_ 1040 ReSideRdrLe20Obj10RdrObjAx 0;
BA_ "GenSigSendType" SG_ 1040 ReSideRdrLe20Obj10RdrObjAy 0;
BA_ "GenSigSendType" SG_ 1040 ReSideRdrLe20Obj10RdrObjBoxLength 0;
BA_ "GenSigSendType" SG_ 1040 ReSideRdrLe20Obj10RdrObjBoxWidth 0;
BA_ "GenSigDataID" SG_ 1040 ReSideRdrLe20Obj10RdrObjChks "0x129D";
BA_ "GenSigFuncType" SG_ 1040 ReSideRdrLe20Obj10RdrObjChks 15;
BA_ "GenSigSendType" SG_ 1040 ReSideRdrLe20Obj10RdrObjChks 0;
BA_ "GenSigFuncType" SG_ 1040 ReSideRdrLe20Obj10RdrObjCntr 16;
BA_ "GenSigSendType" SG_ 1040 ReSideRdrLe20Obj10RdrObjCntr 0;
BA_ "GenSigSendType" SG_ 1040 ReSideRdrLe20Obj10RdrObjCoastCnt 0;
BA_ "GenSigStartValue" SG_ 1040 ReSideRdrLe20Obj10RdrObjCoastCnt 31;
BA_ "GenSigSendType" SG_ 1040 ReSideRdrLe20Obj10RdrObjConf 0;
BA_ "GenSigSendType" SG_ 1040 ReSideRdrLe20Obj10RdrObjDx 0;
BA_ "GenSigSendType" SG_ 1040 ReSideRdrLe20Obj10RdrObjDxStdDe 0;
BA_ "GenSigSendType" SG_ 1040 ReSideRdrLe20Obj10RdrObjDy 0;
BA_ "GenSigStartValue" SG_ 1040 ReSideRdrLe20Obj10RdrObjDy 4000;
BA_ "GenSigSendType" SG_ 1040 ReSideRdrLe20Obj10RdrObjDyStdDe 0;
BA_ "GenSigSendType" SG_ 1040 ReSideRdrLe20Obj10RdrObjElevnConf 0;
BA_ "GenSigSendType" SG_ 1040 ReSideRdrLe20Obj10RdrObjElevnSts 0;
BA_ "GenSigSendType" SG_ 1040 ReSideRdrLe20Obj10RdrObjID 0;
BA_ "GenSigSendType" SG_ 1040 ReSideRdrLe20Obj10RdrObjIsInFreeSpace 0;
BA_ "GenSigStartValue" SG_ 1040 ReSideRdrLe20Obj10RdrObjIsInFreeSpace 1;
BA_ "GenSigSendType" SG_ 1040 ReSideRdrLe20Obj10RdrObjMirrProblty 0;
BA_ "GenSigSendType" SG_ 1040 ReSideRdrLe20Obj10RdrObjMtnPat 0;
BA_ "GenSigStartValue" SG_ 1040 ReSideRdrLe20Obj10RdrObjMtnPat 3;
BA_ "GenSigSendType" SG_ 1040 ReSideRdrLe20Obj10RdrObjNotRealProblty 0;
BA_ "GenSigSendType" SG_ 1040 ReSideRdrLe20Obj10RdrObjStatyCnt 0;
BA_ "GenSigSendType" SG_ 1040 ReSideRdrLe20Obj10RdrObjTiAlv 0;
BA_ "GenSigSendType" SG_ 1040 ReSideRdrLe20Obj10RdrObjTrackSts 0;
BA_ "GenSigSendType" SG_ 1040 ReSideRdrLe20Obj10RdrObjTyp 0;
BA_ "GenSigSendType" SG_ 1040 ReSideRdrLe20Obj10RdrObjTypConfBike 0;
BA_ "GenSigSendType" SG_ 1040 ReSideRdrLe20Obj10RdrObjTypConfPed 0;
BA_ "GenSigSendType" SG_ 1040 ReSideRdrLe20Obj10RdrObjTypConfVeh 0;
BA_ "GenSigSendType" SG_ 1040 ReSideRdrLe20Obj10RdrObjUsedTracker 0;
BA_ "GenSigStartValue" SG_ 1040 ReSideRdrLe20Obj10RdrObjUsedTracker 3;
BA_ "GenSigSendType" SG_ 1040 ReSideRdrLe20Obj10RdrObjVx 0;
BA_ "GenSigStartValue" SG_ 1040 ReSideRdrLe20Obj10RdrObjVx 6400;
BA_ "GenSigSendType" SG_ 1040 ReSideRdrLe20Obj10RdrObjVxStdDe 0;
BA_ "GenSigSendType" SG_ 1040 ReSideRdrLe20Obj10RdrObjVy 0;
BA_ "GenSigStartValue" SG_ 1040 ReSideRdrLe20Obj10RdrObjVy 6400;
BA_ "GenSigSendType" SG_ 1040 ReSideRdrLe20Obj10RdrObjVyStdDe 0;
BA_ "GenSigSendType" SG_ 1040 ReSideRdrLe20Obj10RelVx 0;
BA_ "GenSigStartValue" SG_ 1040 ReSideRdrLe20Obj10RelVx 1780;
BA_ "GenSigSendType" SG_ 1040 ReSideRdrLe20Obj10RelVy 0;
BA_ "GenSigStartValue" SG_ 1040 ReSideRdrLe20Obj10RelVy 1780;
BA_ "GenSigSendType" SG_ 1041 ReSideRdrLe20Obj11Heading 0;
BA_ "GenSigStartValue" SG_ 1041 ReSideRdrLe20Obj11Heading 1800;
BA_ "GenSigSendType" SG_ 1041 ReSideRdrLe20Obj11ObjBoxCenterLat 0;
BA_ "GenSigStartValue" SG_ 1041 ReSideRdrLe20Obj11ObjBoxCenterLat 250;
BA_ "GenSigSendType" SG_ 1041 ReSideRdrLe20Obj11ObjBoxCenterLgt 0;
BA_ "GenSigStartValue" SG_ 1041 ReSideRdrLe20Obj11ObjBoxCenterLgt 250;
BA_ "GenSigSendType" SG_ 1041 ReSideRdrLe20Obj11ObservationHist 0;
BA_ "GenSigSendType" SG_ 1041 ReSideRdrLe20Obj11QualityBits 0;
BA_ "GenSigSendType" SG_ 1041 ReSideRdrLe20Obj11RdrObjAx 0;
BA_ "GenSigSendType" SG_ 1041 ReSideRdrLe20Obj11RdrObjAy 0;
BA_ "GenSigSendType" SG_ 1041 ReSideRdrLe20Obj11RdrObjBoxLength 0;
BA_ "GenSigSendType" SG_ 1041 ReSideRdrLe20Obj11RdrObjBoxWidth 0;
BA_ "GenSigDataID" SG_ 1041 ReSideRdrLe20Obj11RdrObjChks "0x129E";
BA_ "GenSigFuncType" SG_ 1041 ReSideRdrLe20Obj11RdrObjChks 15;
BA_ "GenSigSendType" SG_ 1041 ReSideRdrLe20Obj11RdrObjChks 0;
BA_ "GenSigFuncType" SG_ 1041 ReSideRdrLe20Obj11RdrObjCntr 16;
BA_ "GenSigSendType" SG_ 1041 ReSideRdrLe20Obj11RdrObjCntr 0;
BA_ "GenSigSendType" SG_ 1041 ReSideRdrLe20Obj11RdrObjCoastCnt 0;
BA_ "GenSigStartValue" SG_ 1041 ReSideRdrLe20Obj11RdrObjCoastCnt 31;
BA_ "GenSigSendType" SG_ 1041 ReSideRdrLe20Obj11RdrObjConf 0;
BA_ "GenSigSendType" SG_ 1041 ReSideRdrLe20Obj11RdrObjDx 0;
BA_ "GenSigSendType" SG_ 1041 ReSideRdrLe20Obj11RdrObjDxStdDe 0;
BA_ "GenSigSendType" SG_ 1041 ReSideRdrLe20Obj11RdrObjDy 0;
BA_ "GenSigStartValue" SG_ 1041 ReSideRdrLe20Obj11RdrObjDy 4000;
BA_ "GenSigSendType" SG_ 1041 ReSideRdrLe20Obj11RdrObjDyStdDe 0;
BA_ "GenSigSendType" SG_ 1041 ReSideRdrLe20Obj11RdrObjElevnConf 0;
BA_ "GenSigSendType" SG_ 1041 ReSideRdrLe20Obj11RdrObjElevnSts 0;
BA_ "GenSigSendType" SG_ 1041 ReSideRdrLe20Obj11RdrObjID 0;
BA_ "GenSigSendType" SG_ 1041 ReSideRdrLe20Obj11RdrObjIsInFreeSpace 0;
BA_ "GenSigStartValue" SG_ 1041 ReSideRdrLe20Obj11RdrObjIsInFreeSpace 1;
BA_ "GenSigSendType" SG_ 1041 ReSideRdrLe20Obj11RdrObjMirrProblty 0;
BA_ "GenSigSendType" SG_ 1041 ReSideRdrLe20Obj11RdrObjMtnPat 0;
BA_ "GenSigStartValue" SG_ 1041 ReSideRdrLe20Obj11RdrObjMtnPat 3;
BA_ "GenSigSendType" SG_ 1041 ReSideRdrLe20Obj11RdrObjNotRealProblty 0;
BA_ "GenSigSendType" SG_ 1041 ReSideRdrLe20Obj11RdrObjStatyCnt 0;
BA_ "GenSigSendType" SG_ 1041 ReSideRdrLe20Obj11RdrObjTiAlv 0;
BA_ "GenSigSendType" SG_ 1041 ReSideRdrLe20Obj11RdrObjTrackSts 0;
BA_ "GenSigSendType" SG_ 1041 ReSideRdrLe20Obj11RdrObjTyp 0;
BA_ "GenSigSendType" SG_ 1041 ReSideRdrLe20Obj11RdrObjTypConfBike 0;
BA_ "GenSigSendType" SG_ 1041 ReSideRdrLe20Obj11RdrObjTypConfPed 0;
BA_ "GenSigSendType" SG_ 1041 ReSideRdrLe20Obj11RdrObjTypConfVeh 0;
BA_ "GenSigSendType" SG_ 1041 ReSideRdrLe20Obj11RdrObjUsedTracker 0;
BA_ "GenSigStartValue" SG_ 1041 ReSideRdrLe20Obj11RdrObjUsedTracker 3;
BA_ "GenSigSendType" SG_ 1041 ReSideRdrLe20Obj11RdrObjVx 0;
BA_ "GenSigStartValue" SG_ 1041 ReSideRdrLe20Obj11RdrObjVx 6400;
BA_ "GenSigSendType" SG_ 1041 ReSideRdrLe20Obj11RdrObjVxStdDe 0;
BA_ "GenSigSendType" SG_ 1041 ReSideRdrLe20Obj11RdrObjVy 0;
BA_ "GenSigStartValue" SG_ 1041 ReSideRdrLe20Obj11RdrObjVy 6400;
BA_ "GenSigSendType" SG_ 1041 ReSideRdrLe20Obj11RdrObjVyStdDe 0;
BA_ "GenSigSendType" SG_ 1041 ReSideRdrLe20Obj11RelVx 0;
BA_ "GenSigStartValue" SG_ 1041 ReSideRdrLe20Obj11RelVx 1780;
BA_ "GenSigSendType" SG_ 1041 ReSideRdrLe20Obj11RelVy 0;
BA_ "GenSigStartValue" SG_ 1041 ReSideRdrLe20Obj11RelVy 1780;
BA_ "GenSigSendType" SG_ 1042 ReSideRdrLe20Obj12Heading 0;
BA_ "GenSigStartValue" SG_ 1042 ReSideRdrLe20Obj12Heading 1800;
BA_ "GenSigSendType" SG_ 1042 ReSideRdrLe20Obj12ObjBoxCenterLat 0;
BA_ "GenSigStartValue" SG_ 1042 ReSideRdrLe20Obj12ObjBoxCenterLat 250;
BA_ "GenSigSendType" SG_ 1042 ReSideRdrLe20Obj12ObjBoxCenterLgt 0;
BA_ "GenSigStartValue" SG_ 1042 ReSideRdrLe20Obj12ObjBoxCenterLgt 250;
BA_ "GenSigSendType" SG_ 1042 ReSideRdrLe20Obj12ObservationHist 0;
BA_ "GenSigSendType" SG_ 1042 ReSideRdrLe20Obj12QualityBits 0;
BA_ "GenSigSendType" SG_ 1042 ReSideRdrLe20Obj12RdrObjAx 0;
BA_ "GenSigSendType" SG_ 1042 ReSideRdrLe20Obj12RdrObjAy 0;
BA_ "GenSigSendType" SG_ 1042 ReSideRdrLe20Obj12RdrObjBoxLength 0;
BA_ "GenSigSendType" SG_ 1042 ReSideRdrLe20Obj12RdrObjBoxWidth 0;
BA_ "GenSigDataID" SG_ 1042 ReSideRdrLe20Obj12RdrObjChks "0x129F";
BA_ "GenSigFuncType" SG_ 1042 ReSideRdrLe20Obj12RdrObjChks 15;
BA_ "GenSigSendType" SG_ 1042 ReSideRdrLe20Obj12RdrObjChks 0;
BA_ "GenSigFuncType" SG_ 1042 ReSideRdrLe20Obj12RdrObjCntr 16;
BA_ "GenSigSendType" SG_ 1042 ReSideRdrLe20Obj12RdrObjCntr 0;
BA_ "GenSigSendType" SG_ 1042 ReSideRdrLe20Obj12RdrObjCoastCnt 0;
BA_ "GenSigStartValue" SG_ 1042 ReSideRdrLe20Obj12RdrObjCoastCnt 31;
BA_ "GenSigSendType" SG_ 1042 ReSideRdrLe20Obj12RdrObjConf 0;
BA_ "GenSigSendType" SG_ 1042 ReSideRdrLe20Obj12RdrObjDx 0;
BA_ "GenSigSendType" SG_ 1042 ReSideRdrLe20Obj12RdrObjDxStdDe 0;
BA_ "GenSigSendType" SG_ 1042 ReSideRdrLe20Obj12RdrObjDy 0;
BA_ "GenSigStartValue" SG_ 1042 ReSideRdrLe20Obj12RdrObjDy 4000;
BA_ "GenSigSendType" SG_ 1042 ReSideRdrLe20Obj12RdrObjDyStdDe 0;
BA_ "GenSigSendType" SG_ 1042 ReSideRdrLe20Obj12RdrObjElevnConf 0;
BA_ "GenSigSendType" SG_ 1042 ReSideRdrLe20Obj12RdrObjElevnSts 0;
BA_ "GenSigSendType" SG_ 1042 ReSideRdrLe20Obj12RdrObjID 0;
BA_ "GenSigSendType" SG_ 1042 ReSideRdrLe20Obj12RdrObjIsInFreeSpace 0;
BA_ "GenSigStartValue" SG_ 1042 ReSideRdrLe20Obj12RdrObjIsInFreeSpace 1;
BA_ "GenSigSendType" SG_ 1042 ReSideRdrLe20Obj12RdrObjMirrProblty 0;
BA_ "GenSigSendType" SG_ 1042 ReSideRdrLe20Obj12RdrObjMtnPat 0;
BA_ "GenSigStartValue" SG_ 1042 ReSideRdrLe20Obj12RdrObjMtnPat 3;
BA_ "GenSigSendType" SG_ 1042 ReSideRdrLe20Obj12RdrObjNotRealProblty 0;
BA_ "GenSigSendType" SG_ 1042 ReSideRdrLe20Obj12RdrObjStatyCnt 0;
BA_ "GenSigSendType" SG_ 1042 ReSideRdrLe20Obj12RdrObjTiAlv 0;
BA_ "GenSigSendType" SG_ 1042 ReSideRdrLe20Obj12RdrObjTrackSts 0;
BA_ "GenSigSendType" SG_ 1042 ReSideRdrLe20Obj12RdrObjTyp 0;
BA_ "GenSigSendType" SG_ 1042 ReSideRdrLe20Obj12RdrObjTypConfBike 0;
BA_ "GenSigSendType" SG_ 1042 ReSideRdrLe20Obj12RdrObjTypConfPed 0;
BA_ "GenSigSendType" SG_ 1042 ReSideRdrLe20Obj12RdrObjTypConfVeh 0;
BA_ "GenSigSendType" SG_ 1042 ReSideRdrLe20Obj12RdrObjUsedTracker 0;
BA_ "GenSigStartValue" SG_ 1042 ReSideRdrLe20Obj12RdrObjUsedTracker 3;
BA_ "GenSigSendType" SG_ 1042 ReSideRdrLe20Obj12RdrObjVx 0;
BA_ "GenSigStartValue" SG_ 1042 ReSideRdrLe20Obj12RdrObjVx 6400;
BA_ "GenSigSendType" SG_ 1042 ReSideRdrLe20Obj12RdrObjVxStdDe 0;
BA_ "GenSigSendType" SG_ 1042 ReSideRdrLe20Obj12RdrObjVy 0;
BA_ "GenSigStartValue" SG_ 1042 ReSideRdrLe20Obj12RdrObjVy 6400;
BA_ "GenSigSendType" SG_ 1042 ReSideRdrLe20Obj12RdrObjVyStdDe 0;
BA_ "GenSigSendType" SG_ 1042 ReSideRdrLe20Obj12RelVx 0;
BA_ "GenSigStartValue" SG_ 1042 ReSideRdrLe20Obj12RelVx 1780;
BA_ "GenSigSendType" SG_ 1042 ReSideRdrLe20Obj12RelVy 0;
BA_ "GenSigStartValue" SG_ 1042 ReSideRdrLe20Obj12RelVy 1780;
BA_ "GenSigSendType" SG_ 1043 ReSideRdrLe20Obj13Heading 0;
BA_ "GenSigStartValue" SG_ 1043 ReSideRdrLe20Obj13Heading 1800;
BA_ "GenSigSendType" SG_ 1043 ReSideRdrLe20Obj13ObjBoxCenterLat 0;
BA_ "GenSigStartValue" SG_ 1043 ReSideRdrLe20Obj13ObjBoxCenterLat 250;
BA_ "GenSigSendType" SG_ 1043 ReSideRdrLe20Obj13ObjBoxCenterLgt 0;
BA_ "GenSigStartValue" SG_ 1043 ReSideRdrLe20Obj13ObjBoxCenterLgt 250;
BA_ "GenSigSendType" SG_ 1043 ReSideRdrLe20Obj13ObservationHist 0;
BA_ "GenSigSendType" SG_ 1043 ReSideRdrLe20Obj13QualityBits 0;
BA_ "GenSigSendType" SG_ 1043 ReSideRdrLe20Obj13RdrObjAx 0;
BA_ "GenSigSendType" SG_ 1043 ReSideRdrLe20Obj13RdrObjAy 0;
BA_ "GenSigSendType" SG_ 1043 ReSideRdrLe20Obj13RdrObjBoxLength 0;
BA_ "GenSigSendType" SG_ 1043 ReSideRdrLe20Obj13RdrObjBoxWidth 0;
BA_ "GenSigDataID" SG_ 1043 ReSideRdrLe20Obj13RdrObjChks "0x12A0";
BA_ "GenSigFuncType" SG_ 1043 ReSideRdrLe20Obj13RdrObjChks 15;
BA_ "GenSigSendType" SG_ 1043 ReSideRdrLe20Obj13RdrObjChks 0;
BA_ "GenSigFuncType" SG_ 1043 ReSideRdrLe20Obj13RdrObjCntr 16;
BA_ "GenSigSendType" SG_ 1043 ReSideRdrLe20Obj13RdrObjCntr 0;
BA_ "GenSigSendType" SG_ 1043 ReSideRdrLe20Obj13RdrObjCoastCnt 0;
BA_ "GenSigStartValue" SG_ 1043 ReSideRdrLe20Obj13RdrObjCoastCnt 31;
BA_ "GenSigSendType" SG_ 1043 ReSideRdrLe20Obj13RdrObjConf 0;
BA_ "GenSigSendType" SG_ 1043 ReSideRdrLe20Obj13RdrObjDx 0;
BA_ "GenSigSendType" SG_ 1043 ReSideRdrLe20Obj13RdrObjDxStdDe 0;
BA_ "GenSigSendType" SG_ 1043 ReSideRdrLe20Obj13RdrObjDy 0;
BA_ "GenSigStartValue" SG_ 1043 ReSideRdrLe20Obj13RdrObjDy 4000;
BA_ "GenSigSendType" SG_ 1043 ReSideRdrLe20Obj13RdrObjDyStdDe 0;
BA_ "GenSigSendType" SG_ 1043 ReSideRdrLe20Obj13RdrObjElevnConf 0;
BA_ "GenSigSendType" SG_ 1043 ReSideRdrLe20Obj13RdrObjElevnSts 0;
BA_ "GenSigSendType" SG_ 1043 ReSideRdrLe20Obj13RdrObjID 0;
BA_ "GenSigSendType" SG_ 1043 ReSideRdrLe20Obj13RdrObjIsInFreeSpace 0;
BA_ "GenSigStartValue" SG_ 1043 ReSideRdrLe20Obj13RdrObjIsInFreeSpace 1;
BA_ "GenSigSendType" SG_ 1043 ReSideRdrLe20Obj13RdrObjMirrProblty 0;
BA_ "GenSigSendType" SG_ 1043 ReSideRdrLe20Obj13RdrObjMtnPat 0;
BA_ "GenSigStartValue" SG_ 1043 ReSideRdrLe20Obj13RdrObjMtnPat 3;
BA_ "GenSigSendType" SG_ 1043 ReSideRdrLe20Obj13RdrObjNotRealProblty 0;
BA_ "GenSigSendType" SG_ 1043 ReSideRdrLe20Obj13RdrObjStatyCnt 0;
BA_ "GenSigSendType" SG_ 1043 ReSideRdrLe20Obj13RdrObjTiAlv 0;
BA_ "GenSigSendType" SG_ 1043 ReSideRdrLe20Obj13RdrObjTrackSts 0;
BA_ "GenSigSendType" SG_ 1043 ReSideRdrLe20Obj13RdrObjTyp 0;
BA_ "GenSigSendType" SG_ 1043 ReSideRdrLe20Obj13RdrObjTypConfBike 0;
BA_ "GenSigSendType" SG_ 1043 ReSideRdrLe20Obj13RdrObjTypConfPed 0;
BA_ "GenSigSendType" SG_ 1043 ReSideRdrLe20Obj13RdrObjTypConfVeh 0;
BA_ "GenSigSendType" SG_ 1043 ReSideRdrLe20Obj13RdrObjUsedTracker 0;
BA_ "GenSigStartValue" SG_ 1043 ReSideRdrLe20Obj13RdrObjUsedTracker 3;
BA_ "GenSigSendType" SG_ 1043 ReSideRdrLe20Obj13RdrObjVx 0;
BA_ "GenSigStartValue" SG_ 1043 ReSideRdrLe20Obj13RdrObjVx 6400;
BA_ "GenSigSendType" SG_ 1043 ReSideRdrLe20Obj13RdrObjVxStdDe 0;
BA_ "GenSigSendType" SG_ 1043 ReSideRdrLe20Obj13RdrObjVy 0;
BA_ "GenSigStartValue" SG_ 1043 ReSideRdrLe20Obj13RdrObjVy 6400;
BA_ "GenSigSendType" SG_ 1043 ReSideRdrLe20Obj13RdrObjVyStdDe 0;
BA_ "GenSigSendType" SG_ 1043 ReSideRdrLe20Obj13RelVx 0;
BA_ "GenSigStartValue" SG_ 1043 ReSideRdrLe20Obj13RelVx 1780;
BA_ "GenSigSendType" SG_ 1043 ReSideRdrLe20Obj13RelVy 0;
BA_ "GenSigStartValue" SG_ 1043 ReSideRdrLe20Obj13RelVy 1780;
BA_ "GenSigSendType" SG_ 1044 ReSideRdrLe20Obj14Heading 0;
BA_ "GenSigStartValue" SG_ 1044 ReSideRdrLe20Obj14Heading 1800;
BA_ "GenSigSendType" SG_ 1044 ReSideRdrLe20Obj14ObjBoxCenterLat 0;
BA_ "GenSigStartValue" SG_ 1044 ReSideRdrLe20Obj14ObjBoxCenterLat 250;
BA_ "GenSigSendType" SG_ 1044 ReSideRdrLe20Obj14ObjBoxCenterLgt 0;
BA_ "GenSigStartValue" SG_ 1044 ReSideRdrLe20Obj14ObjBoxCenterLgt 250;
BA_ "GenSigSendType" SG_ 1044 ReSideRdrLe20Obj14ObservationHist 0;
BA_ "GenSigSendType" SG_ 1044 ReSideRdrLe20Obj14QualityBits 0;
BA_ "GenSigSendType" SG_ 1044 ReSideRdrLe20Obj14RdrObjAx 0;
BA_ "GenSigSendType" SG_ 1044 ReSideRdrLe20Obj14RdrObjAy 0;
BA_ "GenSigSendType" SG_ 1044 ReSideRdrLe20Obj14RdrObjBoxLength 0;
BA_ "GenSigSendType" SG_ 1044 ReSideRdrLe20Obj14RdrObjBoxWidth 0;
BA_ "GenSigDataID" SG_ 1044 ReSideRdrLe20Obj14RdrObjChks "0x12A1";
BA_ "GenSigFuncType" SG_ 1044 ReSideRdrLe20Obj14RdrObjChks 15;
BA_ "GenSigSendType" SG_ 1044 ReSideRdrLe20Obj14RdrObjChks 0;
BA_ "GenSigFuncType" SG_ 1044 ReSideRdrLe20Obj14RdrObjCntr 16;
BA_ "GenSigSendType" SG_ 1044 ReSideRdrLe20Obj14RdrObjCntr 0;
BA_ "GenSigSendType" SG_ 1044 ReSideRdrLe20Obj14RdrObjCoastCnt 0;
BA_ "GenSigStartValue" SG_ 1044 ReSideRdrLe20Obj14RdrObjCoastCnt 31;
BA_ "GenSigSendType" SG_ 1044 ReSideRdrLe20Obj14RdrObjConf 0;
BA_ "GenSigSendType" SG_ 1044 ReSideRdrLe20Obj14RdrObjDx 0;
BA_ "GenSigSendType" SG_ 1044 ReSideRdrLe20Obj14RdrObjDxStdDe 0;
BA_ "GenSigSendType" SG_ 1044 ReSideRdrLe20Obj14RdrObjDy 0;
BA_ "GenSigStartValue" SG_ 1044 ReSideRdrLe20Obj14RdrObjDy 4000;
BA_ "GenSigSendType" SG_ 1044 ReSideRdrLe20Obj14RdrObjDyStdDe 0;
BA_ "GenSigSendType" SG_ 1044 ReSideRdrLe20Obj14RdrObjElevnConf 0;
BA_ "GenSigSendType" SG_ 1044 ReSideRdrLe20Obj14RdrObjElevnSts 0;
BA_ "GenSigSendType" SG_ 1044 ReSideRdrLe20Obj14RdrObjID 0;
BA_ "GenSigSendType" SG_ 1044 ReSideRdrLe20Obj14RdrObjIsInFreeSpace 0;
BA_ "GenSigStartValue" SG_ 1044 ReSideRdrLe20Obj14RdrObjIsInFreeSpace 1;
BA_ "GenSigSendType" SG_ 1044 ReSideRdrLe20Obj14RdrObjMirrProblty 0;
BA_ "GenSigSendType" SG_ 1044 ReSideRdrLe20Obj14RdrObjMtnPat 0;
BA_ "GenSigStartValue" SG_ 1044 ReSideRdrLe20Obj14RdrObjMtnPat 3;
BA_ "GenSigSendType" SG_ 1044 ReSideRdrLe20Obj14RdrObjNotRealProblty 0;
BA_ "GenSigSendType" SG_ 1044 ReSideRdrLe20Obj14RdrObjStatyCnt 0;
BA_ "GenSigSendType" SG_ 1044 ReSideRdrLe20Obj14RdrObjTiAlv 0;
BA_ "GenSigSendType" SG_ 1044 ReSideRdrLe20Obj14RdrObjTrackSts 0;
BA_ "GenSigSendType" SG_ 1044 ReSideRdrLe20Obj14RdrObjTyp 0;
BA_ "GenSigSendType" SG_ 1044 ReSideRdrLe20Obj14RdrObjTypConfBike 0;
BA_ "GenSigSendType" SG_ 1044 ReSideRdrLe20Obj14RdrObjTypConfPed 0;
BA_ "GenSigSendType" SG_ 1044 ReSideRdrLe20Obj14RdrObjTypConfVeh 0;
BA_ "GenSigSendType" SG_ 1044 ReSideRdrLe20Obj14RdrObjUsedTracker 0;
BA_ "GenSigStartValue" SG_ 1044 ReSideRdrLe20Obj14RdrObjUsedTracker 3;
BA_ "GenSigSendType" SG_ 1044 ReSideRdrLe20Obj14RdrObjVx 0;
BA_ "GenSigStartValue" SG_ 1044 ReSideRdrLe20Obj14RdrObjVx 6400;
BA_ "GenSigSendType" SG_ 1044 ReSideRdrLe20Obj14RdrObjVxStdDe 0;
BA_ "GenSigSendType" SG_ 1044 ReSideRdrLe20Obj14RdrObjVy 0;
BA_ "GenSigStartValue" SG_ 1044 ReSideRdrLe20Obj14RdrObjVy 6400;
BA_ "GenSigSendType" SG_ 1044 ReSideRdrLe20Obj14RdrObjVyStdDe 0;
BA_ "GenSigSendType" SG_ 1044 ReSideRdrLe20Obj14RelVx 0;
BA_ "GenSigStartValue" SG_ 1044 ReSideRdrLe20Obj14RelVx 1780;
BA_ "GenSigSendType" SG_ 1044 ReSideRdrLe20Obj14RelVy 0;
BA_ "GenSigStartValue" SG_ 1044 ReSideRdrLe20Obj14RelVy 1780;
BA_ "GenSigSendType" SG_ 1045 ReSideRdrLe20Obj15Heading 0;
BA_ "GenSigStartValue" SG_ 1045 ReSideRdrLe20Obj15Heading 1800;
BA_ "GenSigSendType" SG_ 1045 ReSideRdrLe20Obj15ObjBoxCenterLat 0;
BA_ "GenSigStartValue" SG_ 1045 ReSideRdrLe20Obj15ObjBoxCenterLat 250;
BA_ "GenSigSendType" SG_ 1045 ReSideRdrLe20Obj15ObjBoxCenterLgt 0;
BA_ "GenSigStartValue" SG_ 1045 ReSideRdrLe20Obj15ObjBoxCenterLgt 250;
BA_ "GenSigSendType" SG_ 1045 ReSideRdrLe20Obj15ObservationHist 0;
BA_ "GenSigSendType" SG_ 1045 ReSideRdrLe20Obj15QualityBits 0;
BA_ "GenSigSendType" SG_ 1045 ReSideRdrLe20Obj15RdrObjAx 0;
BA_ "GenSigSendType" SG_ 1045 ReSideRdrLe20Obj15RdrObjAy 0;
BA_ "GenSigSendType" SG_ 1045 ReSideRdrLe20Obj15RdrObjBoxLength 0;
BA_ "GenSigSendType" SG_ 1045 ReSideRdrLe20Obj15RdrObjBoxWidth 0;
BA_ "GenSigDataID" SG_ 1045 ReSideRdrLe20Obj15RdrObjChks "0x12A2";
BA_ "GenSigFuncType" SG_ 1045 ReSideRdrLe20Obj15RdrObjChks 15;
BA_ "GenSigSendType" SG_ 1045 ReSideRdrLe20Obj15RdrObjChks 0;
BA_ "GenSigFuncType" SG_ 1045 ReSideRdrLe20Obj15RdrObjCntr 16;
BA_ "GenSigSendType" SG_ 1045 ReSideRdrLe20Obj15RdrObjCntr 0;
BA_ "GenSigSendType" SG_ 1045 ReSideRdrLe20Obj15RdrObjCoastCnt 0;
BA_ "GenSigStartValue" SG_ 1045 ReSideRdrLe20Obj15RdrObjCoastCnt 31;
BA_ "GenSigSendType" SG_ 1045 ReSideRdrLe20Obj15RdrObjConf 0;
BA_ "GenSigSendType" SG_ 1045 ReSideRdrLe20Obj15RdrObjDx 0;
BA_ "GenSigSendType" SG_ 1045 ReSideRdrLe20Obj15RdrObjDxStdDe 0;
BA_ "GenSigSendType" SG_ 1045 ReSideRdrLe20Obj15RdrObjDy 0;
BA_ "GenSigStartValue" SG_ 1045 ReSideRdrLe20Obj15RdrObjDy 4000;
BA_ "GenSigSendType" SG_ 1045 ReSideRdrLe20Obj15RdrObjDyStdDe 0;
BA_ "GenSigSendType" SG_ 1045 ReSideRdrLe20Obj15RdrObjElevnConf 0;
BA_ "GenSigSendType" SG_ 1045 ReSideRdrLe20Obj15RdrObjElevnSts 0;
BA_ "GenSigSendType" SG_ 1045 ReSideRdrLe20Obj15RdrObjID 0;
BA_ "GenSigSendType" SG_ 1045 ReSideRdrLe20Obj15RdrObjIsInFreeSpace 0;
BA_ "GenSigStartValue" SG_ 1045 ReSideRdrLe20Obj15RdrObjIsInFreeSpace 1;
BA_ "GenSigSendType" SG_ 1045 ReSideRdrLe20Obj15RdrObjMirrProblty 0;
BA_ "GenSigSendType" SG_ 1045 ReSideRdrLe20Obj15RdrObjMtnPat 0;
BA_ "GenSigStartValue" SG_ 1045 ReSideRdrLe20Obj15RdrObjMtnPat 3;
BA_ "GenSigSendType" SG_ 1045 ReSideRdrLe20Obj15RdrObjNotRealProblty 0;
BA_ "GenSigSendType" SG_ 1045 ReSideRdrLe20Obj15RdrObjStatyCnt 0;
BA_ "GenSigSendType" SG_ 1045 ReSideRdrLe20Obj15RdrObjTiAlv 0;
BA_ "GenSigSendType" SG_ 1045 ReSideRdrLe20Obj15RdrObjTrackSts 0;
BA_ "GenSigSendType" SG_ 1045 ReSideRdrLe20Obj15RdrObjTyp 0;
BA_ "GenSigSendType" SG_ 1045 ReSideRdrLe20Obj15RdrObjTypConfBike 0;
BA_ "GenSigSendType" SG_ 1045 ReSideRdrLe20Obj15RdrObjTypConfPed 0;
BA_ "GenSigSendType" SG_ 1045 ReSideRdrLe20Obj15RdrObjTypConfVeh 0;
BA_ "GenSigSendType" SG_ 1045 ReSideRdrLe20Obj15RdrObjUsedTracker 0;
BA_ "GenSigStartValue" SG_ 1045 ReSideRdrLe20Obj15RdrObjUsedTracker 3;
BA_ "GenSigSendType" SG_ 1045 ReSideRdrLe20Obj15RdrObjVx 0;
BA_ "GenSigStartValue" SG_ 1045 ReSideRdrLe20Obj15RdrObjVx 6400;
BA_ "GenSigSendType" SG_ 1045 ReSideRdrLe20Obj15RdrObjVxStdDe 0;
BA_ "GenSigSendType" SG_ 1045 ReSideRdrLe20Obj15RdrObjVy 0;
BA_ "GenSigStartValue" SG_ 1045 ReSideRdrLe20Obj15RdrObjVy 6400;
BA_ "GenSigSendType" SG_ 1045 ReSideRdrLe20Obj15RdrObjVyStdDe 0;
BA_ "GenSigSendType" SG_ 1045 ReSideRdrLe20Obj15RelVx 0;
BA_ "GenSigStartValue" SG_ 1045 ReSideRdrLe20Obj15RelVx 1780;
BA_ "GenSigSendType" SG_ 1045 ReSideRdrLe20Obj15RelVy 0;
BA_ "GenSigStartValue" SG_ 1045 ReSideRdrLe20Obj15RelVy 1780;
BA_ "GenSigSendType" SG_ 1046 ReSideRdrLe20Obj16Heading 0;
BA_ "GenSigStartValue" SG_ 1046 ReSideRdrLe20Obj16Heading 1800;
BA_ "GenSigSendType" SG_ 1046 ReSideRdrLe20Obj16ObjBoxCenterLat 0;
BA_ "GenSigStartValue" SG_ 1046 ReSideRdrLe20Obj16ObjBoxCenterLat 250;
BA_ "GenSigSendType" SG_ 1046 ReSideRdrLe20Obj16ObjBoxCenterLgt 0;
BA_ "GenSigStartValue" SG_ 1046 ReSideRdrLe20Obj16ObjBoxCenterLgt 250;
BA_ "GenSigSendType" SG_ 1046 ReSideRdrLe20Obj16ObservationHist 0;
BA_ "GenSigSendType" SG_ 1046 ReSideRdrLe20Obj16QualityBits 0;
BA_ "GenSigSendType" SG_ 1046 ReSideRdrLe20Obj16RdrObjAx 0;
BA_ "GenSigSendType" SG_ 1046 ReSideRdrLe20Obj16RdrObjAy 0;
BA_ "GenSigSendType" SG_ 1046 ReSideRdrLe20Obj16RdrObjBoxLength 0;
BA_ "GenSigSendType" SG_ 1046 ReSideRdrLe20Obj16RdrObjBoxWidth 0;
BA_ "GenSigDataID" SG_ 1046 ReSideRdrLe20Obj16RdrObjChks "0x12A3";
BA_ "GenSigFuncType" SG_ 1046 ReSideRdrLe20Obj16RdrObjChks 15;
BA_ "GenSigSendType" SG_ 1046 ReSideRdrLe20Obj16RdrObjChks 0;
BA_ "GenSigFuncType" SG_ 1046 ReSideRdrLe20Obj16RdrObjCntr 16;
BA_ "GenSigSendType" SG_ 1046 ReSideRdrLe20Obj16RdrObjCntr 0;
BA_ "GenSigSendType" SG_ 1046 ReSideRdrLe20Obj16RdrObjCoastCnt 0;
BA_ "GenSigStartValue" SG_ 1046 ReSideRdrLe20Obj16RdrObjCoastCnt 31;
BA_ "GenSigSendType" SG_ 1046 ReSideRdrLe20Obj16RdrObjConf 0;
BA_ "GenSigSendType" SG_ 1046 ReSideRdrLe20Obj16RdrObjDx 0;
BA_ "GenSigSendType" SG_ 1046 ReSideRdrLe20Obj16RdrObjDxStdDe 0;
BA_ "GenSigSendType" SG_ 1046 ReSideRdrLe20Obj16RdrObjDy 0;
BA_ "GenSigStartValue" SG_ 1046 ReSideRdrLe20Obj16RdrObjDy 4000;
BA_ "GenSigSendType" SG_ 1046 ReSideRdrLe20Obj16RdrObjDyStdDe 0;
BA_ "GenSigSendType" SG_ 1046 ReSideRdrLe20Obj16RdrObjElevnConf 0;
BA_ "GenSigSendType" SG_ 1046 ReSideRdrLe20Obj16RdrObjElevnSts 0;
BA_ "GenSigSendType" SG_ 1046 ReSideRdrLe20Obj16RdrObjID 0;
BA_ "GenSigSendType" SG_ 1046 ReSideRdrLe20Obj16RdrObjIsInFreeSpace 0;
BA_ "GenSigStartValue" SG_ 1046 ReSideRdrLe20Obj16RdrObjIsInFreeSpace 1;
BA_ "GenSigSendType" SG_ 1046 ReSideRdrLe20Obj16RdrObjMirrProblty 0;
BA_ "GenSigSendType" SG_ 1046 ReSideRdrLe20Obj16RdrObjMtnPat 0;
BA_ "GenSigStartValue" SG_ 1046 ReSideRdrLe20Obj16RdrObjMtnPat 3;
BA_ "GenSigSendType" SG_ 1046 ReSideRdrLe20Obj16RdrObjNotRealProblty 0;
BA_ "GenSigSendType" SG_ 1046 ReSideRdrLe20Obj16RdrObjStatyCnt 0;
BA_ "GenSigSendType" SG_ 1046 ReSideRdrLe20Obj16RdrObjTiAlv 0;
BA_ "GenSigSendType" SG_ 1046 ReSideRdrLe20Obj16RdrObjTrackSts 0;
BA_ "GenSigSendType" SG_ 1046 ReSideRdrLe20Obj16RdrObjTyp 0;
BA_ "GenSigSendType" SG_ 1046 ReSideRdrLe20Obj16RdrObjTypConfBike 0;
BA_ "GenSigSendType" SG_ 1046 ReSideRdrLe20Obj16RdrObjTypConfPed 0;
BA_ "GenSigSendType" SG_ 1046 ReSideRdrLe20Obj16RdrObjTypConfVeh 0;
BA_ "GenSigSendType" SG_ 1046 ReSideRdrLe20Obj16RdrObjUsedTracker 0;
BA_ "GenSigStartValue" SG_ 1046 ReSideRdrLe20Obj16RdrObjUsedTracker 3;
BA_ "GenSigSendType" SG_ 1046 ReSideRdrLe20Obj16RdrObjVx 0;
BA_ "GenSigStartValue" SG_ 1046 ReSideRdrLe20Obj16RdrObjVx 6400;
BA_ "GenSigSendType" SG_ 1046 ReSideRdrLe20Obj16RdrObjVxStdDe 0;
BA_ "GenSigSendType" SG_ 1046 ReSideRdrLe20Obj16RdrObjVy 0;
BA_ "GenSigStartValue" SG_ 1046 ReSideRdrLe20Obj16RdrObjVy 6400;
BA_ "GenSigSendType" SG_ 1046 ReSideRdrLe20Obj16RdrObjVyStdDe 0;
BA_ "GenSigSendType" SG_ 1046 ReSideRdrLe20Obj16RelVx 0;
BA_ "GenSigStartValue" SG_ 1046 ReSideRdrLe20Obj16RelVx 1780;
BA_ "GenSigSendType" SG_ 1046 ReSideRdrLe20Obj16RelVy 0;
BA_ "GenSigStartValue" SG_ 1046 ReSideRdrLe20Obj16RelVy 1780;
BA_ "GenSigSendType" SG_ 1047 ReSideRdrLe20Obj17Heading 0;
BA_ "GenSigStartValue" SG_ 1047 ReSideRdrLe20Obj17Heading 1800;
BA_ "GenSigSendType" SG_ 1047 ReSideRdrLe20Obj17ObjBoxCenterLat 0;
BA_ "GenSigStartValue" SG_ 1047 ReSideRdrLe20Obj17ObjBoxCenterLat 250;
BA_ "GenSigSendType" SG_ 1047 ReSideRdrLe20Obj17ObjBoxCenterLgt 0;
BA_ "GenSigStartValue" SG_ 1047 ReSideRdrLe20Obj17ObjBoxCenterLgt 250;
BA_ "GenSigSendType" SG_ 1047 ReSideRdrLe20Obj17ObservationHist 0;
BA_ "GenSigSendType" SG_ 1047 ReSideRdrLe20Obj17QualityBits 0;
BA_ "GenSigSendType" SG_ 1047 ReSideRdrLe20Obj17RdrObjAx 0;
BA_ "GenSigSendType" SG_ 1047 ReSideRdrLe20Obj17RdrObjAy 0;
BA_ "GenSigSendType" SG_ 1047 ReSideRdrLe20Obj17RdrObjBoxLength 0;
BA_ "GenSigSendType" SG_ 1047 ReSideRdrLe20Obj17RdrObjBoxWidth 0;
BA_ "GenSigDataID" SG_ 1047 ReSideRdrLe20Obj17RdrObjChks "0x12A4";
BA_ "GenSigFuncType" SG_ 1047 ReSideRdrLe20Obj17RdrObjChks 15;
BA_ "GenSigSendType" SG_ 1047 ReSideRdrLe20Obj17RdrObjChks 0;
BA_ "GenSigFuncType" SG_ 1047 ReSideRdrLe20Obj17RdrObjCntr 16;
BA_ "GenSigSendType" SG_ 1047 ReSideRdrLe20Obj17RdrObjCntr 0;
BA_ "GenSigSendType" SG_ 1047 ReSideRdrLe20Obj17RdrObjCoastCnt 0;
BA_ "GenSigStartValue" SG_ 1047 ReSideRdrLe20Obj17RdrObjCoastCnt 31;
BA_ "GenSigSendType" SG_ 1047 ReSideRdrLe20Obj17RdrObjConf 0;
BA_ "GenSigSendType" SG_ 1047 ReSideRdrLe20Obj17RdrObjDx 0;
BA_ "GenSigSendType" SG_ 1047 ReSideRdrLe20Obj17RdrObjDxStdDe 0;
BA_ "GenSigSendType" SG_ 1047 ReSideRdrLe20Obj17RdrObjDy 0;
BA_ "GenSigStartValue" SG_ 1047 ReSideRdrLe20Obj17RdrObjDy 4000;
BA_ "GenSigSendType" SG_ 1047 ReSideRdrLe20Obj17RdrObjDyStdDe 0;
BA_ "GenSigSendType" SG_ 1047 ReSideRdrLe20Obj17RdrObjElevnConf 0;
BA_ "GenSigSendType" SG_ 1047 ReSideRdrLe20Obj17RdrObjElevnSts 0;
BA_ "GenSigSendType" SG_ 1047 ReSideRdrLe20Obj17RdrObjID 0;
BA_ "GenSigSendType" SG_ 1047 ReSideRdrLe20Obj17RdrObjIsInFreeSpace 0;
BA_ "GenSigStartValue" SG_ 1047 ReSideRdrLe20Obj17RdrObjIsInFreeSpace 1;
BA_ "GenSigSendType" SG_ 1047 ReSideRdrLe20Obj17RdrObjMirrProblty 0;
BA_ "GenSigSendType" SG_ 1047 ReSideRdrLe20Obj17RdrObjMtnPat 0;
BA_ "GenSigStartValue" SG_ 1047 ReSideRdrLe20Obj17RdrObjMtnPat 3;
BA_ "GenSigSendType" SG_ 1047 ReSideRdrLe20Obj17RdrObjNotRealProblty 0;
BA_ "GenSigSendType" SG_ 1047 ReSideRdrLe20Obj17RdrObjStatyCnt 0;
BA_ "GenSigSendType" SG_ 1047 ReSideRdrLe20Obj17RdrObjTiAlv 0;
BA_ "GenSigSendType" SG_ 1047 ReSideRdrLe20Obj17RdrObjTrackSts 0;
BA_ "GenSigSendType" SG_ 1047 ReSideRdrLe20Obj17RdrObjTyp 0;
BA_ "GenSigSendType" SG_ 1047 ReSideRdrLe20Obj17RdrObjTypConfBike 0;
BA_ "GenSigSendType" SG_ 1047 ReSideRdrLe20Obj17RdrObjTypConfPed 0;
BA_ "GenSigSendType" SG_ 1047 ReSideRdrLe20Obj17RdrObjTypConfVeh 0;
BA_ "GenSigSendType" SG_ 1047 ReSideRdrLe20Obj17RdrObjUsedTracker 0;
BA_ "GenSigStartValue" SG_ 1047 ReSideRdrLe20Obj17RdrObjUsedTracker 3;
BA_ "GenSigSendType" SG_ 1047 ReSideRdrLe20Obj17RdrObjVx 0;
BA_ "GenSigStartValue" SG_ 1047 ReSideRdrLe20Obj17RdrObjVx 6400;
BA_ "GenSigSendType" SG_ 1047 ReSideRdrLe20Obj17RdrObjVxStdDe 0;
BA_ "GenSigSendType" SG_ 1047 ReSideRdrLe20Obj17RdrObjVy 0;
BA_ "GenSigStartValue" SG_ 1047 ReSideRdrLe20Obj17RdrObjVy 6400;
BA_ "GenSigSendType" SG_ 1047 ReSideRdrLe20Obj17RdrObjVyStdDe 0;
BA_ "GenSigSendType" SG_ 1047 ReSideRdrLe20Obj17RelVx 0;
BA_ "GenSigStartValue" SG_ 1047 ReSideRdrLe20Obj17RelVx 1780;
BA_ "GenSigSendType" SG_ 1047 ReSideRdrLe20Obj17RelVy 0;
BA_ "GenSigStartValue" SG_ 1047 ReSideRdrLe20Obj17RelVy 1780;
BA_ "GenSigSendType" SG_ 1048 ReSideRdrLe20Obj18Heading 0;
BA_ "GenSigStartValue" SG_ 1048 ReSideRdrLe20Obj18Heading 1800;
BA_ "GenSigSendType" SG_ 1048 ReSideRdrLe20Obj18ObjBoxCenterLat 0;
BA_ "GenSigStartValue" SG_ 1048 ReSideRdrLe20Obj18ObjBoxCenterLat 250;
BA_ "GenSigSendType" SG_ 1048 ReSideRdrLe20Obj18ObjBoxCenterLgt 0;
BA_ "GenSigStartValue" SG_ 1048 ReSideRdrLe20Obj18ObjBoxCenterLgt 250;
BA_ "GenSigSendType" SG_ 1048 ReSideRdrLe20Obj18ObservationHist 0;
BA_ "GenSigSendType" SG_ 1048 ReSideRdrLe20Obj18QualityBits 0;
BA_ "GenSigSendType" SG_ 1048 ReSideRdrLe20Obj18RdrObjAx 0;
BA_ "GenSigSendType" SG_ 1048 ReSideRdrLe20Obj18RdrObjAy 0;
BA_ "GenSigSendType" SG_ 1048 ReSideRdrLe20Obj18RdrObjBoxLength 0;
BA_ "GenSigSendType" SG_ 1048 ReSideRdrLe20Obj18RdrObjBoxWidth 0;
BA_ "GenSigDataID" SG_ 1048 ReSideRdrLe20Obj18RdrObjChks "0x12A5";
BA_ "GenSigFuncType" SG_ 1048 ReSideRdrLe20Obj18RdrObjChks 15;
BA_ "GenSigSendType" SG_ 1048 ReSideRdrLe20Obj18RdrObjChks 0;
BA_ "GenSigFuncType" SG_ 1048 ReSideRdrLe20Obj18RdrObjCntr 16;
BA_ "GenSigSendType" SG_ 1048 ReSideRdrLe20Obj18RdrObjCntr 0;
BA_ "GenSigSendType" SG_ 1048 ReSideRdrLe20Obj18RdrObjCoastCnt 0;
BA_ "GenSigStartValue" SG_ 1048 ReSideRdrLe20Obj18RdrObjCoastCnt 31;
BA_ "GenSigSendType" SG_ 1048 ReSideRdrLe20Obj18RdrObjConf 0;
BA_ "GenSigSendType" SG_ 1048 ReSideRdrLe20Obj18RdrObjDx 0;
BA_ "GenSigSendType" SG_ 1048 ReSideRdrLe20Obj18RdrObjDxStdDe 0;
BA_ "GenSigSendType" SG_ 1048 ReSideRdrLe20Obj18RdrObjDy 0;
BA_ "GenSigStartValue" SG_ 1048 ReSideRdrLe20Obj18RdrObjDy 4000;
BA_ "GenSigSendType" SG_ 1048 ReSideRdrLe20Obj18RdrObjDyStdDe 0;
BA_ "GenSigSendType" SG_ 1048 ReSideRdrLe20Obj18RdrObjElevnConf 0;
BA_ "GenSigSendType" SG_ 1048 ReSideRdrLe20Obj18RdrObjElevnSts 0;
BA_ "GenSigSendType" SG_ 1048 ReSideRdrLe20Obj18RdrObjID 0;
BA_ "GenSigSendType" SG_ 1048 ReSideRdrLe20Obj18RdrObjIsInFreeSpace 0;
BA_ "GenSigStartValue" SG_ 1048 ReSideRdrLe20Obj18RdrObjIsInFreeSpace 1;
BA_ "GenSigSendType" SG_ 1048 ReSideRdrLe20Obj18RdrObjMirrProblty 0;
BA_ "GenSigSendType" SG_ 1048 ReSideRdrLe20Obj18RdrObjMtnPat 0;
BA_ "GenSigStartValue" SG_ 1048 ReSideRdrLe20Obj18RdrObjMtnPat 3;
BA_ "GenSigSendType" SG_ 1048 ReSideRdrLe20Obj18RdrObjNotRealProblty 0;
BA_ "GenSigSendType" SG_ 1048 ReSideRdrLe20Obj18RdrObjStatyCnt 0;
BA_ "GenSigSendType" SG_ 1048 ReSideRdrLe20Obj18RdrObjTiAlv 0;
BA_ "GenSigSendType" SG_ 1048 ReSideRdrLe20Obj18RdrObjTrackSts 0;
BA_ "GenSigSendType" SG_ 1048 ReSideRdrLe20Obj18RdrObjTyp 0;
BA_ "GenSigSendType" SG_ 1048 ReSideRdrLe20Obj18RdrObjTypConfBike 0;
BA_ "GenSigSendType" SG_ 1048 ReSideRdrLe20Obj18RdrObjTypConfPed 0;
BA_ "GenSigSendType" SG_ 1048 ReSideRdrLe20Obj18RdrObjTypConfVeh 0;
BA_ "GenSigSendType" SG_ 1048 ReSideRdrLe20Obj18RdrObjUsedTracker 0;
BA_ "GenSigStartValue" SG_ 1048 ReSideRdrLe20Obj18RdrObjUsedTracker 3;
BA_ "GenSigSendType" SG_ 1048 ReSideRdrLe20Obj18RdrObjVx 0;
BA_ "GenSigStartValue" SG_ 1048 ReSideRdrLe20Obj18RdrObjVx 6400;
BA_ "GenSigSendType" SG_ 1048 ReSideRdrLe20Obj18RdrObjVxStdDe 0;
BA_ "GenSigSendType" SG_ 1048 ReSideRdrLe20Obj18RdrObjVy 0;
BA_ "GenSigStartValue" SG_ 1048 ReSideRdrLe20Obj18RdrObjVy 6400;
BA_ "GenSigSendType" SG_ 1048 ReSideRdrLe20Obj18RdrObjVyStdDe 0;
BA_ "GenSigSendType" SG_ 1048 ReSideRdrLe20Obj18RelVx 0;
BA_ "GenSigStartValue" SG_ 1048 ReSideRdrLe20Obj18RelVx 1780;
BA_ "GenSigSendType" SG_ 1048 ReSideRdrLe20Obj18RelVy 0;
BA_ "GenSigStartValue" SG_ 1048 ReSideRdrLe20Obj18RelVy 1780;
BA_ "GenSigSendType" SG_ 1049 ReSideRdrLe20Obj19Heading 0;
BA_ "GenSigStartValue" SG_ 1049 ReSideRdrLe20Obj19Heading 1800;
BA_ "GenSigSendType" SG_ 1049 ReSideRdrLe20Obj19ObjBoxCenterLat 0;
BA_ "GenSigStartValue" SG_ 1049 ReSideRdrLe20Obj19ObjBoxCenterLat 250;
BA_ "GenSigSendType" SG_ 1049 ReSideRdrLe20Obj19ObjBoxCenterLgt 0;
BA_ "GenSigStartValue" SG_ 1049 ReSideRdrLe20Obj19ObjBoxCenterLgt 250;
BA_ "GenSigSendType" SG_ 1049 ReSideRdrLe20Obj19ObservationHist 0;
BA_ "GenSigSendType" SG_ 1049 ReSideRdrLe20Obj19QualityBits 0;
BA_ "GenSigSendType" SG_ 1049 ReSideRdrLe20Obj19RdrObjAx 0;
BA_ "GenSigSendType" SG_ 1049 ReSideRdrLe20Obj19RdrObjAy 0;
BA_ "GenSigSendType" SG_ 1049 ReSideRdrLe20Obj19RdrObjBoxLength 0;
BA_ "GenSigSendType" SG_ 1049 ReSideRdrLe20Obj19RdrObjBoxWidth 0;
BA_ "GenSigDataID" SG_ 1049 ReSideRdrLe20Obj19RdrObjChks "0x12A6";
BA_ "GenSigFuncType" SG_ 1049 ReSideRdrLe20Obj19RdrObjChks 15;
BA_ "GenSigSendType" SG_ 1049 ReSideRdrLe20Obj19RdrObjChks 0;
BA_ "GenSigFuncType" SG_ 1049 ReSideRdrLe20Obj19RdrObjCntr 16;
BA_ "GenSigSendType" SG_ 1049 ReSideRdrLe20Obj19RdrObjCntr 0;
BA_ "GenSigSendType" SG_ 1049 ReSideRdrLe20Obj19RdrObjCoastCnt 0;
BA_ "GenSigStartValue" SG_ 1049 ReSideRdrLe20Obj19RdrObjCoastCnt 31;
BA_ "GenSigSendType" SG_ 1049 ReSideRdrLe20Obj19RdrObjConf 0;
BA_ "GenSigSendType" SG_ 1049 ReSideRdrLe20Obj19RdrObjDx 0;
BA_ "GenSigSendType" SG_ 1049 ReSideRdrLe20Obj19RdrObjDxStdDe 0;
BA_ "GenSigSendType" SG_ 1049 ReSideRdrLe20Obj19RdrObjDy 0;
BA_ "GenSigStartValue" SG_ 1049 ReSideRdrLe20Obj19RdrObjDy 4000;
BA_ "GenSigSendType" SG_ 1049 ReSideRdrLe20Obj19RdrObjDyStdDe 0;
BA_ "GenSigSendType" SG_ 1049 ReSideRdrLe20Obj19RdrObjElevnConf 0;
BA_ "GenSigSendType" SG_ 1049 ReSideRdrLe20Obj19RdrObjElevnSts 0;
BA_ "GenSigSendType" SG_ 1049 ReSideRdrLe20Obj19RdrObjID 0;
BA_ "GenSigSendType" SG_ 1049 ReSideRdrLe20Obj19RdrObjIsInFreeSpace 0;
BA_ "GenSigStartValue" SG_ 1049 ReSideRdrLe20Obj19RdrObjIsInFreeSpace 1;
BA_ "GenSigSendType" SG_ 1049 ReSideRdrLe20Obj19RdrObjMirrProblty 0;
BA_ "GenSigSendType" SG_ 1049 ReSideRdrLe20Obj19RdrObjMtnPat 0;
BA_ "GenSigStartValue" SG_ 1049 ReSideRdrLe20Obj19RdrObjMtnPat 3;
BA_ "GenSigSendType" SG_ 1049 ReSideRdrLe20Obj19RdrObjNotRealProblty 0;
BA_ "GenSigSendType" SG_ 1049 ReSideRdrLe20Obj19RdrObjStatyCnt 0;
BA_ "GenSigSendType" SG_ 1049 ReSideRdrLe20Obj19RdrObjTiAlv 0;
BA_ "GenSigSendType" SG_ 1049 ReSideRdrLe20Obj19RdrObjTrackSts 0;
BA_ "GenSigSendType" SG_ 1049 ReSideRdrLe20Obj19RdrObjTyp 0;
BA_ "GenSigSendType" SG_ 1049 ReSideRdrLe20Obj19RdrObjTypConfBike 0;
BA_ "GenSigSendType" SG_ 1049 ReSideRdrLe20Obj19RdrObjTypConfPed 0;
BA_ "GenSigSendType" SG_ 1049 ReSideRdrLe20Obj19RdrObjTypConfVeh 0;
BA_ "GenSigSendType" SG_ 1049 ReSideRdrLe20Obj19RdrObjUsedTracker 0;
BA_ "GenSigStartValue" SG_ 1049 ReSideRdrLe20Obj19RdrObjUsedTracker 3;
BA_ "GenSigSendType" SG_ 1049 ReSideRdrLe20Obj19RdrObjVx 0;
BA_ "GenSigStartValue" SG_ 1049 ReSideRdrLe20Obj19RdrObjVx 6400;
BA_ "GenSigSendType" SG_ 1049 ReSideRdrLe20Obj19RdrObjVxStdDe 0;
BA_ "GenSigSendType" SG_ 1049 ReSideRdrLe20Obj19RdrObjVy 0;
BA_ "GenSigStartValue" SG_ 1049 ReSideRdrLe20Obj19RdrObjVy 6400;
BA_ "GenSigSendType" SG_ 1049 ReSideRdrLe20Obj19RdrObjVyStdDe 0;
BA_ "GenSigSendType" SG_ 1049 ReSideRdrLe20Obj19RelVx 0;
BA_ "GenSigStartValue" SG_ 1049 ReSideRdrLe20Obj19RelVx 1780;
BA_ "GenSigSendType" SG_ 1049 ReSideRdrLe20Obj19RelVy 0;
BA_ "GenSigStartValue" SG_ 1049 ReSideRdrLe20Obj19RelVy 1780;
BA_ "GenSigSendType" SG_ 1032 ReSideRdrLe20Obj8Heading 0;
BA_ "GenSigStartValue" SG_ 1032 ReSideRdrLe20Obj8Heading 1800;
BA_ "GenSigSendType" SG_ 1032 ReSideRdrLe20Obj8ObjBoxCenterLat 0;
BA_ "GenSigStartValue" SG_ 1032 ReSideRdrLe20Obj8ObjBoxCenterLat 250;
BA_ "GenSigSendType" SG_ 1032 ReSideRdrLe20Obj8ObjBoxCenterLgt 0;
BA_ "GenSigStartValue" SG_ 1032 ReSideRdrLe20Obj8ObjBoxCenterLgt 250;
BA_ "GenSigSendType" SG_ 1032 ReSideRdrLe20Obj8ObservationHist 0;
BA_ "GenSigSendType" SG_ 1032 ReSideRdrLe20Obj8QualityBits 0;
BA_ "GenSigSendType" SG_ 1032 ReSideRdrLe20Obj8RdrObjAx 0;
BA_ "GenSigSendType" SG_ 1032 ReSideRdrLe20Obj8RdrObjAy 0;
BA_ "GenSigSendType" SG_ 1032 ReSideRdrLe20Obj8RdrObjBoxLength 0;
BA_ "GenSigSendType" SG_ 1032 ReSideRdrLe20Obj8RdrObjBoxWidth 0;
BA_ "GenSigDataID" SG_ 1032 ReSideRdrLe20Obj8RdrObjChks "0x129B";
BA_ "GenSigFuncType" SG_ 1032 ReSideRdrLe20Obj8RdrObjChks 15;
BA_ "GenSigSendType" SG_ 1032 ReSideRdrLe20Obj8RdrObjChks 0;
BA_ "GenSigFuncType" SG_ 1032 ReSideRdrLe20Obj8RdrObjCntr 16;
BA_ "GenSigSendType" SG_ 1032 ReSideRdrLe20Obj8RdrObjCntr 0;
BA_ "GenSigSendType" SG_ 1032 ReSideRdrLe20Obj8RdrObjCoastCnt 0;
BA_ "GenSigStartValue" SG_ 1032 ReSideRdrLe20Obj8RdrObjCoastCnt 31;
BA_ "GenSigSendType" SG_ 1032 ReSideRdrLe20Obj8RdrObjConf 0;
BA_ "GenSigSendType" SG_ 1032 ReSideRdrLe20Obj8RdrObjDx 0;
BA_ "GenSigSendType" SG_ 1032 ReSideRdrLe20Obj8RdrObjDxStdDe 0;
BA_ "GenSigSendType" SG_ 1032 ReSideRdrLe20Obj8RdrObjDy 0;
BA_ "GenSigStartValue" SG_ 1032 ReSideRdrLe20Obj8RdrObjDy 4000;
BA_ "GenSigSendType" SG_ 1032 ReSideRdrLe20Obj8RdrObjDyStdDe 0;
BA_ "GenSigSendType" SG_ 1032 ReSideRdrLe20Obj8RdrObjElevnConf 0;
BA_ "GenSigSendType" SG_ 1032 ReSideRdrLe20Obj8RdrObjElevnSts 0;
BA_ "GenSigSendType" SG_ 1032 ReSideRdrLe20Obj8RdrObjID 0;
BA_ "GenSigSendType" SG_ 1032 ReSideRdrLe20Obj8RdrObjIsInFreeSpace 0;
BA_ "GenSigStartValue" SG_ 1032 ReSideRdrLe20Obj8RdrObjIsInFreeSpace 1;
BA_ "GenSigSendType" SG_ 1032 ReSideRdrLe20Obj8RdrObjMirrProblty 0;
BA_ "GenSigSendType" SG_ 1032 ReSideRdrLe20Obj8RdrObjMtnPat 0;
BA_ "GenSigStartValue" SG_ 1032 ReSideRdrLe20Obj8RdrObjMtnPat 3;
BA_ "GenSigSendType" SG_ 1032 ReSideRdrLe20Obj8RdrObjNotRealProblty 0;
BA_ "GenSigSendType" SG_ 1032 ReSideRdrLe20Obj8RdrObjStatyCnt 0;
BA_ "GenSigSendType" SG_ 1032 ReSideRdrLe20Obj8RdrObjTiAlv 0;
BA_ "GenSigSendType" SG_ 1032 ReSideRdrLe20Obj8RdrObjTrackSts 0;
BA_ "GenSigSendType" SG_ 1032 ReSideRdrLe20Obj8RdrObjTyp 0;
BA_ "GenSigSendType" SG_ 1032 ReSideRdrLe20Obj8RdrObjTypConfBike 0;
BA_ "GenSigSendType" SG_ 1032 ReSideRdrLe20Obj8RdrObjTypConfPed 0;
BA_ "GenSigSendType" SG_ 1032 ReSideRdrLe20Obj8RdrObjTypConfVeh 0;
BA_ "GenSigSendType" SG_ 1032 ReSideRdrLe20Obj8RdrObjUsedTracker 0;
BA_ "GenSigStartValue" SG_ 1032 ReSideRdrLe20Obj8RdrObjUsedTracker 3;
BA_ "GenSigSendType" SG_ 1032 ReSideRdrLe20Obj8RdrObjVx 0;
BA_ "GenSigStartValue" SG_ 1032 ReSideRdrLe20Obj8RdrObjVx 6400;
BA_ "GenSigSendType" SG_ 1032 ReSideRdrLe20Obj8RdrObjVxStdDe 0;
BA_ "GenSigSendType" SG_ 1032 ReSideRdrLe20Obj8RdrObjVy 0;
BA_ "GenSigStartValue" SG_ 1032 ReSideRdrLe20Obj8RdrObjVy 6400;
BA_ "GenSigSendType" SG_ 1032 ReSideRdrLe20Obj8RdrObjVyStdDe 0;
BA_ "GenSigSendType" SG_ 1032 ReSideRdrLe20Obj8RelVx 0;
BA_ "GenSigStartValue" SG_ 1032 ReSideRdrLe20Obj8RelVx 1780;
BA_ "GenSigSendType" SG_ 1032 ReSideRdrLe20Obj8RelVy 0;
BA_ "GenSigStartValue" SG_ 1032 ReSideRdrLe20Obj8RelVy 1780;
BA_ "GenSigSendType" SG_ 1033 ReSideRdrLe20Obj9Heading 0;
BA_ "GenSigStartValue" SG_ 1033 ReSideRdrLe20Obj9Heading 1800;
BA_ "GenSigSendType" SG_ 1033 ReSideRdrLe20Obj9ObjBoxCenterLat 0;
BA_ "GenSigStartValue" SG_ 1033 ReSideRdrLe20Obj9ObjBoxCenterLat 250;
BA_ "GenSigSendType" SG_ 1033 ReSideRdrLe20Obj9ObjBoxCenterLgt 0;
BA_ "GenSigStartValue" SG_ 1033 ReSideRdrLe20Obj9ObjBoxCenterLgt 250;
BA_ "GenSigSendType" SG_ 1033 ReSideRdrLe20Obj9ObservationHist 0;
BA_ "GenSigSendType" SG_ 1033 ReSideRdrLe20Obj9QualityBits 0;
BA_ "GenSigSendType" SG_ 1033 ReSideRdrLe20Obj9RdrObjAx 0;
BA_ "GenSigSendType" SG_ 1033 ReSideRdrLe20Obj9RdrObjAy 0;
BA_ "GenSigSendType" SG_ 1033 ReSideRdrLe20Obj9RdrObjBoxLength 0;
BA_ "GenSigSendType" SG_ 1033 ReSideRdrLe20Obj9RdrObjBoxWidth 0;
BA_ "GenSigDataID" SG_ 1033 ReSideRdrLe20Obj9RdrObjChks "0x129C";
BA_ "GenSigFuncType" SG_ 1033 ReSideRdrLe20Obj9RdrObjChks 15;
BA_ "GenSigSendType" SG_ 1033 ReSideRdrLe20Obj9RdrObjChks 0;
BA_ "GenSigFuncType" SG_ 1033 ReSideRdrLe20Obj9RdrObjCntr 16;
BA_ "GenSigSendType" SG_ 1033 ReSideRdrLe20Obj9RdrObjCntr 0;
BA_ "GenSigSendType" SG_ 1033 ReSideRdrLe20Obj9RdrObjCoastCnt 0;
BA_ "GenSigStartValue" SG_ 1033 ReSideRdrLe20Obj9RdrObjCoastCnt 31;
BA_ "GenSigSendType" SG_ 1033 ReSideRdrLe20Obj9RdrObjConf 0;
BA_ "GenSigSendType" SG_ 1033 ReSideRdrLe20Obj9RdrObjDx 0;
BA_ "GenSigSendType" SG_ 1033 ReSideRdrLe20Obj9RdrObjDxStdDe 0;
BA_ "GenSigSendType" SG_ 1033 ReSideRdrLe20Obj9RdrObjDy 0;
BA_ "GenSigStartValue" SG_ 1033 ReSideRdrLe20Obj9RdrObjDy 4000;
BA_ "GenSigSendType" SG_ 1033 ReSideRdrLe20Obj9RdrObjDyStdDe 0;
BA_ "GenSigSendType" SG_ 1033 ReSideRdrLe20Obj9RdrObjElevnConf 0;
BA_ "GenSigSendType" SG_ 1033 ReSideRdrLe20Obj9RdrObjElevnSts 0;
BA_ "GenSigSendType" SG_ 1033 ReSideRdrLe20Obj9RdrObjID 0;
BA_ "GenSigSendType" SG_ 1033 ReSideRdrLe20Obj9RdrObjIsInFreeSpace 0;
BA_ "GenSigStartValue" SG_ 1033 ReSideRdrLe20Obj9RdrObjIsInFreeSpace 1;
BA_ "GenSigSendType" SG_ 1033 ReSideRdrLe20Obj9RdrObjMirrProblty 0;
BA_ "GenSigSendType" SG_ 1033 ReSideRdrLe20Obj9RdrObjMtnPat 0;
BA_ "GenSigStartValue" SG_ 1033 ReSideRdrLe20Obj9RdrObjMtnPat 3;
BA_ "GenSigSendType" SG_ 1033 ReSideRdrLe20Obj9RdrObjNotRealProblty 0;
BA_ "GenSigSendType" SG_ 1033 ReSideRdrLe20Obj9RdrObjStatyCnt 0;
BA_ "GenSigSendType" SG_ 1033 ReSideRdrLe20Obj9RdrObjTiAlv 0;
BA_ "GenSigSendType" SG_ 1033 ReSideRdrLe20Obj9RdrObjTrackSts 0;
BA_ "GenSigSendType" SG_ 1033 ReSideRdrLe20Obj9RdrObjTyp 0;
BA_ "GenSigSendType" SG_ 1033 ReSideRdrLe20Obj9RdrObjTypConfBike 0;
BA_ "GenSigSendType" SG_ 1033 ReSideRdrLe20Obj9RdrObjTypConfPed 0;
BA_ "GenSigSendType" SG_ 1033 ReSideRdrLe20Obj9RdrObjTypConfVeh 0;
BA_ "GenSigSendType" SG_ 1033 ReSideRdrLe20Obj9RdrObjUsedTracker 0;
BA_ "GenSigStartValue" SG_ 1033 ReSideRdrLe20Obj9RdrObjUsedTracker 3;
BA_ "GenSigSendType" SG_ 1033 ReSideRdrLe20Obj9RdrObjVx 0;
BA_ "GenSigStartValue" SG_ 1033 ReSideRdrLe20Obj9RdrObjVx 6400;
BA_ "GenSigSendType" SG_ 1033 ReSideRdrLe20Obj9RdrObjVxStdDe 0;
BA_ "GenSigSendType" SG_ 1033 ReSideRdrLe20Obj9RdrObjVy 0;
BA_ "GenSigStartValue" SG_ 1033 ReSideRdrLe20Obj9RdrObjVy 6400;
BA_ "GenSigSendType" SG_ 1033 ReSideRdrLe20Obj9RdrObjVyStdDe 0;
BA_ "GenSigSendType" SG_ 1033 ReSideRdrLe20Obj9RelVx 0;
BA_ "GenSigStartValue" SG_ 1033 ReSideRdrLe20Obj9RelVx 1780;
BA_ "GenSigSendType" SG_ 1033 ReSideRdrLe20Obj9RelVy 0;
BA_ "GenSigStartValue" SG_ 1033 ReSideRdrLe20Obj9RelVy 1780;
VAL_ 1032 ReSideRdrLe20Obj8RdrObjElevnSts 0 "RdrObjElevnSts_Unknown" 1 "RdrObjElevnSts_OverRidable" 2 "RdrObjElevnSts_Rlv" 3 "RdrObjElevnSts_UnderRidable";
VAL_ 1032 ReSideRdrLe20Obj8RdrObjIsInFreeSpace 0 "YesNo2_No" 1 "YesNo2_Yes";
VAL_ 1032 ReSideRdrLe20Obj8RdrObjMtnPat 0 "RdrObjMtnPat_Ukwn" 1 "RdrObjMtnPat_Staty" 2 "RdrObjMtnPat_StatyFromMovg" 3 "RdrObjMtnPat_Movg" 4 "RdrObjMtnPat_Receding" 5 "RdrObjMtnPat_Oncoming" 6 "RdrObjMtnPat_CrossingFromLe" 7 "RdrObjMtnPat_CrossingFromRi";
VAL_ 1032 ReSideRdrLe20Obj8RdrObjTrackSts 0 "RdrObjTrackSts_Invld" 1 "RdrObjTrackSts_Updated" 2 "RdrObjTrackSts_New" 3 "RdrObjTrackSts_Coasted";
VAL_ 1032 ReSideRdrLe20Obj8RdrObjTyp 0 "RdrObjTyp_Ukwn" 1 "RdrObjTyp_Car" 2 "RdrObjTyp_MotorCycle" 3 "RdrObjTyp_Truck" 4 "RdrObjTyp_Ped" 5 "RdrObjTyp_ObstdVert1" 6 "RdrObjTyp_ObstdVert2" 7 "RdrObjTyp_Anim" 8 "RdrObjTyp_ObjGen" 9 "RdrObjTyp_Bicycle" 10 "RdrObjTyp_VehofUkwnClass" 11 "RdrObjTyp_Reserved";
VAL_ 1032 ReSideRdrLe20Obj8RdrObjUsedTracker 0 "RdrObjUsedTracker_Stationary" 1 "RdrObjUsedTracker_MovingCVModel" 2 "RdrObjUsedTracker_MovingCTModel" 3 "RdrObjUsedTracker_Undefined";
VAL_ 1033 ReSideRdrLe20Obj9RdrObjElevnSts 0 "RdrObjElevnSts_Unknown" 1 "RdrObjElevnSts_OverRidable" 2 "RdrObjElevnSts_Rlv" 3 "RdrObjElevnSts_UnderRidable";
VAL_ 1033 ReSideRdrLe20Obj9RdrObjIsInFreeSpace 0 "YesNo2_No" 1 "YesNo2_Yes";
VAL_ 1033 ReSideRdrLe20Obj9RdrObjMtnPat 0 "RdrObjMtnPat_Ukwn" 1 "RdrObjMtnPat_Staty" 2 "RdrObjMtnPat_StatyFromMovg" 3 "RdrObjMtnPat_Movg" 4 "RdrObjMtnPat_Receding" 5 "RdrObjMtnPat_Oncoming" 6 "RdrObjMtnPat_CrossingFromLe" 7 "RdrObjMtnPat_CrossingFromRi";
VAL_ 1033 ReSideRdrLe20Obj9RdrObjTrackSts 0 "RdrObjTrackSts_Invld" 1 "RdrObjTrackSts_Updated" 2 "RdrObjTrackSts_New" 3 "RdrObjTrackSts_Coasted";
VAL_ 1033 ReSideRdrLe20Obj9RdrObjTyp 0 "RdrObjTyp_Ukwn" 1 "RdrObjTyp_Car" 2 "RdrObjTyp_MotorCycle" 3 "RdrObjTyp_Truck" 4 "RdrObjTyp_Ped" 5 "RdrObjTyp_ObstdVert1" 6 "RdrObjTyp_ObstdVert2" 7 "RdrObjTyp_Anim" 8 "RdrObjTyp_ObjGen" 9 "RdrObjTyp_Bicycle" 10 "RdrObjTyp_VehofUkwnClass" 11 "RdrObjTyp_Reserved";
VAL_ 1033 ReSideRdrLe20Obj9RdrObjUsedTracker 0 "RdrObjUsedTracker_Stationary" 1 "RdrObjUsedTracker_MovingCVModel" 2 "RdrObjUsedTracker_MovingCTModel" 3 "RdrObjUsedTracker_Undefined";
VAL_ 1040 ReSideRdrLe20Obj10RdrObjElevnSts 0 "RdrObjElevnSts_Unknown" 1 "RdrObjElevnSts_OverRidable" 2 "RdrObjElevnSts_Rlv" 3 "RdrObjElevnSts_UnderRidable";
VAL_ 1040 ReSideRdrLe20Obj10RdrObjIsInFreeSpace 0 "YesNo2_No" 1 "YesNo2_Yes";
VAL_ 1040 ReSideRdrLe20Obj10RdrObjMtnPat 0 "RdrObjMtnPat_Ukwn" 1 "RdrObjMtnPat_Staty" 2 "RdrObjMtnPat_StatyFromMovg" 3 "RdrObjMtnPat_Movg" 4 "RdrObjMtnPat_Receding" 5 "RdrObjMtnPat_Oncoming" 6 "RdrObjMtnPat_CrossingFromLe" 7 "RdrObjMtnPat_CrossingFromRi";
VAL_ 1040 ReSideRdrLe20Obj10RdrObjTrackSts 0 "RdrObjTrackSts_Invld" 1 "RdrObjTrackSts_Updated" 2 "RdrObjTrackSts_New" 3 "RdrObjTrackSts_Coasted";
VAL_ 1040 ReSideRdrLe20Obj10RdrObjTyp 0 "RdrObjTyp_Ukwn" 1 "RdrObjTyp_Car" 2 "RdrObjTyp_MotorCycle" 3 "RdrObjTyp_Truck" 4 "RdrObjTyp_Ped" 5 "RdrObjTyp_ObstdVert1" 6 "RdrObjTyp_ObstdVert2" 7 "RdrObjTyp_Anim" 8 "RdrObjTyp_ObjGen" 9 "RdrObjTyp_Bicycle" 10 "RdrObjTyp_VehofUkwnClass" 11 "RdrObjTyp_Reserved";
VAL_ 1040 ReSideRdrLe20Obj10RdrObjUsedTracker 0 "RdrObjUsedTracker_Stationary" 1 "RdrObjUsedTracker_MovingCVModel" 2 "RdrObjUsedTracker_MovingCTModel" 3 "RdrObjUsedTracker_Undefined";
VAL_ 1041 ReSideRdrLe20Obj11RdrObjElevnSts 0 "RdrObjElevnSts_Unknown" 1 "RdrObjElevnSts_OverRidable" 2 "RdrObjElevnSts_Rlv" 3 "RdrObjElevnSts_UnderRidable";
VAL_ 1041 ReSideRdrLe20Obj11RdrObjIsInFreeSpace 0 "YesNo2_No" 1 "YesNo2_Yes";
VAL_ 1041 ReSideRdrLe20Obj11RdrObjMtnPat 0 "RdrObjMtnPat_Ukwn" 1 "RdrObjMtnPat_Staty" 2 "RdrObjMtnPat_StatyFromMovg" 3 "RdrObjMtnPat_Movg" 4 "RdrObjMtnPat_Receding" 5 "RdrObjMtnPat_Oncoming" 6 "RdrObjMtnPat_CrossingFromLe" 7 "RdrObjMtnPat_CrossingFromRi";
VAL_ 1041 ReSideRdrLe20Obj11RdrObjTrackSts 0 "RdrObjTrackSts_Invld" 1 "RdrObjTrackSts_Updated" 2 "RdrObjTrackSts_New" 3 "RdrObjTrackSts_Coasted";
VAL_ 1041 ReSideRdrLe20Obj11RdrObjTyp 0 "RdrObjTyp_Ukwn" 1 "RdrObjTyp_Car" 2 "RdrObjTyp_MotorCycle" 3 "RdrObjTyp_Truck" 4 "RdrObjTyp_Ped" 5 "RdrObjTyp_ObstdVert1" 6 "RdrObjTyp_ObstdVert2" 7 "RdrObjTyp_Anim" 8 "RdrObjTyp_ObjGen" 9 "RdrObjTyp_Bicycle" 10 "RdrObjTyp_VehofUkwnClass" 11 "RdrObjTyp_Reserved";
VAL_ 1041 ReSideRdrLe20Obj11RdrObjUsedTracker 0 "RdrObjUsedTracker_Stationary" 1 "RdrObjUsedTracker_MovingCVModel" 2 "RdrObjUsedTracker_MovingCTModel" 3 "RdrObjUsedTracker_Undefined";
VAL_ 1042 ReSideRdrLe20Obj12RdrObjElevnSts 0 "RdrObjElevnSts_Unknown" 1 "RdrObjElevnSts_OverRidable" 2 "RdrObjElevnSts_Rlv" 3 "RdrObjElevnSts_UnderRidable";
VAL_ 1042 ReSideRdrLe20Obj12RdrObjIsInFreeSpace 0 "YesNo2_No" 1 "YesNo2_Yes";
VAL_ 1042 ReSideRdrLe20Obj12RdrObjMtnPat 0 "RdrObjMtnPat_Ukwn" 1 "RdrObjMtnPat_Staty" 2 "RdrObjMtnPat_StatyFromMovg" 3 "RdrObjMtnPat_Movg" 4 "RdrObjMtnPat_Receding" 5 "RdrObjMtnPat_Oncoming" 6 "RdrObjMtnPat_CrossingFromLe" 7 "RdrObjMtnPat_CrossingFromRi";
VAL_ 1042 ReSideRdrLe20Obj12RdrObjTrackSts 0 "RdrObjTrackSts_Invld" 1 "RdrObjTrackSts_Updated" 2 "RdrObjTrackSts_New" 3 "RdrObjTrackSts_Coasted";
VAL_ 1042 ReSideRdrLe20Obj12RdrObjTyp 0 "RdrObjTyp_Ukwn" 1 "RdrObjTyp_Car" 2 "RdrObjTyp_MotorCycle" 3 "RdrObjTyp_Truck" 4 "RdrObjTyp_Ped" 5 "RdrObjTyp_ObstdVert1" 6 "RdrObjTyp_ObstdVert2" 7 "RdrObjTyp_Anim" 8 "RdrObjTyp_ObjGen" 9 "RdrObjTyp_Bicycle" 10 "RdrObjTyp_VehofUkwnClass" 11 "RdrObjTyp_Reserved";
VAL_ 1042 ReSideRdrLe20Obj12RdrObjUsedTracker 0 "RdrObjUsedTracker_Stationary" 1 "RdrObjUsedTracker_MovingCVModel" 2 "RdrObjUsedTracker_MovingCTModel" 3 "RdrObjUsedTracker_Undefined";
VAL_ 1043 ReSideRdrLe20Obj13RdrObjElevnSts 0 "RdrObjElevnSts_Unknown" 1 "RdrObjElevnSts_OverRidable" 2 "RdrObjElevnSts_Rlv" 3 "RdrObjElevnSts_UnderRidable";
VAL_ 1043 ReSideRdrLe20Obj13RdrObjIsInFreeSpace 0 "YesNo2_No" 1 "YesNo2_Yes";
VAL_ 1043 ReSideRdrLe20Obj13RdrObjMtnPat 0 "RdrObjMtnPat_Ukwn" 1 "RdrObjMtnPat_Staty" 2 "RdrObjMtnPat_StatyFromMovg" 3 "RdrObjMtnPat_Movg" 4 "RdrObjMtnPat_Receding" 5 "RdrObjMtnPat_Oncoming" 6 "RdrObjMtnPat_CrossingFromLe" 7 "RdrObjMtnPat_CrossingFromRi";
VAL_ 1043 ReSideRdrLe20Obj13RdrObjTrackSts 0 "RdrObjTrackSts_Invld" 1 "RdrObjTrackSts_Updated" 2 "RdrObjTrackSts_New" 3 "RdrObjTrackSts_Coasted";
VAL_ 1043 ReSideRdrLe20Obj13RdrObjTyp 0 "RdrObjTyp_Ukwn" 1 "RdrObjTyp_Car" 2 "RdrObjTyp_MotorCycle" 3 "RdrObjTyp_Truck" 4 "RdrObjTyp_Ped" 5 "RdrObjTyp_ObstdVert1" 6 "RdrObjTyp_ObstdVert2" 7 "RdrObjTyp_Anim" 8 "RdrObjTyp_ObjGen" 9 "RdrObjTyp_Bicycle" 10 "RdrObjTyp_VehofUkwnClass" 11 "RdrObjTyp_Reserved";
VAL_ 1043 ReSideRdrLe20Obj13RdrObjUsedTracker 0 "RdrObjUsedTracker_Stationary" 1 "RdrObjUsedTracker_MovingCVModel" 2 "RdrObjUsedTracker_MovingCTModel" 3 "RdrObjUsedTracker_Undefined";
VAL_ 1044 ReSideRdrLe20Obj14RdrObjElevnSts 0 "RdrObjElevnSts_Unknown" 1 "RdrObjElevnSts_OverRidable" 2 "RdrObjElevnSts_Rlv" 3 "RdrObjElevnSts_UnderRidable";
VAL_ 1044 ReSideRdrLe20Obj14RdrObjIsInFreeSpace 0 "YesNo2_No" 1 "YesNo2_Yes";
VAL_ 1044 ReSideRdrLe20Obj14RdrObjMtnPat 0 "RdrObjMtnPat_Ukwn" 1 "RdrObjMtnPat_Staty" 2 "RdrObjMtnPat_StatyFromMovg" 3 "RdrObjMtnPat_Movg" 4 "RdrObjMtnPat_Receding" 5 "RdrObjMtnPat_Oncoming" 6 "RdrObjMtnPat_CrossingFromLe" 7 "RdrObjMtnPat_CrossingFromRi";
VAL_ 1044 ReSideRdrLe20Obj14RdrObjTrackSts 0 "RdrObjTrackSts_Invld" 1 "RdrObjTrackSts_Updated" 2 "RdrObjTrackSts_New" 3 "RdrObjTrackSts_Coasted";
VAL_ 1044 ReSideRdrLe20Obj14RdrObjTyp 0 "RdrObjTyp_Ukwn" 1 "RdrObjTyp_Car" 2 "RdrObjTyp_MotorCycle" 3 "RdrObjTyp_Truck" 4 "RdrObjTyp_Ped" 5 "RdrObjTyp_ObstdVert1" 6 "RdrObjTyp_ObstdVert2" 7 "RdrObjTyp_Anim" 8 "RdrObjTyp_ObjGen" 9 "RdrObjTyp_Bicycle" 10 "RdrObjTyp_VehofUkwnClass" 11 "RdrObjTyp_Reserved";
VAL_ 1044 ReSideRdrLe20Obj14RdrObjUsedTracker 0 "RdrObjUsedTracker_Stationary" 1 "RdrObjUsedTracker_MovingCVModel" 2 "RdrObjUsedTracker_MovingCTModel" 3 "RdrObjUsedTracker_Undefined";
VAL_ 1045 ReSideRdrLe20Obj15RdrObjElevnSts 0 "RdrObjElevnSts_Unknown" 1 "RdrObjElevnSts_OverRidable" 2 "RdrObjElevnSts_Rlv" 3 "RdrObjElevnSts_UnderRidable";
VAL_ 1045 ReSideRdrLe20Obj15RdrObjIsInFreeSpace 0 "YesNo2_No" 1 "YesNo2_Yes";
VAL_ 1045 ReSideRdrLe20Obj15RdrObjMtnPat 0 "RdrObjMtnPat_Ukwn" 1 "RdrObjMtnPat_Staty" 2 "RdrObjMtnPat_StatyFromMovg" 3 "RdrObjMtnPat_Movg" 4 "RdrObjMtnPat_Receding" 5 "RdrObjMtnPat_Oncoming" 6 "RdrObjMtnPat_CrossingFromLe" 7 "RdrObjMtnPat_CrossingFromRi";
VAL_ 1045 ReSideRdrLe20Obj15RdrObjTrackSts 0 "RdrObjTrackSts_Invld" 1 "RdrObjTrackSts_Updated" 2 "RdrObjTrackSts_New" 3 "RdrObjTrackSts_Coasted";
VAL_ 1045 ReSideRdrLe20Obj15RdrObjTyp 0 "RdrObjTyp_Ukwn" 1 "RdrObjTyp_Car" 2 "RdrObjTyp_MotorCycle" 3 "RdrObjTyp_Truck" 4 "RdrObjTyp_Ped" 5 "RdrObjTyp_ObstdVert1" 6 "RdrObjTyp_ObstdVert2" 7 "RdrObjTyp_Anim" 8 "RdrObjTyp_ObjGen" 9 "RdrObjTyp_Bicycle" 10 "RdrObjTyp_VehofUkwnClass" 11 "RdrObjTyp_Reserved";
VAL_ 1045 ReSideRdrLe20Obj15RdrObjUsedTracker 0 "RdrObjUsedTracker_Stationary" 1 "RdrObjUsedTracker_MovingCVModel" 2 "RdrObjUsedTracker_MovingCTModel" 3 "RdrObjUsedTracker_Undefined";
VAL_ 1046 ReSideRdrLe20Obj16RdrObjElevnSts 0 "RdrObjElevnSts_Unknown" 1 "RdrObjElevnSts_OverRidable" 2 "RdrObjElevnSts_Rlv" 3 "RdrObjElevnSts_UnderRidable";
VAL_ 1046 ReSideRdrLe20Obj16RdrObjIsInFreeSpace 0 "YesNo2_No" 1 "YesNo2_Yes";
VAL_ 1046 ReSideRdrLe20Obj16RdrObjMtnPat 0 "RdrObjMtnPat_Ukwn" 1 "RdrObjMtnPat_Staty" 2 "RdrObjMtnPat_StatyFromMovg" 3 "RdrObjMtnPat_Movg" 4 "RdrObjMtnPat_Receding" 5 "RdrObjMtnPat_Oncoming" 6 "RdrObjMtnPat_CrossingFromLe" 7 "RdrObjMtnPat_CrossingFromRi";
VAL_ 1046 ReSideRdrLe20Obj16RdrObjTrackSts 0 "RdrObjTrackSts_Invld" 1 "RdrObjTrackSts_Updated" 2 "RdrObjTrackSts_New" 3 "RdrObjTrackSts_Coasted";
VAL_ 1046 ReSideRdrLe20Obj16RdrObjTyp 0 "RdrObjTyp_Ukwn" 1 "RdrObjTyp_Car" 2 "RdrObjTyp_MotorCycle" 3 "RdrObjTyp_Truck" 4 "RdrObjTyp_Ped" 5 "RdrObjTyp_ObstdVert1" 6 "RdrObjTyp_ObstdVert2" 7 "RdrObjTyp_Anim" 8 "RdrObjTyp_ObjGen" 9 "RdrObjTyp_Bicycle" 10 "RdrObjTyp_VehofUkwnClass" 11 "RdrObjTyp_Reserved";
VAL_ 1046 ReSideRdrLe20Obj16RdrObjUsedTracker 0 "RdrObjUsedTracker_Stationary" 1 "RdrObjUsedTracker_MovingCVModel" 2 "RdrObjUsedTracker_MovingCTModel" 3 "RdrObjUsedTracker_Undefined";
VAL_ 1047 ReSideRdrLe20Obj17RdrObjElevnSts 0 "RdrObjElevnSts_Unknown" 1 "RdrObjElevnSts_OverRidable" 2 "RdrObjElevnSts_Rlv" 3 "RdrObjElevnSts_UnderRidable";
VAL_ 1047 ReSideRdrLe20Obj17RdrObjIsInFreeSpace 0 "YesNo2_No" 1 "YesNo2_Yes";
VAL_ 1047 ReSideRdrLe20Obj17RdrObjMtnPat 0 "RdrObjMtnPat_Ukwn" 1 "RdrObjMtnPat_Staty" 2 "RdrObjMtnPat_StatyFromMovg" 3 "RdrObjMtnPat_Movg" 4 "RdrObjMtnPat_Receding" 5 "RdrObjMtnPat_Oncoming" 6 "RdrObjMtnPat_CrossingFromLe" 7 "RdrObjMtnPat_CrossingFromRi";
VAL_ 1047 ReSideRdrLe20Obj17RdrObjTrackSts 0 "RdrObjTrackSts_Invld" 1 "RdrObjTrackSts_Updated" 2 "RdrObjTrackSts_New" 3 "RdrObjTrackSts_Coasted";
VAL_ 1047 ReSideRdrLe20Obj17RdrObjTyp 0 "RdrObjTyp_Ukwn" 1 "RdrObjTyp_Car" 2 "RdrObjTyp_MotorCycle" 3 "RdrObjTyp_Truck" 4 "RdrObjTyp_Ped" 5 "RdrObjTyp_ObstdVert1" 6 "RdrObjTyp_ObstdVert2" 7 "RdrObjTyp_Anim" 8 "RdrObjTyp_ObjGen" 9 "RdrObjTyp_Bicycle" 10 "RdrObjTyp_VehofUkwnClass" 11 "RdrObjTyp_Reserved";
VAL_ 1047 ReSideRdrLe20Obj17RdrObjUsedTracker 0 "RdrObjUsedTracker_Stationary" 1 "RdrObjUsedTracker_MovingCVModel" 2 "RdrObjUsedTracker_MovingCTModel" 3 "RdrObjUsedTracker_Undefined";
VAL_ 1048 ReSideRdrLe20Obj18RdrObjElevnSts 0 "RdrObjElevnSts_Unknown" 1 "RdrObjElevnSts_OverRidable" 2 "RdrObjElevnSts_Rlv" 3 "RdrObjElevnSts_UnderRidable";
VAL_ 1048 ReSideRdrLe20Obj18RdrObjIsInFreeSpace 0 "YesNo2_No" 1 "YesNo2_Yes";
VAL_ 1048 ReSideRdrLe20Obj18RdrObjMtnPat 0 "RdrObjMtnPat_Ukwn" 1 "RdrObjMtnPat_Staty" 2 "RdrObjMtnPat_StatyFromMovg" 3 "RdrObjMtnPat_Movg" 4 "RdrObjMtnPat_Receding" 5 "RdrObjMtnPat_Oncoming" 6 "RdrObjMtnPat_CrossingFromLe" 7 "RdrObjMtnPat_CrossingFromRi";
VAL_ 1048 ReSideRdrLe20Obj18RdrObjTrackSts 0 "RdrObjTrackSts_Invld" 1 "RdrObjTrackSts_Updated" 2 "RdrObjTrackSts_New" 3 "RdrObjTrackSts_Coasted";
VAL_ 1048 ReSideRdrLe20Obj18RdrObjTyp 0 "RdrObjTyp_Ukwn" 1 "RdrObjTyp_Car" 2 "RdrObjTyp_MotorCycle" 3 "RdrObjTyp_Truck" 4 "RdrObjTyp_Ped" 5 "RdrObjTyp_ObstdVert1" 6 "RdrObjTyp_ObstdVert2" 7 "RdrObjTyp_Anim" 8 "RdrObjTyp_ObjGen" 9 "RdrObjTyp_Bicycle" 10 "RdrObjTyp_VehofUkwnClass" 11 "RdrObjTyp_Reserved";
VAL_ 1048 ReSideRdrLe20Obj18RdrObjUsedTracker 0 "RdrObjUsedTracker_Stationary" 1 "RdrObjUsedTracker_MovingCVModel" 2 "RdrObjUsedTracker_MovingCTModel" 3 "RdrObjUsedTracker_Undefined";
VAL_ 1049 ReSideRdrLe20Obj19RdrObjElevnSts 0 "RdrObjElevnSts_Unknown" 1 "RdrObjElevnSts_OverRidable" 2 "RdrObjElevnSts_Rlv" 3 "RdrObjElevnSts_UnderRidable";
VAL_ 1049 ReSideRdrLe20Obj19RdrObjIsInFreeSpace 0 "YesNo2_No" 1 "YesNo2_Yes";
VAL_ 1049 ReSideRdrLe20Obj19RdrObjMtnPat 0 "RdrObjMtnPat_Ukwn" 1 "RdrObjMtnPat_Staty" 2 "RdrObjMtnPat_StatyFromMovg" 3 "RdrObjMtnPat_Movg" 4 "RdrObjMtnPat_Receding" 5 "RdrObjMtnPat_Oncoming" 6 "RdrObjMtnPat_CrossingFromLe" 7 "RdrObjMtnPat_CrossingFromRi";
VAL_ 1049 ReSideRdrLe20Obj19RdrObjTrackSts 0 "RdrObjTrackSts_Invld" 1 "RdrObjTrackSts_Updated" 2 "RdrObjTrackSts_New" 3 "RdrObjTrackSts_Coasted";
VAL_ 1049 ReSideRdrLe20Obj19RdrObjTyp 0 "RdrObjTyp_Ukwn" 1 "RdrObjTyp_Car" 2 "RdrObjTyp_MotorCycle" 3 "RdrObjTyp_Truck" 4 "RdrObjTyp_Ped" 5 "RdrObjTyp_ObstdVert1" 6 "RdrObjTyp_ObstdVert2" 7 "RdrObjTyp_Anim" 8 "RdrObjTyp_ObjGen" 9 "RdrObjTyp_Bicycle" 10 "RdrObjTyp_VehofUkwnClass" 11 "RdrObjTyp_Reserved";
VAL_ 1049 ReSideRdrLe20Obj19RdrObjUsedTracker 0 "RdrObjUsedTracker_Stationary" 1 "RdrObjUsedTracker_MovingCVModel" 2 "RdrObjUsedTracker_MovingCTModel" 3 "RdrObjUsedTracker_Undefined";
SIG_GROUP_ 1040 ReSideRdrLe20Obj10 1 : ReSideRdrLe20Obj10Heading ReSideRdrLe20Obj10ObjBoxCenterLat ReSideRdrLe20Obj10ObjBoxCenterLgt ReSideRdrLe20Obj10ObservationHist ReSideRdrLe20Obj10QualityBits ReSideRdrLe20Obj10RdrObjAx ReSideRdrLe20Obj10RdrObjAy ReSideRdrLe20Obj10RdrObjBoxLength ReSideRdrLe20Obj10RdrObjBoxWidth ReSideRdrLe20Obj10RdrObjChks ReSideRdrLe20Obj10RdrObjCntr ReSideRdrLe20Obj10RdrObjCoastCnt ReSideRdrLe20Obj10RdrObjConf ReSideRdrLe20Obj10RdrObjDx ReSideRdrLe20Obj10RdrObjDxStdDe ReSideRdrLe20Obj10RdrObjDy ReSideRdrLe20Obj10RdrObjDyStdDe ReSideRdrLe20Obj10RdrObjElevnConf ReSideRdrLe20Obj10RdrObjElevnSts ReSideRdrLe20Obj10RdrObjID ReSideRdrLe20Obj10RdrObjIsInFreeSpace ReSideRdrLe20Obj10RdrObjMirrProblty ReSideRdrLe20Obj10RdrObjMtnPat ReSideRdrLe20Obj10RdrObjNotRealProblty ReSideRdrLe20Obj10RdrObjStatyCnt ReSideRdrLe20Obj10RdrObjTiAlv ReSideRdrLe20Obj10RdrObjTrackSts ReSideRdrLe20Obj10RdrObjTyp ReSideRdrLe20Obj10RdrObjTypConfBike ReSideRdrLe20Obj10RdrObjTypConfPed ReSideRdrLe20Obj10RdrObjTypConfVeh ReSideRdrLe20Obj10RdrObjUsedTracker ReSideRdrLe20Obj10RdrObjVx ReSideRdrLe20Obj10RdrObjVxStdDe ReSideRdrLe20Obj10RdrObjVy ReSideRdrLe20Obj10RdrObjVyStdDe ReSideRdrLe20Obj10RelVx ReSideRdrLe20Obj10RelVy;
SIG_GROUP_ 1041 ReSideRdrLe20Obj11 1 : ReSideRdrLe20Obj11Heading ReSideRdrLe20Obj11ObjBoxCenterLat ReSideRdrLe20Obj11ObjBoxCenterLgt ReSideRdrLe20Obj11ObservationHist ReSideRdrLe20Obj11QualityBits ReSideRdrLe20Obj11RdrObjAx ReSideRdrLe20Obj11RdrObjAy ReSideRdrLe20Obj11RdrObjBoxLength ReSideRdrLe20Obj11RdrObjBoxWidth ReSideRdrLe20Obj11RdrObjChks ReSideRdrLe20Obj11RdrObjCntr ReSideRdrLe20Obj11RdrObjCoastCnt ReSideRdrLe20Obj11RdrObjConf ReSideRdrLe20Obj11RdrObjDx ReSideRdrLe20Obj11RdrObjDxStdDe ReSideRdrLe20Obj11RdrObjDy ReSideRdrLe20Obj11RdrObjDyStdDe ReSideRdrLe20Obj11RdrObjElevnConf ReSideRdrLe20Obj11RdrObjElevnSts ReSideRdrLe20Obj11RdrObjID ReSideRdrLe20Obj11RdrObjIsInFreeSpace ReSideRdrLe20Obj11RdrObjMirrProblty ReSideRdrLe20Obj11RdrObjMtnPat ReSideRdrLe20Obj11RdrObjNotRealProblty ReSideRdrLe20Obj11RdrObjStatyCnt ReSideRdrLe20Obj11RdrObjTiAlv ReSideRdrLe20Obj11RdrObjTrackSts ReSideRdrLe20Obj11RdrObjTyp ReSideRdrLe20Obj11RdrObjTypConfBike ReSideRdrLe20Obj11RdrObjTypConfPed ReSideRdrLe20Obj11RdrObjTypConfVeh ReSideRdrLe20Obj11RdrObjUsedTracker ReSideRdrLe20Obj11RdrObjVx ReSideRdrLe20Obj11RdrObjVxStdDe ReSideRdrLe20Obj11RdrObjVy ReSideRdrLe20Obj11RdrObjVyStdDe ReSideRdrLe20Obj11RelVx ReSideRdrLe20Obj11RelVy;
SIG_GROUP_ 1042 ReSideRdrLe20Obj12 1 : ReSideRdrLe20Obj12Heading ReSideRdrLe20Obj12ObjBoxCenterLat ReSideRdrLe20Obj12ObjBoxCenterLgt ReSideRdrLe20Obj12ObservationHist ReSideRdrLe20Obj12QualityBits ReSideRdrLe20Obj12RdrObjAx ReSideRdrLe20Obj12RdrObjAy ReSideRdrLe20Obj12RdrObjBoxLength ReSideRdrLe20Obj12RdrObjBoxWidth ReSideRdrLe20Obj12RdrObjChks ReSideRdrLe20Obj12RdrObjCntr ReSideRdrLe20Obj12RdrObjCoastCnt ReSideRdrLe20Obj12RdrObjConf ReSideRdrLe20Obj12RdrObjDx ReSideRdrLe20Obj12RdrObjDxStdDe ReSideRdrLe20Obj12RdrObjDy ReSideRdrLe20Obj12RdrObjDyStdDe ReSideRdrLe20Obj12RdrObjElevnConf ReSideRdrLe20Obj12RdrObjElevnSts ReSideRdrLe20Obj12RdrObjID ReSideRdrLe20Obj12RdrObjIsInFreeSpace ReSideRdrLe20Obj12RdrObjMirrProblty ReSideRdrLe20Obj12RdrObjMtnPat ReSideRdrLe20Obj12RdrObjNotRealProblty ReSideRdrLe20Obj12RdrObjStatyCnt ReSideRdrLe20Obj12RdrObjTiAlv ReSideRdrLe20Obj12RdrObjTrackSts ReSideRdrLe20Obj12RdrObjTyp ReSideRdrLe20Obj12RdrObjTypConfBike ReSideRdrLe20Obj12RdrObjTypConfPed ReSideRdrLe20Obj12RdrObjTypConfVeh ReSideRdrLe20Obj12RdrObjUsedTracker ReSideRdrLe20Obj12RdrObjVx ReSideRdrLe20Obj12RdrObjVxStdDe ReSideRdrLe20Obj12RdrObjVy ReSideRdrLe20Obj12RdrObjVyStdDe ReSideRdrLe20Obj12RelVx ReSideRdrLe20Obj12RelVy;
SIG_GROUP_ 1043 ReSideRdrLe20Obj13 1 : ReSideRdrLe20Obj13Heading ReSideRdrLe20Obj13ObjBoxCenterLat ReSideRdrLe20Obj13ObjBoxCenterLgt ReSideRdrLe20Obj13ObservationHist ReSideRdrLe20Obj13QualityBits ReSideRdrLe20Obj13RdrObjAx ReSideRdrLe20Obj13RdrObjAy ReSideRdrLe20Obj13RdrObjBoxLength ReSideRdrLe20Obj13RdrObjBoxWidth ReSideRdrLe20Obj13RdrObjChks ReSideRdrLe20Obj13RdrObjCntr ReSideRdrLe20Obj13RdrObjCoastCnt ReSideRdrLe20Obj13RdrObjConf ReSideRdrLe20Obj13RdrObjDx ReSideRdrLe20Obj13RdrObjDxStdDe ReSideRdrLe20Obj13RdrObjDy ReSideRdrLe20Obj13RdrObjDyStdDe ReSideRdrLe20Obj13RdrObjElevnConf ReSideRdrLe20Obj13RdrObjElevnSts ReSideRdrLe20Obj13RdrObjID ReSideRdrLe20Obj13RdrObjIsInFreeSpace ReSideRdrLe20Obj13RdrObjMirrProblty ReSideRdrLe20Obj13RdrObjMtnPat ReSideRdrLe20Obj13RdrObjNotRealProblty ReSideRdrLe20Obj13RdrObjStatyCnt ReSideRdrLe20Obj13RdrObjTiAlv ReSideRdrLe20Obj13RdrObjTrackSts ReSideRdrLe20Obj13RdrObjTyp ReSideRdrLe20Obj13RdrObjTypConfBike ReSideRdrLe20Obj13RdrObjTypConfPed ReSideRdrLe20Obj13RdrObjTypConfVeh ReSideRdrLe20Obj13RdrObjUsedTracker ReSideRdrLe20Obj13RdrObjVx ReSideRdrLe20Obj13RdrObjVxStdDe ReSideRdrLe20Obj13RdrObjVy ReSideRdrLe20Obj13RdrObjVyStdDe ReSideRdrLe20Obj13RelVx ReSideRdrLe20Obj13RelVy;
SIG_GROUP_ 1044 ReSideRdrLe20Obj14 1 : ReSideRdrLe20Obj14Heading ReSideRdrLe20Obj14ObjBoxCenterLat ReSideRdrLe20Obj14ObjBoxCenterLgt ReSideRdrLe20Obj14ObservationHist ReSideRdrLe20Obj14QualityBits ReSideRdrLe20Obj14RdrObjAx ReSideRdrLe20Obj14RdrObjAy ReSideRdrLe20Obj14RdrObjBoxLength ReSideRdrLe20Obj14RdrObjBoxWidth ReSideRdrLe20Obj14RdrObjChks ReSideRdrLe20Obj14RdrObjCntr ReSideRdrLe20Obj14RdrObjCoastCnt ReSideRdrLe20Obj14RdrObjConf ReSideRdrLe20Obj14RdrObjDx ReSideRdrLe20Obj14RdrObjDxStdDe ReSideRdrLe20Obj14RdrObjDy ReSideRdrLe20Obj14RdrObjDyStdDe ReSideRdrLe20Obj14RdrObjElevnConf ReSideRdrLe20Obj14RdrObjElevnSts ReSideRdrLe20Obj14RdrObjID ReSideRdrLe20Obj14RdrObjIsInFreeSpace ReSideRdrLe20Obj14RdrObjMirrProblty ReSideRdrLe20Obj14RdrObjMtnPat ReSideRdrLe20Obj14RdrObjNotRealProblty ReSideRdrLe20Obj14RdrObjStatyCnt ReSideRdrLe20Obj14RdrObjTiAlv ReSideRdrLe20Obj14RdrObjTrackSts ReSideRdrLe20Obj14RdrObjTyp ReSideRdrLe20Obj14RdrObjTypConfBike ReSideRdrLe20Obj14RdrObjTypConfPed ReSideRdrLe20Obj14RdrObjTypConfVeh ReSideRdrLe20Obj14RdrObjUsedTracker ReSideRdrLe20Obj14RdrObjVx ReSideRdrLe20Obj14RdrObjVxStdDe ReSideRdrLe20Obj14RdrObjVy ReSideRdrLe20Obj14RdrObjVyStdDe ReSideRdrLe20Obj14RelVx ReSideRdrLe20Obj14RelVy;
SIG_GROUP_ 1045 ReSideRdrLe20Obj15 1 : ReSideRdrLe20Obj15Heading ReSideRdrLe20Obj15ObjBoxCenterLat ReSideRdrLe20Obj15ObjBoxCenterLgt ReSideRdrLe20Obj15ObservationHist ReSideRdrLe20Obj15QualityBits ReSideRdrLe20Obj15RdrObjAx ReSideRdrLe20Obj15RdrObjAy ReSideRdrLe20Obj15RdrObjBoxLength ReSideRdrLe20Obj15RdrObjBoxWidth ReSideRdrLe20Obj15RdrObjChks ReSideRdrLe20Obj15RdrObjCntr ReSideRdrLe20Obj15RdrObjCoastCnt ReSideRdrLe20Obj15RdrObjConf ReSideRdrLe20Obj15RdrObjDx ReSideRdrLe20Obj15RdrObjDxStdDe ReSideRdrLe20Obj15RdrObjDy ReSideRdrLe20Obj15RdrObjDyStdDe ReSideRdrLe20Obj15RdrObjElevnConf ReSideRdrLe20Obj15RdrObjElevnSts ReSideRdrLe20Obj15RdrObjID ReSideRdrLe20Obj15RdrObjIsInFreeSpace ReSideRdrLe20Obj15RdrObjMirrProblty ReSideRdrLe20Obj15RdrObjMtnPat ReSideRdrLe20Obj15RdrObjNotRealProblty ReSideRdrLe20Obj15RdrObjStatyCnt ReSideRdrLe20Obj15RdrObjTiAlv ReSideRdrLe20Obj15RdrObjTrackSts ReSideRdrLe20Obj15RdrObjTyp ReSideRdrLe20Obj15RdrObjTypConfBike ReSideRdrLe20Obj15RdrObjTypConfPed ReSideRdrLe20Obj15RdrObjTypConfVeh ReSideRdrLe20Obj15RdrObjUsedTracker ReSideRdrLe20Obj15RdrObjVx ReSideRdrLe20Obj15RdrObjVxStdDe ReSideRdrLe20Obj15RdrObjVy ReSideRdrLe20Obj15RdrObjVyStdDe ReSideRdrLe20Obj15RelVx ReSideRdrLe20Obj15RelVy;
SIG_GROUP_ 1046 ReSideRdrLe20Obj16 1 : ReSideRdrLe20Obj16Heading ReSideRdrLe20Obj16ObjBoxCenterLat ReSideRdrLe20Obj16ObjBoxCenterLgt ReSideRdrLe20Obj16ObservationHist ReSideRdrLe20Obj16QualityBits ReSideRdrLe20Obj16RdrObjAx ReSideRdrLe20Obj16RdrObjAy ReSideRdrLe20Obj16RdrObjBoxLength ReSideRdrLe20Obj16RdrObjBoxWidth ReSideRdrLe20Obj16RdrObjChks ReSideRdrLe20Obj16RdrObjCntr ReSideRdrLe20Obj16RdrObjCoastCnt ReSideRdrLe20Obj16RdrObjConf ReSideRdrLe20Obj16RdrObjDx ReSideRdrLe20Obj16RdrObjDxStdDe ReSideRdrLe20Obj16RdrObjDy ReSideRdrLe20Obj16RdrObjDyStdDe ReSideRdrLe20Obj16RdrObjElevnConf ReSideRdrLe20Obj16RdrObjElevnSts ReSideRdrLe20Obj16RdrObjID ReSideRdrLe20Obj16RdrObjIsInFreeSpace ReSideRdrLe20Obj16RdrObjMirrProblty ReSideRdrLe20Obj16RdrObjMtnPat ReSideRdrLe20Obj16RdrObjNotRealProblty ReSideRdrLe20Obj16RdrObjStatyCnt ReSideRdrLe20Obj16RdrObjTiAlv ReSideRdrLe20Obj16RdrObjTrackSts ReSideRdrLe20Obj16RdrObjTyp ReSideRdrLe20Obj16RdrObjTypConfBike ReSideRdrLe20Obj16RdrObjTypConfPed ReSideRdrLe20Obj16RdrObjTypConfVeh ReSideRdrLe20Obj16RdrObjUsedTracker ReSideRdrLe20Obj16RdrObjVx ReSideRdrLe20Obj16RdrObjVxStdDe ReSideRdrLe20Obj16RdrObjVy ReSideRdrLe20Obj16RdrObjVyStdDe ReSideRdrLe20Obj16RelVx ReSideRdrLe20Obj16RelVy;
SIG_GROUP_ 1047 ReSideRdrLe20Obj17 1 : ReSideRdrLe20Obj17Heading ReSideRdrLe20Obj17ObjBoxCenterLat ReSideRdrLe20Obj17ObjBoxCenterLgt ReSideRdrLe20Obj17ObservationHist ReSideRdrLe20Obj17QualityBits ReSideRdrLe20Obj17RdrObjAx ReSideRdrLe20Obj17RdrObjAy ReSideRdrLe20Obj17RdrObjBoxLength ReSideRdrLe20Obj17RdrObjBoxWidth ReSideRdrLe20Obj17RdrObjChks ReSideRdrLe20Obj17RdrObjCntr ReSideRdrLe20Obj17RdrObjCoastCnt ReSideRdrLe20Obj17RdrObjConf ReSideRdrLe20Obj17RdrObjDx ReSideRdrLe20Obj17RdrObjDxStdDe ReSideRdrLe20Obj17RdrObjDy ReSideRdrLe20Obj17RdrObjDyStdDe ReSideRdrLe20Obj17RdrObjElevnConf ReSideRdrLe20Obj17RdrObjElevnSts ReSideRdrLe20Obj17RdrObjID ReSideRdrLe20Obj17RdrObjIsInFreeSpace ReSideRdrLe20Obj17RdrObjMirrProblty ReSideRdrLe20Obj17RdrObjMtnPat ReSideRdrLe20Obj17RdrObjNotRealProblty ReSideRdrLe20Obj17RdrObjStatyCnt ReSideRdrLe20Obj17RdrObjTiAlv ReSideRdrLe20Obj17RdrObjTrackSts ReSideRdrLe20Obj17RdrObjTyp ReSideRdrLe20Obj17RdrObjTypConfBike ReSideRdrLe20Obj17RdrObjTypConfPed ReSideRdrLe20Obj17RdrObjTypConfVeh ReSideRdrLe20Obj17RdrObjUsedTracker ReSideRdrLe20Obj17RdrObjVx ReSideRdrLe20Obj17RdrObjVxStdDe ReSideRdrLe20Obj17RdrObjVy ReSideRdrLe20Obj17RdrObjVyStdDe ReSideRdrLe20Obj17RelVx ReSideRdrLe20Obj17RelVy;
SIG_GROUP_ 1048 ReSideRdrLe20Obj18 1 : ReSideRdrLe20Obj18Heading ReSideRdrLe20Obj18ObjBoxCenterLat ReSideRdrLe20Obj18ObjBoxCenterLgt ReSideRdrLe20Obj18ObservationHist ReSideRdrLe20Obj18QualityBits ReSideRdrLe20Obj18RdrObjAx ReSideRdrLe20Obj18RdrObjAy ReSideRdrLe20Obj18RdrObjBoxLength ReSideRdrLe20Obj18RdrObjBoxWidth ReSideRdrLe20Obj18RdrObjChks ReSideRdrLe20Obj18RdrObjCntr ReSideRdrLe20Obj18RdrObjCoastCnt ReSideRdrLe20Obj18RdrObjConf ReSideRdrLe20Obj18RdrObjDx ReSideRdrLe20Obj18RdrObjDxStdDe ReSideRdrLe20Obj18RdrObjDy ReSideRdrLe20Obj18RdrObjDyStdDe ReSideRdrLe20Obj18RdrObjElevnConf ReSideRdrLe20Obj18RdrObjElevnSts ReSideRdrLe20Obj18RdrObjID ReSideRdrLe20Obj18RdrObjIsInFreeSpace ReSideRdrLe20Obj18RdrObjMirrProblty ReSideRdrLe20Obj18RdrObjMtnPat ReSideRdrLe20Obj18RdrObjNotRealProblty ReSideRdrLe20Obj18RdrObjStatyCnt ReSideRdrLe20Obj18RdrObjTiAlv ReSideRdrLe20Obj18RdrObjTrackSts ReSideRdrLe20Obj18RdrObjTyp ReSideRdrLe20Obj18RdrObjTypConfBike ReSideRdrLe20Obj18RdrObjTypConfPed ReSideRdrLe20Obj18RdrObjTypConfVeh ReSideRdrLe20Obj18RdrObjUsedTracker ReSideRdrLe20Obj18RdrObjVx ReSideRdrLe20Obj18RdrObjVxStdDe ReSideRdrLe20Obj18RdrObjVy ReSideRdrLe20Obj18RdrObjVyStdDe ReSideRdrLe20Obj18RelVx ReSideRdrLe20Obj18RelVy;
SIG_GROUP_ 1049 ReSideRdrLe20Obj19 1 : ReSideRdrLe20Obj19Heading ReSideRdrLe20Obj19ObjBoxCenterLat ReSideRdrLe20Obj19ObjBoxCenterLgt ReSideRdrLe20Obj19ObservationHist ReSideRdrLe20Obj19QualityBits ReSideRdrLe20Obj19RdrObjAx ReSideRdrLe20Obj19RdrObjAy ReSideRdrLe20Obj19RdrObjBoxLength ReSideRdrLe20Obj19RdrObjBoxWidth ReSideRdrLe20Obj19RdrObjChks ReSideRdrLe20Obj19RdrObjCntr ReSideRdrLe20Obj19RdrObjCoastCnt ReSideRdrLe20Obj19RdrObjConf ReSideRdrLe20Obj19RdrObjDx ReSideRdrLe20Obj19RdrObjDxStdDe ReSideRdrLe20Obj19RdrObjDy ReSideRdrLe20Obj19RdrObjDyStdDe ReSideRdrLe20Obj19RdrObjElevnConf ReSideRdrLe20Obj19RdrObjElevnSts ReSideRdrLe20Obj19RdrObjID ReSideRdrLe20Obj19RdrObjIsInFreeSpace ReSideRdrLe20Obj19RdrObjMirrProblty ReSideRdrLe20Obj19RdrObjMtnPat ReSideRdrLe20Obj19RdrObjNotRealProblty ReSideRdrLe20Obj19RdrObjStatyCnt ReSideRdrLe20Obj19RdrObjTiAlv ReSideRdrLe20Obj19RdrObjTrackSts ReSideRdrLe20Obj19RdrObjTyp ReSideRdrLe20Obj19RdrObjTypConfBike ReSideRdrLe20Obj19RdrObjTypConfPed ReSideRdrLe20Obj19RdrObjTypConfVeh ReSideRdrLe20Obj19RdrObjUsedTracker ReSideRdrLe20Obj19RdrObjVx ReSideRdrLe20Obj19RdrObjVxStdDe ReSideRdrLe20Obj19RdrObjVy ReSideRdrLe20Obj19RdrObjVyStdDe ReSideRdrLe20Obj19RelVx ReSideRdrLe20Obj19RelVy;
SIG_GROUP_ 1032 ReSideRdrLe20Obj8 1 : ReSideRdrLe20Obj8Heading ReSideRdrLe20Obj8ObjBoxCenterLat ReSideRdrLe20Obj8ObjBoxCenterLgt ReSideRdrLe20Obj8ObservationHist ReSideRdrLe20Obj8QualityBits ReSideRdrLe20Obj8RdrObjAx ReSideRdrLe20Obj8RdrObjAy ReSideRdrLe20Obj8RdrObjBoxLength ReSideRdrLe20Obj8RdrObjBoxWidth ReSideRdrLe20Obj8RdrObjChks ReSideRdrLe20Obj8RdrObjCntr ReSideRdrLe20Obj8RdrObjCoastCnt ReSideRdrLe20Obj8RdrObjConf ReSideRdrLe20Obj8RdrObjDx ReSideRdrLe20Obj8RdrObjDxStdDe ReSideRdrLe20Obj8RdrObjDy ReSideRdrLe20Obj8RdrObjDyStdDe ReSideRdrLe20Obj8RdrObjElevnConf ReSideRdrLe20Obj8RdrObjElevnSts ReSideRdrLe20Obj8RdrObjID ReSideRdrLe20Obj8RdrObjIsInFreeSpace ReSideRdrLe20Obj8RdrObjMirrProblty ReSideRdrLe20Obj8RdrObjMtnPat ReSideRdrLe20Obj8RdrObjNotRealProblty ReSideRdrLe20Obj8RdrObjStatyCnt ReSideRdrLe20Obj8RdrObjTiAlv ReSideRdrLe20Obj8RdrObjTrackSts ReSideRdrLe20Obj8RdrObjTyp ReSideRdrLe20Obj8RdrObjTypConfBike ReSideRdrLe20Obj8RdrObjTypConfPed ReSideRdrLe20Obj8RdrObjTypConfVeh ReSideRdrLe20Obj8RdrObjUsedTracker ReSideRdrLe20Obj8RdrObjVx ReSideRdrLe20Obj8RdrObjVxStdDe ReSideRdrLe20Obj8RdrObjVy ReSideRdrLe20Obj8RdrObjVyStdDe ReSideRdrLe20Obj8RelVx ReSideRdrLe20Obj8RelVy;
SIG_GROUP_ 1033 ReSideRdrLe20Obj9 1 : ReSideRdrLe20Obj9Heading ReSideRdrLe20Obj9ObjBoxCenterLat ReSideRdrLe20Obj9ObjBoxCenterLgt ReSideRdrLe20Obj9ObservationHist ReSideRdrLe20Obj9QualityBits ReSideRdrLe20Obj9RdrObjAx ReSideRdrLe20Obj9RdrObjAy ReSideRdrLe20Obj9RdrObjBoxLength ReSideRdrLe20Obj9RdrObjBoxWidth ReSideRdrLe20Obj9RdrObjChks ReSideRdrLe20Obj9RdrObjCntr ReSideRdrLe20Obj9RdrObjCoastCnt ReSideRdrLe20Obj9RdrObjConf ReSideRdrLe20Obj9RdrObjDx ReSideRdrLe20Obj9RdrObjDxStdDe ReSideRdrLe20Obj9RdrObjDy ReSideRdrLe20Obj9RdrObjDyStdDe ReSideRdrLe20Obj9RdrObjElevnConf ReSideRdrLe20Obj9RdrObjElevnSts ReSideRdrLe20Obj9RdrObjID ReSideRdrLe20Obj9RdrObjIsInFreeSpace ReSideRdrLe20Obj9RdrObjMirrProblty ReSideRdrLe20Obj9RdrObjMtnPat ReSideRdrLe20Obj9RdrObjNotRealProblty ReSideRdrLe20Obj9RdrObjStatyCnt ReSideRdrLe20Obj9RdrObjTiAlv ReSideRdrLe20Obj9RdrObjTrackSts ReSideRdrLe20Obj9RdrObjTyp ReSideRdrLe20Obj9RdrObjTypConfBike ReSideRdrLe20Obj9RdrObjTypConfPed ReSideRdrLe20Obj9RdrObjTypConfVeh ReSideRdrLe20Obj9RdrObjUsedTracker ReSideRdrLe20Obj9RdrObjVx ReSideRdrLe20Obj9RdrObjVxStdDe ReSideRdrLe20Obj9RdrObjVy ReSideRdrLe20Obj9RdrObjVyStdDe ReSideRdrLe20Obj9RelVx ReSideRdrLe20Obj9RelVy;
