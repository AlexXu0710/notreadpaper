// *************************************************************************** *
// *                                                                           *
// * Description:         CANDB File                                           *
// * Generated at:        2023-03-30 16:08                                     *
// * System:              ZSDB123101                                           *
// * Variant:             CS1E                                                 *
// * Network:             Private_CANFD5                                       *
// *                                                                           *
// *************************************************************************** *
VERSION "Private_CANFD5"

NS_ :

BS_ :

BU_ :  ASDM SODL

BO_ 87 SODLPrivateCANFD5Fr40 : 64 SODL
 SG_ ReSideRdrLeDetn37_UB : 487|1@0+ (1,0) [0|1] "" ASDM
 SG_ ReSideRdrLeDetn37RdrDetnAmbigState : 72|1@0+ (1,0) [0|1] "" ASDM
 SG_ ReSideRdrLeDetn37RdrDetnAssoTrkID : 79|7@0+ (1.0,0.0) [0.0|127.0] "Unitless" ASDM
 SG_ ReSideRdrLeDetn37RdrDetnAzi : 34|11@0+ (0.1,-90.0) [-90.0|90.0] "Deg" ASDM
 SG_ ReSideRdrLeDetn37RdrDetnChks : 7|8@0+ (1.0,0.0) [0.0|255.0] "Unitless" ASDM
 SG_ ReSideRdrLeDetn37RdrDetnCntr : 15|4@0+ (1.0,0.0) [0.0|15.0] "Unitless" ASDM
 SG_ ReSideRdrLeDetn37RdrDetnConf : 11|7@0+ (1.0,0.0) [0.0|100.0] "%" ASDM
 SG_ ReSideRdrLeDetn37RdrDetnElevn : 20|5@0+ (1.0,-15.0) [-15.0|15.0] "Deg" ASDM
 SG_ ReSideRdrLeDetn37RdrDetnPwr : 71|6@0+ (1.0,0.0) [0.0|63.0] "dB" ASDM
 SG_ ReSideRdrLeDetn37RdrDetnRng : 55|14@0+ (0.02,-1.0) [-1.0|200.0] "m" ASDM
 SG_ ReSideRdrLeDetn37RdrDetnRngV : 31|13@0+ (0.02,-80.0) [-80.0|80.0] "m/s" ASDM
 SG_ ReSideRdrLeDetn37RdrDetnSameRV : 65|2@0+ (1,0) [0|3] "" ASDM
 SG_ ReSideRdrLeDetn37RdrDetnSts : 57|2@0+ (1,0) [0|3] "" ASDM
 SG_ ReSideRdrLeDetn38_UB : 486|1@0+ (1,0) [0|1] "" ASDM
 SG_ ReSideRdrLeDetn38RdrDetnAmbigState : 152|1@0+ (1,0) [0|1] "" ASDM
 SG_ ReSideRdrLeDetn38RdrDetnAssoTrkID : 159|7@0+ (1.0,0.0) [0.0|127.0] "Unitless" ASDM
 SG_ ReSideRdrLeDetn38RdrDetnAzi : 114|11@0+ (0.1,-90.0) [-90.0|90.0] "Deg" ASDM
 SG_ ReSideRdrLeDetn38RdrDetnChks : 87|8@0+ (1.0,0.0) [0.0|255.0] "Unitless" ASDM
 SG_ ReSideRdrLeDetn38RdrDetnCntr : 95|4@0+ (1.0,0.0) [0.0|15.0] "Unitless" ASDM
 SG_ ReSideRdrLeDetn38RdrDetnConf : 91|7@0+ (1.0,0.0) [0.0|100.0] "%" ASDM
 SG_ ReSideRdrLeDetn38RdrDetnElevn : 100|5@0+ (1.0,-15.0) [-15.0|15.0] "Deg" ASDM
 SG_ ReSideRdrLeDetn38RdrDetnPwr : 151|6@0+ (1.0,0.0) [0.0|63.0] "dB" ASDM
 SG_ ReSideRdrLeDetn38RdrDetnRng : 135|14@0+ (0.02,-1.0) [-1.0|200.0] "m" ASDM
 SG_ ReSideRdrLeDetn38RdrDetnRngV : 111|13@0+ (0.02,-80.0) [-80.0|80.0] "m/s" ASDM
 SG_ ReSideRdrLeDetn38RdrDetnSameRV : 145|2@0+ (1,0) [0|3] "" ASDM
 SG_ ReSideRdrLeDetn38RdrDetnSts : 137|2@0+ (1,0) [0|3] "" ASDM
 SG_ ReSideRdrLeDetn39_UB : 485|1@0+ (1,0) [0|1] "" ASDM
 SG_ ReSideRdrLeDetn39RdrDetnAmbigState : 232|1@0+ (1,0) [0|1] "" ASDM
 SG_ ReSideRdrLeDetn39RdrDetnAssoTrkID : 239|7@0+ (1.0,0.0) [0.0|127.0] "Unitless" ASDM
 SG_ ReSideRdrLeDetn39RdrDetnAzi : 194|11@0+ (0.1,-90.0) [-90.0|90.0] "Deg" ASDM
 SG_ ReSideRdrLeDetn39RdrDetnChks : 167|8@0+ (1.0,0.0) [0.0|255.0] "Unitless" ASDM
 SG_ ReSideRdrLeDetn39RdrDetnCntr : 175|4@0+ (1.0,0.0) [0.0|15.0] "Unitless" ASDM
 SG_ ReSideRdrLeDetn39RdrDetnConf : 171|7@0+ (1.0,0.0) [0.0|100.0] "%" ASDM
 SG_ ReSideRdrLeDetn39RdrDetnElevn : 180|5@0+ (1.0,-15.0) [-15.0|15.0] "Deg" ASDM
 SG_ ReSideRdrLeDetn39RdrDetnPwr : 231|6@0+ (1.0,0.0) [0.0|63.0] "dB" ASDM
 SG_ ReSideRdrLeDetn39RdrDetnRng : 215|14@0+ (0.02,-1.0) [-1.0|200.0] "m" ASDM
 SG_ ReSideRdrLeDetn39RdrDetnRngV : 191|13@0+ (0.02,-80.0) [-80.0|80.0] "m/s" ASDM
 SG_ ReSideRdrLeDetn39RdrDetnSameRV : 225|2@0+ (1,0) [0|3] "" ASDM
 SG_ ReSideRdrLeDetn39RdrDetnSts : 217|2@0+ (1,0) [0|3] "" ASDM
 SG_ ReSideRdrLeDetn40_UB : 484|1@0+ (1,0) [0|1] "" ASDM
 SG_ ReSideRdrLeDetn40RdrDetnAmbigState : 312|1@0+ (1,0) [0|1] "" ASDM
 SG_ ReSideRdrLeDetn40RdrDetnAssoTrkID : 319|7@0+ (1.0,0.0) [0.0|127.0] "Unitless" ASDM
 SG_ ReSideRdrLeDetn40RdrDetnAzi : 274|11@0+ (0.1,-90.0) [-90.0|90.0] "Deg" ASDM
 SG_ ReSideRdrLeDetn40RdrDetnChks : 247|8@0+ (1.0,0.0) [0.0|255.0] "Unitless" ASDM
 SG_ ReSideRdrLeDetn40RdrDetnCntr : 255|4@0+ (1.0,0.0) [0.0|15.0] "Unitless" ASDM
 SG_ ReSideRdrLeDetn40RdrDetnConf : 251|7@0+ (1.0,0.0) [0.0|100.0] "%" ASDM
 SG_ ReSideRdrLeDetn40RdrDetnElevn : 260|5@0+ (1.0,-15.0) [-15.0|15.0] "Deg" ASDM
 SG_ ReSideRdrLeDetn40RdrDetnPwr : 311|6@0+ (1.0,0.0) [0.0|63.0] "dB" ASDM
 SG_ ReSideRdrLeDetn40RdrDetnRng : 295|14@0+ (0.02,-1.0) [-1.0|200.0] "m" ASDM
 SG_ ReSideRdrLeDetn40RdrDetnRngV : 271|13@0+ (0.02,-80.0) [-80.0|80.0] "m/s" ASDM
 SG_ ReSideRdrLeDetn40RdrDetnSameRV : 305|2@0+ (1,0) [0|3] "" ASDM
 SG_ ReSideRdrLeDetn40RdrDetnSts : 297|2@0+ (1,0) [0|3] "" ASDM
 SG_ ReSideRdrLeDetn41_UB : 483|1@0+ (1,0) [0|1] "" ASDM
 SG_ ReSideRdrLeDetn41RdrDetnAmbigState : 392|1@0+ (1,0) [0|1] "" ASDM
 SG_ ReSideRdrLeDetn41RdrDetnAssoTrkID : 399|7@0+ (1.0,0.0) [0.0|127.0] "Unitless" ASDM
 SG_ ReSideRdrLeDetn41RdrDetnAzi : 354|11@0+ (0.1,-90.0) [-90.0|90.0] "Deg" ASDM
 SG_ ReSideRdrLeDetn41RdrDetnChks : 327|8@0+ (1.0,0.0) [0.0|255.0] "Unitless" ASDM
 SG_ ReSideRdrLeDetn41RdrDetnCntr : 335|4@0+ (1.0,0.0) [0.0|15.0] "Unitless" ASDM
 SG_ ReSideRdrLeDetn41RdrDetnConf : 331|7@0+ (1.0,0.0) [0.0|100.0] "%" ASDM
 SG_ ReSideRdrLeDetn41RdrDetnElevn : 340|5@0+ (1.0,-15.0) [-15.0|15.0] "Deg" ASDM
 SG_ ReSideRdrLeDetn41RdrDetnPwr : 391|6@0+ (1.0,0.0) [0.0|63.0] "dB" ASDM
 SG_ ReSideRdrLeDetn41RdrDetnRng : 375|14@0+ (0.02,-1.0) [-1.0|200.0] "m" ASDM
 SG_ ReSideRdrLeDetn41RdrDetnRngV : 351|13@0+ (0.02,-80.0) [-80.0|80.0] "m/s" ASDM
 SG_ ReSideRdrLeDetn41RdrDetnSameRV : 385|2@0+ (1,0) [0|3] "" ASDM
 SG_ ReSideRdrLeDetn41RdrDetnSts : 377|2@0+ (1,0) [0|3] "" ASDM
 SG_ ReSideRdrLeDetn42_UB : 482|1@0+ (1,0) [0|1] "" ASDM
 SG_ ReSideRdrLeDetn42RdrDetnAmbigState : 472|1@0+ (1,0) [0|1] "" ASDM
 SG_ ReSideRdrLeDetn42RdrDetnAssoTrkID : 479|7@0+ (1.0,0.0) [0.0|127.0] "Unitless" ASDM
 SG_ ReSideRdrLeDetn42RdrDetnAzi : 434|11@0+ (0.1,-90.0) [-90.0|90.0] "Deg" ASDM
 SG_ ReSideRdrLeDetn42RdrDetnChks : 407|8@0+ (1.0,0.0) [0.0|255.0] "Unitless" ASDM
 SG_ ReSideRdrLeDetn42RdrDetnCntr : 415|4@0+ (1.0,0.0) [0.0|15.0] "Unitless" ASDM
 SG_ ReSideRdrLeDetn42RdrDetnConf : 411|7@0+ (1.0,0.0) [0.0|100.0] "%" ASDM
 SG_ ReSideRdrLeDetn42RdrDetnElevn : 420|5@0+ (1.0,-15.0) [-15.0|15.0] "Deg" ASDM
 SG_ ReSideRdrLeDetn42RdrDetnPwr : 471|6@0+ (1.0,0.0) [0.0|63.0] "dB" ASDM
 SG_ ReSideRdrLeDetn42RdrDetnRng : 455|14@0+ (0.02,-1.0) [-1.0|200.0] "m" ASDM
 SG_ ReSideRdrLeDetn42RdrDetnRngV : 431|13@0+ (0.02,-80.0) [-80.0|80.0] "m/s" ASDM
 SG_ ReSideRdrLeDetn42RdrDetnSameRV : 465|2@0+ (1,0) [0|3] "" ASDM
 SG_ ReSideRdrLeDetn42RdrDetnSts : 457|2@0+ (1,0) [0|3] "" ASDM

BO_ 88 SODLPrivateCANFD5Fr41 : 64 SODL
 SG_ ReSideRdrLeDetn43_UB : 487|1@0+ (1,0) [0|1] "" ASDM
 SG_ ReSideRdrLeDetn43RdrDetnAmbigState : 72|1@0+ (1,0) [0|1] "" ASDM
 SG_ ReSideRdrLeDetn43RdrDetnAssoTrkID : 79|7@0+ (1.0,0.0) [0.0|127.0] "Unitless" ASDM
 SG_ ReSideRdrLeDetn43RdrDetnAzi : 34|11@0+ (0.1,-90.0) [-90.0|90.0] "Deg" ASDM
 SG_ ReSideRdrLeDetn43RdrDetnChks : 7|8@0+ (1.0,0.0) [0.0|255.0] "Unitless" ASDM
 SG_ ReSideRdrLeDetn43RdrDetnCntr : 15|4@0+ (1.0,0.0) [0.0|15.0] "Unitless" ASDM
 SG_ ReSideRdrLeDetn43RdrDetnConf : 11|7@0+ (1.0,0.0) [0.0|100.0] "%" ASDM
 SG_ ReSideRdrLeDetn43RdrDetnElevn : 20|5@0+ (1.0,-15.0) [-15.0|15.0] "Deg" ASDM
 SG_ ReSideRdrLeDetn43RdrDetnPwr : 71|6@0+ (1.0,0.0) [0.0|63.0] "dB" ASDM
 SG_ ReSideRdrLeDetn43RdrDetnRng : 55|14@0+ (0.02,-1.0) [-1.0|200.0] "m" ASDM
 SG_ ReSideRdrLeDetn43RdrDetnRngV : 31|13@0+ (0.02,-80.0) [-80.0|80.0] "m/s" ASDM
 SG_ ReSideRdrLeDetn43RdrDetnSameRV : 65|2@0+ (1,0) [0|3] "" ASDM
 SG_ ReSideRdrLeDetn43RdrDetnSts : 57|2@0+ (1,0) [0|3] "" ASDM
 SG_ ReSideRdrLeDetn44_UB : 486|1@0+ (1,0) [0|1] "" ASDM
 SG_ ReSideRdrLeDetn44RdrDetnAmbigState : 152|1@0+ (1,0) [0|1] "" ASDM
 SG_ ReSideRdrLeDetn44RdrDetnAssoTrkID : 159|7@0+ (1.0,0.0) [0.0|127.0] "Unitless" ASDM
 SG_ ReSideRdrLeDetn44RdrDetnAzi : 114|11@0+ (0.1,-90.0) [-90.0|90.0] "Deg" ASDM
 SG_ ReSideRdrLeDetn44RdrDetnChks : 87|8@0+ (1.0,0.0) [0.0|255.0] "Unitless" ASDM
 SG_ ReSideRdrLeDetn44RdrDetnCntr : 95|4@0+ (1.0,0.0) [0.0|15.0] "Unitless" ASDM
 SG_ ReSideRdrLeDetn44RdrDetnConf : 91|7@0+ (1.0,0.0) [0.0|100.0] "%" ASDM
 SG_ ReSideRdrLeDetn44RdrDetnElevn : 100|5@0+ (1.0,-15.0) [-15.0|15.0] "Deg" ASDM
 SG_ ReSideRdrLeDetn44RdrDetnPwr : 151|6@0+ (1.0,0.0) [0.0|63.0] "dB" ASDM
 SG_ ReSideRdrLeDetn44RdrDetnRng : 135|14@0+ (0.02,-1.0) [-1.0|200.0] "m" ASDM
 SG_ ReSideRdrLeDetn44RdrDetnRngV : 111|13@0+ (0.02,-80.0) [-80.0|80.0] "m/s" ASDM
 SG_ ReSideRdrLeDetn44RdrDetnSameRV : 145|2@0+ (1,0) [0|3] "" ASDM
 SG_ ReSideRdrLeDetn44RdrDetnSts : 137|2@0+ (1,0) [0|3] "" ASDM
 SG_ ReSideRdrLeDetn45_UB : 485|1@0+ (1,0) [0|1] "" ASDM
 SG_ ReSideRdrLeDetn45RdrDetnAmbigState : 232|1@0+ (1,0) [0|1] "" ASDM
 SG_ ReSideRdrLeDetn45RdrDetnAssoTrkID : 239|7@0+ (1.0,0.0) [0.0|127.0] "Unitless" ASDM
 SG_ ReSideRdrLeDetn45RdrDetnAzi : 194|11@0+ (0.1,-90.0) [-90.0|90.0] "Deg" ASDM
 SG_ ReSideRdrLeDetn45RdrDetnChks : 167|8@0+ (1.0,0.0) [0.0|255.0] "Unitless" ASDM
 SG_ ReSideRdrLeDetn45RdrDetnCntr : 175|4@0+ (1.0,0.0) [0.0|15.0] "Unitless" ASDM
 SG_ ReSideRdrLeDetn45RdrDetnConf : 171|7@0+ (1.0,0.0) [0.0|100.0] "%" ASDM
 SG_ ReSideRdrLeDetn45RdrDetnElevn : 180|5@0+ (1.0,-15.0) [-15.0|15.0] "Deg" ASDM
 SG_ ReSideRdrLeDetn45RdrDetnPwr : 231|6@0+ (1.0,0.0) [0.0|63.0] "dB" ASDM
 SG_ ReSideRdrLeDetn45RdrDetnRng : 215|14@0+ (0.02,-1.0) [-1.0|200.0] "m" ASDM
 SG_ ReSideRdrLeDetn45RdrDetnRngV : 191|13@0+ (0.02,-80.0) [-80.0|80.0] "m/s" ASDM
 SG_ ReSideRdrLeDetn45RdrDetnSameRV : 225|2@0+ (1,0) [0|3] "" ASDM
 SG_ ReSideRdrLeDetn45RdrDetnSts : 217|2@0+ (1,0) [0|3] "" ASDM
 SG_ ReSideRdrLeDetn46_UB : 484|1@0+ (1,0) [0|1] "" ASDM
 SG_ ReSideRdrLeDetn46RdrDetnAmbigState : 312|1@0+ (1,0) [0|1] "" ASDM
 SG_ ReSideRdrLeDetn46RdrDetnAssoTrkID : 319|7@0+ (1.0,0.0) [0.0|127.0] "Unitless" ASDM
 SG_ ReSideRdrLeDetn46RdrDetnAzi : 274|11@0+ (0.1,-90.0) [-90.0|90.0] "Deg" ASDM
 SG_ ReSideRdrLeDetn46RdrDetnChks : 247|8@0+ (1.0,0.0) [0.0|255.0] "Unitless" ASDM
 SG_ ReSideRdrLeDetn46RdrDetnCntr : 255|4@0+ (1.0,0.0) [0.0|15.0] "Unitless" ASDM
 SG_ ReSideRdrLeDetn46RdrDetnConf : 251|7@0+ (1.0,0.0) [0.0|100.0] "%" ASDM
 SG_ ReSideRdrLeDetn46RdrDetnElevn : 260|5@0+ (1.0,-15.0) [-15.0|15.0] "Deg" ASDM
 SG_ ReSideRdrLeDetn46RdrDetnPwr : 311|6@0+ (1.0,0.0) [0.0|63.0] "dB" ASDM
 SG_ ReSideRdrLeDetn46RdrDetnRng : 295|14@0+ (0.02,-1.0) [-1.0|200.0] "m" ASDM
 SG_ ReSideRdrLeDetn46RdrDetnRngV : 271|13@0+ (0.02,-80.0) [-80.0|80.0] "m/s" ASDM
 SG_ ReSideRdrLeDetn46RdrDetnSameRV : 305|2@0+ (1,0) [0|3] "" ASDM
 SG_ ReSideRdrLeDetn46RdrDetnSts : 297|2@0+ (1,0) [0|3] "" ASDM
 SG_ ReSideRdrLeDetn47_UB : 483|1@0+ (1,0) [0|1] "" ASDM
 SG_ ReSideRdrLeDetn47RdrDetnAmbigState : 392|1@0+ (1,0) [0|1] "" ASDM
 SG_ ReSideRdrLeDetn47RdrDetnAssoTrkID : 399|7@0+ (1.0,0.0) [0.0|127.0] "Unitless" ASDM
 SG_ ReSideRdrLeDetn47RdrDetnAzi : 354|11@0+ (0.1,-90.0) [-90.0|90.0] "Deg" ASDM
 SG_ ReSideRdrLeDetn47RdrDetnChks : 327|8@0+ (1.0,0.0) [0.0|255.0] "Unitless" ASDM
 SG_ ReSideRdrLeDetn47RdrDetnCntr : 335|4@0+ (1.0,0.0) [0.0|15.0] "Unitless" ASDM
 SG_ ReSideRdrLeDetn47RdrDetnConf : 331|7@0+ (1.0,0.0) [0.0|100.0] "%" ASDM
 SG_ ReSideRdrLeDetn47RdrDetnElevn : 340|5@0+ (1.0,-15.0) [-15.0|15.0] "Deg" ASDM
 SG_ ReSideRdrLeDetn47RdrDetnPwr : 391|6@0+ (1.0,0.0) [0.0|63.0] "dB" ASDM
 SG_ ReSideRdrLeDetn47RdrDetnRng : 375|14@0+ (0.02,-1.0) [-1.0|200.0] "m" ASDM
 SG_ ReSideRdrLeDetn47RdrDetnRngV : 351|13@0+ (0.02,-80.0) [-80.0|80.0] "m/s" ASDM
 SG_ ReSideRdrLeDetn47RdrDetnSameRV : 385|2@0+ (1,0) [0|3] "" ASDM
 SG_ ReSideRdrLeDetn47RdrDetnSts : 377|2@0+ (1,0) [0|3] "" ASDM
 SG_ ReSideRdrLeDetn48_UB : 482|1@0+ (1,0) [0|1] "" ASDM
 SG_ ReSideRdrLeDetn48RdrDetnAmbigState : 472|1@0+ (1,0) [0|1] "" ASDM
 SG_ ReSideRdrLeDetn48RdrDetnAssoTrkID : 479|7@0+ (1.0,0.0) [0.0|127.0] "Unitless" ASDM
 SG_ ReSideRdrLeDetn48RdrDetnAzi : 434|11@0+ (0.1,-90.0) [-90.0|90.0] "Deg" ASDM
 SG_ ReSideRdrLeDetn48RdrDetnChks : 407|8@0+ (1.0,0.0) [0.0|255.0] "Unitless" ASDM
 SG_ ReSideRdrLeDetn48RdrDetnCntr : 415|4@0+ (1.0,0.0) [0.0|15.0] "Unitless" ASDM
 SG_ ReSideRdrLeDetn48RdrDetnConf : 411|7@0+ (1.0,0.0) [0.0|100.0] "%" ASDM
 SG_ ReSideRdrLeDetn48RdrDetnElevn : 420|5@0+ (1.0,-15.0) [-15.0|15.0] "Deg" ASDM
 SG_ ReSideRdrLeDetn48RdrDetnPwr : 471|6@0+ (1.0,0.0) [0.0|63.0] "dB" ASDM
 SG_ ReSideRdrLeDetn48RdrDetnRng : 455|14@0+ (0.02,-1.0) [-1.0|200.0] "m" ASDM
 SG_ ReSideRdrLeDetn48RdrDetnRngV : 431|13@0+ (0.02,-80.0) [-80.0|80.0] "m/s" ASDM
 SG_ ReSideRdrLeDetn48RdrDetnSameRV : 465|2@0+ (1,0) [0|3] "" ASDM
 SG_ ReSideRdrLeDetn48RdrDetnSts : 457|2@0+ (1,0) [0|3] "" ASDM

BO_ 89 SODLPrivateCANFD5Fr42 : 64 SODL
 SG_ ReSideRdrLeDetn49_UB : 487|1@0+ (1,0) [0|1] "" ASDM
 SG_ ReSideRdrLeDetn49RdrDetnAmbigState : 72|1@0+ (1,0) [0|1] "" ASDM
 SG_ ReSideRdrLeDetn49RdrDetnAssoTrkID : 79|7@0+ (1.0,0.0) [0.0|127.0] "Unitless" ASDM
 SG_ ReSideRdrLeDetn49RdrDetnAzi : 34|11@0+ (0.1,-90.0) [-90.0|90.0] "Deg" ASDM
 SG_ ReSideRdrLeDetn49RdrDetnChks : 7|8@0+ (1.0,0.0) [0.0|255.0] "Unitless" ASDM
 SG_ ReSideRdrLeDetn49RdrDetnCntr : 15|4@0+ (1.0,0.0) [0.0|15.0] "Unitless" ASDM
 SG_ ReSideRdrLeDetn49RdrDetnConf : 11|7@0+ (1.0,0.0) [0.0|100.0] "%" ASDM
 SG_ ReSideRdrLeDetn49RdrDetnElevn : 20|5@0+ (1.0,-15.0) [-15.0|15.0] "Deg" ASDM
 SG_ ReSideRdrLeDetn49RdrDetnPwr : 71|6@0+ (1.0,0.0) [0.0|63.0] "dB" ASDM
 SG_ ReSideRdrLeDetn49RdrDetnRng : 55|14@0+ (0.02,-1.0) [-1.0|200.0] "m" ASDM
 SG_ ReSideRdrLeDetn49RdrDetnRngV : 31|13@0+ (0.02,-80.0) [-80.0|80.0] "m/s" ASDM
 SG_ ReSideRdrLeDetn49RdrDetnSameRV : 65|2@0+ (1,0) [0|3] "" ASDM
 SG_ ReSideRdrLeDetn49RdrDetnSts : 57|2@0+ (1,0) [0|3] "" ASDM
 SG_ ReSideRdrLeDetn50_UB : 486|1@0+ (1,0) [0|1] "" ASDM
 SG_ ReSideRdrLeDetn50RdrDetnAmbigState : 152|1@0+ (1,0) [0|1] "" ASDM
 SG_ ReSideRdrLeDetn50RdrDetnAssoTrkID : 159|7@0+ (1.0,0.0) [0.0|127.0] "Unitless" ASDM
 SG_ ReSideRdrLeDetn50RdrDetnAzi : 114|11@0+ (0.1,-90.0) [-90.0|90.0] "Deg" ASDM
 SG_ ReSideRdrLeDetn50RdrDetnChks : 87|8@0+ (1.0,0.0) [0.0|255.0] "Unitless" ASDM
 SG_ ReSideRdrLeDetn50RdrDetnCntr : 95|4@0+ (1.0,0.0) [0.0|15.0] "Unitless" ASDM
 SG_ ReSideRdrLeDetn50RdrDetnConf : 91|7@0+ (1.0,0.0) [0.0|100.0] "%" ASDM
 SG_ ReSideRdrLeDetn50RdrDetnElevn : 100|5@0+ (1.0,-15.0) [-15.0|15.0] "Deg" ASDM
 SG_ ReSideRdrLeDetn50RdrDetnPwr : 151|6@0+ (1.0,0.0) [0.0|63.0] "dB" ASDM
 SG_ ReSideRdrLeDetn50RdrDetnRng : 135|14@0+ (0.02,-1.0) [-1.0|200.0] "m" ASDM
 SG_ ReSideRdrLeDetn50RdrDetnRngV : 111|13@0+ (0.02,-80.0) [-80.0|80.0] "m/s" ASDM
 SG_ ReSideRdrLeDetn50RdrDetnSameRV : 145|2@0+ (1,0) [0|3] "" ASDM
 SG_ ReSideRdrLeDetn50RdrDetnSts : 137|2@0+ (1,0) [0|3] "" ASDM
 SG_ ReSideRdrLeDetn51_UB : 485|1@0+ (1,0) [0|1] "" ASDM
 SG_ ReSideRdrLeDetn51RdrDetnAmbigState : 232|1@0+ (1,0) [0|1] "" ASDM
 SG_ ReSideRdrLeDetn51RdrDetnAssoTrkID : 239|7@0+ (1.0,0.0) [0.0|127.0] "Unitless" ASDM
 SG_ ReSideRdrLeDetn51RdrDetnAzi : 194|11@0+ (0.1,-90.0) [-90.0|90.0] "Deg" ASDM
 SG_ ReSideRdrLeDetn51RdrDetnChks : 167|8@0+ (1.0,0.0) [0.0|255.0] "Unitless" ASDM
 SG_ ReSideRdrLeDetn51RdrDetnCntr : 175|4@0+ (1.0,0.0) [0.0|15.0] "Unitless" ASDM
 SG_ ReSideRdrLeDetn51RdrDetnConf : 171|7@0+ (1.0,0.0) [0.0|100.0] "%" ASDM
 SG_ ReSideRdrLeDetn51RdrDetnElevn : 180|5@0+ (1.0,-15.0) [-15.0|15.0] "Deg" ASDM
 SG_ ReSideRdrLeDetn51RdrDetnPwr : 231|6@0+ (1.0,0.0) [0.0|63.0] "dB" ASDM
 SG_ ReSideRdrLeDetn51RdrDetnRng : 215|14@0+ (0.02,-1.0) [-1.0|200.0] "m" ASDM
 SG_ ReSideRdrLeDetn51RdrDetnRngV : 191|13@0+ (0.02,-80.0) [-80.0|80.0] "m/s" ASDM
 SG_ ReSideRdrLeDetn51RdrDetnSameRV : 225|2@0+ (1,0) [0|3] "" ASDM
 SG_ ReSideRdrLeDetn51RdrDetnSts : 217|2@0+ (1,0) [0|3] "" ASDM
 SG_ ReSideRdrLeDetn52_UB : 484|1@0+ (1,0) [0|1] "" ASDM
 SG_ ReSideRdrLeDetn52RdrDetnAmbigState : 312|1@0+ (1,0) [0|1] "" ASDM
 SG_ ReSideRdrLeDetn52RdrDetnAssoTrkID : 319|7@0+ (1.0,0.0) [0.0|127.0] "Unitless" ASDM
 SG_ ReSideRdrLeDetn52RdrDetnAzi : 274|11@0+ (0.1,-90.0) [-90.0|90.0] "Deg" ASDM
 SG_ ReSideRdrLeDetn52RdrDetnChks : 247|8@0+ (1.0,0.0) [0.0|255.0] "Unitless" ASDM
 SG_ ReSideRdrLeDetn52RdrDetnCntr : 255|4@0+ (1.0,0.0) [0.0|15.0] "Unitless" ASDM
 SG_ ReSideRdrLeDetn52RdrDetnConf : 251|7@0+ (1.0,0.0) [0.0|100.0] "%" ASDM
 SG_ ReSideRdrLeDetn52RdrDetnElevn : 260|5@0+ (1.0,-15.0) [-15.0|15.0] "Deg" ASDM
 SG_ ReSideRdrLeDetn52RdrDetnPwr : 311|6@0+ (1.0,0.0) [0.0|63.0] "dB" ASDM
 SG_ ReSideRdrLeDetn52RdrDetnRng : 295|14@0+ (0.02,-1.0) [-1.0|200.0] "m" ASDM
 SG_ ReSideRdrLeDetn52RdrDetnRngV : 271|13@0+ (0.02,-80.0) [-80.0|80.0] "m/s" ASDM
 SG_ ReSideRdrLeDetn52RdrDetnSameRV : 305|2@0+ (1,0) [0|3] "" ASDM
 SG_ ReSideRdrLeDetn52RdrDetnSts : 297|2@0+ (1,0) [0|3] "" ASDM
 SG_ ReSideRdrLeDetn53_UB : 483|1@0+ (1,0) [0|1] "" ASDM
 SG_ ReSideRdrLeDetn53RdrDetnAmbigState : 392|1@0+ (1,0) [0|1] "" ASDM
 SG_ ReSideRdrLeDetn53RdrDetnAssoTrkID : 399|7@0+ (1.0,0.0) [0.0|127.0] "Unitless" ASDM
 SG_ ReSideRdrLeDetn53RdrDetnAzi : 354|11@0+ (0.1,-90.0) [-90.0|90.0] "Deg" ASDM
 SG_ ReSideRdrLeDetn53RdrDetnChks : 327|8@0+ (1.0,0.0) [0.0|255.0] "Unitless" ASDM
 SG_ ReSideRdrLeDetn53RdrDetnCntr : 335|4@0+ (1.0,0.0) [0.0|15.0] "Unitless" ASDM
 SG_ ReSideRdrLeDetn53RdrDetnConf : 331|7@0+ (1.0,0.0) [0.0|100.0] "%" ASDM
 SG_ ReSideRdrLeDetn53RdrDetnElevn : 340|5@0+ (1.0,-15.0) [-15.0|15.0] "Deg" ASDM
 SG_ ReSideRdrLeDetn53RdrDetnPwr : 391|6@0+ (1.0,0.0) [0.0|63.0] "dB" ASDM
 SG_ ReSideRdrLeDetn53RdrDetnRng : 375|14@0+ (0.02,-1.0) [-1.0|200.0] "m" ASDM
 SG_ ReSideRdrLeDetn53RdrDetnRngV : 351|13@0+ (0.02,-80.0) [-80.0|80.0] "m/s" ASDM
 SG_ ReSideRdrLeDetn53RdrDetnSameRV : 385|2@0+ (1,0) [0|3] "" ASDM
 SG_ ReSideRdrLeDetn53RdrDetnSts : 377|2@0+ (1,0) [0|3] "" ASDM
 SG_ ReSideRdrLeDetn54_UB : 482|1@0+ (1,0) [0|1] "" ASDM
 SG_ ReSideRdrLeDetn54RdrDetnAmbigState : 472|1@0+ (1,0) [0|1] "" ASDM
 SG_ ReSideRdrLeDetn54RdrDetnAssoTrkID : 479|7@0+ (1.0,0.0) [0.0|127.0] "Unitless" ASDM
 SG_ ReSideRdrLeDetn54RdrDetnAzi : 434|11@0+ (0.1,-90.0) [-90.0|90.0] "Deg" ASDM
 SG_ ReSideRdrLeDetn54RdrDetnChks : 407|8@0+ (1.0,0.0) [0.0|255.0] "Unitless" ASDM
 SG_ ReSideRdrLeDetn54RdrDetnCntr : 415|4@0+ (1.0,0.0) [0.0|15.0] "Unitless" ASDM
 SG_ ReSideRdrLeDetn54RdrDetnConf : 411|7@0+ (1.0,0.0) [0.0|100.0] "%" ASDM
 SG_ ReSideRdrLeDetn54RdrDetnElevn : 420|5@0+ (1.0,-15.0) [-15.0|15.0] "Deg" ASDM
 SG_ ReSideRdrLeDetn54RdrDetnPwr : 471|6@0+ (1.0,0.0) [0.0|63.0] "dB" ASDM
 SG_ ReSideRdrLeDetn54RdrDetnRng : 455|14@0+ (0.02,-1.0) [-1.0|200.0] "m" ASDM
 SG_ ReSideRdrLeDetn54RdrDetnRngV : 431|13@0+ (0.02,-80.0) [-80.0|80.0] "m/s" ASDM
 SG_ ReSideRdrLeDetn54RdrDetnSameRV : 465|2@0+ (1,0) [0|3] "" ASDM
 SG_ ReSideRdrLeDetn54RdrDetnSts : 457|2@0+ (1,0) [0|3] "" ASDM

BO_ 96 SODLPrivateCANFD5Fr43 : 64 SODL
 SG_ ReSideRdrLeDetn55_UB : 487|1@0+ (1,0) [0|1] "" ASDM
 SG_ ReSideRdrLeDetn55RdrDetnAmbigState : 72|1@0+ (1,0) [0|1] "" ASDM
 SG_ ReSideRdrLeDetn55RdrDetnAssoTrkID : 79|7@0+ (1.0,0.0) [0.0|127.0] "Unitless" ASDM
 SG_ ReSideRdrLeDetn55RdrDetnAzi : 34|11@0+ (0.1,-90.0) [-90.0|90.0] "Deg" ASDM
 SG_ ReSideRdrLeDetn55RdrDetnChks : 7|8@0+ (1.0,0.0) [0.0|255.0] "Unitless" ASDM
 SG_ ReSideRdrLeDetn55RdrDetnCntr : 15|4@0+ (1.0,0.0) [0.0|15.0] "Unitless" ASDM
 SG_ ReSideRdrLeDetn55RdrDetnConf : 11|7@0+ (1.0,0.0) [0.0|100.0] "%" ASDM
 SG_ ReSideRdrLeDetn55RdrDetnElevn : 20|5@0+ (1.0,-15.0) [-15.0|15.0] "Deg" ASDM
 SG_ ReSideRdrLeDetn55RdrDetnPwr : 71|6@0+ (1.0,0.0) [0.0|63.0] "dB" ASDM
 SG_ ReSideRdrLeDetn55RdrDetnRng : 55|14@0+ (0.02,-1.0) [-1.0|200.0] "m" ASDM
 SG_ ReSideRdrLeDetn55RdrDetnRngV : 31|13@0+ (0.02,-80.0) [-80.0|80.0] "m/s" ASDM
 SG_ ReSideRdrLeDetn55RdrDetnSameRV : 65|2@0+ (1,0) [0|3] "" ASDM
 SG_ ReSideRdrLeDetn55RdrDetnSts : 57|2@0+ (1,0) [0|3] "" ASDM
 SG_ ReSideRdrLeDetn56_UB : 486|1@0+ (1,0) [0|1] "" ASDM
 SG_ ReSideRdrLeDetn56RdrDetnAmbigState : 152|1@0+ (1,0) [0|1] "" ASDM
 SG_ ReSideRdrLeDetn56RdrDetnAssoTrkID : 159|7@0+ (1.0,0.0) [0.0|127.0] "Unitless" ASDM
 SG_ ReSideRdrLeDetn56RdrDetnAzi : 114|11@0+ (0.1,-90.0) [-90.0|90.0] "Deg" ASDM
 SG_ ReSideRdrLeDetn56RdrDetnChks : 87|8@0+ (1.0,0.0) [0.0|255.0] "Unitless" ASDM
 SG_ ReSideRdrLeDetn56RdrDetnCntr : 95|4@0+ (1.0,0.0) [0.0|15.0] "Unitless" ASDM
 SG_ ReSideRdrLeDetn56RdrDetnConf : 91|7@0+ (1.0,0.0) [0.0|100.0] "%" ASDM
 SG_ ReSideRdrLeDetn56RdrDetnElevn : 100|5@0+ (1.0,-15.0) [-15.0|15.0] "Deg" ASDM
 SG_ ReSideRdrLeDetn56RdrDetnPwr : 151|6@0+ (1.0,0.0) [0.0|63.0] "dB" ASDM
 SG_ ReSideRdrLeDetn56RdrDetnRng : 135|14@0+ (0.02,-1.0) [-1.0|200.0] "m" ASDM
 SG_ ReSideRdrLeDetn56RdrDetnRngV : 111|13@0+ (0.02,-80.0) [-80.0|80.0] "m/s" ASDM
 SG_ ReSideRdrLeDetn56RdrDetnSameRV : 145|2@0+ (1,0) [0|3] "" ASDM
 SG_ ReSideRdrLeDetn56RdrDetnSts : 137|2@0+ (1,0) [0|3] "" ASDM
 SG_ ReSideRdrLeDetn57_UB : 485|1@0+ (1,0) [0|1] "" ASDM
 SG_ ReSideRdrLeDetn57RdrDetnAmbigState : 232|1@0+ (1,0) [0|1] "" ASDM
 SG_ ReSideRdrLeDetn57RdrDetnAssoTrkID : 239|7@0+ (1.0,0.0) [0.0|127.0] "Unitless" ASDM
 SG_ ReSideRdrLeDetn57RdrDetnAzi : 194|11@0+ (0.1,-90.0) [-90.0|90.0] "Deg" ASDM
 SG_ ReSideRdrLeDetn57RdrDetnChks : 167|8@0+ (1.0,0.0) [0.0|255.0] "Unitless" ASDM
 SG_ ReSideRdrLeDetn57RdrDetnCntr : 175|4@0+ (1.0,0.0) [0.0|15.0] "Unitless" ASDM
 SG_ ReSideRdrLeDetn57RdrDetnConf : 171|7@0+ (1.0,0.0) [0.0|100.0] "%" ASDM
 SG_ ReSideRdrLeDetn57RdrDetnElevn : 180|5@0+ (1.0,-15.0) [-15.0|15.0] "Deg" ASDM
 SG_ ReSideRdrLeDetn57RdrDetnPwr : 231|6@0+ (1.0,0.0) [0.0|63.0] "dB" ASDM
 SG_ ReSideRdrLeDetn57RdrDetnRng : 215|14@0+ (0.02,-1.0) [-1.0|200.0] "m" ASDM
 SG_ ReSideRdrLeDetn57RdrDetnRngV : 191|13@0+ (0.02,-80.0) [-80.0|80.0] "m/s" ASDM
 SG_ ReSideRdrLeDetn57RdrDetnSameRV : 225|2@0+ (1,0) [0|3] "" ASDM
 SG_ ReSideRdrLeDetn57RdrDetnSts : 217|2@0+ (1,0) [0|3] "" ASDM
 SG_ ReSideRdrLeDetn58_UB : 484|1@0+ (1,0) [0|1] "" ASDM
 SG_ ReSideRdrLeDetn58RdrDetnAmbigState : 312|1@0+ (1,0) [0|1] "" ASDM
 SG_ ReSideRdrLeDetn58RdrDetnAssoTrkID : 319|7@0+ (1.0,0.0) [0.0|127.0] "Unitless" ASDM
 SG_ ReSideRdrLeDetn58RdrDetnAzi : 274|11@0+ (0.1,-90.0) [-90.0|90.0] "Deg" ASDM
 SG_ ReSideRdrLeDetn58RdrDetnChks : 247|8@0+ (1.0,0.0) [0.0|255.0] "Unitless" ASDM
 SG_ ReSideRdrLeDetn58RdrDetnCntr : 255|4@0+ (1.0,0.0) [0.0|15.0] "Unitless" ASDM
 SG_ ReSideRdrLeDetn58RdrDetnConf : 251|7@0+ (1.0,0.0) [0.0|100.0] "%" ASDM
 SG_ ReSideRdrLeDetn58RdrDetnElevn : 260|5@0+ (1.0,-15.0) [-15.0|15.0] "Deg" ASDM
 SG_ ReSideRdrLeDetn58RdrDetnPwr : 311|6@0+ (1.0,0.0) [0.0|63.0] "dB" ASDM
 SG_ ReSideRdrLeDetn58RdrDetnRng : 295|14@0+ (0.02,-1.0) [-1.0|200.0] "m" ASDM
 SG_ ReSideRdrLeDetn58RdrDetnRngV : 271|13@0+ (0.02,-80.0) [-80.0|80.0] "m/s" ASDM
 SG_ ReSideRdrLeDetn58RdrDetnSameRV : 305|2@0+ (1,0) [0|3] "" ASDM
 SG_ ReSideRdrLeDetn58RdrDetnSts : 297|2@0+ (1,0) [0|3] "" ASDM
 SG_ ReSideRdrLeDetn59_UB : 483|1@0+ (1,0) [0|1] "" ASDM
 SG_ ReSideRdrLeDetn59RdrDetnAmbigState : 392|1@0+ (1,0) [0|1] "" ASDM
 SG_ ReSideRdrLeDetn59RdrDetnAssoTrkID : 399|7@0+ (1.0,0.0) [0.0|127.0] "Unitless" ASDM
 SG_ ReSideRdrLeDetn59RdrDetnAzi : 354|11@0+ (0.1,-90.0) [-90.0|90.0] "Deg" ASDM
 SG_ ReSideRdrLeDetn59RdrDetnChks : 327|8@0+ (1.0,0.0) [0.0|255.0] "Unitless" ASDM
 SG_ ReSideRdrLeDetn59RdrDetnCntr : 335|4@0+ (1.0,0.0) [0.0|15.0] "Unitless" ASDM
 SG_ ReSideRdrLeDetn59RdrDetnConf : 331|7@0+ (1.0,0.0) [0.0|100.0] "%" ASDM
 SG_ ReSideRdrLeDetn59RdrDetnElevn : 340|5@0+ (1.0,-15.0) [-15.0|15.0] "Deg" ASDM
 SG_ ReSideRdrLeDetn59RdrDetnPwr : 391|6@0+ (1.0,0.0) [0.0|63.0] "dB" ASDM
 SG_ ReSideRdrLeDetn59RdrDetnRng : 375|14@0+ (0.02,-1.0) [-1.0|200.0] "m" ASDM
 SG_ ReSideRdrLeDetn59RdrDetnRngV : 351|13@0+ (0.02,-80.0) [-80.0|80.0] "m/s" ASDM
 SG_ ReSideRdrLeDetn59RdrDetnSameRV : 385|2@0+ (1,0) [0|3] "" ASDM
 SG_ ReSideRdrLeDetn59RdrDetnSts : 377|2@0+ (1,0) [0|3] "" ASDM
 SG_ ReSideRdrLeDetn60_UB : 482|1@0+ (1,0) [0|1] "" ASDM
 SG_ ReSideRdrLeDetn60RdrDetnAmbigState : 472|1@0+ (1,0) [0|1] "" ASDM
 SG_ ReSideRdrLeDetn60RdrDetnAssoTrkID : 479|7@0+ (1.0,0.0) [0.0|127.0] "Unitless" ASDM
 SG_ ReSideRdrLeDetn60RdrDetnAzi : 434|11@0+ (0.1,-90.0) [-90.0|90.0] "Deg" ASDM
 SG_ ReSideRdrLeDetn60RdrDetnChks : 407|8@0+ (1.0,0.0) [0.0|255.0] "Unitless" ASDM
 SG_ ReSideRdrLeDetn60RdrDetnCntr : 415|4@0+ (1.0,0.0) [0.0|15.0] "Unitless" ASDM
 SG_ ReSideRdrLeDetn60RdrDetnConf : 411|7@0+ (1.0,0.0) [0.0|100.0] "%" ASDM
 SG_ ReSideRdrLeDetn60RdrDetnElevn : 420|5@0+ (1.0,-15.0) [-15.0|15.0] "Deg" ASDM
 SG_ ReSideRdrLeDetn60RdrDetnPwr : 471|6@0+ (1.0,0.0) [0.0|63.0] "dB" ASDM
 SG_ ReSideRdrLeDetn60RdrDetnRng : 455|14@0+ (0.02,-1.0) [-1.0|200.0] "m" ASDM
 SG_ ReSideRdrLeDetn60RdrDetnRngV : 431|13@0+ (0.02,-80.0) [-80.0|80.0] "m/s" ASDM
 SG_ ReSideRdrLeDetn60RdrDetnSameRV : 465|2@0+ (1,0) [0|3] "" ASDM
 SG_ ReSideRdrLeDetn60RdrDetnSts : 457|2@0+ (1,0) [0|3] "" ASDM

BO_ 97 SODLPrivateCANFD5Fr44 : 64 SODL
 SG_ ReSideRdrLeDetn61_UB : 487|1@0+ (1,0) [0|1] "" ASDM
 SG_ ReSideRdrLeDetn61RdrDetnAmbigState : 72|1@0+ (1,0) [0|1] "" ASDM
 SG_ ReSideRdrLeDetn61RdrDetnAssoTrkID : 79|7@0+ (1.0,0.0) [0.0|127.0] "Unitless" ASDM
 SG_ ReSideRdrLeDetn61RdrDetnAzi : 34|11@0+ (0.1,-90.0) [-90.0|90.0] "Deg" ASDM
 SG_ ReSideRdrLeDetn61RdrDetnChks : 7|8@0+ (1.0,0.0) [0.0|255.0] "Unitless" ASDM
 SG_ ReSideRdrLeDetn61RdrDetnCntr : 15|4@0+ (1.0,0.0) [0.0|15.0] "Unitless" ASDM
 SG_ ReSideRdrLeDetn61RdrDetnConf : 11|7@0+ (1.0,0.0) [0.0|100.0] "%" ASDM
 SG_ ReSideRdrLeDetn61RdrDetnElevn : 20|5@0+ (1.0,-15.0) [-15.0|15.0] "Deg" ASDM
 SG_ ReSideRdrLeDetn61RdrDetnPwr : 71|6@0+ (1.0,0.0) [0.0|63.0] "dB" ASDM
 SG_ ReSideRdrLeDetn61RdrDetnRng : 55|14@0+ (0.02,-1.0) [-1.0|200.0] "m" ASDM
 SG_ ReSideRdrLeDetn61RdrDetnRngV : 31|13@0+ (0.02,-80.0) [-80.0|80.0] "m/s" ASDM
 SG_ ReSideRdrLeDetn61RdrDetnSameRV : 65|2@0+ (1,0) [0|3] "" ASDM
 SG_ ReSideRdrLeDetn61RdrDetnSts : 57|2@0+ (1,0) [0|3] "" ASDM
 SG_ ReSideRdrLeDetn62_UB : 486|1@0+ (1,0) [0|1] "" ASDM
 SG_ ReSideRdrLeDetn62RdrDetnAmbigState : 152|1@0+ (1,0) [0|1] "" ASDM
 SG_ ReSideRdrLeDetn62RdrDetnAssoTrkID : 159|7@0+ (1.0,0.0) [0.0|127.0] "Unitless" ASDM
 SG_ ReSideRdrLeDetn62RdrDetnAzi : 114|11@0+ (0.1,-90.0) [-90.0|90.0] "Deg" ASDM
 SG_ ReSideRdrLeDetn62RdrDetnChks : 87|8@0+ (1.0,0.0) [0.0|255.0] "Unitless" ASDM
 SG_ ReSideRdrLeDetn62RdrDetnCntr : 95|4@0+ (1.0,0.0) [0.0|15.0] "Unitless" ASDM
 SG_ ReSideRdrLeDetn62RdrDetnConf : 91|7@0+ (1.0,0.0) [0.0|100.0] "%" ASDM
 SG_ ReSideRdrLeDetn62RdrDetnElevn : 100|5@0+ (1.0,-15.0) [-15.0|15.0] "Deg" ASDM
 SG_ ReSideRdrLeDetn62RdrDetnPwr : 151|6@0+ (1.0,0.0) [0.0|63.0] "dB" ASDM
 SG_ ReSideRdrLeDetn62RdrDetnRng : 135|14@0+ (0.02,-1.0) [-1.0|200.0] "m" ASDM
 SG_ ReSideRdrLeDetn62RdrDetnRngV : 111|13@0+ (0.02,-80.0) [-80.0|80.0] "m/s" ASDM
 SG_ ReSideRdrLeDetn62RdrDetnSameRV : 145|2@0+ (1,0) [0|3] "" ASDM
 SG_ ReSideRdrLeDetn62RdrDetnSts : 137|2@0+ (1,0) [0|3] "" ASDM
 SG_ ReSideRdrLeDetn63_UB : 485|1@0+ (1,0) [0|1] "" ASDM
 SG_ ReSideRdrLeDetn63RdrDetnAmbigState : 232|1@0+ (1,0) [0|1] "" ASDM
 SG_ ReSideRdrLeDetn63RdrDetnAssoTrkID : 239|7@0+ (1.0,0.0) [0.0|127.0] "Unitless" ASDM
 SG_ ReSideRdrLeDetn63RdrDetnAzi : 194|11@0+ (0.1,-90.0) [-90.0|90.0] "Deg" ASDM
 SG_ ReSideRdrLeDetn63RdrDetnChks : 167|8@0+ (1.0,0.0) [0.0|255.0] "Unitless" ASDM
 SG_ ReSideRdrLeDetn63RdrDetnCntr : 175|4@0+ (1.0,0.0) [0.0|15.0] "Unitless" ASDM
 SG_ ReSideRdrLeDetn63RdrDetnConf : 171|7@0+ (1.0,0.0) [0.0|100.0] "%" ASDM
 SG_ ReSideRdrLeDetn63RdrDetnElevn : 180|5@0+ (1.0,-15.0) [-15.0|15.0] "Deg" ASDM
 SG_ ReSideRdrLeDetn63RdrDetnPwr : 231|6@0+ (1.0,0.0) [0.0|63.0] "dB" ASDM
 SG_ ReSideRdrLeDetn63RdrDetnRng : 215|14@0+ (0.02,-1.0) [-1.0|200.0] "m" ASDM
 SG_ ReSideRdrLeDetn63RdrDetnRngV : 191|13@0+ (0.02,-80.0) [-80.0|80.0] "m/s" ASDM
 SG_ ReSideRdrLeDetn63RdrDetnSameRV : 225|2@0+ (1,0) [0|3] "" ASDM
 SG_ ReSideRdrLeDetn63RdrDetnSts : 217|2@0+ (1,0) [0|3] "" ASDM
 SG_ ReSideRdrLeDetn64_UB : 484|1@0+ (1,0) [0|1] "" ASDM
 SG_ ReSideRdrLeDetn64RdrDetnAmbigState : 312|1@0+ (1,0) [0|1] "" ASDM
 SG_ ReSideRdrLeDetn64RdrDetnAssoTrkID : 319|7@0+ (1.0,0.0) [0.0|127.0] "Unitless" ASDM
 SG_ ReSideRdrLeDetn64RdrDetnAzi : 274|11@0+ (0.1,-90.0) [-90.0|90.0] "Deg" ASDM
 SG_ ReSideRdrLeDetn64RdrDetnChks : 247|8@0+ (1.0,0.0) [0.0|255.0] "Unitless" ASDM
 SG_ ReSideRdrLeDetn64RdrDetnCntr : 255|4@0+ (1.0,0.0) [0.0|15.0] "Unitless" ASDM
 SG_ ReSideRdrLeDetn64RdrDetnConf : 251|7@0+ (1.0,0.0) [0.0|100.0] "%" ASDM
 SG_ ReSideRdrLeDetn64RdrDetnElevn : 260|5@0+ (1.0,-15.0) [-15.0|15.0] "Deg" ASDM
 SG_ ReSideRdrLeDetn64RdrDetnPwr : 311|6@0+ (1.0,0.0) [0.0|63.0] "dB" ASDM
 SG_ ReSideRdrLeDetn64RdrDetnRng : 295|14@0+ (0.02,-1.0) [-1.0|200.0] "m" ASDM
 SG_ ReSideRdrLeDetn64RdrDetnRngV : 271|13@0+ (0.02,-80.0) [-80.0|80.0] "m/s" ASDM
 SG_ ReSideRdrLeDetn64RdrDetnSameRV : 305|2@0+ (1,0) [0|3] "" ASDM
 SG_ ReSideRdrLeDetn64RdrDetnSts : 297|2@0+ (1,0) [0|3] "" ASDM
 SG_ ReSideRdrLeDetn65_UB : 483|1@0+ (1,0) [0|1] "" ASDM
 SG_ ReSideRdrLeDetn65RdrDetnAmbigState : 392|1@0+ (1,0) [0|1] "" ASDM
 SG_ ReSideRdrLeDetn65RdrDetnAssoTrkID : 399|7@0+ (1.0,0.0) [0.0|127.0] "Unitless" ASDM
 SG_ ReSideRdrLeDetn65RdrDetnAzi : 354|11@0+ (0.1,-90.0) [-90.0|90.0] "Deg" ASDM
 SG_ ReSideRdrLeDetn65RdrDetnChks : 327|8@0+ (1.0,0.0) [0.0|255.0] "Unitless" ASDM
 SG_ ReSideRdrLeDetn65RdrDetnCntr : 335|4@0+ (1.0,0.0) [0.0|15.0] "Unitless" ASDM
 SG_ ReSideRdrLeDetn65RdrDetnConf : 331|7@0+ (1.0,0.0) [0.0|100.0] "%" ASDM
 SG_ ReSideRdrLeDetn65RdrDetnElevn : 340|5@0+ (1.0,-15.0) [-15.0|15.0] "Deg" ASDM
 SG_ ReSideRdrLeDetn65RdrDetnPwr : 391|6@0+ (1.0,0.0) [0.0|63.0] "dB" ASDM
 SG_ ReSideRdrLeDetn65RdrDetnRng : 375|14@0+ (0.02,-1.0) [-1.0|200.0] "m" ASDM
 SG_ ReSideRdrLeDetn65RdrDetnRngV : 351|13@0+ (0.02,-80.0) [-80.0|80.0] "m/s" ASDM
 SG_ ReSideRdrLeDetn65RdrDetnSameRV : 385|2@0+ (1,0) [0|3] "" ASDM
 SG_ ReSideRdrLeDetn65RdrDetnSts : 377|2@0+ (1,0) [0|3] "" ASDM
 SG_ ReSideRdrLeDetn66_UB : 482|1@0+ (1,0) [0|1] "" ASDM
 SG_ ReSideRdrLeDetn66RdrDetnAmbigState : 472|1@0+ (1,0) [0|1] "" ASDM
 SG_ ReSideRdrLeDetn66RdrDetnAssoTrkID : 479|7@0+ (1.0,0.0) [0.0|127.0] "Unitless" ASDM
 SG_ ReSideRdrLeDetn66RdrDetnAzi : 434|11@0+ (0.1,-90.0) [-90.0|90.0] "Deg" ASDM
 SG_ ReSideRdrLeDetn66RdrDetnChks : 407|8@0+ (1.0,0.0) [0.0|255.0] "Unitless" ASDM
 SG_ ReSideRdrLeDetn66RdrDetnCntr : 415|4@0+ (1.0,0.0) [0.0|15.0] "Unitless" ASDM
 SG_ ReSideRdrLeDetn66RdrDetnConf : 411|7@0+ (1.0,0.0) [0.0|100.0] "%" ASDM
 SG_ ReSideRdrLeDetn66RdrDetnElevn : 420|5@0+ (1.0,-15.0) [-15.0|15.0] "Deg" ASDM
 SG_ ReSideRdrLeDetn66RdrDetnPwr : 471|6@0+ (1.0,0.0) [0.0|63.0] "dB" ASDM
 SG_ ReSideRdrLeDetn66RdrDetnRng : 455|14@0+ (0.02,-1.0) [-1.0|200.0] "m" ASDM
 SG_ ReSideRdrLeDetn66RdrDetnRngV : 431|13@0+ (0.02,-80.0) [-80.0|80.0] "m/s" ASDM
 SG_ ReSideRdrLeDetn66RdrDetnSameRV : 465|2@0+ (1,0) [0|3] "" ASDM
 SG_ ReSideRdrLeDetn66RdrDetnSts : 457|2@0+ (1,0) [0|3] "" ASDM

BO_ 98 SODLPrivateCANFD5Fr45 : 64 SODL
 SG_ ReSideRdrLeDetn67_UB : 487|1@0+ (1,0) [0|1] "" ASDM
 SG_ ReSideRdrLeDetn67RdrDetnAmbigState : 72|1@0+ (1,0) [0|1] "" ASDM
 SG_ ReSideRdrLeDetn67RdrDetnAssoTrkID : 79|7@0+ (1.0,0.0) [0.0|127.0] "Unitless" ASDM
 SG_ ReSideRdrLeDetn67RdrDetnAzi : 34|11@0+ (0.1,-90.0) [-90.0|90.0] "Deg" ASDM
 SG_ ReSideRdrLeDetn67RdrDetnChks : 7|8@0+ (1.0,0.0) [0.0|255.0] "Unitless" ASDM
 SG_ ReSideRdrLeDetn67RdrDetnCntr : 15|4@0+ (1.0,0.0) [0.0|15.0] "Unitless" ASDM
 SG_ ReSideRdrLeDetn67RdrDetnConf : 11|7@0+ (1.0,0.0) [0.0|100.0] "%" ASDM
 SG_ ReSideRdrLeDetn67RdrDetnElevn : 20|5@0+ (1.0,-15.0) [-15.0|15.0] "Deg" ASDM
 SG_ ReSideRdrLeDetn67RdrDetnPwr : 71|6@0+ (1.0,0.0) [0.0|63.0] "dB" ASDM
 SG_ ReSideRdrLeDetn67RdrDetnRng : 55|14@0+ (0.02,-1.0) [-1.0|200.0] "m" ASDM
 SG_ ReSideRdrLeDetn67RdrDetnRngV : 31|13@0+ (0.02,-80.0) [-80.0|80.0] "m/s" ASDM
 SG_ ReSideRdrLeDetn67RdrDetnSameRV : 65|2@0+ (1,0) [0|3] "" ASDM
 SG_ ReSideRdrLeDetn67RdrDetnSts : 57|2@0+ (1,0) [0|3] "" ASDM
 SG_ ReSideRdrLeDetn68_UB : 486|1@0+ (1,0) [0|1] "" ASDM
 SG_ ReSideRdrLeDetn68RdrDetnAmbigState : 152|1@0+ (1,0) [0|1] "" ASDM
 SG_ ReSideRdrLeDetn68RdrDetnAssoTrkID : 159|7@0+ (1.0,0.0) [0.0|127.0] "Unitless" ASDM
 SG_ ReSideRdrLeDetn68RdrDetnAzi : 114|11@0+ (0.1,-90.0) [-90.0|90.0] "Deg" ASDM
 SG_ ReSideRdrLeDetn68RdrDetnChks : 87|8@0+ (1.0,0.0) [0.0|255.0] "Unitless" ASDM
 SG_ ReSideRdrLeDetn68RdrDetnCntr : 95|4@0+ (1.0,0.0) [0.0|15.0] "Unitless" ASDM
 SG_ ReSideRdrLeDetn68RdrDetnConf : 91|7@0+ (1.0,0.0) [0.0|100.0] "%" ASDM
 SG_ ReSideRdrLeDetn68RdrDetnElevn : 100|5@0+ (1.0,-15.0) [-15.0|15.0] "Deg" ASDM
 SG_ ReSideRdrLeDetn68RdrDetnPwr : 151|6@0+ (1.0,0.0) [0.0|63.0] "dB" ASDM
 SG_ ReSideRdrLeDetn68RdrDetnRng : 135|14@0+ (0.02,-1.0) [-1.0|200.0] "m" ASDM
 SG_ ReSideRdrLeDetn68RdrDetnRngV : 111|13@0+ (0.02,-80.0) [-80.0|80.0] "m/s" ASDM
 SG_ ReSideRdrLeDetn68RdrDetnSameRV : 145|2@0+ (1,0) [0|3] "" ASDM
 SG_ ReSideRdrLeDetn68RdrDetnSts : 137|2@0+ (1,0) [0|3] "" ASDM
 SG_ ReSideRdrLeDetn69_UB : 485|1@0+ (1,0) [0|1] "" ASDM
 SG_ ReSideRdrLeDetn69RdrDetnAmbigState : 232|1@0+ (1,0) [0|1] "" ASDM
 SG_ ReSideRdrLeDetn69RdrDetnAssoTrkID : 239|7@0+ (1.0,0.0) [0.0|127.0] "Unitless" ASDM
 SG_ ReSideRdrLeDetn69RdrDetnAzi : 194|11@0+ (0.1,-90.0) [-90.0|90.0] "Deg" ASDM
 SG_ ReSideRdrLeDetn69RdrDetnChks : 167|8@0+ (1.0,0.0) [0.0|255.0] "Unitless" ASDM
 SG_ ReSideRdrLeDetn69RdrDetnCntr : 175|4@0+ (1.0,0.0) [0.0|15.0] "Unitless" ASDM
 SG_ ReSideRdrLeDetn69RdrDetnConf : 171|7@0+ (1.0,0.0) [0.0|100.0] "%" ASDM
 SG_ ReSideRdrLeDetn69RdrDetnElevn : 180|5@0+ (1.0,-15.0) [-15.0|15.0] "Deg" ASDM
 SG_ ReSideRdrLeDetn69RdrDetnPwr : 231|6@0+ (1.0,0.0) [0.0|63.0] "dB" ASDM
 SG_ ReSideRdrLeDetn69RdrDetnRng : 215|14@0+ (0.02,-1.0) [-1.0|200.0] "m" ASDM
 SG_ ReSideRdrLeDetn69RdrDetnRngV : 191|13@0+ (0.02,-80.0) [-80.0|80.0] "m/s" ASDM
 SG_ ReSideRdrLeDetn69RdrDetnSameRV : 225|2@0+ (1,0) [0|3] "" ASDM
 SG_ ReSideRdrLeDetn69RdrDetnSts : 217|2@0+ (1,0) [0|3] "" ASDM
 SG_ ReSideRdrLeDetn70_UB : 484|1@0+ (1,0) [0|1] "" ASDM
 SG_ ReSideRdrLeDetn70RdrDetnAmbigState : 312|1@0+ (1,0) [0|1] "" ASDM
 SG_ ReSideRdrLeDetn70RdrDetnAssoTrkID : 319|7@0+ (1.0,0.0) [0.0|127.0] "Unitless" ASDM
 SG_ ReSideRdrLeDetn70RdrDetnAzi : 274|11@0+ (0.1,-90.0) [-90.0|90.0] "Deg" ASDM
 SG_ ReSideRdrLeDetn70RdrDetnChks : 247|8@0+ (1.0,0.0) [0.0|255.0] "Unitless" ASDM
 SG_ ReSideRdrLeDetn70RdrDetnCntr : 255|4@0+ (1.0,0.0) [0.0|15.0] "Unitless" ASDM
 SG_ ReSideRdrLeDetn70RdrDetnConf : 251|7@0+ (1.0,0.0) [0.0|100.0] "%" ASDM
 SG_ ReSideRdrLeDetn70RdrDetnElevn : 260|5@0+ (1.0,-15.0) [-15.0|15.0] "Deg" ASDM
 SG_ ReSideRdrLeDetn70RdrDetnPwr : 311|6@0+ (1.0,0.0) [0.0|63.0] "dB" ASDM
 SG_ ReSideRdrLeDetn70RdrDetnRng : 295|14@0+ (0.02,-1.0) [-1.0|200.0] "m" ASDM
 SG_ ReSideRdrLeDetn70RdrDetnRngV : 271|13@0+ (0.02,-80.0) [-80.0|80.0] "m/s" ASDM
 SG_ ReSideRdrLeDetn70RdrDetnSameRV : 305|2@0+ (1,0) [0|3] "" ASDM
 SG_ ReSideRdrLeDetn70RdrDetnSts : 297|2@0+ (1,0) [0|3] "" ASDM
 SG_ ReSideRdrLeDetn71_UB : 483|1@0+ (1,0) [0|1] "" ASDM
 SG_ ReSideRdrLeDetn71RdrDetnAmbigState : 392|1@0+ (1,0) [0|1] "" ASDM
 SG_ ReSideRdrLeDetn71RdrDetnAssoTrkID : 399|7@0+ (1.0,0.0) [0.0|127.0] "Unitless" ASDM
 SG_ ReSideRdrLeDetn71RdrDetnAzi : 354|11@0+ (0.1,-90.0) [-90.0|90.0] "Deg" ASDM
 SG_ ReSideRdrLeDetn71RdrDetnChks : 327|8@0+ (1.0,0.0) [0.0|255.0] "Unitless" ASDM
 SG_ ReSideRdrLeDetn71RdrDetnCntr : 335|4@0+ (1.0,0.0) [0.0|15.0] "Unitless" ASDM
 SG_ ReSideRdrLeDetn71RdrDetnConf : 331|7@0+ (1.0,0.0) [0.0|100.0] "%" ASDM
 SG_ ReSideRdrLeDetn71RdrDetnElevn : 340|5@0+ (1.0,-15.0) [-15.0|15.0] "Deg" ASDM
 SG_ ReSideRdrLeDetn71RdrDetnPwr : 391|6@0+ (1.0,0.0) [0.0|63.0] "dB" ASDM
 SG_ ReSideRdrLeDetn71RdrDetnRng : 375|14@0+ (0.02,-1.0) [-1.0|200.0] "m" ASDM
 SG_ ReSideRdrLeDetn71RdrDetnRngV : 351|13@0+ (0.02,-80.0) [-80.0|80.0] "m/s" ASDM
 SG_ ReSideRdrLeDetn71RdrDetnSameRV : 385|2@0+ (1,0) [0|3] "" ASDM
 SG_ ReSideRdrLeDetn71RdrDetnSts : 377|2@0+ (1,0) [0|3] "" ASDM
 SG_ ReSideRdrLeDetn72_UB : 482|1@0+ (1,0) [0|1] "" ASDM
 SG_ ReSideRdrLeDetn72RdrDetnAmbigState : 472|1@0+ (1,0) [0|1] "" ASDM
 SG_ ReSideRdrLeDetn72RdrDetnAssoTrkID : 479|7@0+ (1.0,0.0) [0.0|127.0] "Unitless" ASDM
 SG_ ReSideRdrLeDetn72RdrDetnAzi : 434|11@0+ (0.1,-90.0) [-90.0|90.0] "Deg" ASDM
 SG_ ReSideRdrLeDetn72RdrDetnChks : 407|8@0+ (1.0,0.0) [0.0|255.0] "Unitless" ASDM
 SG_ ReSideRdrLeDetn72RdrDetnCntr : 415|4@0+ (1.0,0.0) [0.0|15.0] "Unitless" ASDM
 SG_ ReSideRdrLeDetn72RdrDetnConf : 411|7@0+ (1.0,0.0) [0.0|100.0] "%" ASDM
 SG_ ReSideRdrLeDetn72RdrDetnElevn : 420|5@0+ (1.0,-15.0) [-15.0|15.0] "Deg" ASDM
 SG_ ReSideRdrLeDetn72RdrDetnPwr : 471|6@0+ (1.0,0.0) [0.0|63.0] "dB" ASDM
 SG_ ReSideRdrLeDetn72RdrDetnRng : 455|14@0+ (0.02,-1.0) [-1.0|200.0] "m" ASDM
 SG_ ReSideRdrLeDetn72RdrDetnRngV : 431|13@0+ (0.02,-80.0) [-80.0|80.0] "m/s" ASDM
 SG_ ReSideRdrLeDetn72RdrDetnSameRV : 465|2@0+ (1,0) [0|3] "" ASDM
 SG_ ReSideRdrLeDetn72RdrDetnSts : 457|2@0+ (1,0) [0|3] "" ASDM

BO_ 99 SODLPrivateCANFD5Fr46 : 64 SODL
 SG_ ReSideRdrLeDetn73_UB : 487|1@0+ (1,0) [0|1] "" ASDM
 SG_ ReSideRdrLeDetn73RdrDetnAmbigState : 72|1@0+ (1,0) [0|1] "" ASDM
 SG_ ReSideRdrLeDetn73RdrDetnAssoTrkID : 79|7@0+ (1.0,0.0) [0.0|127.0] "Unitless" ASDM
 SG_ ReSideRdrLeDetn73RdrDetnAzi : 34|11@0+ (0.1,-90.0) [-90.0|90.0] "Deg" ASDM
 SG_ ReSideRdrLeDetn73RdrDetnChks : 7|8@0+ (1.0,0.0) [0.0|255.0] "Unitless" ASDM
 SG_ ReSideRdrLeDetn73RdrDetnCntr : 15|4@0+ (1.0,0.0) [0.0|15.0] "Unitless" ASDM
 SG_ ReSideRdrLeDetn73RdrDetnConf : 11|7@0+ (1.0,0.0) [0.0|100.0] "%" ASDM
 SG_ ReSideRdrLeDetn73RdrDetnElevn : 20|5@0+ (1.0,-15.0) [-15.0|15.0] "Deg" ASDM
 SG_ ReSideRdrLeDetn73RdrDetnPwr : 71|6@0+ (1.0,0.0) [0.0|63.0] "dB" ASDM
 SG_ ReSideRdrLeDetn73RdrDetnRng : 55|14@0+ (0.02,-1.0) [-1.0|200.0] "m" ASDM
 SG_ ReSideRdrLeDetn73RdrDetnRngV : 31|13@0+ (0.02,-80.0) [-80.0|80.0] "m/s" ASDM
 SG_ ReSideRdrLeDetn73RdrDetnSameRV : 65|2@0+ (1,0) [0|3] "" ASDM
 SG_ ReSideRdrLeDetn73RdrDetnSts : 57|2@0+ (1,0) [0|3] "" ASDM
 SG_ ReSideRdrLeDetn74_UB : 486|1@0+ (1,0) [0|1] "" ASDM
 SG_ ReSideRdrLeDetn74RdrDetnAmbigState : 152|1@0+ (1,0) [0|1] "" ASDM
 SG_ ReSideRdrLeDetn74RdrDetnAssoTrkID : 159|7@0+ (1.0,0.0) [0.0|127.0] "Unitless" ASDM
 SG_ ReSideRdrLeDetn74RdrDetnAzi : 114|11@0+ (0.1,-90.0) [-90.0|90.0] "Deg" ASDM
 SG_ ReSideRdrLeDetn74RdrDetnChks : 87|8@0+ (1.0,0.0) [0.0|255.0] "Unitless" ASDM
 SG_ ReSideRdrLeDetn74RdrDetnCntr : 95|4@0+ (1.0,0.0) [0.0|15.0] "Unitless" ASDM
 SG_ ReSideRdrLeDetn74RdrDetnConf : 91|7@0+ (1.0,0.0) [0.0|100.0] "%" ASDM
 SG_ ReSideRdrLeDetn74RdrDetnElevn : 100|5@0+ (1.0,-15.0) [-15.0|15.0] "Deg" ASDM
 SG_ ReSideRdrLeDetn74RdrDetnPwr : 151|6@0+ (1.0,0.0) [0.0|63.0] "dB" ASDM
 SG_ ReSideRdrLeDetn74RdrDetnRng : 135|14@0+ (0.02,-1.0) [-1.0|200.0] "m" ASDM
 SG_ ReSideRdrLeDetn74RdrDetnRngV : 111|13@0+ (0.02,-80.0) [-80.0|80.0] "m/s" ASDM
 SG_ ReSideRdrLeDetn74RdrDetnSameRV : 145|2@0+ (1,0) [0|3] "" ASDM
 SG_ ReSideRdrLeDetn74RdrDetnSts : 137|2@0+ (1,0) [0|3] "" ASDM
 SG_ ReSideRdrLeDetn75_UB : 485|1@0+ (1,0) [0|1] "" ASDM
 SG_ ReSideRdrLeDetn75RdrDetnAmbigState : 232|1@0+ (1,0) [0|1] "" ASDM
 SG_ ReSideRdrLeDetn75RdrDetnAssoTrkID : 239|7@0+ (1.0,0.0) [0.0|127.0] "Unitless" ASDM
 SG_ ReSideRdrLeDetn75RdrDetnAzi : 194|11@0+ (0.1,-90.0) [-90.0|90.0] "Deg" ASDM
 SG_ ReSideRdrLeDetn75RdrDetnChks : 167|8@0+ (1.0,0.0) [0.0|255.0] "Unitless" ASDM
 SG_ ReSideRdrLeDetn75RdrDetnCntr : 175|4@0+ (1.0,0.0) [0.0|15.0] "Unitless" ASDM
 SG_ ReSideRdrLeDetn75RdrDetnConf : 171|7@0+ (1.0,0.0) [0.0|100.0] "%" ASDM
 SG_ ReSideRdrLeDetn75RdrDetnElevn : 180|5@0+ (1.0,-15.0) [-15.0|15.0] "Deg" ASDM
 SG_ ReSideRdrLeDetn75RdrDetnPwr : 231|6@0+ (1.0,0.0) [0.0|63.0] "dB" ASDM
 SG_ ReSideRdrLeDetn75RdrDetnRng : 215|14@0+ (0.02,-1.0) [-1.0|200.0] "m" ASDM
 SG_ ReSideRdrLeDetn75RdrDetnRngV : 191|13@0+ (0.02,-80.0) [-80.0|80.0] "m/s" ASDM
 SG_ ReSideRdrLeDetn75RdrDetnSameRV : 225|2@0+ (1,0) [0|3] "" ASDM
 SG_ ReSideRdrLeDetn75RdrDetnSts : 217|2@0+ (1,0) [0|3] "" ASDM
 SG_ ReSideRdrLeDetn76_UB : 484|1@0+ (1,0) [0|1] "" ASDM
 SG_ ReSideRdrLeDetn76RdrDetnAmbigState : 312|1@0+ (1,0) [0|1] "" ASDM
 SG_ ReSideRdrLeDetn76RdrDetnAssoTrkID : 319|7@0+ (1.0,0.0) [0.0|127.0] "Unitless" ASDM
 SG_ ReSideRdrLeDetn76RdrDetnAzi : 274|11@0+ (0.1,-90.0) [-90.0|90.0] "Deg" ASDM
 SG_ ReSideRdrLeDetn76RdrDetnChks : 247|8@0+ (1.0,0.0) [0.0|255.0] "Unitless" ASDM
 SG_ ReSideRdrLeDetn76RdrDetnCntr : 255|4@0+ (1.0,0.0) [0.0|15.0] "Unitless" ASDM
 SG_ ReSideRdrLeDetn76RdrDetnConf : 251|7@0+ (1.0,0.0) [0.0|100.0] "%" ASDM
 SG_ ReSideRdrLeDetn76RdrDetnElevn : 260|5@0+ (1.0,-15.0) [-15.0|15.0] "Deg" ASDM
 SG_ ReSideRdrLeDetn76RdrDetnPwr : 311|6@0+ (1.0,0.0) [0.0|63.0] "dB" ASDM
 SG_ ReSideRdrLeDetn76RdrDetnRng : 295|14@0+ (0.02,-1.0) [-1.0|200.0] "m" ASDM
 SG_ ReSideRdrLeDetn76RdrDetnRngV : 271|13@0+ (0.02,-80.0) [-80.0|80.0] "m/s" ASDM
 SG_ ReSideRdrLeDetn76RdrDetnSameRV : 305|2@0+ (1,0) [0|3] "" ASDM
 SG_ ReSideRdrLeDetn76RdrDetnSts : 297|2@0+ (1,0) [0|3] "" ASDM
 SG_ ReSideRdrLeDetn77_UB : 483|1@0+ (1,0) [0|1] "" ASDM
 SG_ ReSideRdrLeDetn77RdrDetnAmbigState : 392|1@0+ (1,0) [0|1] "" ASDM
 SG_ ReSideRdrLeDetn77RdrDetnAssoTrkID : 399|7@0+ (1.0,0.0) [0.0|127.0] "Unitless" ASDM
 SG_ ReSideRdrLeDetn77RdrDetnAzi : 354|11@0+ (0.1,-90.0) [-90.0|90.0] "Deg" ASDM
 SG_ ReSideRdrLeDetn77RdrDetnChks : 327|8@0+ (1.0,0.0) [0.0|255.0] "Unitless" ASDM
 SG_ ReSideRdrLeDetn77RdrDetnCntr : 335|4@0+ (1.0,0.0) [0.0|15.0] "Unitless" ASDM
 SG_ ReSideRdrLeDetn77RdrDetnConf : 331|7@0+ (1.0,0.0) [0.0|100.0] "%" ASDM
 SG_ ReSideRdrLeDetn77RdrDetnElevn : 340|5@0+ (1.0,-15.0) [-15.0|15.0] "Deg" ASDM
 SG_ ReSideRdrLeDetn77RdrDetnPwr : 391|6@0+ (1.0,0.0) [0.0|63.0] "dB" ASDM
 SG_ ReSideRdrLeDetn77RdrDetnRng : 375|14@0+ (0.02,-1.0) [-1.0|200.0] "m" ASDM
 SG_ ReSideRdrLeDetn77RdrDetnRngV : 351|13@0+ (0.02,-80.0) [-80.0|80.0] "m/s" ASDM
 SG_ ReSideRdrLeDetn77RdrDetnSameRV : 385|2@0+ (1,0) [0|3] "" ASDM
 SG_ ReSideRdrLeDetn77RdrDetnSts : 377|2@0+ (1,0) [0|3] "" ASDM
 SG_ ReSideRdrLeDetn78_UB : 482|1@0+ (1,0) [0|1] "" ASDM
 SG_ ReSideRdrLeDetn78RdrDetnAmbigState : 472|1@0+ (1,0) [0|1] "" ASDM
 SG_ ReSideRdrLeDetn78RdrDetnAssoTrkID : 479|7@0+ (1.0,0.0) [0.0|127.0] "Unitless" ASDM
 SG_ ReSideRdrLeDetn78RdrDetnAzi : 434|11@0+ (0.1,-90.0) [-90.0|90.0] "Deg" ASDM
 SG_ ReSideRdrLeDetn78RdrDetnChks : 407|8@0+ (1.0,0.0) [0.0|255.0] "Unitless" ASDM
 SG_ ReSideRdrLeDetn78RdrDetnCntr : 415|4@0+ (1.0,0.0) [0.0|15.0] "Unitless" ASDM
 SG_ ReSideRdrLeDetn78RdrDetnConf : 411|7@0+ (1.0,0.0) [0.0|100.0] "%" ASDM
 SG_ ReSideRdrLeDetn78RdrDetnElevn : 420|5@0+ (1.0,-15.0) [-15.0|15.0] "Deg" ASDM
 SG_ ReSideRdrLeDetn78RdrDetnPwr : 471|6@0+ (1.0,0.0) [0.0|63.0] "dB" ASDM
 SG_ ReSideRdrLeDetn78RdrDetnRng : 455|14@0+ (0.02,-1.0) [-1.0|200.0] "m" ASDM
 SG_ ReSideRdrLeDetn78RdrDetnRngV : 431|13@0+ (0.02,-80.0) [-80.0|80.0] "m/s" ASDM
 SG_ ReSideRdrLeDetn78RdrDetnSameRV : 465|2@0+ (1,0) [0|3] "" ASDM
 SG_ ReSideRdrLeDetn78RdrDetnSts : 457|2@0+ (1,0) [0|3] "" ASDM

CM_ SG_ 87 ReSideRdrLeDetn37RdrDetnAmbigState "Dection ambiguous status";
CM_ SG_ 87 ReSideRdrLeDetn37RdrDetnAssoTrkID "Associated tracker ID
";
CM_ SG_ 87 ReSideRdrLeDetn37RdrDetnAzi "Refer to the data element description in ReSideRdrLeDetn1 with the same data element name";
CM_ SG_ 87 ReSideRdrLeDetn37RdrDetnChks "Refer to the data element description in ReSideRdrLeDetn1 with the same data element name";
CM_ SG_ 87 ReSideRdrLeDetn37RdrDetnCntr "Refer to the data element description in ReSideRdrLeDetn1 with the same data element name";
CM_ SG_ 87 ReSideRdrLeDetn37RdrDetnConf "Refer to the data element description in ReSideRdrLeDetn1 with the same data element name";
CM_ SG_ 87 ReSideRdrLeDetn37RdrDetnElevn "Refer to the data element description in ReSideRdrLeDetn1 with the same data element name";
CM_ SG_ 87 ReSideRdrLeDetn37RdrDetnPwr "Refer to the data element description in ReSideRdrLeDetn1 with the same data element name";
CM_ SG_ 87 ReSideRdrLeDetn37RdrDetnRng "Refer to the data element description in ReSideRdrLeDetn1 with the same data element name";
CM_ SG_ 87 ReSideRdrLeDetn37RdrDetnRngV "Range Velocity";
CM_ SG_ 87 ReSideRdrLeDetn37RdrDetnSameRV "object with same distance and speed";
CM_ SG_ 87 ReSideRdrLeDetn37RdrDetnSts "Refer to the data element description in ReSideRdrLeDetn1 with the same data element name";
CM_ SG_ 87 ReSideRdrLeDetn38RdrDetnAmbigState "Dection ambiguous status";
CM_ SG_ 87 ReSideRdrLeDetn38RdrDetnAssoTrkID "Associated tracker ID
";
CM_ SG_ 87 ReSideRdrLeDetn38RdrDetnAzi "Refer to the data element description in ReSideRdrLeDetn1 with the same data element name";
CM_ SG_ 87 ReSideRdrLeDetn38RdrDetnChks "Refer to the data element description in ReSideRdrLeDetn1 with the same data element name";
CM_ SG_ 87 ReSideRdrLeDetn38RdrDetnCntr "Refer to the data element description in ReSideRdrLeDetn1 with the same data element name";
CM_ SG_ 87 ReSideRdrLeDetn38RdrDetnConf "Refer to the data element description in ReSideRdrLeDetn1 with the same data element name";
CM_ SG_ 87 ReSideRdrLeDetn38RdrDetnElevn "Refer to the data element description in ReSideRdrLeDetn1 with the same data element name";
CM_ SG_ 87 ReSideRdrLeDetn38RdrDetnPwr "Refer to the data element description in ReSideRdrLeDetn1 with the same data element name";
CM_ SG_ 87 ReSideRdrLeDetn38RdrDetnRng "Refer to the data element description in ReSideRdrLeDetn1 with the same data element name";
CM_ SG_ 87 ReSideRdrLeDetn38RdrDetnRngV "Range Velocity";
CM_ SG_ 87 ReSideRdrLeDetn38RdrDetnSameRV "object with same distance and speed";
CM_ SG_ 87 ReSideRdrLeDetn38RdrDetnSts "Refer to the data element description in ReSideRdrLeDetn1 with the same data element name";
CM_ SG_ 87 ReSideRdrLeDetn39RdrDetnAmbigState "Dection ambiguous status";
CM_ SG_ 87 ReSideRdrLeDetn39RdrDetnAssoTrkID "Associated tracker ID
";
CM_ SG_ 87 ReSideRdrLeDetn39RdrDetnAzi "Refer to the data element description in ReSideRdrLeDetn1 with the same data element name";
CM_ SG_ 87 ReSideRdrLeDetn39RdrDetnChks "Refer to the data element description in ReSideRdrLeDetn1 with the same data element name";
CM_ SG_ 87 ReSideRdrLeDetn39RdrDetnCntr "Refer to the data element description in ReSideRdrLeDetn1 with the same data element name";
CM_ SG_ 87 ReSideRdrLeDetn39RdrDetnConf "Refer to the data element description in ReSideRdrLeDetn1 with the same data element name";
CM_ SG_ 87 ReSideRdrLeDetn39RdrDetnElevn "Refer to the data element description in ReSideRdrLeDetn1 with the same data element name";
CM_ SG_ 87 ReSideRdrLeDetn39RdrDetnPwr "Refer to the data element description in ReSideRdrLeDetn1 with the same data element name";
CM_ SG_ 87 ReSideRdrLeDetn39RdrDetnRng "Refer to the data element description in ReSideRdrLeDetn1 with the same data element name";
CM_ SG_ 87 ReSideRdrLeDetn39RdrDetnRngV "Range Velocity";
CM_ SG_ 87 ReSideRdrLeDetn39RdrDetnSameRV "object with same distance and speed";
CM_ SG_ 87 ReSideRdrLeDetn39RdrDetnSts "Refer to the data element description in ReSideRdrLeDetn1 with the same data element name";
CM_ SG_ 87 ReSideRdrLeDetn40RdrDetnAmbigState "Dection ambiguous status";
CM_ SG_ 87 ReSideRdrLeDetn40RdrDetnAssoTrkID "Associated tracker ID
";
CM_ SG_ 87 ReSideRdrLeDetn40RdrDetnAzi "Refer to the data element description in ReSideRdrLeDetn1 with the same data element name";
CM_ SG_ 87 ReSideRdrLeDetn40RdrDetnChks "Refer to the data element description in ReSideRdrLeDetn1 with the same data element name";
CM_ SG_ 87 ReSideRdrLeDetn40RdrDetnCntr "Refer to the data element description in ReSideRdrLeDetn1 with the same data element name";
CM_ SG_ 87 ReSideRdrLeDetn40RdrDetnConf "Refer to the data element description in ReSideRdrLeDetn1 with the same data element name";
CM_ SG_ 87 ReSideRdrLeDetn40RdrDetnElevn "Refer to the data element description in ReSideRdrLeDetn1 with the same data element name";
CM_ SG_ 87 ReSideRdrLeDetn40RdrDetnPwr "Refer to the data element description in ReSideRdrLeDetn1 with the same data element name";
CM_ SG_ 87 ReSideRdrLeDetn40RdrDetnRng "Refer to the data element description in ReSideRdrLeDetn1 with the same data element name";
CM_ SG_ 87 ReSideRdrLeDetn40RdrDetnRngV "Range Velocity";
CM_ SG_ 87 ReSideRdrLeDetn40RdrDetnSameRV "object with same distance and speed";
CM_ SG_ 87 ReSideRdrLeDetn40RdrDetnSts "Refer to the data element description in ReSideRdrLeDetn1 with the same data element name";
CM_ SG_ 87 ReSideRdrLeDetn41RdrDetnAmbigState "Dection ambiguous status";
CM_ SG_ 87 ReSideRdrLeDetn41RdrDetnAssoTrkID "Associated tracker ID
";
CM_ SG_ 87 ReSideRdrLeDetn41RdrDetnAzi "Refer to the data element description in ReSideRdrLeDetn1 with the same data element name";
CM_ SG_ 87 ReSideRdrLeDetn41RdrDetnChks "Refer to the data element description in ReSideRdrLeDetn1 with the same data element name";
CM_ SG_ 87 ReSideRdrLeDetn41RdrDetnCntr "Refer to the data element description in ReSideRdrLeDetn1 with the same data element name";
CM_ SG_ 87 ReSideRdrLeDetn41RdrDetnConf "Refer to the data element description in ReSideRdrLeDetn1 with the same data element name";
CM_ SG_ 87 ReSideRdrLeDetn41RdrDetnElevn "Refer to the data element description in ReSideRdrLeDetn1 with the same data element name";
CM_ SG_ 87 ReSideRdrLeDetn41RdrDetnPwr "Refer to the data element description in ReSideRdrLeDetn1 with the same data element name";
CM_ SG_ 87 ReSideRdrLeDetn41RdrDetnRng "Refer to the data element description in ReSideRdrLeDetn1 with the same data element name";
CM_ SG_ 87 ReSideRdrLeDetn41RdrDetnRngV "Range Velocity";
CM_ SG_ 87 ReSideRdrLeDetn41RdrDetnSameRV "object with same distance and speed";
CM_ SG_ 87 ReSideRdrLeDetn41RdrDetnSts "Refer to the data element description in ReSideRdrLeDetn1 with the same data element name";
CM_ SG_ 87 ReSideRdrLeDetn42RdrDetnAmbigState "Dection ambiguous status";
CM_ SG_ 87 ReSideRdrLeDetn42RdrDetnAssoTrkID "Associated tracker ID
";
CM_ SG_ 87 ReSideRdrLeDetn42RdrDetnAzi "Refer to the data element description in ReSideRdrLeDetn1 with the same data element name";
CM_ SG_ 87 ReSideRdrLeDetn42RdrDetnChks "Refer to the data element description in ReSideRdrLeDetn1 with the same data element name";
CM_ SG_ 87 ReSideRdrLeDetn42RdrDetnCntr "Refer to the data element description in ReSideRdrLeDetn1 with the same data element name";
CM_ SG_ 87 ReSideRdrLeDetn42RdrDetnConf "Refer to the data element description in ReSideRdrLeDetn1 with the same data element name";
CM_ SG_ 87 ReSideRdrLeDetn42RdrDetnElevn "Refer to the data element description in ReSideRdrLeDetn1 with the same data element name";
CM_ SG_ 87 ReSideRdrLeDetn42RdrDetnPwr "Refer to the data element description in ReSideRdrLeDetn1 with the same data element name";
CM_ SG_ 87 ReSideRdrLeDetn42RdrDetnRng "Refer to the data element description in ReSideRdrLeDetn1 with the same data element name";
CM_ SG_ 87 ReSideRdrLeDetn42RdrDetnRngV "Range Velocity";
CM_ SG_ 87 ReSideRdrLeDetn42RdrDetnSameRV "object with same distance and speed";
CM_ SG_ 87 ReSideRdrLeDetn42RdrDetnSts "Refer to the data element description in ReSideRdrLeDetn1 with the same data element name";
CM_ SG_ 88 ReSideRdrLeDetn43RdrDetnAmbigState "Dection ambiguous status";
CM_ SG_ 88 ReSideRdrLeDetn43RdrDetnAssoTrkID "Associated tracker ID
";
CM_ SG_ 88 ReSideRdrLeDetn43RdrDetnAzi "Refer to the data element description in ReSideRdrLeDetn1 with the same data element name";
CM_ SG_ 88 ReSideRdrLeDetn43RdrDetnChks "Refer to the data element description in ReSideRdrLeDetn1 with the same data element name";
CM_ SG_ 88 ReSideRdrLeDetn43RdrDetnCntr "Refer to the data element description in ReSideRdrLeDetn1 with the same data element name";
CM_ SG_ 88 ReSideRdrLeDetn43RdrDetnConf "Refer to the data element description in ReSideRdrLeDetn1 with the same data element name";
CM_ SG_ 88 ReSideRdrLeDetn43RdrDetnElevn "Refer to the data element description in ReSideRdrLeDetn1 with the same data element name";
CM_ SG_ 88 ReSideRdrLeDetn43RdrDetnPwr "Refer to the data element description in ReSideRdrLeDetn1 with the same data element name";
CM_ SG_ 88 ReSideRdrLeDetn43RdrDetnRng "Refer to the data element description in ReSideRdrLeDetn1 with the same data element name";
CM_ SG_ 88 ReSideRdrLeDetn43RdrDetnRngV "Range Velocity";
CM_ SG_ 88 ReSideRdrLeDetn43RdrDetnSameRV "object with same distance and speed";
CM_ SG_ 88 ReSideRdrLeDetn43RdrDetnSts "Refer to the data element description in ReSideRdrLeDetn1 with the same data element name";
CM_ SG_ 88 ReSideRdrLeDetn44RdrDetnAmbigState "Dection ambiguous status";
CM_ SG_ 88 ReSideRdrLeDetn44RdrDetnAssoTrkID "Associated tracker ID
";
CM_ SG_ 88 ReSideRdrLeDetn44RdrDetnAzi "Refer to the data element description in ReSideRdrLeDetn1 with the same data element name";
CM_ SG_ 88 ReSideRdrLeDetn44RdrDetnChks "Refer to the data element description in ReSideRdrLeDetn1 with the same data element name";
CM_ SG_ 88 ReSideRdrLeDetn44RdrDetnCntr "Refer to the data element description in ReSideRdrLeDetn1 with the same data element name";
CM_ SG_ 88 ReSideRdrLeDetn44RdrDetnConf "Refer to the data element description in ReSideRdrLeDetn1 with the same data element name";
CM_ SG_ 88 ReSideRdrLeDetn44RdrDetnElevn "Refer to the data element description in ReSideRdrLeDetn1 with the same data element name";
CM_ SG_ 88 ReSideRdrLeDetn44RdrDetnPwr "Refer to the data element description in ReSideRdrLeDetn1 with the same data element name";
CM_ SG_ 88 ReSideRdrLeDetn44RdrDetnRng "Refer to the data element description in ReSideRdrLeDetn1 with the same data element name";
CM_ SG_ 88 ReSideRdrLeDetn44RdrDetnRngV "Range Velocity";
CM_ SG_ 88 ReSideRdrLeDetn44RdrDetnSameRV "object with same distance and speed";
CM_ SG_ 88 ReSideRdrLeDetn44RdrDetnSts "Refer to the data element description in ReSideRdrLeDetn1 with the same data element name";
CM_ SG_ 88 ReSideRdrLeDetn45RdrDetnAmbigState "Dection ambiguous status";
CM_ SG_ 88 ReSideRdrLeDetn45RdrDetnAssoTrkID "Associated tracker ID
";
CM_ SG_ 88 ReSideRdrLeDetn45RdrDetnAzi "Refer to the data element description in ReSideRdrLeDetn1 with the same data element name";
CM_ SG_ 88 ReSideRdrLeDetn45RdrDetnChks "Refer to the data element description in ReSideRdrLeDetn1 with the same data element name";
CM_ SG_ 88 ReSideRdrLeDetn45RdrDetnCntr "Refer to the data element description in ReSideRdrLeDetn1 with the same data element name";
CM_ SG_ 88 ReSideRdrLeDetn45RdrDetnConf "Refer to the data element description in ReSideRdrLeDetn1 with the same data element name";
CM_ SG_ 88 ReSideRdrLeDetn45RdrDetnElevn "Refer to the data element description in ReSideRdrLeDetn1 with the same data element name";
CM_ SG_ 88 ReSideRdrLeDetn45RdrDetnPwr "Refer to the data element description in ReSideRdrLeDetn1 with the same data element name";
CM_ SG_ 88 ReSideRdrLeDetn45RdrDetnRng "Refer to the data element description in ReSideRdrLeDetn1 with the same data element name";
CM_ SG_ 88 ReSideRdrLeDetn45RdrDetnRngV "Range Velocity";
CM_ SG_ 88 ReSideRdrLeDetn45RdrDetnSameRV "object with same distance and speed";
CM_ SG_ 88 ReSideRdrLeDetn45RdrDetnSts "Refer to the data element description in ReSideRdrLeDetn1 with the same data element name";
CM_ SG_ 88 ReSideRdrLeDetn46RdrDetnAmbigState "Dection ambiguous status";
CM_ SG_ 88 ReSideRdrLeDetn46RdrDetnAssoTrkID "Associated tracker ID
";
CM_ SG_ 88 ReSideRdrLeDetn46RdrDetnAzi "Refer to the data element description in ReSideRdrLeDetn1 with the same data element name";
CM_ SG_ 88 ReSideRdrLeDetn46RdrDetnChks "Refer to the data element description in ReSideRdrLeDetn1 with the same data element name";
CM_ SG_ 88 ReSideRdrLeDetn46RdrDetnCntr "Refer to the data element description in ReSideRdrLeDetn1 with the same data element name";
CM_ SG_ 88 ReSideRdrLeDetn46RdrDetnConf "Refer to the data element description in ReSideRdrLeDetn1 with the same data element name";
CM_ SG_ 88 ReSideRdrLeDetn46RdrDetnElevn "Refer to the data element description in ReSideRdrLeDetn1 with the same data element name";
CM_ SG_ 88 ReSideRdrLeDetn46RdrDetnPwr "Refer to the data element description in ReSideRdrLeDetn1 with the same data element name";
CM_ SG_ 88 ReSideRdrLeDetn46RdrDetnRng "Refer to the data element description in ReSideRdrLeDetn1 with the same data element name";
CM_ SG_ 88 ReSideRdrLeDetn46RdrDetnRngV "Range Velocity";
CM_ SG_ 88 ReSideRdrLeDetn46RdrDetnSameRV "object with same distance and speed";
CM_ SG_ 88 ReSideRdrLeDetn46RdrDetnSts "Refer to the data element description in ReSideRdrLeDetn1 with the same data element name";
CM_ SG_ 88 ReSideRdrLeDetn47RdrDetnAmbigState "Dection ambiguous status";
CM_ SG_ 88 ReSideRdrLeDetn47RdrDetnAssoTrkID "Associated tracker ID
";
CM_ SG_ 88 ReSideRdrLeDetn47RdrDetnAzi "Refer to the data element description in ReSideRdrLeDetn1 with the same data element name";
CM_ SG_ 88 ReSideRdrLeDetn47RdrDetnChks "Refer to the data element description in ReSideRdrLeDetn1 with the same data element name";
CM_ SG_ 88 ReSideRdrLeDetn47RdrDetnCntr "Refer to the data element description in ReSideRdrLeDetn1 with the same data element name";
CM_ SG_ 88 ReSideRdrLeDetn47RdrDetnConf "Refer to the data element description in ReSideRdrLeDetn1 with the same data element name";
CM_ SG_ 88 ReSideRdrLeDetn47RdrDetnElevn "Refer to the data element description in ReSideRdrLeDetn1 with the same data element name";
CM_ SG_ 88 ReSideRdrLeDetn47RdrDetnPwr "Refer to the data element description in ReSideRdrLeDetn1 with the same data element name";
CM_ SG_ 88 ReSideRdrLeDetn47RdrDetnRng "Refer to the data element description in ReSideRdrLeDetn1 with the same data element name";
CM_ SG_ 88 ReSideRdrLeDetn47RdrDetnRngV "Range Velocity";
CM_ SG_ 88 ReSideRdrLeDetn47RdrDetnSameRV "object with same distance and speed";
CM_ SG_ 88 ReSideRdrLeDetn47RdrDetnSts "Refer to the data element description in ReSideRdrLeDetn1 with the same data element name";
CM_ SG_ 88 ReSideRdrLeDetn48RdrDetnAmbigState "Dection ambiguous status";
CM_ SG_ 88 ReSideRdrLeDetn48RdrDetnAssoTrkID "Associated tracker ID
";
CM_ SG_ 88 ReSideRdrLeDetn48RdrDetnAzi "Refer to the data element description in ReSideRdrLeDetn1 with the same data element name";
CM_ SG_ 88 ReSideRdrLeDetn48RdrDetnChks "Refer to the data element description in ReSideRdrLeDetn1 with the same data element name";
CM_ SG_ 88 ReSideRdrLeDetn48RdrDetnCntr "Refer to the data element description in ReSideRdrLeDetn1 with the same data element name";
CM_ SG_ 88 ReSideRdrLeDetn48RdrDetnConf "Refer to the data element description in ReSideRdrLeDetn1 with the same data element name";
CM_ SG_ 88 ReSideRdrLeDetn48RdrDetnElevn "Refer to the data element description in ReSideRdrLeDetn1 with the same data element name";
CM_ SG_ 88 ReSideRdrLeDetn48RdrDetnPwr "Refer to the data element description in ReSideRdrLeDetn1 with the same data element name";
CM_ SG_ 88 ReSideRdrLeDetn48RdrDetnRng "Refer to the data element description in ReSideRdrLeDetn1 with the same data element name";
CM_ SG_ 88 ReSideRdrLeDetn48RdrDetnRngV "Range Velocity";
CM_ SG_ 88 ReSideRdrLeDetn48RdrDetnSameRV "object with same distance and speed";
CM_ SG_ 88 ReSideRdrLeDetn48RdrDetnSts "Refer to the data element description in ReSideRdrLeDetn1 with the same data element name";
CM_ SG_ 89 ReSideRdrLeDetn49RdrDetnAmbigState "Dection ambiguous status";
CM_ SG_ 89 ReSideRdrLeDetn49RdrDetnAssoTrkID "Associated tracker ID
";
CM_ SG_ 89 ReSideRdrLeDetn49RdrDetnAzi "Refer to the data element description in ReSideRdrLeDetn1 with the same data element name";
CM_ SG_ 89 ReSideRdrLeDetn49RdrDetnChks "Refer to the data element description in ReSideRdrLeDetn1 with the same data element name";
CM_ SG_ 89 ReSideRdrLeDetn49RdrDetnCntr "Refer to the data element description in ReSideRdrLeDetn1 with the same data element name";
CM_ SG_ 89 ReSideRdrLeDetn49RdrDetnConf "Refer to the data element description in ReSideRdrLeDetn1 with the same data element name";
CM_ SG_ 89 ReSideRdrLeDetn49RdrDetnElevn "Refer to the data element description in ReSideRdrLeDetn1 with the same data element name";
CM_ SG_ 89 ReSideRdrLeDetn49RdrDetnPwr "Refer to the data element description in ReSideRdrLeDetn1 with the same data element name";
CM_ SG_ 89 ReSideRdrLeDetn49RdrDetnRng "Refer to the data element description in ReSideRdrLeDetn1 with the same data element name";
CM_ SG_ 89 ReSideRdrLeDetn49RdrDetnRngV "Range Velocity";
CM_ SG_ 89 ReSideRdrLeDetn49RdrDetnSameRV "object with same distance and speed";
CM_ SG_ 89 ReSideRdrLeDetn49RdrDetnSts "Refer to the data element description in ReSideRdrLeDetn1 with the same data element name";
CM_ SG_ 89 ReSideRdrLeDetn50RdrDetnAmbigState "Dection ambiguous status";
CM_ SG_ 89 ReSideRdrLeDetn50RdrDetnAssoTrkID "Associated tracker ID
";
CM_ SG_ 89 ReSideRdrLeDetn50RdrDetnAzi "Refer to the data element description in ReSideRdrLeDetn1 with the same data element name";
CM_ SG_ 89 ReSideRdrLeDetn50RdrDetnChks "Refer to the data element description in ReSideRdrLeDetn1 with the same data element name";
CM_ SG_ 89 ReSideRdrLeDetn50RdrDetnCntr "Refer to the data element description in ReSideRdrLeDetn1 with the same data element name";
CM_ SG_ 89 ReSideRdrLeDetn50RdrDetnConf "Refer to the data element description in ReSideRdrLeDetn1 with the same data element name";
CM_ SG_ 89 ReSideRdrLeDetn50RdrDetnElevn "Refer to the data element description in ReSideRdrLeDetn1 with the same data element name";
CM_ SG_ 89 ReSideRdrLeDetn50RdrDetnPwr "Refer to the data element description in ReSideRdrLeDetn1 with the same data element name";
CM_ SG_ 89 ReSideRdrLeDetn50RdrDetnRng "Refer to the data element description in ReSideRdrLeDetn1 with the same data element name";
CM_ SG_ 89 ReSideRdrLeDetn50RdrDetnRngV "Range Velocity";
CM_ SG_ 89 ReSideRdrLeDetn50RdrDetnSameRV "object with same distance and speed";
CM_ SG_ 89 ReSideRdrLeDetn50RdrDetnSts "Refer to the data element description in ReSideRdrLeDetn1 with the same data element name";
CM_ SG_ 89 ReSideRdrLeDetn51RdrDetnAmbigState "Dection ambiguous status";
CM_ SG_ 89 ReSideRdrLeDetn51RdrDetnAssoTrkID "Associated tracker ID
";
CM_ SG_ 89 ReSideRdrLeDetn51RdrDetnAzi "Refer to the data element description in ReSideRdrLeDetn1 with the same data element name";
CM_ SG_ 89 ReSideRdrLeDetn51RdrDetnChks "Refer to the data element description in ReSideRdrLeDetn1 with the same data element name";
CM_ SG_ 89 ReSideRdrLeDetn51RdrDetnCntr "Refer to the data element description in ReSideRdrLeDetn1 with the same data element name";
CM_ SG_ 89 ReSideRdrLeDetn51RdrDetnConf "Refer to the data element description in ReSideRdrLeDetn1 with the same data element name";
CM_ SG_ 89 ReSideRdrLeDetn51RdrDetnElevn "Refer to the data element description in ReSideRdrLeDetn1 with the same data element name";
CM_ SG_ 89 ReSideRdrLeDetn51RdrDetnPwr "Refer to the data element description in ReSideRdrLeDetn1 with the same data element name";
CM_ SG_ 89 ReSideRdrLeDetn51RdrDetnRng "Refer to the data element description in ReSideRdrLeDetn1 with the same data element name";
CM_ SG_ 89 ReSideRdrLeDetn51RdrDetnRngV "Range Velocity";
CM_ SG_ 89 ReSideRdrLeDetn51RdrDetnSameRV "object with same distance and speed";
CM_ SG_ 89 ReSideRdrLeDetn51RdrDetnSts "Refer to the data element description in ReSideRdrLeDetn1 with the same data element name";
CM_ SG_ 89 ReSideRdrLeDetn52RdrDetnAmbigState "Dection ambiguous status";
CM_ SG_ 89 ReSideRdrLeDetn52RdrDetnAssoTrkID "Associated tracker ID
";
CM_ SG_ 89 ReSideRdrLeDetn52RdrDetnAzi "Refer to the data element description in ReSideRdrLeDetn1 with the same data element name";
CM_ SG_ 89 ReSideRdrLeDetn52RdrDetnChks "Refer to the data element description in ReSideRdrLeDetn1 with the same data element name";
CM_ SG_ 89 ReSideRdrLeDetn52RdrDetnCntr "Refer to the data element description in ReSideRdrLeDetn1 with the same data element name";
CM_ SG_ 89 ReSideRdrLeDetn52RdrDetnConf "Refer to the data element description in ReSideRdrLeDetn1 with the same data element name";
CM_ SG_ 89 ReSideRdrLeDetn52RdrDetnElevn "Refer to the data element description in ReSideRdrLeDetn1 with the same data element name";
CM_ SG_ 89 ReSideRdrLeDetn52RdrDetnPwr "Refer to the data element description in ReSideRdrLeDetn1 with the same data element name";
CM_ SG_ 89 ReSideRdrLeDetn52RdrDetnRng "Refer to the data element description in ReSideRdrLeDetn1 with the same data element name";
CM_ SG_ 89 ReSideRdrLeDetn52RdrDetnRngV "Range Velocity";
CM_ SG_ 89 ReSideRdrLeDetn52RdrDetnSameRV "object with same distance and speed";
CM_ SG_ 89 ReSideRdrLeDetn52RdrDetnSts "Refer to the data element description in ReSideRdrLeDetn1 with the same data element name";
CM_ SG_ 89 ReSideRdrLeDetn53RdrDetnAmbigState "Dection ambiguous status";
CM_ SG_ 89 ReSideRdrLeDetn53RdrDetnAssoTrkID "Associated tracker ID
";
CM_ SG_ 89 ReSideRdrLeDetn53RdrDetnAzi "Refer to the data element description in ReSideRdrLeDetn1 with the same data element name";
CM_ SG_ 89 ReSideRdrLeDetn53RdrDetnChks "Refer to the data element description in ReSideRdrLeDetn1 with the same data element name";
CM_ SG_ 89 ReSideRdrLeDetn53RdrDetnCntr "Refer to the data element description in ReSideRdrLeDetn1 with the same data element name";
CM_ SG_ 89 ReSideRdrLeDetn53RdrDetnConf "Refer to the data element description in ReSideRdrLeDetn1 with the same data element name";
CM_ SG_ 89 ReSideRdrLeDetn53RdrDetnElevn "Refer to the data element description in ReSideRdrLeDetn1 with the same data element name";
CM_ SG_ 89 ReSideRdrLeDetn53RdrDetnPwr "Refer to the data element description in ReSideRdrLeDetn1 with the same data element name";
CM_ SG_ 89 ReSideRdrLeDetn53RdrDetnRng "Refer to the data element description in ReSideRdrLeDetn1 with the same data element name";
CM_ SG_ 89 ReSideRdrLeDetn53RdrDetnRngV "Range Velocity";
CM_ SG_ 89 ReSideRdrLeDetn53RdrDetnSameRV "object with same distance and speed";
CM_ SG_ 89 ReSideRdrLeDetn53RdrDetnSts "Refer to the data element description in ReSideRdrLeDetn1 with the same data element name";
CM_ SG_ 89 ReSideRdrLeDetn54RdrDetnAmbigState "Dection ambiguous status";
CM_ SG_ 89 ReSideRdrLeDetn54RdrDetnAssoTrkID "Associated tracker ID
";
CM_ SG_ 89 ReSideRdrLeDetn54RdrDetnAzi "Refer to the data element description in ReSideRdrLeDetn1 with the same data element name";
CM_ SG_ 89 ReSideRdrLeDetn54RdrDetnChks "Refer to the data element description in ReSideRdrLeDetn1 with the same data element name";
CM_ SG_ 89 ReSideRdrLeDetn54RdrDetnCntr "Refer to the data element description in ReSideRdrLeDetn1 with the same data element name";
CM_ SG_ 89 ReSideRdrLeDetn54RdrDetnConf "Refer to the data element description in ReSideRdrLeDetn1 with the same data element name";
CM_ SG_ 89 ReSideRdrLeDetn54RdrDetnElevn "Refer to the data element description in ReSideRdrLeDetn1 with the same data element name";
CM_ SG_ 89 ReSideRdrLeDetn54RdrDetnPwr "Refer to the data element description in ReSideRdrLeDetn1 with the same data element name";
CM_ SG_ 89 ReSideRdrLeDetn54RdrDetnRng "Refer to the data element description in ReSideRdrLeDetn1 with the same data element name";
CM_ SG_ 89 ReSideRdrLeDetn54RdrDetnRngV "Range Velocity";
CM_ SG_ 89 ReSideRdrLeDetn54RdrDetnSameRV "object with same distance and speed";
CM_ SG_ 89 ReSideRdrLeDetn54RdrDetnSts "Refer to the data element description in ReSideRdrLeDetn1 with the same data element name";
CM_ SG_ 96 ReSideRdrLeDetn55RdrDetnAmbigState "Dection ambiguous status";
CM_ SG_ 96 ReSideRdrLeDetn55RdrDetnAssoTrkID "Associated tracker ID
";
CM_ SG_ 96 ReSideRdrLeDetn55RdrDetnAzi "Refer to the data element description in ReSideRdrLeDetn1 with the same data element name";
CM_ SG_ 96 ReSideRdrLeDetn55RdrDetnChks "Refer to the data element description in ReSideRdrLeDetn1 with the same data element name";
CM_ SG_ 96 ReSideRdrLeDetn55RdrDetnCntr "Refer to the data element description in ReSideRdrLeDetn1 with the same data element name";
CM_ SG_ 96 ReSideRdrLeDetn55RdrDetnConf "Refer to the data element description in ReSideRdrLeDetn1 with the same data element name";
CM_ SG_ 96 ReSideRdrLeDetn55RdrDetnElevn "Refer to the data element description in ReSideRdrLeDetn1 with the same data element name";
CM_ SG_ 96 ReSideRdrLeDetn55RdrDetnPwr "Refer to the data element description in ReSideRdrLeDetn1 with the same data element name";
CM_ SG_ 96 ReSideRdrLeDetn55RdrDetnRng "Refer to the data element description in ReSideRdrLeDetn1 with the same data element name";
CM_ SG_ 96 ReSideRdrLeDetn55RdrDetnRngV "Range Velocity";
CM_ SG_ 96 ReSideRdrLeDetn55RdrDetnSameRV "object with same distance and speed";
CM_ SG_ 96 ReSideRdrLeDetn55RdrDetnSts "Refer to the data element description in ReSideRdrLeDetn1 with the same data element name";
CM_ SG_ 96 ReSideRdrLeDetn56RdrDetnAmbigState "Dection ambiguous status";
CM_ SG_ 96 ReSideRdrLeDetn56RdrDetnAssoTrkID "Associated tracker ID
";
CM_ SG_ 96 ReSideRdrLeDetn56RdrDetnAzi "Refer to the data element description in ReSideRdrLeDetn1 with the same data element name";
CM_ SG_ 96 ReSideRdrLeDetn56RdrDetnChks "Refer to the data element description in ReSideRdrLeDetn1 with the same data element name";
CM_ SG_ 96 ReSideRdrLeDetn56RdrDetnCntr "Refer to the data element description in ReSideRdrLeDetn1 with the same data element name";
CM_ SG_ 96 ReSideRdrLeDetn56RdrDetnConf "Refer to the data element description in ReSideRdrLeDetn1 with the same data element name";
CM_ SG_ 96 ReSideRdrLeDetn56RdrDetnElevn "Refer to the data element description in ReSideRdrLeDetn1 with the same data element name";
CM_ SG_ 96 ReSideRdrLeDetn56RdrDetnPwr "Refer to the data element description in ReSideRdrLeDetn1 with the same data element name";
CM_ SG_ 96 ReSideRdrLeDetn56RdrDetnRng "Refer to the data element description in ReSideRdrLeDetn1 with the same data element name";
CM_ SG_ 96 ReSideRdrLeDetn56RdrDetnRngV "Range Velocity";
CM_ SG_ 96 ReSideRdrLeDetn56RdrDetnSameRV "object with same distance and speed";
CM_ SG_ 96 ReSideRdrLeDetn56RdrDetnSts "Refer to the data element description in ReSideRdrLeDetn1 with the same data element name";
CM_ SG_ 96 ReSideRdrLeDetn57RdrDetnAmbigState "Dection ambiguous status";
CM_ SG_ 96 ReSideRdrLeDetn57RdrDetnAssoTrkID "Associated tracker ID
";
CM_ SG_ 96 ReSideRdrLeDetn57RdrDetnAzi "Refer to the data element description in ReSideRdrLeDetn1 with the same data element name";
CM_ SG_ 96 ReSideRdrLeDetn57RdrDetnChks "Refer to the data element description in ReSideRdrLeDetn1 with the same data element name";
CM_ SG_ 96 ReSideRdrLeDetn57RdrDetnCntr "Refer to the data element description in ReSideRdrLeDetn1 with the same data element name";
CM_ SG_ 96 ReSideRdrLeDetn57RdrDetnConf "Refer to the data element description in ReSideRdrLeDetn1 with the same data element name";
CM_ SG_ 96 ReSideRdrLeDetn57RdrDetnElevn "Refer to the data element description in ReSideRdrLeDetn1 with the same data element name";
CM_ SG_ 96 ReSideRdrLeDetn57RdrDetnPwr "Refer to the data element description in ReSideRdrLeDetn1 with the same data element name";
CM_ SG_ 96 ReSideRdrLeDetn57RdrDetnRng "Refer to the data element description in ReSideRdrLeDetn1 with the same data element name";
CM_ SG_ 96 ReSideRdrLeDetn57RdrDetnRngV "Range Velocity";
CM_ SG_ 96 ReSideRdrLeDetn57RdrDetnSameRV "object with same distance and speed";
CM_ SG_ 96 ReSideRdrLeDetn57RdrDetnSts "Refer to the data element description in ReSideRdrLeDetn1 with the same data element name";
CM_ SG_ 96 ReSideRdrLeDetn58RdrDetnAmbigState "Dection ambiguous status";
CM_ SG_ 96 ReSideRdrLeDetn58RdrDetnAssoTrkID "Associated tracker ID
";
CM_ SG_ 96 ReSideRdrLeDetn58RdrDetnAzi "Refer to the data element description in ReSideRdrLeDetn1 with the same data element name";
CM_ SG_ 96 ReSideRdrLeDetn58RdrDetnChks "Refer to the data element description in ReSideRdrLeDetn1 with the same data element name";
CM_ SG_ 96 ReSideRdrLeDetn58RdrDetnCntr "Refer to the data element description in ReSideRdrLeDetn1 with the same data element name";
CM_ SG_ 96 ReSideRdrLeDetn58RdrDetnConf "Refer to the data element description in ReSideRdrLeDetn1 with the same data element name";
CM_ SG_ 96 ReSideRdrLeDetn58RdrDetnElevn "Refer to the data element description in ReSideRdrLeDetn1 with the same data element name";
CM_ SG_ 96 ReSideRdrLeDetn58RdrDetnPwr "Refer to the data element description in ReSideRdrLeDetn1 with the same data element name";
CM_ SG_ 96 ReSideRdrLeDetn58RdrDetnRng "Refer to the data element description in ReSideRdrLeDetn1 with the same data element name";
CM_ SG_ 96 ReSideRdrLeDetn58RdrDetnRngV "Range Velocity";
CM_ SG_ 96 ReSideRdrLeDetn58RdrDetnSameRV "object with same distance and speed";
CM_ SG_ 96 ReSideRdrLeDetn58RdrDetnSts "Refer to the data element description in ReSideRdrLeDetn1 with the same data element name";
CM_ SG_ 96 ReSideRdrLeDetn59RdrDetnAmbigState "Dection ambiguous status";
CM_ SG_ 96 ReSideRdrLeDetn59RdrDetnAssoTrkID "Associated tracker ID
";
CM_ SG_ 96 ReSideRdrLeDetn59RdrDetnAzi "Refer to the data element description in ReSideRdrLeDetn1 with the same data element name";
CM_ SG_ 96 ReSideRdrLeDetn59RdrDetnChks "Refer to the data element description in ReSideRdrLeDetn1 with the same data element name";
CM_ SG_ 96 ReSideRdrLeDetn59RdrDetnCntr "Refer to the data element description in ReSideRdrLeDetn1 with the same data element name";
CM_ SG_ 96 ReSideRdrLeDetn59RdrDetnConf "Refer to the data element description in ReSideRdrLeDetn1 with the same data element name";
CM_ SG_ 96 ReSideRdrLeDetn59RdrDetnElevn "Refer to the data element description in ReSideRdrLeDetn1 with the same data element name";
CM_ SG_ 96 ReSideRdrLeDetn59RdrDetnPwr "Refer to the data element description in ReSideRdrLeDetn1 with the same data element name";
CM_ SG_ 96 ReSideRdrLeDetn59RdrDetnRng "Refer to the data element description in ReSideRdrLeDetn1 with the same data element name";
CM_ SG_ 96 ReSideRdrLeDetn59RdrDetnRngV "Range Velocity";
CM_ SG_ 96 ReSideRdrLeDetn59RdrDetnSameRV "object with same distance and speed";
CM_ SG_ 96 ReSideRdrLeDetn59RdrDetnSts "Refer to the data element description in ReSideRdrLeDetn1 with the same data element name";
CM_ SG_ 96 ReSideRdrLeDetn60RdrDetnAmbigState "Dection ambiguous status";
CM_ SG_ 96 ReSideRdrLeDetn60RdrDetnAssoTrkID "Associated tracker ID
";
CM_ SG_ 96 ReSideRdrLeDetn60RdrDetnAzi "Refer to the data element description in ReSideRdrLeDetn1 with the same data element name";
CM_ SG_ 96 ReSideRdrLeDetn60RdrDetnChks "Refer to the data element description in ReSideRdrLeDetn1 with the same data element name";
CM_ SG_ 96 ReSideRdrLeDetn60RdrDetnCntr "Refer to the data element description in ReSideRdrLeDetn1 with the same data element name";
CM_ SG_ 96 ReSideRdrLeDetn60RdrDetnConf "Refer to the data element description in ReSideRdrLeDetn1 with the same data element name";
CM_ SG_ 96 ReSideRdrLeDetn60RdrDetnElevn "Refer to the data element description in ReSideRdrLeDetn1 with the same data element name";
CM_ SG_ 96 ReSideRdrLeDetn60RdrDetnPwr "Refer to the data element description in ReSideRdrLeDetn1 with the same data element name";
CM_ SG_ 96 ReSideRdrLeDetn60RdrDetnRng "Refer to the data element description in ReSideRdrLeDetn1 with the same data element name";
CM_ SG_ 96 ReSideRdrLeDetn60RdrDetnRngV "Range Velocity";
CM_ SG_ 96 ReSideRdrLeDetn60RdrDetnSameRV "object with same distance and speed";
CM_ SG_ 96 ReSideRdrLeDetn60RdrDetnSts "Refer to the data element description in ReSideRdrLeDetn1 with the same data element name";
CM_ SG_ 97 ReSideRdrLeDetn61RdrDetnAmbigState "Dection ambiguous status";
CM_ SG_ 97 ReSideRdrLeDetn61RdrDetnAssoTrkID "Associated tracker ID
";
CM_ SG_ 97 ReSideRdrLeDetn61RdrDetnAzi "Refer to the data element description in ReSideRdrLeDetn1 with the same data element name";
CM_ SG_ 97 ReSideRdrLeDetn61RdrDetnChks "Refer to the data element description in ReSideRdrLeDetn1 with the same data element name";
CM_ SG_ 97 ReSideRdrLeDetn61RdrDetnCntr "Refer to the data element description in ReSideRdrLeDetn1 with the same data element name";
CM_ SG_ 97 ReSideRdrLeDetn61RdrDetnConf "Refer to the data element description in ReSideRdrLeDetn1 with the same data element name";
CM_ SG_ 97 ReSideRdrLeDetn61RdrDetnElevn "Refer to the data element description in ReSideRdrLeDetn1 with the same data element name";
CM_ SG_ 97 ReSideRdrLeDetn61RdrDetnPwr "Refer to the data element description in ReSideRdrLeDetn1 with the same data element name";
CM_ SG_ 97 ReSideRdrLeDetn61RdrDetnRng "Refer to the data element description in ReSideRdrLeDetn1 with the same data element name";
CM_ SG_ 97 ReSideRdrLeDetn61RdrDetnRngV "Range Velocity";
CM_ SG_ 97 ReSideRdrLeDetn61RdrDetnSameRV "object with same distance and speed";
CM_ SG_ 97 ReSideRdrLeDetn61RdrDetnSts "Refer to the data element description in ReSideRdrLeDetn1 with the same data element name";
CM_ SG_ 97 ReSideRdrLeDetn62RdrDetnAmbigState "Dection ambiguous status";
CM_ SG_ 97 ReSideRdrLeDetn62RdrDetnAssoTrkID "Associated tracker ID
";
CM_ SG_ 97 ReSideRdrLeDetn62RdrDetnAzi "Refer to the data element description in ReSideRdrLeDetn1 with the same data element name";
CM_ SG_ 97 ReSideRdrLeDetn62RdrDetnChks "Refer to the data element description in ReSideRdrLeDetn1 with the same data element name";
CM_ SG_ 97 ReSideRdrLeDetn62RdrDetnCntr "Refer to the data element description in ReSideRdrLeDetn1 with the same data element name";
CM_ SG_ 97 ReSideRdrLeDetn62RdrDetnConf "Refer to the data element description in ReSideRdrLeDetn1 with the same data element name";
CM_ SG_ 97 ReSideRdrLeDetn62RdrDetnElevn "Refer to the data element description in ReSideRdrLeDetn1 with the same data element name";
CM_ SG_ 97 ReSideRdrLeDetn62RdrDetnPwr "Refer to the data element description in ReSideRdrLeDetn1 with the same data element name";
CM_ SG_ 97 ReSideRdrLeDetn62RdrDetnRng "Refer to the data element description in ReSideRdrLeDetn1 with the same data element name";
CM_ SG_ 97 ReSideRdrLeDetn62RdrDetnRngV "Range Velocity";
CM_ SG_ 97 ReSideRdrLeDetn62RdrDetnSameRV "object with same distance and speed";
CM_ SG_ 97 ReSideRdrLeDetn62RdrDetnSts "Refer to the data element description in ReSideRdrLeDetn1 with the same data element name";
CM_ SG_ 97 ReSideRdrLeDetn63RdrDetnAmbigState "Dection ambiguous status";
CM_ SG_ 97 ReSideRdrLeDetn63RdrDetnAssoTrkID "Associated tracker ID
";
CM_ SG_ 97 ReSideRdrLeDetn63RdrDetnAzi "Refer to the data element description in ReSideRdrLeDetn1 with the same data element name";
CM_ SG_ 97 ReSideRdrLeDetn63RdrDetnChks "Refer to the data element description in ReSideRdrLeDetn1 with the same data element name";
CM_ SG_ 97 ReSideRdrLeDetn63RdrDetnCntr "Refer to the data element description in ReSideRdrLeDetn1 with the same data element name";
CM_ SG_ 97 ReSideRdrLeDetn63RdrDetnConf "Refer to the data element description in ReSideRdrLeDetn1 with the same data element name";
CM_ SG_ 97 ReSideRdrLeDetn63RdrDetnElevn "Refer to the data element description in ReSideRdrLeDetn1 with the same data element name";
CM_ SG_ 97 ReSideRdrLeDetn63RdrDetnPwr "Refer to the data element description in ReSideRdrLeDetn1 with the same data element name";
CM_ SG_ 97 ReSideRdrLeDetn63RdrDetnRng "Refer to the data element description in ReSideRdrLeDetn1 with the same data element name";
CM_ SG_ 97 ReSideRdrLeDetn63RdrDetnRngV "Range Velocity";
CM_ SG_ 97 ReSideRdrLeDetn63RdrDetnSameRV "object with same distance and speed";
CM_ SG_ 97 ReSideRdrLeDetn63RdrDetnSts "Refer to the data element description in ReSideRdrLeDetn1 with the same data element name";
CM_ SG_ 97 ReSideRdrLeDetn64RdrDetnAmbigState "Dection ambiguous status";
CM_ SG_ 97 ReSideRdrLeDetn64RdrDetnAssoTrkID "Associated tracker ID
";
CM_ SG_ 97 ReSideRdrLeDetn64RdrDetnAzi "Refer to the data element description in ReSideRdrLeDetn1 with the same data element name";
CM_ SG_ 97 ReSideRdrLeDetn64RdrDetnChks "Refer to the data element description in ReSideRdrLeDetn1 with the same data element name";
CM_ SG_ 97 ReSideRdrLeDetn64RdrDetnCntr "Refer to the data element description in ReSideRdrLeDetn1 with the same data element name";
CM_ SG_ 97 ReSideRdrLeDetn64RdrDetnConf "Refer to the data element description in ReSideRdrLeDetn1 with the same data element name";
CM_ SG_ 97 ReSideRdrLeDetn64RdrDetnElevn "Refer to the data element description in ReSideRdrLeDetn1 with the same data element name";
CM_ SG_ 97 ReSideRdrLeDetn64RdrDetnPwr "Refer to the data element description in ReSideRdrLeDetn1 with the same data element name";
CM_ SG_ 97 ReSideRdrLeDetn64RdrDetnRng "Refer to the data element description in ReSideRdrLeDetn1 with the same data element name";
CM_ SG_ 97 ReSideRdrLeDetn64RdrDetnRngV "Range Velocity";
CM_ SG_ 97 ReSideRdrLeDetn64RdrDetnSameRV "object with same distance and speed";
CM_ SG_ 97 ReSideRdrLeDetn64RdrDetnSts "Refer to the data element description in ReSideRdrLeDetn1 with the same data element name";
CM_ SG_ 97 ReSideRdrLeDetn65RdrDetnAmbigState "Dection ambiguous status";
CM_ SG_ 97 ReSideRdrLeDetn65RdrDetnAssoTrkID "Associated tracker ID
";
CM_ SG_ 97 ReSideRdrLeDetn65RdrDetnAzi "Refer to the data element description in ReSideRdrLeDetn1 with the same data element name";
CM_ SG_ 97 ReSideRdrLeDetn65RdrDetnChks "Refer to the data element description in ReSideRdrLeDetn1 with the same data element name";
CM_ SG_ 97 ReSideRdrLeDetn65RdrDetnCntr "Refer to the data element description in ReSideRdrLeDetn1 with the same data element name";
CM_ SG_ 97 ReSideRdrLeDetn65RdrDetnConf "Refer to the data element description in ReSideRdrLeDetn1 with the same data element name";
CM_ SG_ 97 ReSideRdrLeDetn65RdrDetnElevn "Refer to the data element description in ReSideRdrLeDetn1 with the same data element name";
CM_ SG_ 97 ReSideRdrLeDetn65RdrDetnPwr "Refer to the data element description in ReSideRdrLeDetn1 with the same data element name";
CM_ SG_ 97 ReSideRdrLeDetn65RdrDetnRng "Refer to the data element description in ReSideRdrLeDetn1 with the same data element name";
CM_ SG_ 97 ReSideRdrLeDetn65RdrDetnRngV "Range Velocity";
CM_ SG_ 97 ReSideRdrLeDetn65RdrDetnSameRV "object with same distance and speed";
CM_ SG_ 97 ReSideRdrLeDetn65RdrDetnSts "Refer to the data element description in ReSideRdrLeDetn1 with the same data element name";
CM_ SG_ 97 ReSideRdrLeDetn66RdrDetnAmbigState "Dection ambiguous status";
CM_ SG_ 97 ReSideRdrLeDetn66RdrDetnAssoTrkID "Associated tracker ID
";
CM_ SG_ 97 ReSideRdrLeDetn66RdrDetnAzi "Refer to the data element description in ReSideRdrLeDetn1 with the same data element name";
CM_ SG_ 97 ReSideRdrLeDetn66RdrDetnChks "Refer to the data element description in ReSideRdrLeDetn1 with the same data element name";
CM_ SG_ 97 ReSideRdrLeDetn66RdrDetnCntr "Refer to the data element description in ReSideRdrLeDetn1 with the same data element name";
CM_ SG_ 97 ReSideRdrLeDetn66RdrDetnConf "Refer to the data element description in ReSideRdrLeDetn1 with the same data element name";
CM_ SG_ 97 ReSideRdrLeDetn66RdrDetnElevn "Refer to the data element description in ReSideRdrLeDetn1 with the same data element name";
CM_ SG_ 97 ReSideRdrLeDetn66RdrDetnPwr "Refer to the data element description in ReSideRdrLeDetn1 with the same data element name";
CM_ SG_ 97 ReSideRdrLeDetn66RdrDetnRng "Refer to the data element description in ReSideRdrLeDetn1 with the same data element name";
CM_ SG_ 97 ReSideRdrLeDetn66RdrDetnRngV "Range Velocity";
CM_ SG_ 97 ReSideRdrLeDetn66RdrDetnSameRV "object with same distance and speed";
CM_ SG_ 97 ReSideRdrLeDetn66RdrDetnSts "Refer to the data element description in ReSideRdrLeDetn1 with the same data element name";
CM_ SG_ 98 ReSideRdrLeDetn67RdrDetnAmbigState "Dection ambiguous status";
CM_ SG_ 98 ReSideRdrLeDetn67RdrDetnAssoTrkID "Associated tracker ID
";
CM_ SG_ 98 ReSideRdrLeDetn67RdrDetnAzi "Refer to the data element description in ReSideRdrLeDetn1 with the same data element name";
CM_ SG_ 98 ReSideRdrLeDetn67RdrDetnChks "Refer to the data element description in ReSideRdrLeDetn1 with the same data element name";
CM_ SG_ 98 ReSideRdrLeDetn67RdrDetnCntr "Refer to the data element description in ReSideRdrLeDetn1 with the same data element name";
CM_ SG_ 98 ReSideRdrLeDetn67RdrDetnConf "Refer to the data element description in ReSideRdrLeDetn1 with the same data element name";
CM_ SG_ 98 ReSideRdrLeDetn67RdrDetnElevn "Refer to the data element description in ReSideRdrLeDetn1 with the same data element name";
CM_ SG_ 98 ReSideRdrLeDetn67RdrDetnPwr "Refer to the data element description in ReSideRdrLeDetn1 with the same data element name";
CM_ SG_ 98 ReSideRdrLeDetn67RdrDetnRng "Refer to the data element description in ReSideRdrLeDetn1 with the same data element name";
CM_ SG_ 98 ReSideRdrLeDetn67RdrDetnRngV "Range Velocity";
CM_ SG_ 98 ReSideRdrLeDetn67RdrDetnSameRV "object with same distance and speed";
CM_ SG_ 98 ReSideRdrLeDetn67RdrDetnSts "Refer to the data element description in ReSideRdrLeDetn1 with the same data element name";
CM_ SG_ 98 ReSideRdrLeDetn68RdrDetnAmbigState "Dection ambiguous status";
CM_ SG_ 98 ReSideRdrLeDetn68RdrDetnAssoTrkID "Associated tracker ID
";
CM_ SG_ 98 ReSideRdrLeDetn68RdrDetnAzi "Refer to the data element description in ReSideRdrLeDetn1 with the same data element name";
CM_ SG_ 98 ReSideRdrLeDetn68RdrDetnChks "Refer to the data element description in ReSideRdrLeDetn1 with the same data element name";
CM_ SG_ 98 ReSideRdrLeDetn68RdrDetnCntr "Refer to the data element description in ReSideRdrLeDetn1 with the same data element name";
CM_ SG_ 98 ReSideRdrLeDetn68RdrDetnConf "Refer to the data element description in ReSideRdrLeDetn1 with the same data element name";
CM_ SG_ 98 ReSideRdrLeDetn68RdrDetnElevn "Refer to the data element description in ReSideRdrLeDetn1 with the same data element name";
CM_ SG_ 98 ReSideRdrLeDetn68RdrDetnPwr "Refer to the data element description in ReSideRdrLeDetn1 with the same data element name";
CM_ SG_ 98 ReSideRdrLeDetn68RdrDetnRng "Refer to the data element description in ReSideRdrLeDetn1 with the same data element name";
CM_ SG_ 98 ReSideRdrLeDetn68RdrDetnRngV "Range Velocity";
CM_ SG_ 98 ReSideRdrLeDetn68RdrDetnSameRV "object with same distance and speed";
CM_ SG_ 98 ReSideRdrLeDetn68RdrDetnSts "Refer to the data element description in ReSideRdrLeDetn1 with the same data element name";
CM_ SG_ 98 ReSideRdrLeDetn69RdrDetnAmbigState "Dection ambiguous status";
CM_ SG_ 98 ReSideRdrLeDetn69RdrDetnAssoTrkID "Associated tracker ID
";
CM_ SG_ 98 ReSideRdrLeDetn69RdrDetnAzi "Refer to the data element description in ReSideRdrLeDetn1 with the same data element name";
CM_ SG_ 98 ReSideRdrLeDetn69RdrDetnChks "Refer to the data element description in ReSideRdrLeDetn1 with the same data element name";
CM_ SG_ 98 ReSideRdrLeDetn69RdrDetnCntr "Refer to the data element description in ReSideRdrLeDetn1 with the same data element name";
CM_ SG_ 98 ReSideRdrLeDetn69RdrDetnConf "Refer to the data element description in ReSideRdrLeDetn1 with the same data element name";
CM_ SG_ 98 ReSideRdrLeDetn69RdrDetnElevn "Refer to the data element description in ReSideRdrLeDetn1 with the same data element name";
CM_ SG_ 98 ReSideRdrLeDetn69RdrDetnPwr "Refer to the data element description in ReSideRdrLeDetn1 with the same data element name";
CM_ SG_ 98 ReSideRdrLeDetn69RdrDetnRng "Refer to the data element description in ReSideRdrLeDetn1 with the same data element name";
CM_ SG_ 98 ReSideRdrLeDetn69RdrDetnRngV "Range Velocity";
CM_ SG_ 98 ReSideRdrLeDetn69RdrDetnSameRV "object with same distance and speed";
CM_ SG_ 98 ReSideRdrLeDetn69RdrDetnSts "Refer to the data element description in ReSideRdrLeDetn1 with the same data element name";
CM_ SG_ 98 ReSideRdrLeDetn70RdrDetnAmbigState "Dection ambiguous status";
CM_ SG_ 98 ReSideRdrLeDetn70RdrDetnAssoTrkID "Associated tracker ID
";
CM_ SG_ 98 ReSideRdrLeDetn70RdrDetnAzi "Refer to the data element description in ReSideRdrLeDetn1 with the same data element name";
CM_ SG_ 98 ReSideRdrLeDetn70RdrDetnChks "Refer to the data element description in ReSideRdrLeDetn1 with the same data element name";
CM_ SG_ 98 ReSideRdrLeDetn70RdrDetnCntr "Refer to the data element description in ReSideRdrLeDetn1 with the same data element name";
CM_ SG_ 98 ReSideRdrLeDetn70RdrDetnConf "Refer to the data element description in ReSideRdrLeDetn1 with the same data element name";
CM_ SG_ 98 ReSideRdrLeDetn70RdrDetnElevn "Refer to the data element description in ReSideRdrLeDetn1 with the same data element name";
CM_ SG_ 98 ReSideRdrLeDetn70RdrDetnPwr "Refer to the data element description in ReSideRdrLeDetn1 with the same data element name";
CM_ SG_ 98 ReSideRdrLeDetn70RdrDetnRng "Refer to the data element description in ReSideRdrLeDetn1 with the same data element name";
CM_ SG_ 98 ReSideRdrLeDetn70RdrDetnRngV "Range Velocity";
CM_ SG_ 98 ReSideRdrLeDetn70RdrDetnSameRV "object with same distance and speed";
CM_ SG_ 98 ReSideRdrLeDetn70RdrDetnSts "Refer to the data element description in ReSideRdrLeDetn1 with the same data element name";
CM_ SG_ 98 ReSideRdrLeDetn71RdrDetnAmbigState "Dection ambiguous status";
CM_ SG_ 98 ReSideRdrLeDetn71RdrDetnAssoTrkID "Associated tracker ID
";
CM_ SG_ 98 ReSideRdrLeDetn71RdrDetnAzi "Refer to the data element description in ReSideRdrLeDetn1 with the same data element name";
CM_ SG_ 98 ReSideRdrLeDetn71RdrDetnChks "Refer to the data element description in ReSideRdrLeDetn1 with the same data element name";
CM_ SG_ 98 ReSideRdrLeDetn71RdrDetnCntr "Refer to the data element description in ReSideRdrLeDetn1 with the same data element name";
CM_ SG_ 98 ReSideRdrLeDetn71RdrDetnConf "Refer to the data element description in ReSideRdrLeDetn1 with the same data element name";
CM_ SG_ 98 ReSideRdrLeDetn71RdrDetnElevn "Refer to the data element description in ReSideRdrLeDetn1 with the same data element name";
CM_ SG_ 98 ReSideRdrLeDetn71RdrDetnPwr "Refer to the data element description in ReSideRdrLeDetn1 with the same data element name";
CM_ SG_ 98 ReSideRdrLeDetn71RdrDetnRng "Refer to the data element description in ReSideRdrLeDetn1 with the same data element name";
CM_ SG_ 98 ReSideRdrLeDetn71RdrDetnRngV "Range Velocity";
CM_ SG_ 98 ReSideRdrLeDetn71RdrDetnSameRV "object with same distance and speed";
CM_ SG_ 98 ReSideRdrLeDetn71RdrDetnSts "Refer to the data element description in ReSideRdrLeDetn1 with the same data element name";
CM_ SG_ 98 ReSideRdrLeDetn72RdrDetnAmbigState "Dection ambiguous status";
CM_ SG_ 98 ReSideRdrLeDetn72RdrDetnAssoTrkID "Associated tracker ID
";
CM_ SG_ 98 ReSideRdrLeDetn72RdrDetnAzi "Refer to the data element description in ReSideRdrLeDetn1 with the same data element name";
CM_ SG_ 98 ReSideRdrLeDetn72RdrDetnChks "Refer to the data element description in ReSideRdrLeDetn1 with the same data element name";
CM_ SG_ 98 ReSideRdrLeDetn72RdrDetnCntr "Refer to the data element description in ReSideRdrLeDetn1 with the same data element name";
CM_ SG_ 98 ReSideRdrLeDetn72RdrDetnConf "Refer to the data element description in ReSideRdrLeDetn1 with the same data element name";
CM_ SG_ 98 ReSideRdrLeDetn72RdrDetnElevn "Refer to the data element description in ReSideRdrLeDetn1 with the same data element name";
CM_ SG_ 98 ReSideRdrLeDetn72RdrDetnPwr "Refer to the data element description in ReSideRdrLeDetn1 with the same data element name";
CM_ SG_ 98 ReSideRdrLeDetn72RdrDetnRng "Refer to the data element description in ReSideRdrLeDetn1 with the same data element name";
CM_ SG_ 98 ReSideRdrLeDetn72RdrDetnRngV "Range Velocity";
CM_ SG_ 98 ReSideRdrLeDetn72RdrDetnSameRV "object with same distance and speed";
CM_ SG_ 98 ReSideRdrLeDetn72RdrDetnSts "Refer to the data element description in ReSideRdrLeDetn1 with the same data element name";
CM_ SG_ 99 ReSideRdrLeDetn73RdrDetnAmbigState "Dection ambiguous status";
CM_ SG_ 99 ReSideRdrLeDetn73RdrDetnAssoTrkID "Associated tracker ID
";
CM_ SG_ 99 ReSideRdrLeDetn73RdrDetnAzi "Refer to the data element description in ReSideRdrLeDetn1 with the same data element name";
CM_ SG_ 99 ReSideRdrLeDetn73RdrDetnChks "Refer to the data element description in ReSideRdrLeDetn1 with the same data element name";
CM_ SG_ 99 ReSideRdrLeDetn73RdrDetnCntr "Refer to the data element description in ReSideRdrLeDetn1 with the same data element name";
CM_ SG_ 99 ReSideRdrLeDetn73RdrDetnConf "Refer to the data element description in ReSideRdrLeDetn1 with the same data element name";
CM_ SG_ 99 ReSideRdrLeDetn73RdrDetnElevn "Refer to the data element description in ReSideRdrLeDetn1 with the same data element name";
CM_ SG_ 99 ReSideRdrLeDetn73RdrDetnPwr "Refer to the data element description in ReSideRdrLeDetn1 with the same data element name";
CM_ SG_ 99 ReSideRdrLeDetn73RdrDetnRng "Refer to the data element description in ReSideRdrLeDetn1 with the same data element name";
CM_ SG_ 99 ReSideRdrLeDetn73RdrDetnRngV "Range Velocity";
CM_ SG_ 99 ReSideRdrLeDetn73RdrDetnSameRV "object with same distance and speed";
CM_ SG_ 99 ReSideRdrLeDetn73RdrDetnSts "Refer to the data element description in ReSideRdrLeDetn1 with the same data element name";
CM_ SG_ 99 ReSideRdrLeDetn74RdrDetnAmbigState "Dection ambiguous status";
CM_ SG_ 99 ReSideRdrLeDetn74RdrDetnAssoTrkID "Associated tracker ID
";
CM_ SG_ 99 ReSideRdrLeDetn74RdrDetnAzi "Refer to the data element description in ReSideRdrLeDetn1 with the same data element name";
CM_ SG_ 99 ReSideRdrLeDetn74RdrDetnChks "Refer to the data element description in ReSideRdrLeDetn1 with the same data element name";
CM_ SG_ 99 ReSideRdrLeDetn74RdrDetnCntr "Refer to the data element description in ReSideRdrLeDetn1 with the same data element name";
CM_ SG_ 99 ReSideRdrLeDetn74RdrDetnConf "Refer to the data element description in ReSideRdrLeDetn1 with the same data element name";
CM_ SG_ 99 ReSideRdrLeDetn74RdrDetnElevn "Refer to the data element description in ReSideRdrLeDetn1 with the same data element name";
CM_ SG_ 99 ReSideRdrLeDetn74RdrDetnPwr "Refer to the data element description in ReSideRdrLeDetn1 with the same data element name";
CM_ SG_ 99 ReSideRdrLeDetn74RdrDetnRng "Refer to the data element description in ReSideRdrLeDetn1 with the same data element name";
CM_ SG_ 99 ReSideRdrLeDetn74RdrDetnRngV "Range Velocity";
CM_ SG_ 99 ReSideRdrLeDetn74RdrDetnSameRV "object with same distance and speed";
CM_ SG_ 99 ReSideRdrLeDetn74RdrDetnSts "Refer to the data element description in ReSideRdrLeDetn1 with the same data element name";
CM_ SG_ 99 ReSideRdrLeDetn75RdrDetnAmbigState "Dection ambiguous status";
CM_ SG_ 99 ReSideRdrLeDetn75RdrDetnAssoTrkID "Associated tracker ID
";
CM_ SG_ 99 ReSideRdrLeDetn75RdrDetnAzi "Refer to the data element description in ReSideRdrLeDetn1 with the same data element name";
CM_ SG_ 99 ReSideRdrLeDetn75RdrDetnChks "Refer to the data element description in ReSideRdrLeDetn1 with the same data element name";
CM_ SG_ 99 ReSideRdrLeDetn75RdrDetnCntr "Refer to the data element description in ReSideRdrLeDetn1 with the same data element name";
CM_ SG_ 99 ReSideRdrLeDetn75RdrDetnConf "Refer to the data element description in ReSideRdrLeDetn1 with the same data element name";
CM_ SG_ 99 ReSideRdrLeDetn75RdrDetnElevn "Refer to the data element description in ReSideRdrLeDetn1 with the same data element name";
CM_ SG_ 99 ReSideRdrLeDetn75RdrDetnPwr "Refer to the data element description in ReSideRdrLeDetn1 with the same data element name";
CM_ SG_ 99 ReSideRdrLeDetn75RdrDetnRng "Refer to the data element description in ReSideRdrLeDetn1 with the same data element name";
CM_ SG_ 99 ReSideRdrLeDetn75RdrDetnRngV "Range Velocity";
CM_ SG_ 99 ReSideRdrLeDetn75RdrDetnSameRV "object with same distance and speed";
CM_ SG_ 99 ReSideRdrLeDetn75RdrDetnSts "Refer to the data element description in ReSideRdrLeDetn1 with the same data element name";
CM_ SG_ 99 ReSideRdrLeDetn76RdrDetnAmbigState "Dection ambiguous status";
CM_ SG_ 99 ReSideRdrLeDetn76RdrDetnAssoTrkID "Associated tracker ID
";
CM_ SG_ 99 ReSideRdrLeDetn76RdrDetnAzi "Refer to the data element description in ReSideRdrLeDetn1 with the same data element name";
CM_ SG_ 99 ReSideRdrLeDetn76RdrDetnChks "Refer to the data element description in ReSideRdrLeDetn1 with the same data element name";
CM_ SG_ 99 ReSideRdrLeDetn76RdrDetnCntr "Refer to the data element description in ReSideRdrLeDetn1 with the same data element name";
CM_ SG_ 99 ReSideRdrLeDetn76RdrDetnConf "Refer to the data element description in ReSideRdrLeDetn1 with the same data element name";
CM_ SG_ 99 ReSideRdrLeDetn76RdrDetnElevn "Refer to the data element description in ReSideRdrLeDetn1 with the same data element name";
CM_ SG_ 99 ReSideRdrLeDetn76RdrDetnPwr "Refer to the data element description in ReSideRdrLeDetn1 with the same data element name";
CM_ SG_ 99 ReSideRdrLeDetn76RdrDetnRng "Refer to the data element description in ReSideRdrLeDetn1 with the same data element name";
CM_ SG_ 99 ReSideRdrLeDetn76RdrDetnRngV "Range Velocity";
CM_ SG_ 99 ReSideRdrLeDetn76RdrDetnSameRV "object with same distance and speed";
CM_ SG_ 99 ReSideRdrLeDetn76RdrDetnSts "Refer to the data element description in ReSideRdrLeDetn1 with the same data element name";
CM_ SG_ 99 ReSideRdrLeDetn77RdrDetnAmbigState "Dection ambiguous status";
CM_ SG_ 99 ReSideRdrLeDetn77RdrDetnAssoTrkID "Associated tracker ID
";
CM_ SG_ 99 ReSideRdrLeDetn77RdrDetnAzi "Refer to the data element description in ReSideRdrLeDetn1 with the same data element name";
CM_ SG_ 99 ReSideRdrLeDetn77RdrDetnChks "Refer to the data element description in ReSideRdrLeDetn1 with the same data element name";
CM_ SG_ 99 ReSideRdrLeDetn77RdrDetnCntr "Refer to the data element description in ReSideRdrLeDetn1 with the same data element name";
CM_ SG_ 99 ReSideRdrLeDetn77RdrDetnConf "Refer to the data element description in ReSideRdrLeDetn1 with the same data element name";
CM_ SG_ 99 ReSideRdrLeDetn77RdrDetnElevn "Refer to the data element description in ReSideRdrLeDetn1 with the same data element name";
CM_ SG_ 99 ReSideRdrLeDetn77RdrDetnPwr "Refer to the data element description in ReSideRdrLeDetn1 with the same data element name";
CM_ SG_ 99 ReSideRdrLeDetn77RdrDetnRng "Refer to the data element description in ReSideRdrLeDetn1 with the same data element name";
CM_ SG_ 99 ReSideRdrLeDetn77RdrDetnRngV "Range Velocity";
CM_ SG_ 99 ReSideRdrLeDetn77RdrDetnSameRV "object with same distance and speed";
CM_ SG_ 99 ReSideRdrLeDetn77RdrDetnSts "Refer to the data element description in ReSideRdrLeDetn1 with the same data element name";
CM_ SG_ 99 ReSideRdrLeDetn78RdrDetnAmbigState "Dection ambiguous status";
CM_ SG_ 99 ReSideRdrLeDetn78RdrDetnAssoTrkID "Associated tracker ID
";
CM_ SG_ 99 ReSideRdrLeDetn78RdrDetnAzi "Refer to the data element description in ReSideRdrLeDetn1 with the same data element name";
CM_ SG_ 99 ReSideRdrLeDetn78RdrDetnChks "Refer to the data element description in ReSideRdrLeDetn1 with the same data element name";
CM_ SG_ 99 ReSideRdrLeDetn78RdrDetnCntr "Refer to the data element description in ReSideRdrLeDetn1 with the same data element name";
CM_ SG_ 99 ReSideRdrLeDetn78RdrDetnConf "Refer to the data element description in ReSideRdrLeDetn1 with the same data element name";
CM_ SG_ 99 ReSideRdrLeDetn78RdrDetnElevn "Refer to the data element description in ReSideRdrLeDetn1 with the same data element name";
CM_ SG_ 99 ReSideRdrLeDetn78RdrDetnPwr "Refer to the data element description in ReSideRdrLeDetn1 with the same data element name";
CM_ SG_ 99 ReSideRdrLeDetn78RdrDetnRng "Refer to the data element description in ReSideRdrLeDetn1 with the same data element name";
CM_ SG_ 99 ReSideRdrLeDetn78RdrDetnRngV "Range Velocity";
CM_ SG_ 99 ReSideRdrLeDetn78RdrDetnSameRV "object with same distance and speed";
CM_ SG_ 99 ReSideRdrLeDetn78RdrDetnSts "Refer to the data element description in ReSideRdrLeDetn1 with the same data element name";
BA_DEF_ BO_ "CANFD_BRS" ENUM "0","1";
BA_DEF_ BO_ "GenMsgCycleTime" INT 0 65536; // [ms]
BA_DEF_ BO_ "GenMsgDelayTime" INT 0 65536; // [ms]
BA_DEF_ BO_ "GenMsgSendType" ENUM "cyclic", "spontaneous", "not-used", "not-used", "not-used", "cyclicAndSpontaneous", "not-used", "cyclicIfActive", "NoMsgSendType"; // [us]
BA_DEF_ BO_ "GenMsgStartDelayTime" INT 0 65536; // [ms]
BA_DEF_ BO_ "VFrameFormat" ENUM "StandardCAN","ExtendedCAN","reserved","J1939PG","reserved","reserved","reserved","reserved","reserved","reserved","reserved","reserved","reserved","reserved","StandardCAN_FD","ExtendedCAN_FD";
BA_DEF_ SG_ "GenSigSendType" ENUM "Cyclic","OnWrite","OnWriteWithRepetition","OnChange","OnChangeWithRepetition","IfActive","IfActiveWithRepetition","NoSigSendType";
BA_DEF_ SG_ "GenSigStartValue" HEX 0 80000000;
BA_DEF_ BO_ "GenMsgILSupport" ENUM "No","Yes";
BA_DEF_ BO_ "NmAsrMessage" ENUM "No","Yes";
BA_DEF_ SG_ "GenSigFuncType" ENUM "NoFunction","n/a","n/a","n/a","n/a","n/a","n/a","n/a","n/a","n/a","n/a","n/a","n/a","n/a","n/a","CHK","CNTR","n/a","n/a","n/a","CNTR_AR_01","CRC_AR_01_BOTH","CRC_AR_01_ALT","CRC_AR_01_LOW","CRC_AR_01_NIBBLE","CNTR_AR_04","CRC_AR_04A","CNTR_AR_05","CRC_AR_05";
BA_DEF_ SG_ "GenSigDataID" STRING;
BA_DEF_DEF_ "CANFD_BRS" "1";
BA_DEF_DEF_ "GenSigStartValue" 0;
BA_DEF_DEF_ "VFrameFormat" "J1939PG";
BA_DEF_DEF_ "GenSigSendType" "NoSigSendType";
BA_DEF_DEF_ "GenMsgCycleTime" 0;
BA_DEF_DEF_ "GenMsgDelayTime" 0;
BA_DEF_DEF_ "GenMsgStartDelayTime" 0;
BA_DEF_DEF_ "GenMsgSendType" "NoMsgSendType";
BA_DEF_DEF_ "GenMsgILSupport" "Yes";
BA_DEF_DEF_ "NmAsrMessage" "No";
BA_DEF_DEF_ "GenSigFuncType" "NoFunction";
BA_DEF_DEF_ "GenSigDataID" "";
// Frame: SODLPrivateCANFD5Fr40
BA_ "GenMsgCycleTime" BO_ 87 50 ;
BA_ "GenMsgSendType" BO_ 87 0;
BA_ "VFrameFormat" BO_ 87 14;
// Frame: SODLPrivateCANFD5Fr41
BA_ "GenMsgCycleTime" BO_ 88 50 ;
BA_ "GenMsgSendType" BO_ 88 0;
BA_ "VFrameFormat" BO_ 88 14;
// Frame: SODLPrivateCANFD5Fr42
BA_ "GenMsgCycleTime" BO_ 89 50 ;
BA_ "GenMsgSendType" BO_ 89 0;
BA_ "VFrameFormat" BO_ 89 14;
// Frame: SODLPrivateCANFD5Fr43
BA_ "GenMsgCycleTime" BO_ 96 50 ;
BA_ "GenMsgSendType" BO_ 96 0;
BA_ "VFrameFormat" BO_ 96 14;
// Frame: SODLPrivateCANFD5Fr44
BA_ "GenMsgCycleTime" BO_ 97 50 ;
BA_ "GenMsgSendType" BO_ 97 0;
BA_ "VFrameFormat" BO_ 97 14;
// Frame: SODLPrivateCANFD5Fr45
BA_ "GenMsgCycleTime" BO_ 98 50 ;
BA_ "GenMsgSendType" BO_ 98 0;
BA_ "VFrameFormat" BO_ 98 14;
// Frame: SODLPrivateCANFD5Fr46
BA_ "GenMsgCycleTime" BO_ 99 50 ;
BA_ "GenMsgSendType" BO_ 99 0;
BA_ "VFrameFormat" BO_ 99 14;
BA_ "GenSigSendType" SG_ 87 ReSideRdrLeDetn37RdrDetnAmbigState 0;
BA_ "GenSigSendType" SG_ 87 ReSideRdrLeDetn37RdrDetnAssoTrkID 0;
BA_ "GenSigSendType" SG_ 87 ReSideRdrLeDetn37RdrDetnAzi 0;
BA_ "GenSigStartValue" SG_ 87 ReSideRdrLeDetn37RdrDetnAzi 900;
BA_ "GenSigDataID" SG_ 87 ReSideRdrLeDetn37RdrDetnChks "0x9B6";
BA_ "GenSigFuncType" SG_ 87 ReSideRdrLeDetn37RdrDetnChks 15;
BA_ "GenSigSendType" SG_ 87 ReSideRdrLeDetn37RdrDetnChks 0;
BA_ "GenSigFuncType" SG_ 87 ReSideRdrLeDetn37RdrDetnCntr 16;
BA_ "GenSigSendType" SG_ 87 ReSideRdrLeDetn37RdrDetnCntr 0;
BA_ "GenSigSendType" SG_ 87 ReSideRdrLeDetn37RdrDetnConf 0;
BA_ "GenSigSendType" SG_ 87 ReSideRdrLeDetn37RdrDetnElevn 0;
BA_ "GenSigStartValue" SG_ 87 ReSideRdrLeDetn37RdrDetnElevn 15;
BA_ "GenSigSendType" SG_ 87 ReSideRdrLeDetn37RdrDetnPwr 0;
BA_ "GenSigSendType" SG_ 87 ReSideRdrLeDetn37RdrDetnRng 0;
BA_ "GenSigStartValue" SG_ 87 ReSideRdrLeDetn37RdrDetnRng 10050;
BA_ "GenSigSendType" SG_ 87 ReSideRdrLeDetn37RdrDetnRngV 0;
BA_ "GenSigStartValue" SG_ 87 ReSideRdrLeDetn37RdrDetnRngV 4000;
BA_ "GenSigSendType" SG_ 87 ReSideRdrLeDetn37RdrDetnSameRV 0;
BA_ "GenSigSendType" SG_ 87 ReSideRdrLeDetn37RdrDetnSts 0;
BA_ "GenSigStartValue" SG_ 87 ReSideRdrLeDetn37RdrDetnSts 3;
BA_ "GenSigSendType" SG_ 87 ReSideRdrLeDetn38RdrDetnAmbigState 0;
BA_ "GenSigSendType" SG_ 87 ReSideRdrLeDetn38RdrDetnAssoTrkID 0;
BA_ "GenSigSendType" SG_ 87 ReSideRdrLeDetn38RdrDetnAzi 0;
BA_ "GenSigStartValue" SG_ 87 ReSideRdrLeDetn38RdrDetnAzi 900;
BA_ "GenSigDataID" SG_ 87 ReSideRdrLeDetn38RdrDetnChks "0x9B7";
BA_ "GenSigFuncType" SG_ 87 ReSideRdrLeDetn38RdrDetnChks 15;
BA_ "GenSigSendType" SG_ 87 ReSideRdrLeDetn38RdrDetnChks 0;
BA_ "GenSigFuncType" SG_ 87 ReSideRdrLeDetn38RdrDetnCntr 16;
BA_ "GenSigSendType" SG_ 87 ReSideRdrLeDetn38RdrDetnCntr 0;
BA_ "GenSigSendType" SG_ 87 ReSideRdrLeDetn38RdrDetnConf 0;
BA_ "GenSigSendType" SG_ 87 ReSideRdrLeDetn38RdrDetnElevn 0;
BA_ "GenSigStartValue" SG_ 87 ReSideRdrLeDetn38RdrDetnElevn 15;
BA_ "GenSigSendType" SG_ 87 ReSideRdrLeDetn38RdrDetnPwr 0;
BA_ "GenSigSendType" SG_ 87 ReSideRdrLeDetn38RdrDetnRng 0;
BA_ "GenSigStartValue" SG_ 87 ReSideRdrLeDetn38RdrDetnRng 10050;
BA_ "GenSigSendType" SG_ 87 ReSideRdrLeDetn38RdrDetnRngV 0;
BA_ "GenSigStartValue" SG_ 87 ReSideRdrLeDetn38RdrDetnRngV 4000;
BA_ "GenSigSendType" SG_ 87 ReSideRdrLeDetn38RdrDetnSameRV 0;
BA_ "GenSigSendType" SG_ 87 ReSideRdrLeDetn38RdrDetnSts 0;
BA_ "GenSigStartValue" SG_ 87 ReSideRdrLeDetn38RdrDetnSts 3;
BA_ "GenSigSendType" SG_ 87 ReSideRdrLeDetn39RdrDetnAmbigState 0;
BA_ "GenSigSendType" SG_ 87 ReSideRdrLeDetn39RdrDetnAssoTrkID 0;
BA_ "GenSigSendType" SG_ 87 ReSideRdrLeDetn39RdrDetnAzi 0;
BA_ "GenSigStartValue" SG_ 87 ReSideRdrLeDetn39RdrDetnAzi 900;
BA_ "GenSigDataID" SG_ 87 ReSideRdrLeDetn39RdrDetnChks "0x9B8";
BA_ "GenSigFuncType" SG_ 87 ReSideRdrLeDetn39RdrDetnChks 15;
BA_ "GenSigSendType" SG_ 87 ReSideRdrLeDetn39RdrDetnChks 0;
BA_ "GenSigFuncType" SG_ 87 ReSideRdrLeDetn39RdrDetnCntr 16;
BA_ "GenSigSendType" SG_ 87 ReSideRdrLeDetn39RdrDetnCntr 0;
BA_ "GenSigSendType" SG_ 87 ReSideRdrLeDetn39RdrDetnConf 0;
BA_ "GenSigSendType" SG_ 87 ReSideRdrLeDetn39RdrDetnElevn 0;
BA_ "GenSigStartValue" SG_ 87 ReSideRdrLeDetn39RdrDetnElevn 15;
BA_ "GenSigSendType" SG_ 87 ReSideRdrLeDetn39RdrDetnPwr 0;
BA_ "GenSigSendType" SG_ 87 ReSideRdrLeDetn39RdrDetnRng 0;
BA_ "GenSigStartValue" SG_ 87 ReSideRdrLeDetn39RdrDetnRng 10050;
BA_ "GenSigSendType" SG_ 87 ReSideRdrLeDetn39RdrDetnRngV 0;
BA_ "GenSigStartValue" SG_ 87 ReSideRdrLeDetn39RdrDetnRngV 4000;
BA_ "GenSigSendType" SG_ 87 ReSideRdrLeDetn39RdrDetnSameRV 0;
BA_ "GenSigSendType" SG_ 87 ReSideRdrLeDetn39RdrDetnSts 0;
BA_ "GenSigStartValue" SG_ 87 ReSideRdrLeDetn39RdrDetnSts 3;
BA_ "GenSigSendType" SG_ 87 ReSideRdrLeDetn40RdrDetnAmbigState 0;
BA_ "GenSigSendType" SG_ 87 ReSideRdrLeDetn40RdrDetnAssoTrkID 0;
BA_ "GenSigSendType" SG_ 87 ReSideRdrLeDetn40RdrDetnAzi 0;
BA_ "GenSigStartValue" SG_ 87 ReSideRdrLeDetn40RdrDetnAzi 900;
BA_ "GenSigDataID" SG_ 87 ReSideRdrLeDetn40RdrDetnChks "0x9B9";
BA_ "GenSigFuncType" SG_ 87 ReSideRdrLeDetn40RdrDetnChks 15;
BA_ "GenSigSendType" SG_ 87 ReSideRdrLeDetn40RdrDetnChks 0;
BA_ "GenSigFuncType" SG_ 87 ReSideRdrLeDetn40RdrDetnCntr 16;
BA_ "GenSigSendType" SG_ 87 ReSideRdrLeDetn40RdrDetnCntr 0;
BA_ "GenSigSendType" SG_ 87 ReSideRdrLeDetn40RdrDetnConf 0;
BA_ "GenSigSendType" SG_ 87 ReSideRdrLeDetn40RdrDetnElevn 0;
BA_ "GenSigStartValue" SG_ 87 ReSideRdrLeDetn40RdrDetnElevn 15;
BA_ "GenSigSendType" SG_ 87 ReSideRdrLeDetn40RdrDetnPwr 0;
BA_ "GenSigSendType" SG_ 87 ReSideRdrLeDetn40RdrDetnRng 0;
BA_ "GenSigStartValue" SG_ 87 ReSideRdrLeDetn40RdrDetnRng 10050;
BA_ "GenSigSendType" SG_ 87 ReSideRdrLeDetn40RdrDetnRngV 0;
BA_ "GenSigStartValue" SG_ 87 ReSideRdrLeDetn40RdrDetnRngV 4000;
BA_ "GenSigSendType" SG_ 87 ReSideRdrLeDetn40RdrDetnSameRV 0;
BA_ "GenSigSendType" SG_ 87 ReSideRdrLeDetn40RdrDetnSts 0;
BA_ "GenSigStartValue" SG_ 87 ReSideRdrLeDetn40RdrDetnSts 3;
BA_ "GenSigSendType" SG_ 87 ReSideRdrLeDetn41RdrDetnAmbigState 0;
BA_ "GenSigSendType" SG_ 87 ReSideRdrLeDetn41RdrDetnAssoTrkID 0;
BA_ "GenSigSendType" SG_ 87 ReSideRdrLeDetn41RdrDetnAzi 0;
BA_ "GenSigStartValue" SG_ 87 ReSideRdrLeDetn41RdrDetnAzi 900;
BA_ "GenSigDataID" SG_ 87 ReSideRdrLeDetn41RdrDetnChks "0x9BA";
BA_ "GenSigFuncType" SG_ 87 ReSideRdrLeDetn41RdrDetnChks 15;
BA_ "GenSigSendType" SG_ 87 ReSideRdrLeDetn41RdrDetnChks 0;
BA_ "GenSigFuncType" SG_ 87 ReSideRdrLeDetn41RdrDetnCntr 16;
BA_ "GenSigSendType" SG_ 87 ReSideRdrLeDetn41RdrDetnCntr 0;
BA_ "GenSigSendType" SG_ 87 ReSideRdrLeDetn41RdrDetnConf 0;
BA_ "GenSigSendType" SG_ 87 ReSideRdrLeDetn41RdrDetnElevn 0;
BA_ "GenSigStartValue" SG_ 87 ReSideRdrLeDetn41RdrDetnElevn 15;
BA_ "GenSigSendType" SG_ 87 ReSideRdrLeDetn41RdrDetnPwr 0;
BA_ "GenSigSendType" SG_ 87 ReSideRdrLeDetn41RdrDetnRng 0;
BA_ "GenSigStartValue" SG_ 87 ReSideRdrLeDetn41RdrDetnRng 10050;
BA_ "GenSigSendType" SG_ 87 ReSideRdrLeDetn41RdrDetnRngV 0;
BA_ "GenSigStartValue" SG_ 87 ReSideRdrLeDetn41RdrDetnRngV 4000;
BA_ "GenSigSendType" SG_ 87 ReSideRdrLeDetn41RdrDetnSameRV 0;
BA_ "GenSigSendType" SG_ 87 ReSideRdrLeDetn41RdrDetnSts 0;
BA_ "GenSigStartValue" SG_ 87 ReSideRdrLeDetn41RdrDetnSts 3;
BA_ "GenSigSendType" SG_ 87 ReSideRdrLeDetn42RdrDetnAmbigState 0;
BA_ "GenSigSendType" SG_ 87 ReSideRdrLeDetn42RdrDetnAssoTrkID 0;
BA_ "GenSigSendType" SG_ 87 ReSideRdrLeDetn42RdrDetnAzi 0;
BA_ "GenSigStartValue" SG_ 87 ReSideRdrLeDetn42RdrDetnAzi 900;
BA_ "GenSigDataID" SG_ 87 ReSideRdrLeDetn42RdrDetnChks "0x9BB";
BA_ "GenSigFuncType" SG_ 87 ReSideRdrLeDetn42RdrDetnChks 15;
BA_ "GenSigSendType" SG_ 87 ReSideRdrLeDetn42RdrDetnChks 0;
BA_ "GenSigFuncType" SG_ 87 ReSideRdrLeDetn42RdrDetnCntr 16;
BA_ "GenSigSendType" SG_ 87 ReSideRdrLeDetn42RdrDetnCntr 0;
BA_ "GenSigSendType" SG_ 87 ReSideRdrLeDetn42RdrDetnConf 0;
BA_ "GenSigSendType" SG_ 87 ReSideRdrLeDetn42RdrDetnElevn 0;
BA_ "GenSigStartValue" SG_ 87 ReSideRdrLeDetn42RdrDetnElevn 15;
BA_ "GenSigSendType" SG_ 87 ReSideRdrLeDetn42RdrDetnPwr 0;
BA_ "GenSigSendType" SG_ 87 ReSideRdrLeDetn42RdrDetnRng 0;
BA_ "GenSigStartValue" SG_ 87 ReSideRdrLeDetn42RdrDetnRng 10050;
BA_ "GenSigSendType" SG_ 87 ReSideRdrLeDetn42RdrDetnRngV 0;
BA_ "GenSigStartValue" SG_ 87 ReSideRdrLeDetn42RdrDetnRngV 4000;
BA_ "GenSigSendType" SG_ 87 ReSideRdrLeDetn42RdrDetnSameRV 0;
BA_ "GenSigSendType" SG_ 87 ReSideRdrLeDetn42RdrDetnSts 0;
BA_ "GenSigStartValue" SG_ 87 ReSideRdrLeDetn42RdrDetnSts 3;
BA_ "GenSigSendType" SG_ 88 ReSideRdrLeDetn43RdrDetnAmbigState 0;
BA_ "GenSigSendType" SG_ 88 ReSideRdrLeDetn43RdrDetnAssoTrkID 0;
BA_ "GenSigSendType" SG_ 88 ReSideRdrLeDetn43RdrDetnAzi 0;
BA_ "GenSigStartValue" SG_ 88 ReSideRdrLeDetn43RdrDetnAzi 900;
BA_ "GenSigDataID" SG_ 88 ReSideRdrLeDetn43RdrDetnChks "0x9BC";
BA_ "GenSigFuncType" SG_ 88 ReSideRdrLeDetn43RdrDetnChks 15;
BA_ "GenSigSendType" SG_ 88 ReSideRdrLeDetn43RdrDetnChks 0;
BA_ "GenSigFuncType" SG_ 88 ReSideRdrLeDetn43RdrDetnCntr 16;
BA_ "GenSigSendType" SG_ 88 ReSideRdrLeDetn43RdrDetnCntr 0;
BA_ "GenSigSendType" SG_ 88 ReSideRdrLeDetn43RdrDetnConf 0;
BA_ "GenSigSendType" SG_ 88 ReSideRdrLeDetn43RdrDetnElevn 0;
BA_ "GenSigStartValue" SG_ 88 ReSideRdrLeDetn43RdrDetnElevn 15;
BA_ "GenSigSendType" SG_ 88 ReSideRdrLeDetn43RdrDetnPwr 0;
BA_ "GenSigSendType" SG_ 88 ReSideRdrLeDetn43RdrDetnRng 0;
BA_ "GenSigStartValue" SG_ 88 ReSideRdrLeDetn43RdrDetnRng 10050;
BA_ "GenSigSendType" SG_ 88 ReSideRdrLeDetn43RdrDetnRngV 0;
BA_ "GenSigStartValue" SG_ 88 ReSideRdrLeDetn43RdrDetnRngV 4000;
BA_ "GenSigSendType" SG_ 88 ReSideRdrLeDetn43RdrDetnSameRV 0;
BA_ "GenSigSendType" SG_ 88 ReSideRdrLeDetn43RdrDetnSts 0;
BA_ "GenSigStartValue" SG_ 88 ReSideRdrLeDetn43RdrDetnSts 3;
BA_ "GenSigSendType" SG_ 88 ReSideRdrLeDetn44RdrDetnAmbigState 0;
BA_ "GenSigSendType" SG_ 88 ReSideRdrLeDetn44RdrDetnAssoTrkID 0;
BA_ "GenSigSendType" SG_ 88 ReSideRdrLeDetn44RdrDetnAzi 0;
BA_ "GenSigStartValue" SG_ 88 ReSideRdrLeDetn44RdrDetnAzi 900;
BA_ "GenSigDataID" SG_ 88 ReSideRdrLeDetn44RdrDetnChks "0x9BD";
BA_ "GenSigFuncType" SG_ 88 ReSideRdrLeDetn44RdrDetnChks 15;
BA_ "GenSigSendType" SG_ 88 ReSideRdrLeDetn44RdrDetnChks 0;
BA_ "GenSigFuncType" SG_ 88 ReSideRdrLeDetn44RdrDetnCntr 16;
BA_ "GenSigSendType" SG_ 88 ReSideRdrLeDetn44RdrDetnCntr 0;
BA_ "GenSigSendType" SG_ 88 ReSideRdrLeDetn44RdrDetnConf 0;
BA_ "GenSigSendType" SG_ 88 ReSideRdrLeDetn44RdrDetnElevn 0;
BA_ "GenSigStartValue" SG_ 88 ReSideRdrLeDetn44RdrDetnElevn 15;
BA_ "GenSigSendType" SG_ 88 ReSideRdrLeDetn44RdrDetnPwr 0;
BA_ "GenSigSendType" SG_ 88 ReSideRdrLeDetn44RdrDetnRng 0;
BA_ "GenSigStartValue" SG_ 88 ReSideRdrLeDetn44RdrDetnRng 10050;
BA_ "GenSigSendType" SG_ 88 ReSideRdrLeDetn44RdrDetnRngV 0;
BA_ "GenSigStartValue" SG_ 88 ReSideRdrLeDetn44RdrDetnRngV 4000;
BA_ "GenSigSendType" SG_ 88 ReSideRdrLeDetn44RdrDetnSameRV 0;
BA_ "GenSigSendType" SG_ 88 ReSideRdrLeDetn44RdrDetnSts 0;
BA_ "GenSigStartValue" SG_ 88 ReSideRdrLeDetn44RdrDetnSts 3;
BA_ "GenSigSendType" SG_ 88 ReSideRdrLeDetn45RdrDetnAmbigState 0;
BA_ "GenSigSendType" SG_ 88 ReSideRdrLeDetn45RdrDetnAssoTrkID 0;
BA_ "GenSigSendType" SG_ 88 ReSideRdrLeDetn45RdrDetnAzi 0;
BA_ "GenSigStartValue" SG_ 88 ReSideRdrLeDetn45RdrDetnAzi 900;
BA_ "GenSigDataID" SG_ 88 ReSideRdrLeDetn45RdrDetnChks "0x9BE";
BA_ "GenSigFuncType" SG_ 88 ReSideRdrLeDetn45RdrDetnChks 15;
BA_ "GenSigSendType" SG_ 88 ReSideRdrLeDetn45RdrDetnChks 0;
BA_ "GenSigFuncType" SG_ 88 ReSideRdrLeDetn45RdrDetnCntr 16;
BA_ "GenSigSendType" SG_ 88 ReSideRdrLeDetn45RdrDetnCntr 0;
BA_ "GenSigSendType" SG_ 88 ReSideRdrLeDetn45RdrDetnConf 0;
BA_ "GenSigSendType" SG_ 88 ReSideRdrLeDetn45RdrDetnElevn 0;
BA_ "GenSigStartValue" SG_ 88 ReSideRdrLeDetn45RdrDetnElevn 15;
BA_ "GenSigSendType" SG_ 88 ReSideRdrLeDetn45RdrDetnPwr 0;
BA_ "GenSigSendType" SG_ 88 ReSideRdrLeDetn45RdrDetnRng 0;
BA_ "GenSigStartValue" SG_ 88 ReSideRdrLeDetn45RdrDetnRng 10050;
BA_ "GenSigSendType" SG_ 88 ReSideRdrLeDetn45RdrDetnRngV 0;
BA_ "GenSigStartValue" SG_ 88 ReSideRdrLeDetn45RdrDetnRngV 4000;
BA_ "GenSigSendType" SG_ 88 ReSideRdrLeDetn45RdrDetnSameRV 0;
BA_ "GenSigSendType" SG_ 88 ReSideRdrLeDetn45RdrDetnSts 0;
BA_ "GenSigStartValue" SG_ 88 ReSideRdrLeDetn45RdrDetnSts 3;
BA_ "GenSigSendType" SG_ 88 ReSideRdrLeDetn46RdrDetnAmbigState 0;
BA_ "GenSigSendType" SG_ 88 ReSideRdrLeDetn46RdrDetnAssoTrkID 0;
BA_ "GenSigSendType" SG_ 88 ReSideRdrLeDetn46RdrDetnAzi 0;
BA_ "GenSigStartValue" SG_ 88 ReSideRdrLeDetn46RdrDetnAzi 900;
BA_ "GenSigDataID" SG_ 88 ReSideRdrLeDetn46RdrDetnChks "0x9BF";
BA_ "GenSigFuncType" SG_ 88 ReSideRdrLeDetn46RdrDetnChks 15;
BA_ "GenSigSendType" SG_ 88 ReSideRdrLeDetn46RdrDetnChks 0;
BA_ "GenSigFuncType" SG_ 88 ReSideRdrLeDetn46RdrDetnCntr 16;
BA_ "GenSigSendType" SG_ 88 ReSideRdrLeDetn46RdrDetnCntr 0;
BA_ "GenSigSendType" SG_ 88 ReSideRdrLeDetn46RdrDetnConf 0;
BA_ "GenSigSendType" SG_ 88 ReSideRdrLeDetn46RdrDetnElevn 0;
BA_ "GenSigStartValue" SG_ 88 ReSideRdrLeDetn46RdrDetnElevn 15;
BA_ "GenSigSendType" SG_ 88 ReSideRdrLeDetn46RdrDetnPwr 0;
BA_ "GenSigSendType" SG_ 88 ReSideRdrLeDetn46RdrDetnRng 0;
BA_ "GenSigStartValue" SG_ 88 ReSideRdrLeDetn46RdrDetnRng 10050;
BA_ "GenSigSendType" SG_ 88 ReSideRdrLeDetn46RdrDetnRngV 0;
BA_ "GenSigStartValue" SG_ 88 ReSideRdrLeDetn46RdrDetnRngV 4000;
BA_ "GenSigSendType" SG_ 88 ReSideRdrLeDetn46RdrDetnSameRV 0;
BA_ "GenSigSendType" SG_ 88 ReSideRdrLeDetn46RdrDetnSts 0;
BA_ "GenSigStartValue" SG_ 88 ReSideRdrLeDetn46RdrDetnSts 3;
BA_ "GenSigSendType" SG_ 88 ReSideRdrLeDetn47RdrDetnAmbigState 0;
BA_ "GenSigSendType" SG_ 88 ReSideRdrLeDetn47RdrDetnAssoTrkID 0;
BA_ "GenSigSendType" SG_ 88 ReSideRdrLeDetn47RdrDetnAzi 0;
BA_ "GenSigStartValue" SG_ 88 ReSideRdrLeDetn47RdrDetnAzi 900;
BA_ "GenSigDataID" SG_ 88 ReSideRdrLeDetn47RdrDetnChks "0x9C0";
BA_ "GenSigFuncType" SG_ 88 ReSideRdrLeDetn47RdrDetnChks 15;
BA_ "GenSigSendType" SG_ 88 ReSideRdrLeDetn47RdrDetnChks 0;
BA_ "GenSigFuncType" SG_ 88 ReSideRdrLeDetn47RdrDetnCntr 16;
BA_ "GenSigSendType" SG_ 88 ReSideRdrLeDetn47RdrDetnCntr 0;
BA_ "GenSigSendType" SG_ 88 ReSideRdrLeDetn47RdrDetnConf 0;
BA_ "GenSigSendType" SG_ 88 ReSideRdrLeDetn47RdrDetnElevn 0;
BA_ "GenSigStartValue" SG_ 88 ReSideRdrLeDetn47RdrDetnElevn 15;
BA_ "GenSigSendType" SG_ 88 ReSideRdrLeDetn47RdrDetnPwr 0;
BA_ "GenSigSendType" SG_ 88 ReSideRdrLeDetn47RdrDetnRng 0;
BA_ "GenSigStartValue" SG_ 88 ReSideRdrLeDetn47RdrDetnRng 10050;
BA_ "GenSigSendType" SG_ 88 ReSideRdrLeDetn47RdrDetnRngV 0;
BA_ "GenSigStartValue" SG_ 88 ReSideRdrLeDetn47RdrDetnRngV 4000;
BA_ "GenSigSendType" SG_ 88 ReSideRdrLeDetn47RdrDetnSameRV 0;
BA_ "GenSigSendType" SG_ 88 ReSideRdrLeDetn47RdrDetnSts 0;
BA_ "GenSigStartValue" SG_ 88 ReSideRdrLeDetn47RdrDetnSts 3;
BA_ "GenSigSendType" SG_ 88 ReSideRdrLeDetn48RdrDetnAmbigState 0;
BA_ "GenSigSendType" SG_ 88 ReSideRdrLeDetn48RdrDetnAssoTrkID 0;
BA_ "GenSigSendType" SG_ 88 ReSideRdrLeDetn48RdrDetnAzi 0;
BA_ "GenSigStartValue" SG_ 88 ReSideRdrLeDetn48RdrDetnAzi 900;
BA_ "GenSigDataID" SG_ 88 ReSideRdrLeDetn48RdrDetnChks "0x9C1";
BA_ "GenSigFuncType" SG_ 88 ReSideRdrLeDetn48RdrDetnChks 15;
BA_ "GenSigSendType" SG_ 88 ReSideRdrLeDetn48RdrDetnChks 0;
BA_ "GenSigFuncType" SG_ 88 ReSideRdrLeDetn48RdrDetnCntr 16;
BA_ "GenSigSendType" SG_ 88 ReSideRdrLeDetn48RdrDetnCntr 0;
BA_ "GenSigSendType" SG_ 88 ReSideRdrLeDetn48RdrDetnConf 0;
BA_ "GenSigSendType" SG_ 88 ReSideRdrLeDetn48RdrDetnElevn 0;
BA_ "GenSigStartValue" SG_ 88 ReSideRdrLeDetn48RdrDetnElevn 15;
BA_ "GenSigSendType" SG_ 88 ReSideRdrLeDetn48RdrDetnPwr 0;
BA_ "GenSigSendType" SG_ 88 ReSideRdrLeDetn48RdrDetnRng 0;
BA_ "GenSigStartValue" SG_ 88 ReSideRdrLeDetn48RdrDetnRng 10050;
BA_ "GenSigSendType" SG_ 88 ReSideRdrLeDetn48RdrDetnRngV 0;
BA_ "GenSigStartValue" SG_ 88 ReSideRdrLeDetn48RdrDetnRngV 4000;
BA_ "GenSigSendType" SG_ 88 ReSideRdrLeDetn48RdrDetnSameRV 0;
BA_ "GenSigSendType" SG_ 88 ReSideRdrLeDetn48RdrDetnSts 0;
BA_ "GenSigStartValue" SG_ 88 ReSideRdrLeDetn48RdrDetnSts 3;
BA_ "GenSigSendType" SG_ 89 ReSideRdrLeDetn49RdrDetnAmbigState 0;
BA_ "GenSigSendType" SG_ 89 ReSideRdrLeDetn49RdrDetnAssoTrkID 0;
BA_ "GenSigSendType" SG_ 89 ReSideRdrLeDetn49RdrDetnAzi 0;
BA_ "GenSigStartValue" SG_ 89 ReSideRdrLeDetn49RdrDetnAzi 900;
BA_ "GenSigDataID" SG_ 89 ReSideRdrLeDetn49RdrDetnChks "0x9C2";
BA_ "GenSigFuncType" SG_ 89 ReSideRdrLeDetn49RdrDetnChks 15;
BA_ "GenSigSendType" SG_ 89 ReSideRdrLeDetn49RdrDetnChks 0;
BA_ "GenSigFuncType" SG_ 89 ReSideRdrLeDetn49RdrDetnCntr 16;
BA_ "GenSigSendType" SG_ 89 ReSideRdrLeDetn49RdrDetnCntr 0;
BA_ "GenSigSendType" SG_ 89 ReSideRdrLeDetn49RdrDetnConf 0;
BA_ "GenSigSendType" SG_ 89 ReSideRdrLeDetn49RdrDetnElevn 0;
BA_ "GenSigStartValue" SG_ 89 ReSideRdrLeDetn49RdrDetnElevn 15;
BA_ "GenSigSendType" SG_ 89 ReSideRdrLeDetn49RdrDetnPwr 0;
BA_ "GenSigSendType" SG_ 89 ReSideRdrLeDetn49RdrDetnRng 0;
BA_ "GenSigStartValue" SG_ 89 ReSideRdrLeDetn49RdrDetnRng 10050;
BA_ "GenSigSendType" SG_ 89 ReSideRdrLeDetn49RdrDetnRngV 0;
BA_ "GenSigStartValue" SG_ 89 ReSideRdrLeDetn49RdrDetnRngV 4000;
BA_ "GenSigSendType" SG_ 89 ReSideRdrLeDetn49RdrDetnSameRV 0;
BA_ "GenSigSendType" SG_ 89 ReSideRdrLeDetn49RdrDetnSts 0;
BA_ "GenSigStartValue" SG_ 89 ReSideRdrLeDetn49RdrDetnSts 3;
BA_ "GenSigSendType" SG_ 89 ReSideRdrLeDetn50RdrDetnAmbigState 0;
BA_ "GenSigSendType" SG_ 89 ReSideRdrLeDetn50RdrDetnAssoTrkID 0;
BA_ "GenSigSendType" SG_ 89 ReSideRdrLeDetn50RdrDetnAzi 0;
BA_ "GenSigStartValue" SG_ 89 ReSideRdrLeDetn50RdrDetnAzi 900;
BA_ "GenSigDataID" SG_ 89 ReSideRdrLeDetn50RdrDetnChks "0x9C3";
BA_ "GenSigFuncType" SG_ 89 ReSideRdrLeDetn50RdrDetnChks 15;
BA_ "GenSigSendType" SG_ 89 ReSideRdrLeDetn50RdrDetnChks 0;
BA_ "GenSigFuncType" SG_ 89 ReSideRdrLeDetn50RdrDetnCntr 16;
BA_ "GenSigSendType" SG_ 89 ReSideRdrLeDetn50RdrDetnCntr 0;
BA_ "GenSigSendType" SG_ 89 ReSideRdrLeDetn50RdrDetnConf 0;
BA_ "GenSigSendType" SG_ 89 ReSideRdrLeDetn50RdrDetnElevn 0;
BA_ "GenSigStartValue" SG_ 89 ReSideRdrLeDetn50RdrDetnElevn 15;
BA_ "GenSigSendType" SG_ 89 ReSideRdrLeDetn50RdrDetnPwr 0;
BA_ "GenSigSendType" SG_ 89 ReSideRdrLeDetn50RdrDetnRng 0;
BA_ "GenSigStartValue" SG_ 89 ReSideRdrLeDetn50RdrDetnRng 10050;
BA_ "GenSigSendType" SG_ 89 ReSideRdrLeDetn50RdrDetnRngV 0;
BA_ "GenSigStartValue" SG_ 89 ReSideRdrLeDetn50RdrDetnRngV 4000;
BA_ "GenSigSendType" SG_ 89 ReSideRdrLeDetn50RdrDetnSameRV 0;
BA_ "GenSigSendType" SG_ 89 ReSideRdrLeDetn50RdrDetnSts 0;
BA_ "GenSigStartValue" SG_ 89 ReSideRdrLeDetn50RdrDetnSts 3;
BA_ "GenSigSendType" SG_ 89 ReSideRdrLeDetn51RdrDetnAmbigState 0;
BA_ "GenSigSendType" SG_ 89 ReSideRdrLeDetn51RdrDetnAssoTrkID 0;
BA_ "GenSigSendType" SG_ 89 ReSideRdrLeDetn51RdrDetnAzi 0;
BA_ "GenSigStartValue" SG_ 89 ReSideRdrLeDetn51RdrDetnAzi 900;
BA_ "GenSigDataID" SG_ 89 ReSideRdrLeDetn51RdrDetnChks "0x9C4";
BA_ "GenSigFuncType" SG_ 89 ReSideRdrLeDetn51RdrDetnChks 15;
BA_ "GenSigSendType" SG_ 89 ReSideRdrLeDetn51RdrDetnChks 0;
BA_ "GenSigFuncType" SG_ 89 ReSideRdrLeDetn51RdrDetnCntr 16;
BA_ "GenSigSendType" SG_ 89 ReSideRdrLeDetn51RdrDetnCntr 0;
BA_ "GenSigSendType" SG_ 89 ReSideRdrLeDetn51RdrDetnConf 0;
BA_ "GenSigSendType" SG_ 89 ReSideRdrLeDetn51RdrDetnElevn 0;
BA_ "GenSigStartValue" SG_ 89 ReSideRdrLeDetn51RdrDetnElevn 15;
BA_ "GenSigSendType" SG_ 89 ReSideRdrLeDetn51RdrDetnPwr 0;
BA_ "GenSigSendType" SG_ 89 ReSideRdrLeDetn51RdrDetnRng 0;
BA_ "GenSigStartValue" SG_ 89 ReSideRdrLeDetn51RdrDetnRng 10050;
BA_ "GenSigSendType" SG_ 89 ReSideRdrLeDetn51RdrDetnRngV 0;
BA_ "GenSigStartValue" SG_ 89 ReSideRdrLeDetn51RdrDetnRngV 4000;
BA_ "GenSigSendType" SG_ 89 ReSideRdrLeDetn51RdrDetnSameRV 0;
BA_ "GenSigSendType" SG_ 89 ReSideRdrLeDetn51RdrDetnSts 0;
BA_ "GenSigStartValue" SG_ 89 ReSideRdrLeDetn51RdrDetnSts 3;
BA_ "GenSigSendType" SG_ 89 ReSideRdrLeDetn52RdrDetnAmbigState 0;
BA_ "GenSigSendType" SG_ 89 ReSideRdrLeDetn52RdrDetnAssoTrkID 0;
BA_ "GenSigSendType" SG_ 89 ReSideRdrLeDetn52RdrDetnAzi 0;
BA_ "GenSigStartValue" SG_ 89 ReSideRdrLeDetn52RdrDetnAzi 900;
BA_ "GenSigDataID" SG_ 89 ReSideRdrLeDetn52RdrDetnChks "0x9C5";
BA_ "GenSigFuncType" SG_ 89 ReSideRdrLeDetn52RdrDetnChks 15;
BA_ "GenSigSendType" SG_ 89 ReSideRdrLeDetn52RdrDetnChks 0;
BA_ "GenSigFuncType" SG_ 89 ReSideRdrLeDetn52RdrDetnCntr 16;
BA_ "GenSigSendType" SG_ 89 ReSideRdrLeDetn52RdrDetnCntr 0;
BA_ "GenSigSendType" SG_ 89 ReSideRdrLeDetn52RdrDetnConf 0;
BA_ "GenSigSendType" SG_ 89 ReSideRdrLeDetn52RdrDetnElevn 0;
BA_ "GenSigStartValue" SG_ 89 ReSideRdrLeDetn52RdrDetnElevn 15;
BA_ "GenSigSendType" SG_ 89 ReSideRdrLeDetn52RdrDetnPwr 0;
BA_ "GenSigSendType" SG_ 89 ReSideRdrLeDetn52RdrDetnRng 0;
BA_ "GenSigStartValue" SG_ 89 ReSideRdrLeDetn52RdrDetnRng 10050;
BA_ "GenSigSendType" SG_ 89 ReSideRdrLeDetn52RdrDetnRngV 0;
BA_ "GenSigStartValue" SG_ 89 ReSideRdrLeDetn52RdrDetnRngV 4000;
BA_ "GenSigSendType" SG_ 89 ReSideRdrLeDetn52RdrDetnSameRV 0;
BA_ "GenSigSendType" SG_ 89 ReSideRdrLeDetn52RdrDetnSts 0;
BA_ "GenSigStartValue" SG_ 89 ReSideRdrLeDetn52RdrDetnSts 3;
BA_ "GenSigSendType" SG_ 89 ReSideRdrLeDetn53RdrDetnAmbigState 0;
BA_ "GenSigSendType" SG_ 89 ReSideRdrLeDetn53RdrDetnAssoTrkID 0;
BA_ "GenSigSendType" SG_ 89 ReSideRdrLeDetn53RdrDetnAzi 0;
BA_ "GenSigStartValue" SG_ 89 ReSideRdrLeDetn53RdrDetnAzi 900;
BA_ "GenSigDataID" SG_ 89 ReSideRdrLeDetn53RdrDetnChks "0x9C6";
BA_ "GenSigFuncType" SG_ 89 ReSideRdrLeDetn53RdrDetnChks 15;
BA_ "GenSigSendType" SG_ 89 ReSideRdrLeDetn53RdrDetnChks 0;
BA_ "GenSigFuncType" SG_ 89 ReSideRdrLeDetn53RdrDetnCntr 16;
BA_ "GenSigSendType" SG_ 89 ReSideRdrLeDetn53RdrDetnCntr 0;
BA_ "GenSigSendType" SG_ 89 ReSideRdrLeDetn53RdrDetnConf 0;
BA_ "GenSigSendType" SG_ 89 ReSideRdrLeDetn53RdrDetnElevn 0;
BA_ "GenSigStartValue" SG_ 89 ReSideRdrLeDetn53RdrDetnElevn 15;
BA_ "GenSigSendType" SG_ 89 ReSideRdrLeDetn53RdrDetnPwr 0;
BA_ "GenSigSendType" SG_ 89 ReSideRdrLeDetn53RdrDetnRng 0;
BA_ "GenSigStartValue" SG_ 89 ReSideRdrLeDetn53RdrDetnRng 10050;
BA_ "GenSigSendType" SG_ 89 ReSideRdrLeDetn53RdrDetnRngV 0;
BA_ "GenSigStartValue" SG_ 89 ReSideRdrLeDetn53RdrDetnRngV 4000;
BA_ "GenSigSendType" SG_ 89 ReSideRdrLeDetn53RdrDetnSameRV 0;
BA_ "GenSigSendType" SG_ 89 ReSideRdrLeDetn53RdrDetnSts 0;
BA_ "GenSigStartValue" SG_ 89 ReSideRdrLeDetn53RdrDetnSts 3;
BA_ "GenSigSendType" SG_ 89 ReSideRdrLeDetn54RdrDetnAmbigState 0;
BA_ "GenSigSendType" SG_ 89 ReSideRdrLeDetn54RdrDetnAssoTrkID 0;
BA_ "GenSigSendType" SG_ 89 ReSideRdrLeDetn54RdrDetnAzi 0;
BA_ "GenSigStartValue" SG_ 89 ReSideRdrLeDetn54RdrDetnAzi 900;
BA_ "GenSigDataID" SG_ 89 ReSideRdrLeDetn54RdrDetnChks "0x9C7";
BA_ "GenSigFuncType" SG_ 89 ReSideRdrLeDetn54RdrDetnChks 15;
BA_ "GenSigSendType" SG_ 89 ReSideRdrLeDetn54RdrDetnChks 0;
BA_ "GenSigFuncType" SG_ 89 ReSideRdrLeDetn54RdrDetnCntr 16;
BA_ "GenSigSendType" SG_ 89 ReSideRdrLeDetn54RdrDetnCntr 0;
BA_ "GenSigSendType" SG_ 89 ReSideRdrLeDetn54RdrDetnConf 0;
BA_ "GenSigSendType" SG_ 89 ReSideRdrLeDetn54RdrDetnElevn 0;
BA_ "GenSigStartValue" SG_ 89 ReSideRdrLeDetn54RdrDetnElevn 15;
BA_ "GenSigSendType" SG_ 89 ReSideRdrLeDetn54RdrDetnPwr 0;
BA_ "GenSigSendType" SG_ 89 ReSideRdrLeDetn54RdrDetnRng 0;
BA_ "GenSigStartValue" SG_ 89 ReSideRdrLeDetn54RdrDetnRng 10050;
BA_ "GenSigSendType" SG_ 89 ReSideRdrLeDetn54RdrDetnRngV 0;
BA_ "GenSigStartValue" SG_ 89 ReSideRdrLeDetn54RdrDetnRngV 4000;
BA_ "GenSigSendType" SG_ 89 ReSideRdrLeDetn54RdrDetnSameRV 0;
BA_ "GenSigSendType" SG_ 89 ReSideRdrLeDetn54RdrDetnSts 0;
BA_ "GenSigStartValue" SG_ 89 ReSideRdrLeDetn54RdrDetnSts 3;
BA_ "GenSigSendType" SG_ 96 ReSideRdrLeDetn55RdrDetnAmbigState 0;
BA_ "GenSigSendType" SG_ 96 ReSideRdrLeDetn55RdrDetnAssoTrkID 0;
BA_ "GenSigSendType" SG_ 96 ReSideRdrLeDetn55RdrDetnAzi 0;
BA_ "GenSigStartValue" SG_ 96 ReSideRdrLeDetn55RdrDetnAzi 900;
BA_ "GenSigDataID" SG_ 96 ReSideRdrLeDetn55RdrDetnChks "0x9C8";
BA_ "GenSigFuncType" SG_ 96 ReSideRdrLeDetn55RdrDetnChks 15;
BA_ "GenSigSendType" SG_ 96 ReSideRdrLeDetn55RdrDetnChks 0;
BA_ "GenSigFuncType" SG_ 96 ReSideRdrLeDetn55RdrDetnCntr 16;
BA_ "GenSigSendType" SG_ 96 ReSideRdrLeDetn55RdrDetnCntr 0;
BA_ "GenSigSendType" SG_ 96 ReSideRdrLeDetn55RdrDetnConf 0;
BA_ "GenSigSendType" SG_ 96 ReSideRdrLeDetn55RdrDetnElevn 0;
BA_ "GenSigStartValue" SG_ 96 ReSideRdrLeDetn55RdrDetnElevn 15;
BA_ "GenSigSendType" SG_ 96 ReSideRdrLeDetn55RdrDetnPwr 0;
BA_ "GenSigSendType" SG_ 96 ReSideRdrLeDetn55RdrDetnRng 0;
BA_ "GenSigStartValue" SG_ 96 ReSideRdrLeDetn55RdrDetnRng 10050;
BA_ "GenSigSendType" SG_ 96 ReSideRdrLeDetn55RdrDetnRngV 0;
BA_ "GenSigStartValue" SG_ 96 ReSideRdrLeDetn55RdrDetnRngV 4000;
BA_ "GenSigSendType" SG_ 96 ReSideRdrLeDetn55RdrDetnSameRV 0;
BA_ "GenSigSendType" SG_ 96 ReSideRdrLeDetn55RdrDetnSts 0;
BA_ "GenSigStartValue" SG_ 96 ReSideRdrLeDetn55RdrDetnSts 3;
BA_ "GenSigSendType" SG_ 96 ReSideRdrLeDetn56RdrDetnAmbigState 0;
BA_ "GenSigSendType" SG_ 96 ReSideRdrLeDetn56RdrDetnAssoTrkID 0;
BA_ "GenSigSendType" SG_ 96 ReSideRdrLeDetn56RdrDetnAzi 0;
BA_ "GenSigStartValue" SG_ 96 ReSideRdrLeDetn56RdrDetnAzi 900;
BA_ "GenSigDataID" SG_ 96 ReSideRdrLeDetn56RdrDetnChks "0x9C9";
BA_ "GenSigFuncType" SG_ 96 ReSideRdrLeDetn56RdrDetnChks 15;
BA_ "GenSigSendType" SG_ 96 ReSideRdrLeDetn56RdrDetnChks 0;
BA_ "GenSigFuncType" SG_ 96 ReSideRdrLeDetn56RdrDetnCntr 16;
BA_ "GenSigSendType" SG_ 96 ReSideRdrLeDetn56RdrDetnCntr 0;
BA_ "GenSigSendType" SG_ 96 ReSideRdrLeDetn56RdrDetnConf 0;
BA_ "GenSigSendType" SG_ 96 ReSideRdrLeDetn56RdrDetnElevn 0;
BA_ "GenSigStartValue" SG_ 96 ReSideRdrLeDetn56RdrDetnElevn 15;
BA_ "GenSigSendType" SG_ 96 ReSideRdrLeDetn56RdrDetnPwr 0;
BA_ "GenSigSendType" SG_ 96 ReSideRdrLeDetn56RdrDetnRng 0;
BA_ "GenSigStartValue" SG_ 96 ReSideRdrLeDetn56RdrDetnRng 10050;
BA_ "GenSigSendType" SG_ 96 ReSideRdrLeDetn56RdrDetnRngV 0;
BA_ "GenSigStartValue" SG_ 96 ReSideRdrLeDetn56RdrDetnRngV 4000;
BA_ "GenSigSendType" SG_ 96 ReSideRdrLeDetn56RdrDetnSameRV 0;
BA_ "GenSigSendType" SG_ 96 ReSideRdrLeDetn56RdrDetnSts 0;
BA_ "GenSigStartValue" SG_ 96 ReSideRdrLeDetn56RdrDetnSts 3;
BA_ "GenSigSendType" SG_ 96 ReSideRdrLeDetn57RdrDetnAmbigState 0;
BA_ "GenSigSendType" SG_ 96 ReSideRdrLeDetn57RdrDetnAssoTrkID 0;
BA_ "GenSigSendType" SG_ 96 ReSideRdrLeDetn57RdrDetnAzi 0;
BA_ "GenSigStartValue" SG_ 96 ReSideRdrLeDetn57RdrDetnAzi 900;
BA_ "GenSigDataID" SG_ 96 ReSideRdrLeDetn57RdrDetnChks "0x9CA";
BA_ "GenSigFuncType" SG_ 96 ReSideRdrLeDetn57RdrDetnChks 15;
BA_ "GenSigSendType" SG_ 96 ReSideRdrLeDetn57RdrDetnChks 0;
BA_ "GenSigFuncType" SG_ 96 ReSideRdrLeDetn57RdrDetnCntr 16;
BA_ "GenSigSendType" SG_ 96 ReSideRdrLeDetn57RdrDetnCntr 0;
BA_ "GenSigSendType" SG_ 96 ReSideRdrLeDetn57RdrDetnConf 0;
BA_ "GenSigSendType" SG_ 96 ReSideRdrLeDetn57RdrDetnElevn 0;
BA_ "GenSigStartValue" SG_ 96 ReSideRdrLeDetn57RdrDetnElevn 15;
BA_ "GenSigSendType" SG_ 96 ReSideRdrLeDetn57RdrDetnPwr 0;
BA_ "GenSigSendType" SG_ 96 ReSideRdrLeDetn57RdrDetnRng 0;
BA_ "GenSigStartValue" SG_ 96 ReSideRdrLeDetn57RdrDetnRng 10050;
BA_ "GenSigSendType" SG_ 96 ReSideRdrLeDetn57RdrDetnRngV 0;
BA_ "GenSigStartValue" SG_ 96 ReSideRdrLeDetn57RdrDetnRngV 4000;
BA_ "GenSigSendType" SG_ 96 ReSideRdrLeDetn57RdrDetnSameRV 0;
BA_ "GenSigSendType" SG_ 96 ReSideRdrLeDetn57RdrDetnSts 0;
BA_ "GenSigStartValue" SG_ 96 ReSideRdrLeDetn57RdrDetnSts 3;
BA_ "GenSigSendType" SG_ 96 ReSideRdrLeDetn58RdrDetnAmbigState 0;
BA_ "GenSigSendType" SG_ 96 ReSideRdrLeDetn58RdrDetnAssoTrkID 0;
BA_ "GenSigSendType" SG_ 96 ReSideRdrLeDetn58RdrDetnAzi 0;
BA_ "GenSigStartValue" SG_ 96 ReSideRdrLeDetn58RdrDetnAzi 900;
BA_ "GenSigDataID" SG_ 96 ReSideRdrLeDetn58RdrDetnChks "0x9CB";
BA_ "GenSigFuncType" SG_ 96 ReSideRdrLeDetn58RdrDetnChks 15;
BA_ "GenSigSendType" SG_ 96 ReSideRdrLeDetn58RdrDetnChks 0;
BA_ "GenSigFuncType" SG_ 96 ReSideRdrLeDetn58RdrDetnCntr 16;
BA_ "GenSigSendType" SG_ 96 ReSideRdrLeDetn58RdrDetnCntr 0;
BA_ "GenSigSendType" SG_ 96 ReSideRdrLeDetn58RdrDetnConf 0;
BA_ "GenSigSendType" SG_ 96 ReSideRdrLeDetn58RdrDetnElevn 0;
BA_ "GenSigStartValue" SG_ 96 ReSideRdrLeDetn58RdrDetnElevn 15;
BA_ "GenSigSendType" SG_ 96 ReSideRdrLeDetn58RdrDetnPwr 0;
BA_ "GenSigSendType" SG_ 96 ReSideRdrLeDetn58RdrDetnRng 0;
BA_ "GenSigStartValue" SG_ 96 ReSideRdrLeDetn58RdrDetnRng 10050;
BA_ "GenSigSendType" SG_ 96 ReSideRdrLeDetn58RdrDetnRngV 0;
BA_ "GenSigStartValue" SG_ 96 ReSideRdrLeDetn58RdrDetnRngV 4000;
BA_ "GenSigSendType" SG_ 96 ReSideRdrLeDetn58RdrDetnSameRV 0;
BA_ "GenSigSendType" SG_ 96 ReSideRdrLeDetn58RdrDetnSts 0;
BA_ "GenSigStartValue" SG_ 96 ReSideRdrLeDetn58RdrDetnSts 3;
BA_ "GenSigSendType" SG_ 96 ReSideRdrLeDetn59RdrDetnAmbigState 0;
BA_ "GenSigSendType" SG_ 96 ReSideRdrLeDetn59RdrDetnAssoTrkID 0;
BA_ "GenSigSendType" SG_ 96 ReSideRdrLeDetn59RdrDetnAzi 0;
BA_ "GenSigStartValue" SG_ 96 ReSideRdrLeDetn59RdrDetnAzi 900;
BA_ "GenSigDataID" SG_ 96 ReSideRdrLeDetn59RdrDetnChks "0x9CC";
BA_ "GenSigFuncType" SG_ 96 ReSideRdrLeDetn59RdrDetnChks 15;
BA_ "GenSigSendType" SG_ 96 ReSideRdrLeDetn59RdrDetnChks 0;
BA_ "GenSigFuncType" SG_ 96 ReSideRdrLeDetn59RdrDetnCntr 16;
BA_ "GenSigSendType" SG_ 96 ReSideRdrLeDetn59RdrDetnCntr 0;
BA_ "GenSigSendType" SG_ 96 ReSideRdrLeDetn59RdrDetnConf 0;
BA_ "GenSigSendType" SG_ 96 ReSideRdrLeDetn59RdrDetnElevn 0;
BA_ "GenSigStartValue" SG_ 96 ReSideRdrLeDetn59RdrDetnElevn 15;
BA_ "GenSigSendType" SG_ 96 ReSideRdrLeDetn59RdrDetnPwr 0;
BA_ "GenSigSendType" SG_ 96 ReSideRdrLeDetn59RdrDetnRng 0;
BA_ "GenSigStartValue" SG_ 96 ReSideRdrLeDetn59RdrDetnRng 10050;
BA_ "GenSigSendType" SG_ 96 ReSideRdrLeDetn59RdrDetnRngV 0;
BA_ "GenSigStartValue" SG_ 96 ReSideRdrLeDetn59RdrDetnRngV 4000;
BA_ "GenSigSendType" SG_ 96 ReSideRdrLeDetn59RdrDetnSameRV 0;
BA_ "GenSigSendType" SG_ 96 ReSideRdrLeDetn59RdrDetnSts 0;
BA_ "GenSigStartValue" SG_ 96 ReSideRdrLeDetn59RdrDetnSts 3;
BA_ "GenSigSendType" SG_ 96 ReSideRdrLeDetn60RdrDetnAmbigState 0;
BA_ "GenSigSendType" SG_ 96 ReSideRdrLeDetn60RdrDetnAssoTrkID 0;
BA_ "GenSigSendType" SG_ 96 ReSideRdrLeDetn60RdrDetnAzi 0;
BA_ "GenSigStartValue" SG_ 96 ReSideRdrLeDetn60RdrDetnAzi 900;
BA_ "GenSigDataID" SG_ 96 ReSideRdrLeDetn60RdrDetnChks "0x9CD";
BA_ "GenSigFuncType" SG_ 96 ReSideRdrLeDetn60RdrDetnChks 15;
BA_ "GenSigSendType" SG_ 96 ReSideRdrLeDetn60RdrDetnChks 0;
BA_ "GenSigFuncType" SG_ 96 ReSideRdrLeDetn60RdrDetnCntr 16;
BA_ "GenSigSendType" SG_ 96 ReSideRdrLeDetn60RdrDetnCntr 0;
BA_ "GenSigSendType" SG_ 96 ReSideRdrLeDetn60RdrDetnConf 0;
BA_ "GenSigSendType" SG_ 96 ReSideRdrLeDetn60RdrDetnElevn 0;
BA_ "GenSigStartValue" SG_ 96 ReSideRdrLeDetn60RdrDetnElevn 15;
BA_ "GenSigSendType" SG_ 96 ReSideRdrLeDetn60RdrDetnPwr 0;
BA_ "GenSigSendType" SG_ 96 ReSideRdrLeDetn60RdrDetnRng 0;
BA_ "GenSigStartValue" SG_ 96 ReSideRdrLeDetn60RdrDetnRng 10050;
BA_ "GenSigSendType" SG_ 96 ReSideRdrLeDetn60RdrDetnRngV 0;
BA_ "GenSigStartValue" SG_ 96 ReSideRdrLeDetn60RdrDetnRngV 4000;
BA_ "GenSigSendType" SG_ 96 ReSideRdrLeDetn60RdrDetnSameRV 0;
BA_ "GenSigSendType" SG_ 96 ReSideRdrLeDetn60RdrDetnSts 0;
BA_ "GenSigStartValue" SG_ 96 ReSideRdrLeDetn60RdrDetnSts 3;
BA_ "GenSigSendType" SG_ 97 ReSideRdrLeDetn61RdrDetnAmbigState 0;
BA_ "GenSigSendType" SG_ 97 ReSideRdrLeDetn61RdrDetnAssoTrkID 0;
BA_ "GenSigSendType" SG_ 97 ReSideRdrLeDetn61RdrDetnAzi 0;
BA_ "GenSigStartValue" SG_ 97 ReSideRdrLeDetn61RdrDetnAzi 900;
BA_ "GenSigDataID" SG_ 97 ReSideRdrLeDetn61RdrDetnChks "0x9CE";
BA_ "GenSigFuncType" SG_ 97 ReSideRdrLeDetn61RdrDetnChks 15;
BA_ "GenSigSendType" SG_ 97 ReSideRdrLeDetn61RdrDetnChks 0;
BA_ "GenSigFuncType" SG_ 97 ReSideRdrLeDetn61RdrDetnCntr 16;
BA_ "GenSigSendType" SG_ 97 ReSideRdrLeDetn61RdrDetnCntr 0;
BA_ "GenSigSendType" SG_ 97 ReSideRdrLeDetn61RdrDetnConf 0;
BA_ "GenSigSendType" SG_ 97 ReSideRdrLeDetn61RdrDetnElevn 0;
BA_ "GenSigStartValue" SG_ 97 ReSideRdrLeDetn61RdrDetnElevn 15;
BA_ "GenSigSendType" SG_ 97 ReSideRdrLeDetn61RdrDetnPwr 0;
BA_ "GenSigSendType" SG_ 97 ReSideRdrLeDetn61RdrDetnRng 0;
BA_ "GenSigStartValue" SG_ 97 ReSideRdrLeDetn61RdrDetnRng 10050;
BA_ "GenSigSendType" SG_ 97 ReSideRdrLeDetn61RdrDetnRngV 0;
BA_ "GenSigStartValue" SG_ 97 ReSideRdrLeDetn61RdrDetnRngV 4000;
BA_ "GenSigSendType" SG_ 97 ReSideRdrLeDetn61RdrDetnSameRV 0;
BA_ "GenSigSendType" SG_ 97 ReSideRdrLeDetn61RdrDetnSts 0;
BA_ "GenSigStartValue" SG_ 97 ReSideRdrLeDetn61RdrDetnSts 3;
BA_ "GenSigSendType" SG_ 97 ReSideRdrLeDetn62RdrDetnAmbigState 0;
BA_ "GenSigSendType" SG_ 97 ReSideRdrLeDetn62RdrDetnAssoTrkID 0;
BA_ "GenSigSendType" SG_ 97 ReSideRdrLeDetn62RdrDetnAzi 0;
BA_ "GenSigStartValue" SG_ 97 ReSideRdrLeDetn62RdrDetnAzi 900;
BA_ "GenSigDataID" SG_ 97 ReSideRdrLeDetn62RdrDetnChks "0x9CF";
BA_ "GenSigFuncType" SG_ 97 ReSideRdrLeDetn62RdrDetnChks 15;
BA_ "GenSigSendType" SG_ 97 ReSideRdrLeDetn62RdrDetnChks 0;
BA_ "GenSigFuncType" SG_ 97 ReSideRdrLeDetn62RdrDetnCntr 16;
BA_ "GenSigSendType" SG_ 97 ReSideRdrLeDetn62RdrDetnCntr 0;
BA_ "GenSigSendType" SG_ 97 ReSideRdrLeDetn62RdrDetnConf 0;
BA_ "GenSigSendType" SG_ 97 ReSideRdrLeDetn62RdrDetnElevn 0;
BA_ "GenSigStartValue" SG_ 97 ReSideRdrLeDetn62RdrDetnElevn 15;
BA_ "GenSigSendType" SG_ 97 ReSideRdrLeDetn62RdrDetnPwr 0;
BA_ "GenSigSendType" SG_ 97 ReSideRdrLeDetn62RdrDetnRng 0;
BA_ "GenSigStartValue" SG_ 97 ReSideRdrLeDetn62RdrDetnRng 10050;
BA_ "GenSigSendType" SG_ 97 ReSideRdrLeDetn62RdrDetnRngV 0;
BA_ "GenSigStartValue" SG_ 97 ReSideRdrLeDetn62RdrDetnRngV 4000;
BA_ "GenSigSendType" SG_ 97 ReSideRdrLeDetn62RdrDetnSameRV 0;
BA_ "GenSigSendType" SG_ 97 ReSideRdrLeDetn62RdrDetnSts 0;
BA_ "GenSigStartValue" SG_ 97 ReSideRdrLeDetn62RdrDetnSts 3;
BA_ "GenSigSendType" SG_ 97 ReSideRdrLeDetn63RdrDetnAmbigState 0;
BA_ "GenSigSendType" SG_ 97 ReSideRdrLeDetn63RdrDetnAssoTrkID 0;
BA_ "GenSigSendType" SG_ 97 ReSideRdrLeDetn63RdrDetnAzi 0;
BA_ "GenSigStartValue" SG_ 97 ReSideRdrLeDetn63RdrDetnAzi 900;
BA_ "GenSigDataID" SG_ 97 ReSideRdrLeDetn63RdrDetnChks "0x9D0";
BA_ "GenSigFuncType" SG_ 97 ReSideRdrLeDetn63RdrDetnChks 15;
BA_ "GenSigSendType" SG_ 97 ReSideRdrLeDetn63RdrDetnChks 0;
BA_ "GenSigFuncType" SG_ 97 ReSideRdrLeDetn63RdrDetnCntr 16;
BA_ "GenSigSendType" SG_ 97 ReSideRdrLeDetn63RdrDetnCntr 0;
BA_ "GenSigSendType" SG_ 97 ReSideRdrLeDetn63RdrDetnConf 0;
BA_ "GenSigSendType" SG_ 97 ReSideRdrLeDetn63RdrDetnElevn 0;
BA_ "GenSigStartValue" SG_ 97 ReSideRdrLeDetn63RdrDetnElevn 15;
BA_ "GenSigSendType" SG_ 97 ReSideRdrLeDetn63RdrDetnPwr 0;
BA_ "GenSigSendType" SG_ 97 ReSideRdrLeDetn63RdrDetnRng 0;
BA_ "GenSigStartValue" SG_ 97 ReSideRdrLeDetn63RdrDetnRng 10050;
BA_ "GenSigSendType" SG_ 97 ReSideRdrLeDetn63RdrDetnRngV 0;
BA_ "GenSigStartValue" SG_ 97 ReSideRdrLeDetn63RdrDetnRngV 4000;
BA_ "GenSigSendType" SG_ 97 ReSideRdrLeDetn63RdrDetnSameRV 0;
BA_ "GenSigSendType" SG_ 97 ReSideRdrLeDetn63RdrDetnSts 0;
BA_ "GenSigStartValue" SG_ 97 ReSideRdrLeDetn63RdrDetnSts 3;
BA_ "GenSigSendType" SG_ 97 ReSideRdrLeDetn64RdrDetnAmbigState 0;
BA_ "GenSigSendType" SG_ 97 ReSideRdrLeDetn64RdrDetnAssoTrkID 0;
BA_ "GenSigSendType" SG_ 97 ReSideRdrLeDetn64RdrDetnAzi 0;
BA_ "GenSigStartValue" SG_ 97 ReSideRdrLeDetn64RdrDetnAzi 900;
BA_ "GenSigDataID" SG_ 97 ReSideRdrLeDetn64RdrDetnChks "0x9D1";
BA_ "GenSigFuncType" SG_ 97 ReSideRdrLeDetn64RdrDetnChks 15;
BA_ "GenSigSendType" SG_ 97 ReSideRdrLeDetn64RdrDetnChks 0;
BA_ "GenSigFuncType" SG_ 97 ReSideRdrLeDetn64RdrDetnCntr 16;
BA_ "GenSigSendType" SG_ 97 ReSideRdrLeDetn64RdrDetnCntr 0;
BA_ "GenSigSendType" SG_ 97 ReSideRdrLeDetn64RdrDetnConf 0;
BA_ "GenSigSendType" SG_ 97 ReSideRdrLeDetn64RdrDetnElevn 0;
BA_ "GenSigStartValue" SG_ 97 ReSideRdrLeDetn64RdrDetnElevn 15;
BA_ "GenSigSendType" SG_ 97 ReSideRdrLeDetn64RdrDetnPwr 0;
BA_ "GenSigSendType" SG_ 97 ReSideRdrLeDetn64RdrDetnRng 0;
BA_ "GenSigStartValue" SG_ 97 ReSideRdrLeDetn64RdrDetnRng 10050;
BA_ "GenSigSendType" SG_ 97 ReSideRdrLeDetn64RdrDetnRngV 0;
BA_ "GenSigStartValue" SG_ 97 ReSideRdrLeDetn64RdrDetnRngV 4000;
BA_ "GenSigSendType" SG_ 97 ReSideRdrLeDetn64RdrDetnSameRV 0;
BA_ "GenSigSendType" SG_ 97 ReSideRdrLeDetn64RdrDetnSts 0;
BA_ "GenSigStartValue" SG_ 97 ReSideRdrLeDetn64RdrDetnSts 3;
BA_ "GenSigSendType" SG_ 97 ReSideRdrLeDetn65RdrDetnAmbigState 0;
BA_ "GenSigSendType" SG_ 97 ReSideRdrLeDetn65RdrDetnAssoTrkID 0;
BA_ "GenSigSendType" SG_ 97 ReSideRdrLeDetn65RdrDetnAzi 0;
BA_ "GenSigStartValue" SG_ 97 ReSideRdrLeDetn65RdrDetnAzi 900;
BA_ "GenSigDataID" SG_ 97 ReSideRdrLeDetn65RdrDetnChks "0x9D2";
BA_ "GenSigFuncType" SG_ 97 ReSideRdrLeDetn65RdrDetnChks 15;
BA_ "GenSigSendType" SG_ 97 ReSideRdrLeDetn65RdrDetnChks 0;
BA_ "GenSigFuncType" SG_ 97 ReSideRdrLeDetn65RdrDetnCntr 16;
BA_ "GenSigSendType" SG_ 97 ReSideRdrLeDetn65RdrDetnCntr 0;
BA_ "GenSigSendType" SG_ 97 ReSideRdrLeDetn65RdrDetnConf 0;
BA_ "GenSigSendType" SG_ 97 ReSideRdrLeDetn65RdrDetnElevn 0;
BA_ "GenSigStartValue" SG_ 97 ReSideRdrLeDetn65RdrDetnElevn 15;
BA_ "GenSigSendType" SG_ 97 ReSideRdrLeDetn65RdrDetnPwr 0;
BA_ "GenSigSendType" SG_ 97 ReSideRdrLeDetn65RdrDetnRng 0;
BA_ "GenSigStartValue" SG_ 97 ReSideRdrLeDetn65RdrDetnRng 10050;
BA_ "GenSigSendType" SG_ 97 ReSideRdrLeDetn65RdrDetnRngV 0;
BA_ "GenSigStartValue" SG_ 97 ReSideRdrLeDetn65RdrDetnRngV 4000;
BA_ "GenSigSendType" SG_ 97 ReSideRdrLeDetn65RdrDetnSameRV 0;
BA_ "GenSigSendType" SG_ 97 ReSideRdrLeDetn65RdrDetnSts 0;
BA_ "GenSigStartValue" SG_ 97 ReSideRdrLeDetn65RdrDetnSts 3;
BA_ "GenSigSendType" SG_ 97 ReSideRdrLeDetn66RdrDetnAmbigState 0;
BA_ "GenSigSendType" SG_ 97 ReSideRdrLeDetn66RdrDetnAssoTrkID 0;
BA_ "GenSigSendType" SG_ 97 ReSideRdrLeDetn66RdrDetnAzi 0;
BA_ "GenSigStartValue" SG_ 97 ReSideRdrLeDetn66RdrDetnAzi 900;
BA_ "GenSigDataID" SG_ 97 ReSideRdrLeDetn66RdrDetnChks "0x9D3";
BA_ "GenSigFuncType" SG_ 97 ReSideRdrLeDetn66RdrDetnChks 15;
BA_ "GenSigSendType" SG_ 97 ReSideRdrLeDetn66RdrDetnChks 0;
BA_ "GenSigFuncType" SG_ 97 ReSideRdrLeDetn66RdrDetnCntr 16;
BA_ "GenSigSendType" SG_ 97 ReSideRdrLeDetn66RdrDetnCntr 0;
BA_ "GenSigSendType" SG_ 97 ReSideRdrLeDetn66RdrDetnConf 0;
BA_ "GenSigSendType" SG_ 97 ReSideRdrLeDetn66RdrDetnElevn 0;
BA_ "GenSigStartValue" SG_ 97 ReSideRdrLeDetn66RdrDetnElevn 15;
BA_ "GenSigSendType" SG_ 97 ReSideRdrLeDetn66RdrDetnPwr 0;
BA_ "GenSigSendType" SG_ 97 ReSideRdrLeDetn66RdrDetnRng 0;
BA_ "GenSigStartValue" SG_ 97 ReSideRdrLeDetn66RdrDetnRng 10050;
BA_ "GenSigSendType" SG_ 97 ReSideRdrLeDetn66RdrDetnRngV 0;
BA_ "GenSigStartValue" SG_ 97 ReSideRdrLeDetn66RdrDetnRngV 4000;
BA_ "GenSigSendType" SG_ 97 ReSideRdrLeDetn66RdrDetnSameRV 0;
BA_ "GenSigSendType" SG_ 97 ReSideRdrLeDetn66RdrDetnSts 0;
BA_ "GenSigStartValue" SG_ 97 ReSideRdrLeDetn66RdrDetnSts 3;
BA_ "GenSigSendType" SG_ 98 ReSideRdrLeDetn67RdrDetnAmbigState 0;
BA_ "GenSigSendType" SG_ 98 ReSideRdrLeDetn67RdrDetnAssoTrkID 0;
BA_ "GenSigSendType" SG_ 98 ReSideRdrLeDetn67RdrDetnAzi 0;
BA_ "GenSigStartValue" SG_ 98 ReSideRdrLeDetn67RdrDetnAzi 900;
BA_ "GenSigDataID" SG_ 98 ReSideRdrLeDetn67RdrDetnChks "0x9D4";
BA_ "GenSigFuncType" SG_ 98 ReSideRdrLeDetn67RdrDetnChks 15;
BA_ "GenSigSendType" SG_ 98 ReSideRdrLeDetn67RdrDetnChks 0;
BA_ "GenSigFuncType" SG_ 98 ReSideRdrLeDetn67RdrDetnCntr 16;
BA_ "GenSigSendType" SG_ 98 ReSideRdrLeDetn67RdrDetnCntr 0;
BA_ "GenSigSendType" SG_ 98 ReSideRdrLeDetn67RdrDetnConf 0;
BA_ "GenSigSendType" SG_ 98 ReSideRdrLeDetn67RdrDetnElevn 0;
BA_ "GenSigStartValue" SG_ 98 ReSideRdrLeDetn67RdrDetnElevn 15;
BA_ "GenSigSendType" SG_ 98 ReSideRdrLeDetn67RdrDetnPwr 0;
BA_ "GenSigSendType" SG_ 98 ReSideRdrLeDetn67RdrDetnRng 0;
BA_ "GenSigStartValue" SG_ 98 ReSideRdrLeDetn67RdrDetnRng 10050;
BA_ "GenSigSendType" SG_ 98 ReSideRdrLeDetn67RdrDetnRngV 0;
BA_ "GenSigStartValue" SG_ 98 ReSideRdrLeDetn67RdrDetnRngV 4000;
BA_ "GenSigSendType" SG_ 98 ReSideRdrLeDetn67RdrDetnSameRV 0;
BA_ "GenSigSendType" SG_ 98 ReSideRdrLeDetn67RdrDetnSts 0;
BA_ "GenSigStartValue" SG_ 98 ReSideRdrLeDetn67RdrDetnSts 3;
BA_ "GenSigSendType" SG_ 98 ReSideRdrLeDetn68RdrDetnAmbigState 0;
BA_ "GenSigSendType" SG_ 98 ReSideRdrLeDetn68RdrDetnAssoTrkID 0;
BA_ "GenSigSendType" SG_ 98 ReSideRdrLeDetn68RdrDetnAzi 0;
BA_ "GenSigStartValue" SG_ 98 ReSideRdrLeDetn68RdrDetnAzi 900;
BA_ "GenSigDataID" SG_ 98 ReSideRdrLeDetn68RdrDetnChks "0x9D5";
BA_ "GenSigFuncType" SG_ 98 ReSideRdrLeDetn68RdrDetnChks 15;
BA_ "GenSigSendType" SG_ 98 ReSideRdrLeDetn68RdrDetnChks 0;
BA_ "GenSigFuncType" SG_ 98 ReSideRdrLeDetn68RdrDetnCntr 16;
BA_ "GenSigSendType" SG_ 98 ReSideRdrLeDetn68RdrDetnCntr 0;
BA_ "GenSigSendType" SG_ 98 ReSideRdrLeDetn68RdrDetnConf 0;
BA_ "GenSigSendType" SG_ 98 ReSideRdrLeDetn68RdrDetnElevn 0;
BA_ "GenSigStartValue" SG_ 98 ReSideRdrLeDetn68RdrDetnElevn 15;
BA_ "GenSigSendType" SG_ 98 ReSideRdrLeDetn68RdrDetnPwr 0;
BA_ "GenSigSendType" SG_ 98 ReSideRdrLeDetn68RdrDetnRng 0;
BA_ "GenSigStartValue" SG_ 98 ReSideRdrLeDetn68RdrDetnRng 10050;
BA_ "GenSigSendType" SG_ 98 ReSideRdrLeDetn68RdrDetnRngV 0;
BA_ "GenSigStartValue" SG_ 98 ReSideRdrLeDetn68RdrDetnRngV 4000;
BA_ "GenSigSendType" SG_ 98 ReSideRdrLeDetn68RdrDetnSameRV 0;
BA_ "GenSigSendType" SG_ 98 ReSideRdrLeDetn68RdrDetnSts 0;
BA_ "GenSigStartValue" SG_ 98 ReSideRdrLeDetn68RdrDetnSts 3;
BA_ "GenSigSendType" SG_ 98 ReSideRdrLeDetn69RdrDetnAmbigState 0;
BA_ "GenSigSendType" SG_ 98 ReSideRdrLeDetn69RdrDetnAssoTrkID 0;
BA_ "GenSigSendType" SG_ 98 ReSideRdrLeDetn69RdrDetnAzi 0;
BA_ "GenSigStartValue" SG_ 98 ReSideRdrLeDetn69RdrDetnAzi 900;
BA_ "GenSigDataID" SG_ 98 ReSideRdrLeDetn69RdrDetnChks "0x9D6";
BA_ "GenSigFuncType" SG_ 98 ReSideRdrLeDetn69RdrDetnChks 15;
BA_ "GenSigSendType" SG_ 98 ReSideRdrLeDetn69RdrDetnChks 0;
BA_ "GenSigFuncType" SG_ 98 ReSideRdrLeDetn69RdrDetnCntr 16;
BA_ "GenSigSendType" SG_ 98 ReSideRdrLeDetn69RdrDetnCntr 0;
BA_ "GenSigSendType" SG_ 98 ReSideRdrLeDetn69RdrDetnConf 0;
BA_ "GenSigSendType" SG_ 98 ReSideRdrLeDetn69RdrDetnElevn 0;
BA_ "GenSigStartValue" SG_ 98 ReSideRdrLeDetn69RdrDetnElevn 15;
BA_ "GenSigSendType" SG_ 98 ReSideRdrLeDetn69RdrDetnPwr 0;
BA_ "GenSigSendType" SG_ 98 ReSideRdrLeDetn69RdrDetnRng 0;
BA_ "GenSigStartValue" SG_ 98 ReSideRdrLeDetn69RdrDetnRng 10050;
BA_ "GenSigSendType" SG_ 98 ReSideRdrLeDetn69RdrDetnRngV 0;
BA_ "GenSigStartValue" SG_ 98 ReSideRdrLeDetn69RdrDetnRngV 4000;
BA_ "GenSigSendType" SG_ 98 ReSideRdrLeDetn69RdrDetnSameRV 0;
BA_ "GenSigSendType" SG_ 98 ReSideRdrLeDetn69RdrDetnSts 0;
BA_ "GenSigStartValue" SG_ 98 ReSideRdrLeDetn69RdrDetnSts 3;
BA_ "GenSigSendType" SG_ 98 ReSideRdrLeDetn70RdrDetnAmbigState 0;
BA_ "GenSigSendType" SG_ 98 ReSideRdrLeDetn70RdrDetnAssoTrkID 0;
BA_ "GenSigSendType" SG_ 98 ReSideRdrLeDetn70RdrDetnAzi 0;
BA_ "GenSigStartValue" SG_ 98 ReSideRdrLeDetn70RdrDetnAzi 900;
BA_ "GenSigDataID" SG_ 98 ReSideRdrLeDetn70RdrDetnChks "0x9D7";
BA_ "GenSigFuncType" SG_ 98 ReSideRdrLeDetn70RdrDetnChks 15;
BA_ "GenSigSendType" SG_ 98 ReSideRdrLeDetn70RdrDetnChks 0;
BA_ "GenSigFuncType" SG_ 98 ReSideRdrLeDetn70RdrDetnCntr 16;
BA_ "GenSigSendType" SG_ 98 ReSideRdrLeDetn70RdrDetnCntr 0;
BA_ "GenSigSendType" SG_ 98 ReSideRdrLeDetn70RdrDetnConf 0;
BA_ "GenSigSendType" SG_ 98 ReSideRdrLeDetn70RdrDetnElevn 0;
BA_ "GenSigStartValue" SG_ 98 ReSideRdrLeDetn70RdrDetnElevn 15;
BA_ "GenSigSendType" SG_ 98 ReSideRdrLeDetn70RdrDetnPwr 0;
BA_ "GenSigSendType" SG_ 98 ReSideRdrLeDetn70RdrDetnRng 0;
BA_ "GenSigStartValue" SG_ 98 ReSideRdrLeDetn70RdrDetnRng 10050;
BA_ "GenSigSendType" SG_ 98 ReSideRdrLeDetn70RdrDetnRngV 0;
BA_ "GenSigStartValue" SG_ 98 ReSideRdrLeDetn70RdrDetnRngV 4000;
BA_ "GenSigSendType" SG_ 98 ReSideRdrLeDetn70RdrDetnSameRV 0;
BA_ "GenSigSendType" SG_ 98 ReSideRdrLeDetn70RdrDetnSts 0;
BA_ "GenSigStartValue" SG_ 98 ReSideRdrLeDetn70RdrDetnSts 3;
BA_ "GenSigSendType" SG_ 98 ReSideRdrLeDetn71RdrDetnAmbigState 0;
BA_ "GenSigSendType" SG_ 98 ReSideRdrLeDetn71RdrDetnAssoTrkID 0;
BA_ "GenSigSendType" SG_ 98 ReSideRdrLeDetn71RdrDetnAzi 0;
BA_ "GenSigStartValue" SG_ 98 ReSideRdrLeDetn71RdrDetnAzi 900;
BA_ "GenSigDataID" SG_ 98 ReSideRdrLeDetn71RdrDetnChks "0x9D8";
BA_ "GenSigFuncType" SG_ 98 ReSideRdrLeDetn71RdrDetnChks 15;
BA_ "GenSigSendType" SG_ 98 ReSideRdrLeDetn71RdrDetnChks 0;
BA_ "GenSigFuncType" SG_ 98 ReSideRdrLeDetn71RdrDetnCntr 16;
BA_ "GenSigSendType" SG_ 98 ReSideRdrLeDetn71RdrDetnCntr 0;
BA_ "GenSigSendType" SG_ 98 ReSideRdrLeDetn71RdrDetnConf 0;
BA_ "GenSigSendType" SG_ 98 ReSideRdrLeDetn71RdrDetnElevn 0;
BA_ "GenSigStartValue" SG_ 98 ReSideRdrLeDetn71RdrDetnElevn 15;
BA_ "GenSigSendType" SG_ 98 ReSideRdrLeDetn71RdrDetnPwr 0;
BA_ "GenSigSendType" SG_ 98 ReSideRdrLeDetn71RdrDetnRng 0;
BA_ "GenSigStartValue" SG_ 98 ReSideRdrLeDetn71RdrDetnRng 10050;
BA_ "GenSigSendType" SG_ 98 ReSideRdrLeDetn71RdrDetnRngV 0;
BA_ "GenSigStartValue" SG_ 98 ReSideRdrLeDetn71RdrDetnRngV 4000;
BA_ "GenSigSendType" SG_ 98 ReSideRdrLeDetn71RdrDetnSameRV 0;
BA_ "GenSigSendType" SG_ 98 ReSideRdrLeDetn71RdrDetnSts 0;
BA_ "GenSigStartValue" SG_ 98 ReSideRdrLeDetn71RdrDetnSts 3;
BA_ "GenSigSendType" SG_ 98 ReSideRdrLeDetn72RdrDetnAmbigState 0;
BA_ "GenSigSendType" SG_ 98 ReSideRdrLeDetn72RdrDetnAssoTrkID 0;
BA_ "GenSigSendType" SG_ 98 ReSideRdrLeDetn72RdrDetnAzi 0;
BA_ "GenSigStartValue" SG_ 98 ReSideRdrLeDetn72RdrDetnAzi 900;
BA_ "GenSigDataID" SG_ 98 ReSideRdrLeDetn72RdrDetnChks "0x9D9";
BA_ "GenSigFuncType" SG_ 98 ReSideRdrLeDetn72RdrDetnChks 15;
BA_ "GenSigSendType" SG_ 98 ReSideRdrLeDetn72RdrDetnChks 0;
BA_ "GenSigFuncType" SG_ 98 ReSideRdrLeDetn72RdrDetnCntr 16;
BA_ "GenSigSendType" SG_ 98 ReSideRdrLeDetn72RdrDetnCntr 0;
BA_ "GenSigSendType" SG_ 98 ReSideRdrLeDetn72RdrDetnConf 0;
BA_ "GenSigSendType" SG_ 98 ReSideRdrLeDetn72RdrDetnElevn 0;
BA_ "GenSigStartValue" SG_ 98 ReSideRdrLeDetn72RdrDetnElevn 15;
BA_ "GenSigSendType" SG_ 98 ReSideRdrLeDetn72RdrDetnPwr 0;
BA_ "GenSigSendType" SG_ 98 ReSideRdrLeDetn72RdrDetnRng 0;
BA_ "GenSigStartValue" SG_ 98 ReSideRdrLeDetn72RdrDetnRng 10050;
BA_ "GenSigSendType" SG_ 98 ReSideRdrLeDetn72RdrDetnRngV 0;
BA_ "GenSigStartValue" SG_ 98 ReSideRdrLeDetn72RdrDetnRngV 4000;
BA_ "GenSigSendType" SG_ 98 ReSideRdrLeDetn72RdrDetnSameRV 0;
BA_ "GenSigSendType" SG_ 98 ReSideRdrLeDetn72RdrDetnSts 0;
BA_ "GenSigStartValue" SG_ 98 ReSideRdrLeDetn72RdrDetnSts 3;
BA_ "GenSigSendType" SG_ 99 ReSideRdrLeDetn73RdrDetnAmbigState 0;
BA_ "GenSigSendType" SG_ 99 ReSideRdrLeDetn73RdrDetnAssoTrkID 0;
BA_ "GenSigSendType" SG_ 99 ReSideRdrLeDetn73RdrDetnAzi 0;
BA_ "GenSigStartValue" SG_ 99 ReSideRdrLeDetn73RdrDetnAzi 900;
BA_ "GenSigDataID" SG_ 99 ReSideRdrLeDetn73RdrDetnChks "0x9DA";
BA_ "GenSigFuncType" SG_ 99 ReSideRdrLeDetn73RdrDetnChks 15;
BA_ "GenSigSendType" SG_ 99 ReSideRdrLeDetn73RdrDetnChks 0;
BA_ "GenSigFuncType" SG_ 99 ReSideRdrLeDetn73RdrDetnCntr 16;
BA_ "GenSigSendType" SG_ 99 ReSideRdrLeDetn73RdrDetnCntr 0;
BA_ "GenSigSendType" SG_ 99 ReSideRdrLeDetn73RdrDetnConf 0;
BA_ "GenSigSendType" SG_ 99 ReSideRdrLeDetn73RdrDetnElevn 0;
BA_ "GenSigStartValue" SG_ 99 ReSideRdrLeDetn73RdrDetnElevn 15;
BA_ "GenSigSendType" SG_ 99 ReSideRdrLeDetn73RdrDetnPwr 0;
BA_ "GenSigSendType" SG_ 99 ReSideRdrLeDetn73RdrDetnRng 0;
BA_ "GenSigStartValue" SG_ 99 ReSideRdrLeDetn73RdrDetnRng 10050;
BA_ "GenSigSendType" SG_ 99 ReSideRdrLeDetn73RdrDetnRngV 0;
BA_ "GenSigStartValue" SG_ 99 ReSideRdrLeDetn73RdrDetnRngV 4000;
BA_ "GenSigSendType" SG_ 99 ReSideRdrLeDetn73RdrDetnSameRV 0;
BA_ "GenSigSendType" SG_ 99 ReSideRdrLeDetn73RdrDetnSts 0;
BA_ "GenSigStartValue" SG_ 99 ReSideRdrLeDetn73RdrDetnSts 3;
BA_ "GenSigSendType" SG_ 99 ReSideRdrLeDetn74RdrDetnAmbigState 0;
BA_ "GenSigSendType" SG_ 99 ReSideRdrLeDetn74RdrDetnAssoTrkID 0;
BA_ "GenSigSendType" SG_ 99 ReSideRdrLeDetn74RdrDetnAzi 0;
BA_ "GenSigStartValue" SG_ 99 ReSideRdrLeDetn74RdrDetnAzi 900;
BA_ "GenSigDataID" SG_ 99 ReSideRdrLeDetn74RdrDetnChks "0x9DB";
BA_ "GenSigFuncType" SG_ 99 ReSideRdrLeDetn74RdrDetnChks 15;
BA_ "GenSigSendType" SG_ 99 ReSideRdrLeDetn74RdrDetnChks 0;
BA_ "GenSigFuncType" SG_ 99 ReSideRdrLeDetn74RdrDetnCntr 16;
BA_ "GenSigSendType" SG_ 99 ReSideRdrLeDetn74RdrDetnCntr 0;
BA_ "GenSigSendType" SG_ 99 ReSideRdrLeDetn74RdrDetnConf 0;
BA_ "GenSigSendType" SG_ 99 ReSideRdrLeDetn74RdrDetnElevn 0;
BA_ "GenSigStartValue" SG_ 99 ReSideRdrLeDetn74RdrDetnElevn 15;
BA_ "GenSigSendType" SG_ 99 ReSideRdrLeDetn74RdrDetnPwr 0;
BA_ "GenSigSendType" SG_ 99 ReSideRdrLeDetn74RdrDetnRng 0;
BA_ "GenSigStartValue" SG_ 99 ReSideRdrLeDetn74RdrDetnRng 10050;
BA_ "GenSigSendType" SG_ 99 ReSideRdrLeDetn74RdrDetnRngV 0;
BA_ "GenSigStartValue" SG_ 99 ReSideRdrLeDetn74RdrDetnRngV 4000;
BA_ "GenSigSendType" SG_ 99 ReSideRdrLeDetn74RdrDetnSameRV 0;
BA_ "GenSigSendType" SG_ 99 ReSideRdrLeDetn74RdrDetnSts 0;
BA_ "GenSigStartValue" SG_ 99 ReSideRdrLeDetn74RdrDetnSts 3;
BA_ "GenSigSendType" SG_ 99 ReSideRdrLeDetn75RdrDetnAmbigState 0;
BA_ "GenSigSendType" SG_ 99 ReSideRdrLeDetn75RdrDetnAssoTrkID 0;
BA_ "GenSigSendType" SG_ 99 ReSideRdrLeDetn75RdrDetnAzi 0;
BA_ "GenSigStartValue" SG_ 99 ReSideRdrLeDetn75RdrDetnAzi 900;
BA_ "GenSigDataID" SG_ 99 ReSideRdrLeDetn75RdrDetnChks "0x9DC";
BA_ "GenSigFuncType" SG_ 99 ReSideRdrLeDetn75RdrDetnChks 15;
BA_ "GenSigSendType" SG_ 99 ReSideRdrLeDetn75RdrDetnChks 0;
BA_ "GenSigFuncType" SG_ 99 ReSideRdrLeDetn75RdrDetnCntr 16;
BA_ "GenSigSendType" SG_ 99 ReSideRdrLeDetn75RdrDetnCntr 0;
BA_ "GenSigSendType" SG_ 99 ReSideRdrLeDetn75RdrDetnConf 0;
BA_ "GenSigSendType" SG_ 99 ReSideRdrLeDetn75RdrDetnElevn 0;
BA_ "GenSigStartValue" SG_ 99 ReSideRdrLeDetn75RdrDetnElevn 15;
BA_ "GenSigSendType" SG_ 99 ReSideRdrLeDetn75RdrDetnPwr 0;
BA_ "GenSigSendType" SG_ 99 ReSideRdrLeDetn75RdrDetnRng 0;
BA_ "GenSigStartValue" SG_ 99 ReSideRdrLeDetn75RdrDetnRng 10050;
BA_ "GenSigSendType" SG_ 99 ReSideRdrLeDetn75RdrDetnRngV 0;
BA_ "GenSigStartValue" SG_ 99 ReSideRdrLeDetn75RdrDetnRngV 4000;
BA_ "GenSigSendType" SG_ 99 ReSideRdrLeDetn75RdrDetnSameRV 0;
BA_ "GenSigSendType" SG_ 99 ReSideRdrLeDetn75RdrDetnSts 0;
BA_ "GenSigStartValue" SG_ 99 ReSideRdrLeDetn75RdrDetnSts 3;
BA_ "GenSigSendType" SG_ 99 ReSideRdrLeDetn76RdrDetnAmbigState 0;
BA_ "GenSigSendType" SG_ 99 ReSideRdrLeDetn76RdrDetnAssoTrkID 0;
BA_ "GenSigSendType" SG_ 99 ReSideRdrLeDetn76RdrDetnAzi 0;
BA_ "GenSigStartValue" SG_ 99 ReSideRdrLeDetn76RdrDetnAzi 900;
BA_ "GenSigDataID" SG_ 99 ReSideRdrLeDetn76RdrDetnChks "0x9DD";
BA_ "GenSigFuncType" SG_ 99 ReSideRdrLeDetn76RdrDetnChks 15;
BA_ "GenSigSendType" SG_ 99 ReSideRdrLeDetn76RdrDetnChks 0;
BA_ "GenSigFuncType" SG_ 99 ReSideRdrLeDetn76RdrDetnCntr 16;
BA_ "GenSigSendType" SG_ 99 ReSideRdrLeDetn76RdrDetnCntr 0;
BA_ "GenSigSendType" SG_ 99 ReSideRdrLeDetn76RdrDetnConf 0;
BA_ "GenSigSendType" SG_ 99 ReSideRdrLeDetn76RdrDetnElevn 0;
BA_ "GenSigStartValue" SG_ 99 ReSideRdrLeDetn76RdrDetnElevn 15;
BA_ "GenSigSendType" SG_ 99 ReSideRdrLeDetn76RdrDetnPwr 0;
BA_ "GenSigSendType" SG_ 99 ReSideRdrLeDetn76RdrDetnRng 0;
BA_ "GenSigStartValue" SG_ 99 ReSideRdrLeDetn76RdrDetnRng 10050;
BA_ "GenSigSendType" SG_ 99 ReSideRdrLeDetn76RdrDetnRngV 0;
BA_ "GenSigStartValue" SG_ 99 ReSideRdrLeDetn76RdrDetnRngV 4000;
BA_ "GenSigSendType" SG_ 99 ReSideRdrLeDetn76RdrDetnSameRV 0;
BA_ "GenSigSendType" SG_ 99 ReSideRdrLeDetn76RdrDetnSts 0;
BA_ "GenSigStartValue" SG_ 99 ReSideRdrLeDetn76RdrDetnSts 3;
BA_ "GenSigSendType" SG_ 99 ReSideRdrLeDetn77RdrDetnAmbigState 0;
BA_ "GenSigSendType" SG_ 99 ReSideRdrLeDetn77RdrDetnAssoTrkID 0;
BA_ "GenSigSendType" SG_ 99 ReSideRdrLeDetn77RdrDetnAzi 0;
BA_ "GenSigStartValue" SG_ 99 ReSideRdrLeDetn77RdrDetnAzi 900;
BA_ "GenSigDataID" SG_ 99 ReSideRdrLeDetn77RdrDetnChks "0x9DE";
BA_ "GenSigFuncType" SG_ 99 ReSideRdrLeDetn77RdrDetnChks 15;
BA_ "GenSigSendType" SG_ 99 ReSideRdrLeDetn77RdrDetnChks 0;
BA_ "GenSigFuncType" SG_ 99 ReSideRdrLeDetn77RdrDetnCntr 16;
BA_ "GenSigSendType" SG_ 99 ReSideRdrLeDetn77RdrDetnCntr 0;
BA_ "GenSigSendType" SG_ 99 ReSideRdrLeDetn77RdrDetnConf 0;
BA_ "GenSigSendType" SG_ 99 ReSideRdrLeDetn77RdrDetnElevn 0;
BA_ "GenSigStartValue" SG_ 99 ReSideRdrLeDetn77RdrDetnElevn 15;
BA_ "GenSigSendType" SG_ 99 ReSideRdrLeDetn77RdrDetnPwr 0;
BA_ "GenSigSendType" SG_ 99 ReSideRdrLeDetn77RdrDetnRng 0;
BA_ "GenSigStartValue" SG_ 99 ReSideRdrLeDetn77RdrDetnRng 10050;
BA_ "GenSigSendType" SG_ 99 ReSideRdrLeDetn77RdrDetnRngV 0;
BA_ "GenSigStartValue" SG_ 99 ReSideRdrLeDetn77RdrDetnRngV 4000;
BA_ "GenSigSendType" SG_ 99 ReSideRdrLeDetn77RdrDetnSameRV 0;
BA_ "GenSigSendType" SG_ 99 ReSideRdrLeDetn77RdrDetnSts 0;
BA_ "GenSigStartValue" SG_ 99 ReSideRdrLeDetn77RdrDetnSts 3;
BA_ "GenSigSendType" SG_ 99 ReSideRdrLeDetn78RdrDetnAmbigState 0;
BA_ "GenSigSendType" SG_ 99 ReSideRdrLeDetn78RdrDetnAssoTrkID 0;
BA_ "GenSigSendType" SG_ 99 ReSideRdrLeDetn78RdrDetnAzi 0;
BA_ "GenSigStartValue" SG_ 99 ReSideRdrLeDetn78RdrDetnAzi 900;
BA_ "GenSigDataID" SG_ 99 ReSideRdrLeDetn78RdrDetnChks "0x9DF";
BA_ "GenSigFuncType" SG_ 99 ReSideRdrLeDetn78RdrDetnChks 15;
BA_ "GenSigSendType" SG_ 99 ReSideRdrLeDetn78RdrDetnChks 0;
BA_ "GenSigFuncType" SG_ 99 ReSideRdrLeDetn78RdrDetnCntr 16;
BA_ "GenSigSendType" SG_ 99 ReSideRdrLeDetn78RdrDetnCntr 0;
BA_ "GenSigSendType" SG_ 99 ReSideRdrLeDetn78RdrDetnConf 0;
BA_ "GenSigSendType" SG_ 99 ReSideRdrLeDetn78RdrDetnElevn 0;
BA_ "GenSigStartValue" SG_ 99 ReSideRdrLeDetn78RdrDetnElevn 15;
BA_ "GenSigSendType" SG_ 99 ReSideRdrLeDetn78RdrDetnPwr 0;
BA_ "GenSigSendType" SG_ 99 ReSideRdrLeDetn78RdrDetnRng 0;
BA_ "GenSigStartValue" SG_ 99 ReSideRdrLeDetn78RdrDetnRng 10050;
BA_ "GenSigSendType" SG_ 99 ReSideRdrLeDetn78RdrDetnRngV 0;
BA_ "GenSigStartValue" SG_ 99 ReSideRdrLeDetn78RdrDetnRngV 4000;
BA_ "GenSigSendType" SG_ 99 ReSideRdrLeDetn78RdrDetnSameRV 0;
BA_ "GenSigSendType" SG_ 99 ReSideRdrLeDetn78RdrDetnSts 0;
BA_ "GenSigStartValue" SG_ 99 ReSideRdrLeDetn78RdrDetnSts 3;
VAL_ 87 ReSideRdrLeDetn37RdrDetnAmbigState 0 "YesNo1_Yes" 1 "YesNo1_No";
VAL_ 87 ReSideRdrLeDetn37RdrDetnSameRV 0 "Mode6_0" 1 "Mode6_1" 2 "Mode6_2";
VAL_ 87 ReSideRdrLeDetn37RdrDetnSts 0 "RdrDetnSts_Ukwn" 1 "RdrDetnSts_Movg" 2 "RdrDetnSts_Staty" 3 "RdrDetnSts_Invalid";
VAL_ 87 ReSideRdrLeDetn38RdrDetnAmbigState 0 "YesNo1_Yes" 1 "YesNo1_No";
VAL_ 87 ReSideRdrLeDetn38RdrDetnSameRV 0 "Mode6_0" 1 "Mode6_1" 2 "Mode6_2";
VAL_ 87 ReSideRdrLeDetn38RdrDetnSts 0 "RdrDetnSts_Ukwn" 1 "RdrDetnSts_Movg" 2 "RdrDetnSts_Staty" 3 "RdrDetnSts_Invalid";
VAL_ 87 ReSideRdrLeDetn39RdrDetnAmbigState 0 "YesNo1_Yes" 1 "YesNo1_No";
VAL_ 87 ReSideRdrLeDetn39RdrDetnSameRV 0 "Mode6_0" 1 "Mode6_1" 2 "Mode6_2";
VAL_ 87 ReSideRdrLeDetn39RdrDetnSts 0 "RdrDetnSts_Ukwn" 1 "RdrDetnSts_Movg" 2 "RdrDetnSts_Staty" 3 "RdrDetnSts_Invalid";
VAL_ 87 ReSideRdrLeDetn40RdrDetnAmbigState 0 "YesNo1_Yes" 1 "YesNo1_No";
VAL_ 87 ReSideRdrLeDetn40RdrDetnSameRV 0 "Mode6_0" 1 "Mode6_1" 2 "Mode6_2";
VAL_ 87 ReSideRdrLeDetn40RdrDetnSts 0 "RdrDetnSts_Ukwn" 1 "RdrDetnSts_Movg" 2 "RdrDetnSts_Staty" 3 "RdrDetnSts_Invalid";
VAL_ 87 ReSideRdrLeDetn41RdrDetnAmbigState 0 "YesNo1_Yes" 1 "YesNo1_No";
VAL_ 87 ReSideRdrLeDetn41RdrDetnSameRV 0 "Mode6_0" 1 "Mode6_1" 2 "Mode6_2";
VAL_ 87 ReSideRdrLeDetn41RdrDetnSts 0 "RdrDetnSts_Ukwn" 1 "RdrDetnSts_Movg" 2 "RdrDetnSts_Staty" 3 "RdrDetnSts_Invalid";
VAL_ 87 ReSideRdrLeDetn42RdrDetnAmbigState 0 "YesNo1_Yes" 1 "YesNo1_No";
VAL_ 87 ReSideRdrLeDetn42RdrDetnSameRV 0 "Mode6_0" 1 "Mode6_1" 2 "Mode6_2";
VAL_ 87 ReSideRdrLeDetn42RdrDetnSts 0 "RdrDetnSts_Ukwn" 1 "RdrDetnSts_Movg" 2 "RdrDetnSts_Staty" 3 "RdrDetnSts_Invalid";
VAL_ 88 ReSideRdrLeDetn43RdrDetnAmbigState 0 "YesNo1_Yes" 1 "YesNo1_No";
VAL_ 88 ReSideRdrLeDetn43RdrDetnSameRV 0 "Mode6_0" 1 "Mode6_1" 2 "Mode6_2";
VAL_ 88 ReSideRdrLeDetn43RdrDetnSts 0 "RdrDetnSts_Ukwn" 1 "RdrDetnSts_Movg" 2 "RdrDetnSts_Staty" 3 "RdrDetnSts_Invalid";
VAL_ 88 ReSideRdrLeDetn44RdrDetnAmbigState 0 "YesNo1_Yes" 1 "YesNo1_No";
VAL_ 88 ReSideRdrLeDetn44RdrDetnSameRV 0 "Mode6_0" 1 "Mode6_1" 2 "Mode6_2";
VAL_ 88 ReSideRdrLeDetn44RdrDetnSts 0 "RdrDetnSts_Ukwn" 1 "RdrDetnSts_Movg" 2 "RdrDetnSts_Staty" 3 "RdrDetnSts_Invalid";
VAL_ 88 ReSideRdrLeDetn45RdrDetnAmbigState 0 "YesNo1_Yes" 1 "YesNo1_No";
VAL_ 88 ReSideRdrLeDetn45RdrDetnSameRV 0 "Mode6_0" 1 "Mode6_1" 2 "Mode6_2";
VAL_ 88 ReSideRdrLeDetn45RdrDetnSts 0 "RdrDetnSts_Ukwn" 1 "RdrDetnSts_Movg" 2 "RdrDetnSts_Staty" 3 "RdrDetnSts_Invalid";
VAL_ 88 ReSideRdrLeDetn46RdrDetnAmbigState 0 "YesNo1_Yes" 1 "YesNo1_No";
VAL_ 88 ReSideRdrLeDetn46RdrDetnSameRV 0 "Mode6_0" 1 "Mode6_1" 2 "Mode6_2";
VAL_ 88 ReSideRdrLeDetn46RdrDetnSts 0 "RdrDetnSts_Ukwn" 1 "RdrDetnSts_Movg" 2 "RdrDetnSts_Staty" 3 "RdrDetnSts_Invalid";
VAL_ 88 ReSideRdrLeDetn47RdrDetnAmbigState 0 "YesNo1_Yes" 1 "YesNo1_No";
VAL_ 88 ReSideRdrLeDetn47RdrDetnSameRV 0 "Mode6_0" 1 "Mode6_1" 2 "Mode6_2";
VAL_ 88 ReSideRdrLeDetn47RdrDetnSts 0 "RdrDetnSts_Ukwn" 1 "RdrDetnSts_Movg" 2 "RdrDetnSts_Staty" 3 "RdrDetnSts_Invalid";
VAL_ 88 ReSideRdrLeDetn48RdrDetnAmbigState 0 "YesNo1_Yes" 1 "YesNo1_No";
VAL_ 88 ReSideRdrLeDetn48RdrDetnSameRV 0 "Mode6_0" 1 "Mode6_1" 2 "Mode6_2";
VAL_ 88 ReSideRdrLeDetn48RdrDetnSts 0 "RdrDetnSts_Ukwn" 1 "RdrDetnSts_Movg" 2 "RdrDetnSts_Staty" 3 "RdrDetnSts_Invalid";
VAL_ 89 ReSideRdrLeDetn49RdrDetnAmbigState 0 "YesNo1_Yes" 1 "YesNo1_No";
VAL_ 89 ReSideRdrLeDetn49RdrDetnSameRV 0 "Mode6_0" 1 "Mode6_1" 2 "Mode6_2";
VAL_ 89 ReSideRdrLeDetn49RdrDetnSts 0 "RdrDetnSts_Ukwn" 1 "RdrDetnSts_Movg" 2 "RdrDetnSts_Staty" 3 "RdrDetnSts_Invalid";
VAL_ 89 ReSideRdrLeDetn50RdrDetnAmbigState 0 "YesNo1_Yes" 1 "YesNo1_No";
VAL_ 89 ReSideRdrLeDetn50RdrDetnSameRV 0 "Mode6_0" 1 "Mode6_1" 2 "Mode6_2";
VAL_ 89 ReSideRdrLeDetn50RdrDetnSts 0 "RdrDetnSts_Ukwn" 1 "RdrDetnSts_Movg" 2 "RdrDetnSts_Staty" 3 "RdrDetnSts_Invalid";
VAL_ 89 ReSideRdrLeDetn51RdrDetnAmbigState 0 "YesNo1_Yes" 1 "YesNo1_No";
VAL_ 89 ReSideRdrLeDetn51RdrDetnSameRV 0 "Mode6_0" 1 "Mode6_1" 2 "Mode6_2";
VAL_ 89 ReSideRdrLeDetn51RdrDetnSts 0 "RdrDetnSts_Ukwn" 1 "RdrDetnSts_Movg" 2 "RdrDetnSts_Staty" 3 "RdrDetnSts_Invalid";
VAL_ 89 ReSideRdrLeDetn52RdrDetnAmbigState 0 "YesNo1_Yes" 1 "YesNo1_No";
VAL_ 89 ReSideRdrLeDetn52RdrDetnSameRV 0 "Mode6_0" 1 "Mode6_1" 2 "Mode6_2";
VAL_ 89 ReSideRdrLeDetn52RdrDetnSts 0 "RdrDetnSts_Ukwn" 1 "RdrDetnSts_Movg" 2 "RdrDetnSts_Staty" 3 "RdrDetnSts_Invalid";
VAL_ 89 ReSideRdrLeDetn53RdrDetnAmbigState 0 "YesNo1_Yes" 1 "YesNo1_No";
VAL_ 89 ReSideRdrLeDetn53RdrDetnSameRV 0 "Mode6_0" 1 "Mode6_1" 2 "Mode6_2";
VAL_ 89 ReSideRdrLeDetn53RdrDetnSts 0 "RdrDetnSts_Ukwn" 1 "RdrDetnSts_Movg" 2 "RdrDetnSts_Staty" 3 "RdrDetnSts_Invalid";
VAL_ 89 ReSideRdrLeDetn54RdrDetnAmbigState 0 "YesNo1_Yes" 1 "YesNo1_No";
VAL_ 89 ReSideRdrLeDetn54RdrDetnSameRV 0 "Mode6_0" 1 "Mode6_1" 2 "Mode6_2";
VAL_ 89 ReSideRdrLeDetn54RdrDetnSts 0 "RdrDetnSts_Ukwn" 1 "RdrDetnSts_Movg" 2 "RdrDetnSts_Staty" 3 "RdrDetnSts_Invalid";
VAL_ 96 ReSideRdrLeDetn55RdrDetnAmbigState 0 "YesNo1_Yes" 1 "YesNo1_No";
VAL_ 96 ReSideRdrLeDetn55RdrDetnSameRV 0 "Mode6_0" 1 "Mode6_1" 2 "Mode6_2";
VAL_ 96 ReSideRdrLeDetn55RdrDetnSts 0 "RdrDetnSts_Ukwn" 1 "RdrDetnSts_Movg" 2 "RdrDetnSts_Staty" 3 "RdrDetnSts_Invalid";
VAL_ 96 ReSideRdrLeDetn56RdrDetnAmbigState 0 "YesNo1_Yes" 1 "YesNo1_No";
VAL_ 96 ReSideRdrLeDetn56RdrDetnSameRV 0 "Mode6_0" 1 "Mode6_1" 2 "Mode6_2";
VAL_ 96 ReSideRdrLeDetn56RdrDetnSts 0 "RdrDetnSts_Ukwn" 1 "RdrDetnSts_Movg" 2 "RdrDetnSts_Staty" 3 "RdrDetnSts_Invalid";
VAL_ 96 ReSideRdrLeDetn57RdrDetnAmbigState 0 "YesNo1_Yes" 1 "YesNo1_No";
VAL_ 96 ReSideRdrLeDetn57RdrDetnSameRV 0 "Mode6_0" 1 "Mode6_1" 2 "Mode6_2";
VAL_ 96 ReSideRdrLeDetn57RdrDetnSts 0 "RdrDetnSts_Ukwn" 1 "RdrDetnSts_Movg" 2 "RdrDetnSts_Staty" 3 "RdrDetnSts_Invalid";
VAL_ 96 ReSideRdrLeDetn58RdrDetnAmbigState 0 "YesNo1_Yes" 1 "YesNo1_No";
VAL_ 96 ReSideRdrLeDetn58RdrDetnSameRV 0 "Mode6_0" 1 "Mode6_1" 2 "Mode6_2";
VAL_ 96 ReSideRdrLeDetn58RdrDetnSts 0 "RdrDetnSts_Ukwn" 1 "RdrDetnSts_Movg" 2 "RdrDetnSts_Staty" 3 "RdrDetnSts_Invalid";
VAL_ 96 ReSideRdrLeDetn59RdrDetnAmbigState 0 "YesNo1_Yes" 1 "YesNo1_No";
VAL_ 96 ReSideRdrLeDetn59RdrDetnSameRV 0 "Mode6_0" 1 "Mode6_1" 2 "Mode6_2";
VAL_ 96 ReSideRdrLeDetn59RdrDetnSts 0 "RdrDetnSts_Ukwn" 1 "RdrDetnSts_Movg" 2 "RdrDetnSts_Staty" 3 "RdrDetnSts_Invalid";
VAL_ 96 ReSideRdrLeDetn60RdrDetnAmbigState 0 "YesNo1_Yes" 1 "YesNo1_No";
VAL_ 96 ReSideRdrLeDetn60RdrDetnSameRV 0 "Mode6_0" 1 "Mode6_1" 2 "Mode6_2";
VAL_ 96 ReSideRdrLeDetn60RdrDetnSts 0 "RdrDetnSts_Ukwn" 1 "RdrDetnSts_Movg" 2 "RdrDetnSts_Staty" 3 "RdrDetnSts_Invalid";
VAL_ 97 ReSideRdrLeDetn61RdrDetnAmbigState 0 "YesNo1_Yes" 1 "YesNo1_No";
VAL_ 97 ReSideRdrLeDetn61RdrDetnSameRV 0 "Mode6_0" 1 "Mode6_1" 2 "Mode6_2";
VAL_ 97 ReSideRdrLeDetn61RdrDetnSts 0 "RdrDetnSts_Ukwn" 1 "RdrDetnSts_Movg" 2 "RdrDetnSts_Staty" 3 "RdrDetnSts_Invalid";
VAL_ 97 ReSideRdrLeDetn62RdrDetnAmbigState 0 "YesNo1_Yes" 1 "YesNo1_No";
VAL_ 97 ReSideRdrLeDetn62RdrDetnSameRV 0 "Mode6_0" 1 "Mode6_1" 2 "Mode6_2";
VAL_ 97 ReSideRdrLeDetn62RdrDetnSts 0 "RdrDetnSts_Ukwn" 1 "RdrDetnSts_Movg" 2 "RdrDetnSts_Staty" 3 "RdrDetnSts_Invalid";
VAL_ 97 ReSideRdrLeDetn63RdrDetnAmbigState 0 "YesNo1_Yes" 1 "YesNo1_No";
VAL_ 97 ReSideRdrLeDetn63RdrDetnSameRV 0 "Mode6_0" 1 "Mode6_1" 2 "Mode6_2";
VAL_ 97 ReSideRdrLeDetn63RdrDetnSts 0 "RdrDetnSts_Ukwn" 1 "RdrDetnSts_Movg" 2 "RdrDetnSts_Staty" 3 "RdrDetnSts_Invalid";
VAL_ 97 ReSideRdrLeDetn64RdrDetnAmbigState 0 "YesNo1_Yes" 1 "YesNo1_No";
VAL_ 97 ReSideRdrLeDetn64RdrDetnSameRV 0 "Mode6_0" 1 "Mode6_1" 2 "Mode6_2";
VAL_ 97 ReSideRdrLeDetn64RdrDetnSts 0 "RdrDetnSts_Ukwn" 1 "RdrDetnSts_Movg" 2 "RdrDetnSts_Staty" 3 "RdrDetnSts_Invalid";
VAL_ 97 ReSideRdrLeDetn65RdrDetnAmbigState 0 "YesNo1_Yes" 1 "YesNo1_No";
VAL_ 97 ReSideRdrLeDetn65RdrDetnSameRV 0 "Mode6_0" 1 "Mode6_1" 2 "Mode6_2";
VAL_ 97 ReSideRdrLeDetn65RdrDetnSts 0 "RdrDetnSts_Ukwn" 1 "RdrDetnSts_Movg" 2 "RdrDetnSts_Staty" 3 "RdrDetnSts_Invalid";
VAL_ 97 ReSideRdrLeDetn66RdrDetnAmbigState 0 "YesNo1_Yes" 1 "YesNo1_No";
VAL_ 97 ReSideRdrLeDetn66RdrDetnSameRV 0 "Mode6_0" 1 "Mode6_1" 2 "Mode6_2";
VAL_ 97 ReSideRdrLeDetn66RdrDetnSts 0 "RdrDetnSts_Ukwn" 1 "RdrDetnSts_Movg" 2 "RdrDetnSts_Staty" 3 "RdrDetnSts_Invalid";
VAL_ 98 ReSideRdrLeDetn67RdrDetnAmbigState 0 "YesNo1_Yes" 1 "YesNo1_No";
VAL_ 98 ReSideRdrLeDetn67RdrDetnSameRV 0 "Mode6_0" 1 "Mode6_1" 2 "Mode6_2";
VAL_ 98 ReSideRdrLeDetn67RdrDetnSts 0 "RdrDetnSts_Ukwn" 1 "RdrDetnSts_Movg" 2 "RdrDetnSts_Staty" 3 "RdrDetnSts_Invalid";
VAL_ 98 ReSideRdrLeDetn68RdrDetnAmbigState 0 "YesNo1_Yes" 1 "YesNo1_No";
VAL_ 98 ReSideRdrLeDetn68RdrDetnSameRV 0 "Mode6_0" 1 "Mode6_1" 2 "Mode6_2";
VAL_ 98 ReSideRdrLeDetn68RdrDetnSts 0 "RdrDetnSts_Ukwn" 1 "RdrDetnSts_Movg" 2 "RdrDetnSts_Staty" 3 "RdrDetnSts_Invalid";
VAL_ 98 ReSideRdrLeDetn69RdrDetnAmbigState 0 "YesNo1_Yes" 1 "YesNo1_No";
VAL_ 98 ReSideRdrLeDetn69RdrDetnSameRV 0 "Mode6_0" 1 "Mode6_1" 2 "Mode6_2";
VAL_ 98 ReSideRdrLeDetn69RdrDetnSts 0 "RdrDetnSts_Ukwn" 1 "RdrDetnSts_Movg" 2 "RdrDetnSts_Staty" 3 "RdrDetnSts_Invalid";
VAL_ 98 ReSideRdrLeDetn70RdrDetnAmbigState 0 "YesNo1_Yes" 1 "YesNo1_No";
VAL_ 98 ReSideRdrLeDetn70RdrDetnSameRV 0 "Mode6_0" 1 "Mode6_1" 2 "Mode6_2";
VAL_ 98 ReSideRdrLeDetn70RdrDetnSts 0 "RdrDetnSts_Ukwn" 1 "RdrDetnSts_Movg" 2 "RdrDetnSts_Staty" 3 "RdrDetnSts_Invalid";
VAL_ 98 ReSideRdrLeDetn71RdrDetnAmbigState 0 "YesNo1_Yes" 1 "YesNo1_No";
VAL_ 98 ReSideRdrLeDetn71RdrDetnSameRV 0 "Mode6_0" 1 "Mode6_1" 2 "Mode6_2";
VAL_ 98 ReSideRdrLeDetn71RdrDetnSts 0 "RdrDetnSts_Ukwn" 1 "RdrDetnSts_Movg" 2 "RdrDetnSts_Staty" 3 "RdrDetnSts_Invalid";
VAL_ 98 ReSideRdrLeDetn72RdrDetnAmbigState 0 "YesNo1_Yes" 1 "YesNo1_No";
VAL_ 98 ReSideRdrLeDetn72RdrDetnSameRV 0 "Mode6_0" 1 "Mode6_1" 2 "Mode6_2";
VAL_ 98 ReSideRdrLeDetn72RdrDetnSts 0 "RdrDetnSts_Ukwn" 1 "RdrDetnSts_Movg" 2 "RdrDetnSts_Staty" 3 "RdrDetnSts_Invalid";
VAL_ 99 ReSideRdrLeDetn73RdrDetnAmbigState 0 "YesNo1_Yes" 1 "YesNo1_No";
VAL_ 99 ReSideRdrLeDetn73RdrDetnSameRV 0 "Mode6_0" 1 "Mode6_1" 2 "Mode6_2";
VAL_ 99 ReSideRdrLeDetn73RdrDetnSts 0 "RdrDetnSts_Ukwn" 1 "RdrDetnSts_Movg" 2 "RdrDetnSts_Staty" 3 "RdrDetnSts_Invalid";
VAL_ 99 ReSideRdrLeDetn74RdrDetnAmbigState 0 "YesNo1_Yes" 1 "YesNo1_No";
VAL_ 99 ReSideRdrLeDetn74RdrDetnSameRV 0 "Mode6_0" 1 "Mode6_1" 2 "Mode6_2";
VAL_ 99 ReSideRdrLeDetn74RdrDetnSts 0 "RdrDetnSts_Ukwn" 1 "RdrDetnSts_Movg" 2 "RdrDetnSts_Staty" 3 "RdrDetnSts_Invalid";
VAL_ 99 ReSideRdrLeDetn75RdrDetnAmbigState 0 "YesNo1_Yes" 1 "YesNo1_No";
VAL_ 99 ReSideRdrLeDetn75RdrDetnSameRV 0 "Mode6_0" 1 "Mode6_1" 2 "Mode6_2";
VAL_ 99 ReSideRdrLeDetn75RdrDetnSts 0 "RdrDetnSts_Ukwn" 1 "RdrDetnSts_Movg" 2 "RdrDetnSts_Staty" 3 "RdrDetnSts_Invalid";
VAL_ 99 ReSideRdrLeDetn76RdrDetnAmbigState 0 "YesNo1_Yes" 1 "YesNo1_No";
VAL_ 99 ReSideRdrLeDetn76RdrDetnSameRV 0 "Mode6_0" 1 "Mode6_1" 2 "Mode6_2";
VAL_ 99 ReSideRdrLeDetn76RdrDetnSts 0 "RdrDetnSts_Ukwn" 1 "RdrDetnSts_Movg" 2 "RdrDetnSts_Staty" 3 "RdrDetnSts_Invalid";
VAL_ 99 ReSideRdrLeDetn77RdrDetnAmbigState 0 "YesNo1_Yes" 1 "YesNo1_No";
VAL_ 99 ReSideRdrLeDetn77RdrDetnSameRV 0 "Mode6_0" 1 "Mode6_1" 2 "Mode6_2";
VAL_ 99 ReSideRdrLeDetn77RdrDetnSts 0 "RdrDetnSts_Ukwn" 1 "RdrDetnSts_Movg" 2 "RdrDetnSts_Staty" 3 "RdrDetnSts_Invalid";
VAL_ 99 ReSideRdrLeDetn78RdrDetnAmbigState 0 "YesNo1_Yes" 1 "YesNo1_No";
VAL_ 99 ReSideRdrLeDetn78RdrDetnSameRV 0 "Mode6_0" 1 "Mode6_1" 2 "Mode6_2";
VAL_ 99 ReSideRdrLeDetn78RdrDetnSts 0 "RdrDetnSts_Ukwn" 1 "RdrDetnSts_Movg" 2 "RdrDetnSts_Staty" 3 "RdrDetnSts_Invalid";
SIG_GROUP_ 87 ReSideRdrLeDetn37 1 : ReSideRdrLeDetn37RdrDetnAmbigState ReSideRdrLeDetn37RdrDetnAssoTrkID ReSideRdrLeDetn37RdrDetnAzi ReSideRdrLeDetn37RdrDetnChks ReSideRdrLeDetn37RdrDetnCntr ReSideRdrLeDetn37RdrDetnConf ReSideRdrLeDetn37RdrDetnElevn ReSideRdrLeDetn37RdrDetnPwr ReSideRdrLeDetn37RdrDetnRng ReSideRdrLeDetn37RdrDetnRngV ReSideRdrLeDetn37RdrDetnSameRV ReSideRdrLeDetn37RdrDetnSts;
SIG_GROUP_ 87 ReSideRdrLeDetn38 1 : ReSideRdrLeDetn38RdrDetnAmbigState ReSideRdrLeDetn38RdrDetnAssoTrkID ReSideRdrLeDetn38RdrDetnAzi ReSideRdrLeDetn38RdrDetnChks ReSideRdrLeDetn38RdrDetnCntr ReSideRdrLeDetn38RdrDetnConf ReSideRdrLeDetn38RdrDetnElevn ReSideRdrLeDetn38RdrDetnPwr ReSideRdrLeDetn38RdrDetnRng ReSideRdrLeDetn38RdrDetnRngV ReSideRdrLeDetn38RdrDetnSameRV ReSideRdrLeDetn38RdrDetnSts;
SIG_GROUP_ 87 ReSideRdrLeDetn39 1 : ReSideRdrLeDetn39RdrDetnAmbigState ReSideRdrLeDetn39RdrDetnAssoTrkID ReSideRdrLeDetn39RdrDetnAzi ReSideRdrLeDetn39RdrDetnChks ReSideRdrLeDetn39RdrDetnCntr ReSideRdrLeDetn39RdrDetnConf ReSideRdrLeDetn39RdrDetnElevn ReSideRdrLeDetn39RdrDetnPwr ReSideRdrLeDetn39RdrDetnRng ReSideRdrLeDetn39RdrDetnRngV ReSideRdrLeDetn39RdrDetnSameRV ReSideRdrLeDetn39RdrDetnSts;
SIG_GROUP_ 87 ReSideRdrLeDetn40 1 : ReSideRdrLeDetn40RdrDetnAmbigState ReSideRdrLeDetn40RdrDetnAssoTrkID ReSideRdrLeDetn40RdrDetnAzi ReSideRdrLeDetn40RdrDetnChks ReSideRdrLeDetn40RdrDetnCntr ReSideRdrLeDetn40RdrDetnConf ReSideRdrLeDetn40RdrDetnElevn ReSideRdrLeDetn40RdrDetnPwr ReSideRdrLeDetn40RdrDetnRng ReSideRdrLeDetn40RdrDetnRngV ReSideRdrLeDetn40RdrDetnSameRV ReSideRdrLeDetn40RdrDetnSts;
SIG_GROUP_ 87 ReSideRdrLeDetn41 1 : ReSideRdrLeDetn41RdrDetnAmbigState ReSideRdrLeDetn41RdrDetnAssoTrkID ReSideRdrLeDetn41RdrDetnAzi ReSideRdrLeDetn41RdrDetnChks ReSideRdrLeDetn41RdrDetnCntr ReSideRdrLeDetn41RdrDetnConf ReSideRdrLeDetn41RdrDetnElevn ReSideRdrLeDetn41RdrDetnPwr ReSideRdrLeDetn41RdrDetnRng ReSideRdrLeDetn41RdrDetnRngV ReSideRdrLeDetn41RdrDetnSameRV ReSideRdrLeDetn41RdrDetnSts;
SIG_GROUP_ 87 ReSideRdrLeDetn42 1 : ReSideRdrLeDetn42RdrDetnAmbigState ReSideRdrLeDetn42RdrDetnAssoTrkID ReSideRdrLeDetn42RdrDetnAzi ReSideRdrLeDetn42RdrDetnChks ReSideRdrLeDetn42RdrDetnCntr ReSideRdrLeDetn42RdrDetnConf ReSideRdrLeDetn42RdrDetnElevn ReSideRdrLeDetn42RdrDetnPwr ReSideRdrLeDetn42RdrDetnRng ReSideRdrLeDetn42RdrDetnRngV ReSideRdrLeDetn42RdrDetnSameRV ReSideRdrLeDetn42RdrDetnSts;
SIG_GROUP_ 88 ReSideRdrLeDetn43 1 : ReSideRdrLeDetn43RdrDetnAmbigState ReSideRdrLeDetn43RdrDetnAssoTrkID ReSideRdrLeDetn43RdrDetnAzi ReSideRdrLeDetn43RdrDetnChks ReSideRdrLeDetn43RdrDetnCntr ReSideRdrLeDetn43RdrDetnConf ReSideRdrLeDetn43RdrDetnElevn ReSideRdrLeDetn43RdrDetnPwr ReSideRdrLeDetn43RdrDetnRng ReSideRdrLeDetn43RdrDetnRngV ReSideRdrLeDetn43RdrDetnSameRV ReSideRdrLeDetn43RdrDetnSts;
SIG_GROUP_ 88 ReSideRdrLeDetn44 1 : ReSideRdrLeDetn44RdrDetnAmbigState ReSideRdrLeDetn44RdrDetnAssoTrkID ReSideRdrLeDetn44RdrDetnAzi ReSideRdrLeDetn44RdrDetnChks ReSideRdrLeDetn44RdrDetnCntr ReSideRdrLeDetn44RdrDetnConf ReSideRdrLeDetn44RdrDetnElevn ReSideRdrLeDetn44RdrDetnPwr ReSideRdrLeDetn44RdrDetnRng ReSideRdrLeDetn44RdrDetnRngV ReSideRdrLeDetn44RdrDetnSameRV ReSideRdrLeDetn44RdrDetnSts;
SIG_GROUP_ 88 ReSideRdrLeDetn45 1 : ReSideRdrLeDetn45RdrDetnAmbigState ReSideRdrLeDetn45RdrDetnAssoTrkID ReSideRdrLeDetn45RdrDetnAzi ReSideRdrLeDetn45RdrDetnChks ReSideRdrLeDetn45RdrDetnCntr ReSideRdrLeDetn45RdrDetnConf ReSideRdrLeDetn45RdrDetnElevn ReSideRdrLeDetn45RdrDetnPwr ReSideRdrLeDetn45RdrDetnRng ReSideRdrLeDetn45RdrDetnRngV ReSideRdrLeDetn45RdrDetnSameRV ReSideRdrLeDetn45RdrDetnSts;
SIG_GROUP_ 88 ReSideRdrLeDetn46 1 : ReSideRdrLeDetn46RdrDetnAmbigState ReSideRdrLeDetn46RdrDetnAssoTrkID ReSideRdrLeDetn46RdrDetnAzi ReSideRdrLeDetn46RdrDetnChks ReSideRdrLeDetn46RdrDetnCntr ReSideRdrLeDetn46RdrDetnConf ReSideRdrLeDetn46RdrDetnElevn ReSideRdrLeDetn46RdrDetnPwr ReSideRdrLeDetn46RdrDetnRng ReSideRdrLeDetn46RdrDetnRngV ReSideRdrLeDetn46RdrDetnSameRV ReSideRdrLeDetn46RdrDetnSts;
SIG_GROUP_ 88 ReSideRdrLeDetn47 1 : ReSideRdrLeDetn47RdrDetnAmbigState ReSideRdrLeDetn47RdrDetnAssoTrkID ReSideRdrLeDetn47RdrDetnAzi ReSideRdrLeDetn47RdrDetnChks ReSideRdrLeDetn47RdrDetnCntr ReSideRdrLeDetn47RdrDetnConf ReSideRdrLeDetn47RdrDetnElevn ReSideRdrLeDetn47RdrDetnPwr ReSideRdrLeDetn47RdrDetnRng ReSideRdrLeDetn47RdrDetnRngV ReSideRdrLeDetn47RdrDetnSameRV ReSideRdrLeDetn47RdrDetnSts;
SIG_GROUP_ 88 ReSideRdrLeDetn48 1 : ReSideRdrLeDetn48RdrDetnAmbigState ReSideRdrLeDetn48RdrDetnAssoTrkID ReSideRdrLeDetn48RdrDetnAzi ReSideRdrLeDetn48RdrDetnChks ReSideRdrLeDetn48RdrDetnCntr ReSideRdrLeDetn48RdrDetnConf ReSideRdrLeDetn48RdrDetnElevn ReSideRdrLeDetn48RdrDetnPwr ReSideRdrLeDetn48RdrDetnRng ReSideRdrLeDetn48RdrDetnRngV ReSideRdrLeDetn48RdrDetnSameRV ReSideRdrLeDetn48RdrDetnSts;
SIG_GROUP_ 89 ReSideRdrLeDetn49 1 : ReSideRdrLeDetn49RdrDetnAmbigState ReSideRdrLeDetn49RdrDetnAssoTrkID ReSideRdrLeDetn49RdrDetnAzi ReSideRdrLeDetn49RdrDetnChks ReSideRdrLeDetn49RdrDetnCntr ReSideRdrLeDetn49RdrDetnConf ReSideRdrLeDetn49RdrDetnElevn ReSideRdrLeDetn49RdrDetnPwr ReSideRdrLeDetn49RdrDetnRng ReSideRdrLeDetn49RdrDetnRngV ReSideRdrLeDetn49RdrDetnSameRV ReSideRdrLeDetn49RdrDetnSts;
SIG_GROUP_ 89 ReSideRdrLeDetn50 1 : ReSideRdrLeDetn50RdrDetnAmbigState ReSideRdrLeDetn50RdrDetnAssoTrkID ReSideRdrLeDetn50RdrDetnAzi ReSideRdrLeDetn50RdrDetnChks ReSideRdrLeDetn50RdrDetnCntr ReSideRdrLeDetn50RdrDetnConf ReSideRdrLeDetn50RdrDetnElevn ReSideRdrLeDetn50RdrDetnPwr ReSideRdrLeDetn50RdrDetnRng ReSideRdrLeDetn50RdrDetnRngV ReSideRdrLeDetn50RdrDetnSameRV ReSideRdrLeDetn50RdrDetnSts;
SIG_GROUP_ 89 ReSideRdrLeDetn51 1 : ReSideRdrLeDetn51RdrDetnAmbigState ReSideRdrLeDetn51RdrDetnAssoTrkID ReSideRdrLeDetn51RdrDetnAzi ReSideRdrLeDetn51RdrDetnChks ReSideRdrLeDetn51RdrDetnCntr ReSideRdrLeDetn51RdrDetnConf ReSideRdrLeDetn51RdrDetnElevn ReSideRdrLeDetn51RdrDetnPwr ReSideRdrLeDetn51RdrDetnRng ReSideRdrLeDetn51RdrDetnRngV ReSideRdrLeDetn51RdrDetnSameRV ReSideRdrLeDetn51RdrDetnSts;
SIG_GROUP_ 89 ReSideRdrLeDetn52 1 : ReSideRdrLeDetn52RdrDetnAmbigState ReSideRdrLeDetn52RdrDetnAssoTrkID ReSideRdrLeDetn52RdrDetnAzi ReSideRdrLeDetn52RdrDetnChks ReSideRdrLeDetn52RdrDetnCntr ReSideRdrLeDetn52RdrDetnConf ReSideRdrLeDetn52RdrDetnElevn ReSideRdrLeDetn52RdrDetnPwr ReSideRdrLeDetn52RdrDetnRng ReSideRdrLeDetn52RdrDetnRngV ReSideRdrLeDetn52RdrDetnSameRV ReSideRdrLeDetn52RdrDetnSts;
SIG_GROUP_ 89 ReSideRdrLeDetn53 1 : ReSideRdrLeDetn53RdrDetnAmbigState ReSideRdrLeDetn53RdrDetnAssoTrkID ReSideRdrLeDetn53RdrDetnAzi ReSideRdrLeDetn53RdrDetnChks ReSideRdrLeDetn53RdrDetnCntr ReSideRdrLeDetn53RdrDetnConf ReSideRdrLeDetn53RdrDetnElevn ReSideRdrLeDetn53RdrDetnPwr ReSideRdrLeDetn53RdrDetnRng ReSideRdrLeDetn53RdrDetnRngV ReSideRdrLeDetn53RdrDetnSameRV ReSideRdrLeDetn53RdrDetnSts;
SIG_GROUP_ 89 ReSideRdrLeDetn54 1 : ReSideRdrLeDetn54RdrDetnAmbigState ReSideRdrLeDetn54RdrDetnAssoTrkID ReSideRdrLeDetn54RdrDetnAzi ReSideRdrLeDetn54RdrDetnChks ReSideRdrLeDetn54RdrDetnCntr ReSideRdrLeDetn54RdrDetnConf ReSideRdrLeDetn54RdrDetnElevn ReSideRdrLeDetn54RdrDetnPwr ReSideRdrLeDetn54RdrDetnRng ReSideRdrLeDetn54RdrDetnRngV ReSideRdrLeDetn54RdrDetnSameRV ReSideRdrLeDetn54RdrDetnSts;
SIG_GROUP_ 96 ReSideRdrLeDetn55 1 : ReSideRdrLeDetn55RdrDetnAmbigState ReSideRdrLeDetn55RdrDetnAssoTrkID ReSideRdrLeDetn55RdrDetnAzi ReSideRdrLeDetn55RdrDetnChks ReSideRdrLeDetn55RdrDetnCntr ReSideRdrLeDetn55RdrDetnConf ReSideRdrLeDetn55RdrDetnElevn ReSideRdrLeDetn55RdrDetnPwr ReSideRdrLeDetn55RdrDetnRng ReSideRdrLeDetn55RdrDetnRngV ReSideRdrLeDetn55RdrDetnSameRV ReSideRdrLeDetn55RdrDetnSts;
SIG_GROUP_ 96 ReSideRdrLeDetn56 1 : ReSideRdrLeDetn56RdrDetnAmbigState ReSideRdrLeDetn56RdrDetnAssoTrkID ReSideRdrLeDetn56RdrDetnAzi ReSideRdrLeDetn56RdrDetnChks ReSideRdrLeDetn56RdrDetnCntr ReSideRdrLeDetn56RdrDetnConf ReSideRdrLeDetn56RdrDetnElevn ReSideRdrLeDetn56RdrDetnPwr ReSideRdrLeDetn56RdrDetnRng ReSideRdrLeDetn56RdrDetnRngV ReSideRdrLeDetn56RdrDetnSameRV ReSideRdrLeDetn56RdrDetnSts;
SIG_GROUP_ 96 ReSideRdrLeDetn57 1 : ReSideRdrLeDetn57RdrDetnAmbigState ReSideRdrLeDetn57RdrDetnAssoTrkID ReSideRdrLeDetn57RdrDetnAzi ReSideRdrLeDetn57RdrDetnChks ReSideRdrLeDetn57RdrDetnCntr ReSideRdrLeDetn57RdrDetnConf ReSideRdrLeDetn57RdrDetnElevn ReSideRdrLeDetn57RdrDetnPwr ReSideRdrLeDetn57RdrDetnRng ReSideRdrLeDetn57RdrDetnRngV ReSideRdrLeDetn57RdrDetnSameRV ReSideRdrLeDetn57RdrDetnSts;
SIG_GROUP_ 96 ReSideRdrLeDetn58 1 : ReSideRdrLeDetn58RdrDetnAmbigState ReSideRdrLeDetn58RdrDetnAssoTrkID ReSideRdrLeDetn58RdrDetnAzi ReSideRdrLeDetn58RdrDetnChks ReSideRdrLeDetn58RdrDetnCntr ReSideRdrLeDetn58RdrDetnConf ReSideRdrLeDetn58RdrDetnElevn ReSideRdrLeDetn58RdrDetnPwr ReSideRdrLeDetn58RdrDetnRng ReSideRdrLeDetn58RdrDetnRngV ReSideRdrLeDetn58RdrDetnSameRV ReSideRdrLeDetn58RdrDetnSts;
SIG_GROUP_ 96 ReSideRdrLeDetn59 1 : ReSideRdrLeDetn59RdrDetnAmbigState ReSideRdrLeDetn59RdrDetnAssoTrkID ReSideRdrLeDetn59RdrDetnAzi ReSideRdrLeDetn59RdrDetnChks ReSideRdrLeDetn59RdrDetnCntr ReSideRdrLeDetn59RdrDetnConf ReSideRdrLeDetn59RdrDetnElevn ReSideRdrLeDetn59RdrDetnPwr ReSideRdrLeDetn59RdrDetnRng ReSideRdrLeDetn59RdrDetnRngV ReSideRdrLeDetn59RdrDetnSameRV ReSideRdrLeDetn59RdrDetnSts;
SIG_GROUP_ 96 ReSideRdrLeDetn60 1 : ReSideRdrLeDetn60RdrDetnAmbigState ReSideRdrLeDetn60RdrDetnAssoTrkID ReSideRdrLeDetn60RdrDetnAzi ReSideRdrLeDetn60RdrDetnChks ReSideRdrLeDetn60RdrDetnCntr ReSideRdrLeDetn60RdrDetnConf ReSideRdrLeDetn60RdrDetnElevn ReSideRdrLeDetn60RdrDetnPwr ReSideRdrLeDetn60RdrDetnRng ReSideRdrLeDetn60RdrDetnRngV ReSideRdrLeDetn60RdrDetnSameRV ReSideRdrLeDetn60RdrDetnSts;
SIG_GROUP_ 97 ReSideRdrLeDetn61 1 : ReSideRdrLeDetn61RdrDetnAmbigState ReSideRdrLeDetn61RdrDetnAssoTrkID ReSideRdrLeDetn61RdrDetnAzi ReSideRdrLeDetn61RdrDetnChks ReSideRdrLeDetn61RdrDetnCntr ReSideRdrLeDetn61RdrDetnConf ReSideRdrLeDetn61RdrDetnElevn ReSideRdrLeDetn61RdrDetnPwr ReSideRdrLeDetn61RdrDetnRng ReSideRdrLeDetn61RdrDetnRngV ReSideRdrLeDetn61RdrDetnSameRV ReSideRdrLeDetn61RdrDetnSts;
SIG_GROUP_ 97 ReSideRdrLeDetn62 1 : ReSideRdrLeDetn62RdrDetnAmbigState ReSideRdrLeDetn62RdrDetnAssoTrkID ReSideRdrLeDetn62RdrDetnAzi ReSideRdrLeDetn62RdrDetnChks ReSideRdrLeDetn62RdrDetnCntr ReSideRdrLeDetn62RdrDetnConf ReSideRdrLeDetn62RdrDetnElevn ReSideRdrLeDetn62RdrDetnPwr ReSideRdrLeDetn62RdrDetnRng ReSideRdrLeDetn62RdrDetnRngV ReSideRdrLeDetn62RdrDetnSameRV ReSideRdrLeDetn62RdrDetnSts;
SIG_GROUP_ 97 ReSideRdrLeDetn63 1 : ReSideRdrLeDetn63RdrDetnAmbigState ReSideRdrLeDetn63RdrDetnAssoTrkID ReSideRdrLeDetn63RdrDetnAzi ReSideRdrLeDetn63RdrDetnChks ReSideRdrLeDetn63RdrDetnCntr ReSideRdrLeDetn63RdrDetnConf ReSideRdrLeDetn63RdrDetnElevn ReSideRdrLeDetn63RdrDetnPwr ReSideRdrLeDetn63RdrDetnRng ReSideRdrLeDetn63RdrDetnRngV ReSideRdrLeDetn63RdrDetnSameRV ReSideRdrLeDetn63RdrDetnSts;
SIG_GROUP_ 97 ReSideRdrLeDetn64 1 : ReSideRdrLeDetn64RdrDetnAmbigState ReSideRdrLeDetn64RdrDetnAssoTrkID ReSideRdrLeDetn64RdrDetnAzi ReSideRdrLeDetn64RdrDetnChks ReSideRdrLeDetn64RdrDetnCntr ReSideRdrLeDetn64RdrDetnConf ReSideRdrLeDetn64RdrDetnElevn ReSideRdrLeDetn64RdrDetnPwr ReSideRdrLeDetn64RdrDetnRng ReSideRdrLeDetn64RdrDetnRngV ReSideRdrLeDetn64RdrDetnSameRV ReSideRdrLeDetn64RdrDetnSts;
SIG_GROUP_ 97 ReSideRdrLeDetn65 1 : ReSideRdrLeDetn65RdrDetnAmbigState ReSideRdrLeDetn65RdrDetnAssoTrkID ReSideRdrLeDetn65RdrDetnAzi ReSideRdrLeDetn65RdrDetnChks ReSideRdrLeDetn65RdrDetnCntr ReSideRdrLeDetn65RdrDetnConf ReSideRdrLeDetn65RdrDetnElevn ReSideRdrLeDetn65RdrDetnPwr ReSideRdrLeDetn65RdrDetnRng ReSideRdrLeDetn65RdrDetnRngV ReSideRdrLeDetn65RdrDetnSameRV ReSideRdrLeDetn65RdrDetnSts;
SIG_GROUP_ 97 ReSideRdrLeDetn66 1 : ReSideRdrLeDetn66RdrDetnAmbigState ReSideRdrLeDetn66RdrDetnAssoTrkID ReSideRdrLeDetn66RdrDetnAzi ReSideRdrLeDetn66RdrDetnChks ReSideRdrLeDetn66RdrDetnCntr ReSideRdrLeDetn66RdrDetnConf ReSideRdrLeDetn66RdrDetnElevn ReSideRdrLeDetn66RdrDetnPwr ReSideRdrLeDetn66RdrDetnRng ReSideRdrLeDetn66RdrDetnRngV ReSideRdrLeDetn66RdrDetnSameRV ReSideRdrLeDetn66RdrDetnSts;
SIG_GROUP_ 98 ReSideRdrLeDetn67 1 : ReSideRdrLeDetn67RdrDetnAmbigState ReSideRdrLeDetn67RdrDetnAssoTrkID ReSideRdrLeDetn67RdrDetnAzi ReSideRdrLeDetn67RdrDetnChks ReSideRdrLeDetn67RdrDetnCntr ReSideRdrLeDetn67RdrDetnConf ReSideRdrLeDetn67RdrDetnElevn ReSideRdrLeDetn67RdrDetnPwr ReSideRdrLeDetn67RdrDetnRng ReSideRdrLeDetn67RdrDetnRngV ReSideRdrLeDetn67RdrDetnSameRV ReSideRdrLeDetn67RdrDetnSts;
SIG_GROUP_ 98 ReSideRdrLeDetn68 1 : ReSideRdrLeDetn68RdrDetnAmbigState ReSideRdrLeDetn68RdrDetnAssoTrkID ReSideRdrLeDetn68RdrDetnAzi ReSideRdrLeDetn68RdrDetnChks ReSideRdrLeDetn68RdrDetnCntr ReSideRdrLeDetn68RdrDetnConf ReSideRdrLeDetn68RdrDetnElevn ReSideRdrLeDetn68RdrDetnPwr ReSideRdrLeDetn68RdrDetnRng ReSideRdrLeDetn68RdrDetnRngV ReSideRdrLeDetn68RdrDetnSameRV ReSideRdrLeDetn68RdrDetnSts;
SIG_GROUP_ 98 ReSideRdrLeDetn69 1 : ReSideRdrLeDetn69RdrDetnAmbigState ReSideRdrLeDetn69RdrDetnAssoTrkID ReSideRdrLeDetn69RdrDetnAzi ReSideRdrLeDetn69RdrDetnChks ReSideRdrLeDetn69RdrDetnCntr ReSideRdrLeDetn69RdrDetnConf ReSideRdrLeDetn69RdrDetnElevn ReSideRdrLeDetn69RdrDetnPwr ReSideRdrLeDetn69RdrDetnRng ReSideRdrLeDetn69RdrDetnRngV ReSideRdrLeDetn69RdrDetnSameRV ReSideRdrLeDetn69RdrDetnSts;
SIG_GROUP_ 98 ReSideRdrLeDetn70 1 : ReSideRdrLeDetn70RdrDetnAmbigState ReSideRdrLeDetn70RdrDetnAssoTrkID ReSideRdrLeDetn70RdrDetnAzi ReSideRdrLeDetn70RdrDetnChks ReSideRdrLeDetn70RdrDetnCntr ReSideRdrLeDetn70RdrDetnConf ReSideRdrLeDetn70RdrDetnElevn ReSideRdrLeDetn70RdrDetnPwr ReSideRdrLeDetn70RdrDetnRng ReSideRdrLeDetn70RdrDetnRngV ReSideRdrLeDetn70RdrDetnSameRV ReSideRdrLeDetn70RdrDetnSts;
SIG_GROUP_ 98 ReSideRdrLeDetn71 1 : ReSideRdrLeDetn71RdrDetnAmbigState ReSideRdrLeDetn71RdrDetnAssoTrkID ReSideRdrLeDetn71RdrDetnAzi ReSideRdrLeDetn71RdrDetnChks ReSideRdrLeDetn71RdrDetnCntr ReSideRdrLeDetn71RdrDetnConf ReSideRdrLeDetn71RdrDetnElevn ReSideRdrLeDetn71RdrDetnPwr ReSideRdrLeDetn71RdrDetnRng ReSideRdrLeDetn71RdrDetnRngV ReSideRdrLeDetn71RdrDetnSameRV ReSideRdrLeDetn71RdrDetnSts;
SIG_GROUP_ 98 ReSideRdrLeDetn72 1 : ReSideRdrLeDetn72RdrDetnAmbigState ReSideRdrLeDetn72RdrDetnAssoTrkID ReSideRdrLeDetn72RdrDetnAzi ReSideRdrLeDetn72RdrDetnChks ReSideRdrLeDetn72RdrDetnCntr ReSideRdrLeDetn72RdrDetnConf ReSideRdrLeDetn72RdrDetnElevn ReSideRdrLeDetn72RdrDetnPwr ReSideRdrLeDetn72RdrDetnRng ReSideRdrLeDetn72RdrDetnRngV ReSideRdrLeDetn72RdrDetnSameRV ReSideRdrLeDetn72RdrDetnSts;
SIG_GROUP_ 99 ReSideRdrLeDetn73 1 : ReSideRdrLeDetn73RdrDetnAmbigState ReSideRdrLeDetn73RdrDetnAssoTrkID ReSideRdrLeDetn73RdrDetnAzi ReSideRdrLeDetn73RdrDetnChks ReSideRdrLeDetn73RdrDetnCntr ReSideRdrLeDetn73RdrDetnConf ReSideRdrLeDetn73RdrDetnElevn ReSideRdrLeDetn73RdrDetnPwr ReSideRdrLeDetn73RdrDetnRng ReSideRdrLeDetn73RdrDetnRngV ReSideRdrLeDetn73RdrDetnSameRV ReSideRdrLeDetn73RdrDetnSts;
SIG_GROUP_ 99 ReSideRdrLeDetn74 1 : ReSideRdrLeDetn74RdrDetnAmbigState ReSideRdrLeDetn74RdrDetnAssoTrkID ReSideRdrLeDetn74RdrDetnAzi ReSideRdrLeDetn74RdrDetnChks ReSideRdrLeDetn74RdrDetnCntr ReSideRdrLeDetn74RdrDetnConf ReSideRdrLeDetn74RdrDetnElevn ReSideRdrLeDetn74RdrDetnPwr ReSideRdrLeDetn74RdrDetnRng ReSideRdrLeDetn74RdrDetnRngV ReSideRdrLeDetn74RdrDetnSameRV ReSideRdrLeDetn74RdrDetnSts;
SIG_GROUP_ 99 ReSideRdrLeDetn75 1 : ReSideRdrLeDetn75RdrDetnAmbigState ReSideRdrLeDetn75RdrDetnAssoTrkID ReSideRdrLeDetn75RdrDetnAzi ReSideRdrLeDetn75RdrDetnChks ReSideRdrLeDetn75RdrDetnCntr ReSideRdrLeDetn75RdrDetnConf ReSideRdrLeDetn75RdrDetnElevn ReSideRdrLeDetn75RdrDetnPwr ReSideRdrLeDetn75RdrDetnRng ReSideRdrLeDetn75RdrDetnRngV ReSideRdrLeDetn75RdrDetnSameRV ReSideRdrLeDetn75RdrDetnSts;
SIG_GROUP_ 99 ReSideRdrLeDetn76 1 : ReSideRdrLeDetn76RdrDetnAmbigState ReSideRdrLeDetn76RdrDetnAssoTrkID ReSideRdrLeDetn76RdrDetnAzi ReSideRdrLeDetn76RdrDetnChks ReSideRdrLeDetn76RdrDetnCntr ReSideRdrLeDetn76RdrDetnConf ReSideRdrLeDetn76RdrDetnElevn ReSideRdrLeDetn76RdrDetnPwr ReSideRdrLeDetn76RdrDetnRng ReSideRdrLeDetn76RdrDetnRngV ReSideRdrLeDetn76RdrDetnSameRV ReSideRdrLeDetn76RdrDetnSts;
SIG_GROUP_ 99 ReSideRdrLeDetn77 1 : ReSideRdrLeDetn77RdrDetnAmbigState ReSideRdrLeDetn77RdrDetnAssoTrkID ReSideRdrLeDetn77RdrDetnAzi ReSideRdrLeDetn77RdrDetnChks ReSideRdrLeDetn77RdrDetnCntr ReSideRdrLeDetn77RdrDetnConf ReSideRdrLeDetn77RdrDetnElevn ReSideRdrLeDetn77RdrDetnPwr ReSideRdrLeDetn77RdrDetnRng ReSideRdrLeDetn77RdrDetnRngV ReSideRdrLeDetn77RdrDetnSameRV ReSideRdrLeDetn77RdrDetnSts;
SIG_GROUP_ 99 ReSideRdrLeDetn78 1 : ReSideRdrLeDetn78RdrDetnAmbigState ReSideRdrLeDetn78RdrDetnAssoTrkID ReSideRdrLeDetn78RdrDetnAzi ReSideRdrLeDetn78RdrDetnChks ReSideRdrLeDetn78RdrDetnCntr ReSideRdrLeDetn78RdrDetnConf ReSideRdrLeDetn78RdrDetnElevn ReSideRdrLeDetn78RdrDetnPwr ReSideRdrLeDetn78RdrDetnRng ReSideRdrLeDetn78RdrDetnRngV ReSideRdrLeDetn78RdrDetnSameRV ReSideRdrLeDetn78RdrDetnSts;
